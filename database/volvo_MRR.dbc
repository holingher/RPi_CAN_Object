// *************************************************************************** *
// *                                                                           *
// * Description:         CANDB File                                           *
// * Generated at:        2023-01-05 13:51                                     *
// * System:              FLRsystem_MAIN_26                                    *
// * Network:             FLR1CAN                                              *
// *                                                                           *
// *************************************************************************** *
VERSION "FLR1CAN"

NS_ :

BS_ :

BU_ :  FLR FLRdpHPA FLRdpHPB

BO_ 324 FlrFlr1canFr83 : 64 FLR
 SG_ FLR2RdrObject4To5_UB : 367|1@0+ (1,0) [0|1] "" FLRdpHPA,FLRdpHPB
 SG_ FLR2RdrObject4To5Class0 : 36|2@1+ (1,0) [0|3] "" FLRdpHPA,FLRdpHPB
 SG_ FLR2RdrObject4To5Class1 : 195|2@1+ (1,0) [0|3] "" FLRdpHPA,FLRdpHPB
 SG_ FLR2RdrObject4To5Counter : 16|8@1+ (1.0,0.0) [0.0|255.0] "Unitless" FLRdpHPA,FLRdpHPB
 SG_ FLR2RdrObject4To5CRC : 0|16@1+ (1.0,0.0) [0.0|65535.0] "Unitless" FLRdpHPA,FLRdpHPB
 SG_ FLR2RdrObject4To5DataCoastCntr0 : 38|3@1+ (1,0) [0|7] "" FLRdpHPA,FLRdpHPB
 SG_ FLR2RdrObject4To5DataCoastCntr1 : 197|3@1+ (1,0) [0|7] "" FLRdpHPA,FLRdpHPB
 SG_ FLR2RdrObject4To5DataConf0 : 41|7@1+ (1.0,0.0) [0.0|100.0] "%" FLRdpHPA,FLRdpHPB
 SG_ FLR2RdrObject4To5DataConf1 : 200|7@1+ (1.0,0.0) [0.0|100.0] "%" FLRdpHPA,FLRdpHPB
 SG_ FLR2RdrObject4To5DataLen0 : 48|8@1+ (0.2,0.0) [0.0|30.0] "m" FLRdpHPA,FLRdpHPB
 SG_ FLR2RdrObject4To5DataLen1 : 207|8@1+ (0.2,0.0) [0.0|30.0] "m" FLRdpHPA,FLRdpHPB
 SG_ FLR2RdrObject4To5DataStDLatAcc0 : 56|5@1+ (0.35,0.0) [0.0|10.85] "m/s^2" FLRdpHPA,FLRdpHPB
 SG_ FLR2RdrObject4To5DataStDLatAcc1 : 215|5@1+ (0.35,0.0) [0.0|10.85] "m/s^2" FLRdpHPA,FLRdpHPB
 SG_ FLR2RdrObject4To5DataStDLatPos0 : 61|8@1+ (0.1,0.0) [0.0|25.5] "m" FLRdpHPA,FLRdpHPB
 SG_ FLR2RdrObject4To5DataStDLatPos1 : 220|8@1+ (0.1,0.0) [0.0|25.5] "m" FLRdpHPA,FLRdpHPB
 SG_ FLR2RdrObject4To5DataStDLatVelo0 : 69|6@1+ (0.2,0.0) [0.0|12.600000000000001] "m/s" FLRdpHPA,FLRdpHPB
 SG_ FLR2RdrObject4To5DataStDLatVelo1 : 228|6@1+ (0.2,0.0) [0.0|12.600000000000001] "m/s" FLRdpHPA,FLRdpHPB
 SG_ FLR2RdrObject4To5DataStDLgtAcc0 : 75|5@1+ (0.35,0.0) [0.0|10.85] "m/s^2" FLRdpHPA,FLRdpHPB
 SG_ FLR2RdrObject4To5DataStDLgtAcc1 : 234|5@1+ (0.35,0.0) [0.0|10.85] "m/s^2" FLRdpHPA,FLRdpHPB
 SG_ FLR2RdrObject4To5DataStDLgtPos0 : 80|8@1+ (0.05,0.0) [0.0|12.75] "m" FLRdpHPA,FLRdpHPB
 SG_ FLR2RdrObject4To5DataStDLgtPos1 : 239|8@1+ (0.05,0.0) [0.0|12.75] "m" FLRdpHPA,FLRdpHPB
 SG_ FLR2RdrObject4To5DataStDLgtVelo0 : 88|6@1+ (0.2,0.0) [0.0|12.600000000000001] "m/s" FLRdpHPA,FLRdpHPB
 SG_ FLR2RdrObject4To5DataStDLgtVelo1 : 247|6@1+ (0.2,0.0) [0.0|12.600000000000001] "m/s" FLRdpHPA,FLRdpHPB
 SG_ FLR2RdrObject4To5DataWidth0 : 94|7@1+ (0.2,0.0) [0.0|15.0] "m" FLRdpHPA,FLRdpHPB
 SG_ FLR2RdrObject4To5DataWidth1 : 253|7@1+ (0.2,0.0) [0.0|15.0] "m" FLRdpHPA,FLRdpHPB
 SG_ FLR2RdrObject4To5HeadingAng0 : 101|10@1+ (0.01,-3.15) [-3.15|3.15] "rad" FLRdpHPA,FLRdpHPB
 SG_ FLR2RdrObject4To5HeadingAng1 : 260|10@1+ (0.01,-3.15) [-3.15|3.15] "rad" FLRdpHPA,FLRdpHPB
 SG_ FLR2RdrObject4To5LatAcc0 : 111|10@1+ (0.125,-44.5) [-44.5|44.5] "m/s^2" FLRdpHPA,FLRdpHPB
 SG_ FLR2RdrObject4To5LatAcc1 : 270|10@1+ (0.125,-44.5) [-44.5|44.5] "m/s^2" FLRdpHPA,FLRdpHPB
 SG_ FLR2RdrObject4To5LatPos0 : 121|13@1+ (0.0625,-255.9375) [-255.9375|255.9375] "Unitless" FLRdpHPA,FLRdpHPB
 SG_ FLR2RdrObject4To5LatPos1 : 280|13@1+ (0.0625,-255.9375) [-255.9375|255.9375] "Unitless" FLRdpHPA,FLRdpHPB
 SG_ FLR2RdrObject4To5LatVelo0 : 134|11@1+ (0.125,-128.0) [-128.0|127.875] "m/s" FLRdpHPA,FLRdpHPB
 SG_ FLR2RdrObject4To5LatVelo1 : 293|11@1+ (0.125,-128.0) [-128.0|127.875] "m/s" FLRdpHPA,FLRdpHPB
 SG_ FLR2RdrObject4To5LgtAcc0 : 145|10@1+ (0.125,-44.5) [-44.5|44.5] "m/s^2" FLRdpHPA,FLRdpHPB
 SG_ FLR2RdrObject4To5LgtAcc1 : 304|10@1+ (0.125,-44.5) [-44.5|44.5] "m/s^2" FLRdpHPA,FLRdpHPB
 SG_ FLR2RdrObject4To5LgtPos0 : 155|13@1+ (0.0625,-255.9375) [-255.9375|255.9375] "Unitless" FLRdpHPA,FLRdpHPB
 SG_ FLR2RdrObject4To5LgtPos1 : 314|13@1+ (0.0625,-255.9375) [-255.9375|255.9375] "Unitless" FLRdpHPA,FLRdpHPB
 SG_ FLR2RdrObject4To5LgtVelo0 : 168|11@1+ (0.125,-128.0) [-128.0|127.875] "m/s" FLRdpHPA,FLRdpHPB
 SG_ FLR2RdrObject4To5LgtVelo1 : 327|11@1+ (0.125,-128.0) [-128.0|127.875] "m/s" FLRdpHPA,FLRdpHPB
 SG_ FLR2RdrObject4To5ModeInfo0 : 179|2@1+ (1,0) [0|3] "" FLRdpHPA,FLRdpHPB
 SG_ FLR2RdrObject4To5ModeInfo1 : 338|2@1+ (1,0) [0|3] "" FLRdpHPA,FLRdpHPB
 SG_ FLR2RdrObject4To5MsgCntr : 32|4@1+ (1.0,0.0) [0.0|15.0] "Unitless" FLRdpHPA,FLRdpHPB
 SG_ FLR2RdrObject4To5MtnModel0 : 181|2@1+ (1.0,0.0) [0.0|3.0] "Unitless" FLRdpHPA,FLRdpHPB
 SG_ FLR2RdrObject4To5MtnModel1 : 340|2@1+ (1.0,0.0) [0.0|3.0] "Unitless" FLRdpHPA,FLRdpHPB
 SG_ FLR2RdrObject4To5MtnPattern0 : 183|4@1+ (1,0) [0|15] "" FLRdpHPA,FLRdpHPB
 SG_ FLR2RdrObject4To5MtnPattern1 : 342|4@1+ (1,0) [0|15] "" FLRdpHPA,FLRdpHPB
 SG_ FLR2RdrObject4To5PedMicroDoppler0 : 187|1@1+ (1.0,0.0) [0.0|1.0] "Unitless" FLRdpHPA,FLRdpHPB
 SG_ FLR2RdrObject4To5PedMicroDoppler1 : 346|1@1+ (1.0,0.0) [0.0|1.0] "Unitless" FLRdpHPA,FLRdpHPB
 SG_ FLR2RdrObject4To5Qly0 : 188|7@1+ (1.0,0.0) [0.0|100.0] "Unitless" FLRdpHPA,FLRdpHPB
 SG_ FLR2RdrObject4To5Qly1 : 347|7@1+ (1.0,0.0) [0.0|100.0] "Unitless" FLRdpHPA,FLRdpHPB
 SG_ FLR2RdrObject4To5ScanID : 24|8@1+ (1.0,0.0) [0.0|255.0] "Unitless" FLRdpHPA,FLRdpHPB

BO_ 326 FlrFlr1canFr84 : 64 FLR
 SG_ FLR2RdrObject6To7_UB : 367|1@0+ (1,0) [0|1] "" FLRdpHPA,FLRdpHPB
 SG_ FLR2RdrObject6To7Class0 : 36|2@1+ (1,0) [0|3] "" FLRdpHPA,FLRdpHPB
 SG_ FLR2RdrObject6To7Class1 : 195|2@1+ (1,0) [0|3] "" FLRdpHPA,FLRdpHPB
 SG_ FLR2RdrObject6To7Counter : 16|8@1+ (1.0,0.0) [0.0|255.0] "Unitless" FLRdpHPA,FLRdpHPB
 SG_ FLR2RdrObject6To7CRC : 0|16@1+ (1.0,0.0) [0.0|65535.0] "Unitless" FLRdpHPA,FLRdpHPB
 SG_ FLR2RdrObject6To7DataCoastCntr0 : 38|3@1+ (1,0) [0|7] "" FLRdpHPA,FLRdpHPB
 SG_ FLR2RdrObject6To7DataCoastCntr1 : 197|3@1+ (1,0) [0|7] "" FLRdpHPA,FLRdpHPB
 SG_ FLR2RdrObject6To7DataConf0 : 41|7@1+ (1.0,0.0) [0.0|100.0] "%" FLRdpHPA,FLRdpHPB
 SG_ FLR2RdrObject6To7DataConf1 : 200|7@1+ (1.0,0.0) [0.0|100.0] "%" FLRdpHPA,FLRdpHPB
 SG_ FLR2RdrObject6To7DataLen0 : 48|8@1+ (0.2,0.0) [0.0|30.0] "m" FLRdpHPA,FLRdpHPB
 SG_ FLR2RdrObject6To7DataLen1 : 207|8@1+ (0.2,0.0) [0.0|30.0] "m" FLRdpHPA,FLRdpHPB
 SG_ FLR2RdrObject6To7DataStDLatAcc0 : 56|5@1+ (0.35,0.0) [0.0|10.85] "m/s^2" FLRdpHPA,FLRdpHPB
 SG_ FLR2RdrObject6To7DataStDLatAcc1 : 215|5@1+ (0.35,0.0) [0.0|10.85] "m/s^2" FLRdpHPA,FLRdpHPB
 SG_ FLR2RdrObject6To7DataStDLatPos0 : 61|8@1+ (0.1,0.0) [0.0|25.5] "m" FLRdpHPA,FLRdpHPB
 SG_ FLR2RdrObject6To7DataStDLatPos1 : 220|8@1+ (0.1,0.0) [0.0|25.5] "m" FLRdpHPA,FLRdpHPB
 SG_ FLR2RdrObject6To7DataStDLatVelo0 : 69|6@1+ (0.2,0.0) [0.0|12.600000000000001] "m/s" FLRdpHPA,FLRdpHPB
 SG_ FLR2RdrObject6To7DataStDLatVelo1 : 228|6@1+ (0.2,0.0) [0.0|12.600000000000001] "m/s" FLRdpHPA,FLRdpHPB
 SG_ FLR2RdrObject6To7DataStDLgtAcc0 : 75|5@1+ (0.35,0.0) [0.0|10.85] "m/s^2" FLRdpHPA,FLRdpHPB
 SG_ FLR2RdrObject6To7DataStDLgtAcc1 : 234|5@1+ (0.35,0.0) [0.0|10.85] "m/s^2" FLRdpHPA,FLRdpHPB
 SG_ FLR2RdrObject6To7DataStDLgtPos0 : 80|8@1+ (0.05,0.0) [0.0|12.75] "m" FLRdpHPA,FLRdpHPB
 SG_ FLR2RdrObject6To7DataStDLgtPos1 : 239|8@1+ (0.05,0.0) [0.0|12.75] "m" FLRdpHPA,FLRdpHPB
 SG_ FLR2RdrObject6To7DataStDLgtVelo0 : 88|6@1+ (0.2,0.0) [0.0|12.600000000000001] "m/s" FLRdpHPA,FLRdpHPB
 SG_ FLR2RdrObject6To7DataStDLgtVelo1 : 247|6@1+ (0.2,0.0) [0.0|12.600000000000001] "m/s" FLRdpHPA,FLRdpHPB
 SG_ FLR2RdrObject6To7DataWidth0 : 94|7@1+ (0.2,0.0) [0.0|15.0] "m" FLRdpHPA,FLRdpHPB
 SG_ FLR2RdrObject6To7DataWidth1 : 253|7@1+ (0.2,0.0) [0.0|15.0] "m" FLRdpHPA,FLRdpHPB
 SG_ FLR2RdrObject6To7HeadingAng0 : 101|10@1+ (0.01,-3.15) [-3.15|3.15] "rad" FLRdpHPA,FLRdpHPB
 SG_ FLR2RdrObject6To7HeadingAng1 : 260|10@1+ (0.01,-3.15) [-3.15|3.15] "rad" FLRdpHPA,FLRdpHPB
 SG_ FLR2RdrObject6To7LatAcc0 : 111|10@1+ (0.125,-44.5) [-44.5|44.5] "m/s^2" FLRdpHPA,FLRdpHPB
 SG_ FLR2RdrObject6To7LatAcc1 : 270|10@1+ (0.125,-44.5) [-44.5|44.5] "m/s^2" FLRdpHPA,FLRdpHPB
 SG_ FLR2RdrObject6To7LatPos0 : 121|13@1+ (0.0625,-255.9375) [-255.9375|255.9375] "Unitless" FLRdpHPA,FLRdpHPB
 SG_ FLR2RdrObject6To7LatPos1 : 280|13@1+ (0.0625,-255.9375) [-255.9375|255.9375] "Unitless" FLRdpHPA,FLRdpHPB
 SG_ FLR2RdrObject6To7LatVelo0 : 134|11@1+ (0.125,-128.0) [-128.0|127.875] "m/s" FLRdpHPA,FLRdpHPB
 SG_ FLR2RdrObject6To7LatVelo1 : 293|11@1+ (0.125,-128.0) [-128.0|127.875] "m/s" FLRdpHPA,FLRdpHPB
 SG_ FLR2RdrObject6To7LgtAcc0 : 145|10@1+ (0.125,-44.5) [-44.5|44.5] "m/s^2" FLRdpHPA,FLRdpHPB
 SG_ FLR2RdrObject6To7LgtAcc1 : 304|10@1+ (0.125,-44.5) [-44.5|44.5] "m/s^2" FLRdpHPA,FLRdpHPB
 SG_ FLR2RdrObject6To7LgtPos0 : 155|13@1+ (0.0625,-255.9375) [-255.9375|255.9375] "Unitless" FLRdpHPA,FLRdpHPB
 SG_ FLR2RdrObject6To7LgtPos1 : 314|13@1+ (0.0625,-255.9375) [-255.9375|255.9375] "Unitless" FLRdpHPA,FLRdpHPB
 SG_ FLR2RdrObject6To7LgtVelo0 : 168|11@1+ (0.125,-128.0) [-128.0|127.875] "m/s" FLRdpHPA,FLRdpHPB
 SG_ FLR2RdrObject6To7LgtVelo1 : 327|11@1+ (0.125,-128.0) [-128.0|127.875] "m/s" FLRdpHPA,FLRdpHPB
 SG_ FLR2RdrObject6To7ModeInfo0 : 179|2@1+ (1,0) [0|3] "" FLRdpHPA,FLRdpHPB
 SG_ FLR2RdrObject6To7ModeInfo1 : 338|2@1+ (1,0) [0|3] "" FLRdpHPA,FLRdpHPB
 SG_ FLR2RdrObject6To7MsgCntr : 32|4@1+ (1.0,0.0) [0.0|15.0] "Unitless" FLRdpHPA,FLRdpHPB
 SG_ FLR2RdrObject6To7MtnModel0 : 181|2@1+ (1.0,0.0) [0.0|3.0] "Unitless" FLRdpHPA,FLRdpHPB
 SG_ FLR2RdrObject6To7MtnModel1 : 340|2@1+ (1.0,0.0) [0.0|3.0] "Unitless" FLRdpHPA,FLRdpHPB
 SG_ FLR2RdrObject6To7MtnPattern0 : 183|4@1+ (1,0) [0|15] "" FLRdpHPA,FLRdpHPB
 SG_ FLR2RdrObject6To7MtnPattern1 : 342|4@1+ (1,0) [0|15] "" FLRdpHPA,FLRdpHPB
 SG_ FLR2RdrObject6To7PedMicroDoppler0 : 187|1@1+ (1.0,0.0) [0.0|1.0] "Unitless" FLRdpHPA,FLRdpHPB
 SG_ FLR2RdrObject6To7PedMicroDoppler1 : 346|1@1+ (1.0,0.0) [0.0|1.0] "Unitless" FLRdpHPA,FLRdpHPB
 SG_ FLR2RdrObject6To7Qly0 : 188|7@1+ (1.0,0.0) [0.0|100.0] "Unitless" FLRdpHPA,FLRdpHPB
 SG_ FLR2RdrObject6To7Qly1 : 347|7@1+ (1.0,0.0) [0.0|100.0] "Unitless" FLRdpHPA,FLRdpHPB
 SG_ FLR2RdrObject6To7ScanID : 24|8@1+ (1.0,0.0) [0.0|255.0] "Unitless" FLRdpHPA,FLRdpHPB

BO_ 328 FlrFlr1canFr85 : 64 FLR
 SG_ FLR2RdrObject8To9_UB : 367|1@0+ (1,0) [0|1] "" FLRdpHPA,FLRdpHPB
 SG_ FLR2RdrObject8To9Class0 : 36|2@1+ (1,0) [0|3] "" FLRdpHPA,FLRdpHPB
 SG_ FLR2RdrObject8To9Class1 : 195|2@1+ (1,0) [0|3] "" FLRdpHPA,FLRdpHPB
 SG_ FLR2RdrObject8To9Counter : 16|8@1+ (1.0,0.0) [0.0|255.0] "Unitless" FLRdpHPA,FLRdpHPB
 SG_ FLR2RdrObject8To9CRC : 0|16@1+ (1.0,0.0) [0.0|65535.0] "Unitless" FLRdpHPA,FLRdpHPB
 SG_ FLR2RdrObject8To9DataCoastCntr0 : 38|3@1+ (1,0) [0|7] "" FLRdpHPA,FLRdpHPB
 SG_ FLR2RdrObject8To9DataCoastCntr1 : 197|3@1+ (1,0) [0|7] "" FLRdpHPA,FLRdpHPB
 SG_ FLR2RdrObject8To9DataConf0 : 41|7@1+ (1.0,0.0) [0.0|100.0] "%" FLRdpHPA,FLRdpHPB
 SG_ FLR2RdrObject8To9DataConf1 : 200|7@1+ (1.0,0.0) [0.0|100.0] "%" FLRdpHPA,FLRdpHPB
 SG_ FLR2RdrObject8To9DataLen0 : 48|8@1+ (0.2,0.0) [0.0|30.0] "m" FLRdpHPA,FLRdpHPB
 SG_ FLR2RdrObject8To9DataLen1 : 207|8@1+ (0.2,0.0) [0.0|30.0] "m" FLRdpHPA,FLRdpHPB
 SG_ FLR2RdrObject8To9DataStDLatAcc0 : 56|5@1+ (0.35,0.0) [0.0|10.85] "m/s^2" FLRdpHPA,FLRdpHPB
 SG_ FLR2RdrObject8To9DataStDLatAcc1 : 215|5@1+ (0.35,0.0) [0.0|10.85] "m/s^2" FLRdpHPA,FLRdpHPB
 SG_ FLR2RdrObject8To9DataStDLatPos0 : 61|8@1+ (0.1,0.0) [0.0|25.5] "m" FLRdpHPA,FLRdpHPB
 SG_ FLR2RdrObject8To9DataStDLatPos1 : 220|8@1+ (0.1,0.0) [0.0|25.5] "m" FLRdpHPA,FLRdpHPB
 SG_ FLR2RdrObject8To9DataStDLatVelo0 : 69|6@1+ (0.2,0.0) [0.0|12.600000000000001] "m/s" FLRdpHPA,FLRdpHPB
 SG_ FLR2RdrObject8To9DataStDLatVelo1 : 228|6@1+ (0.2,0.0) [0.0|12.600000000000001] "m/s" FLRdpHPA,FLRdpHPB
 SG_ FLR2RdrObject8To9DataStDLgtAcc0 : 75|5@1+ (0.35,0.0) [0.0|10.85] "m/s^2" FLRdpHPA,FLRdpHPB
 SG_ FLR2RdrObject8To9DataStDLgtAcc1 : 234|5@1+ (0.35,0.0) [0.0|10.85] "m/s^2" FLRdpHPA,FLRdpHPB
 SG_ FLR2RdrObject8To9DataStDLgtPos0 : 80|8@1+ (0.05,0.0) [0.0|12.75] "m" FLRdpHPA,FLRdpHPB
 SG_ FLR2RdrObject8To9DataStDLgtPos1 : 239|8@1+ (0.05,0.0) [0.0|12.75] "m" FLRdpHPA,FLRdpHPB
 SG_ FLR2RdrObject8To9DataStDLgtVelo0 : 88|6@1+ (0.2,0.0) [0.0|12.600000000000001] "m/s" FLRdpHPA,FLRdpHPB
 SG_ FLR2RdrObject8To9DataStDLgtVelo1 : 247|6@1+ (0.2,0.0) [0.0|12.600000000000001] "m/s" FLRdpHPA,FLRdpHPB
 SG_ FLR2RdrObject8To9DataWidth0 : 94|7@1+ (0.2,0.0) [0.0|15.0] "m" FLRdpHPA,FLRdpHPB
 SG_ FLR2RdrObject8To9DataWidth1 : 253|7@1+ (0.2,0.0) [0.0|15.0] "m" FLRdpHPA,FLRdpHPB
 SG_ FLR2RdrObject8To9HeadingAng0 : 101|10@1+ (0.01,-3.15) [-3.15|3.15] "rad" FLRdpHPA,FLRdpHPB
 SG_ FLR2RdrObject8To9HeadingAng1 : 260|10@1+ (0.01,-3.15) [-3.15|3.15] "rad" FLRdpHPA,FLRdpHPB
 SG_ FLR2RdrObject8To9LatAcc0 : 111|10@1+ (0.125,-44.5) [-44.5|44.5] "m/s^2" FLRdpHPA,FLRdpHPB
 SG_ FLR2RdrObject8To9LatAcc1 : 270|10@1+ (0.125,-44.5) [-44.5|44.5] "m/s^2" FLRdpHPA,FLRdpHPB
 SG_ FLR2RdrObject8To9LatPos0 : 121|13@1+ (0.0625,-255.9375) [-255.9375|255.9375] "Unitless" FLRdpHPA,FLRdpHPB
 SG_ FLR2RdrObject8To9LatPos1 : 280|13@1+ (0.0625,-255.9375) [-255.9375|255.9375] "Unitless" FLRdpHPA,FLRdpHPB
 SG_ FLR2RdrObject8To9LatVelo0 : 134|11@1+ (0.125,-128.0) [-128.0|127.875] "m/s" FLRdpHPA,FLRdpHPB
 SG_ FLR2RdrObject8To9LatVelo1 : 293|11@1+ (0.125,-128.0) [-128.0|127.875] "m/s" FLRdpHPA,FLRdpHPB
 SG_ FLR2RdrObject8To9LgtAcc0 : 145|10@1+ (0.125,-44.5) [-44.5|44.5] "m/s^2" FLRdpHPA,FLRdpHPB
 SG_ FLR2RdrObject8To9LgtAcc1 : 304|10@1+ (0.125,-44.5) [-44.5|44.5] "m/s^2" FLRdpHPA,FLRdpHPB
 SG_ FLR2RdrObject8To9LgtPos0 : 155|13@1+ (0.0625,-255.9375) [-255.9375|255.9375] "Unitless" FLRdpHPA,FLRdpHPB
 SG_ FLR2RdrObject8To9LgtPos1 : 314|13@1+ (0.0625,-255.9375) [-255.9375|255.9375] "Unitless" FLRdpHPA,FLRdpHPB
 SG_ FLR2RdrObject8To9LgtVelo0 : 168|11@1+ (0.125,-128.0) [-128.0|127.875] "m/s" FLRdpHPA,FLRdpHPB
 SG_ FLR2RdrObject8To9LgtVelo1 : 327|11@1+ (0.125,-128.0) [-128.0|127.875] "m/s" FLRdpHPA,FLRdpHPB
 SG_ FLR2RdrObject8To9ModeInfo0 : 179|2@1+ (1,0) [0|3] "" FLRdpHPA,FLRdpHPB
 SG_ FLR2RdrObject8To9ModeInfo1 : 338|2@1+ (1,0) [0|3] "" FLRdpHPA,FLRdpHPB
 SG_ FLR2RdrObject8To9MsgCntr : 32|4@1+ (1.0,0.0) [0.0|15.0] "Unitless" FLRdpHPA,FLRdpHPB
 SG_ FLR2RdrObject8To9MtnModel0 : 181|2@1+ (1.0,0.0) [0.0|3.0] "Unitless" FLRdpHPA,FLRdpHPB
 SG_ FLR2RdrObject8To9MtnModel1 : 340|2@1+ (1.0,0.0) [0.0|3.0] "Unitless" FLRdpHPA,FLRdpHPB
 SG_ FLR2RdrObject8To9MtnPattern0 : 183|4@1+ (1,0) [0|15] "" FLRdpHPA,FLRdpHPB
 SG_ FLR2RdrObject8To9MtnPattern1 : 342|4@1+ (1,0) [0|15] "" FLRdpHPA,FLRdpHPB
 SG_ FLR2RdrObject8To9PedMicroDoppler0 : 187|1@1+ (1.0,0.0) [0.0|1.0] "Unitless" FLRdpHPA,FLRdpHPB
 SG_ FLR2RdrObject8To9PedMicroDoppler1 : 346|1@1+ (1.0,0.0) [0.0|1.0] "Unitless" FLRdpHPA,FLRdpHPB
 SG_ FLR2RdrObject8To9Qly0 : 188|7@1+ (1.0,0.0) [0.0|100.0] "Unitless" FLRdpHPA,FLRdpHPB
 SG_ FLR2RdrObject8To9Qly1 : 347|7@1+ (1.0,0.0) [0.0|100.0] "Unitless" FLRdpHPA,FLRdpHPB
 SG_ FLR2RdrObject8To9ScanID : 24|8@1+ (1.0,0.0) [0.0|255.0] "Unitless" FLRdpHPA,FLRdpHPB

BO_ 330 FlrFlr1canFr86 : 64 FLR
 SG_ FLR2RdrObject10To11_UB : 367|1@0+ (1,0) [0|1] "" FLRdpHPA,FLRdpHPB
 SG_ FLR2RdrObject10To11Class0 : 36|2@1+ (1,0) [0|3] "" FLRdpHPA,FLRdpHPB
 SG_ FLR2RdrObject10To11Class1 : 195|2@1+ (1,0) [0|3] "" FLRdpHPA,FLRdpHPB
 SG_ FLR2RdrObject10To11Counter : 16|8@1+ (1.0,0.0) [0.0|255.0] "Unitless" FLRdpHPA,FLRdpHPB
 SG_ FLR2RdrObject10To11CRC : 0|16@1+ (1.0,0.0) [0.0|65535.0] "Unitless" FLRdpHPA,FLRdpHPB
 SG_ FLR2RdrObject10To11DataCoastCntr0 : 38|3@1+ (1,0) [0|7] "" FLRdpHPA,FLRdpHPB
 SG_ FLR2RdrObject10To11DataCoastCntr1 : 197|3@1+ (1,0) [0|7] "" FLRdpHPA,FLRdpHPB
 SG_ FLR2RdrObject10To11DataConf0 : 41|7@1+ (1.0,0.0) [0.0|100.0] "%" FLRdpHPA,FLRdpHPB
 SG_ FLR2RdrObject10To11DataConf1 : 200|7@1+ (1.0,0.0) [0.0|100.0] "%" FLRdpHPA,FLRdpHPB
 SG_ FLR2RdrObject10To11DataLen0 : 48|8@1+ (0.2,0.0) [0.0|30.0] "m" FLRdpHPA,FLRdpHPB
 SG_ FLR2RdrObject10To11DataLen1 : 207|8@1+ (0.2,0.0) [0.0|30.0] "m" FLRdpHPA,FLRdpHPB
 SG_ FLR2RdrObject10To11DataStDLatAcc0 : 56|5@1+ (0.35,0.0) [0.0|10.85] "m/s^2" FLRdpHPA,FLRdpHPB
 SG_ FLR2RdrObject10To11DataStDLatAcc1 : 215|5@1+ (0.35,0.0) [0.0|10.85] "m/s^2" FLRdpHPA,FLRdpHPB
 SG_ FLR2RdrObject10To11DataStDLatPos0 : 61|8@1+ (0.1,0.0) [0.0|25.5] "m" FLRdpHPA,FLRdpHPB
 SG_ FLR2RdrObject10To11DataStDLatPos1 : 220|8@1+ (0.1,0.0) [0.0|25.5] "m" FLRdpHPA,FLRdpHPB
 SG_ FLR2RdrObject10To11DataStDLatVelo0 : 69|6@1+ (0.2,0.0) [0.0|12.600000000000001] "m/s" FLRdpHPA,FLRdpHPB
 SG_ FLR2RdrObject10To11DataStDLatVelo1 : 228|6@1+ (0.2,0.0) [0.0|12.600000000000001] "m/s" FLRdpHPA,FLRdpHPB
 SG_ FLR2RdrObject10To11DataStDLgtAcc0 : 75|5@1+ (0.35,0.0) [0.0|10.85] "m/s^2" FLRdpHPA,FLRdpHPB
 SG_ FLR2RdrObject10To11DataStDLgtAcc1 : 234|5@1+ (0.35,0.0) [0.0|10.85] "m/s^2" FLRdpHPA,FLRdpHPB
 SG_ FLR2RdrObject10To11DataStDLgtPos0 : 80|8@1+ (0.05,0.0) [0.0|12.75] "m" FLRdpHPA,FLRdpHPB
 SG_ FLR2RdrObject10To11DataStDLgtPos1 : 239|8@1+ (0.05,0.0) [0.0|12.75] "m" FLRdpHPA,FLRdpHPB
 SG_ FLR2RdrObject10To11DataStDLgtVelo0 : 88|6@1+ (0.2,0.0) [0.0|12.600000000000001] "m/s" FLRdpHPA,FLRdpHPB
 SG_ FLR2RdrObject10To11DataStDLgtVelo1 : 247|6@1+ (0.2,0.0) [0.0|12.600000000000001] "m/s" FLRdpHPA,FLRdpHPB
 SG_ FLR2RdrObject10To11DataWidth0 : 94|7@1+ (0.2,0.0) [0.0|15.0] "m" FLRdpHPA,FLRdpHPB
 SG_ FLR2RdrObject10To11DataWidth1 : 253|7@1+ (0.2,0.0) [0.0|15.0] "m" FLRdpHPA,FLRdpHPB
 SG_ FLR2RdrObject10To11HeadingAng0 : 101|10@1+ (0.01,-3.15) [-3.15|3.15] "rad" FLRdpHPA,FLRdpHPB
 SG_ FLR2RdrObject10To11HeadingAng1 : 260|10@1+ (0.01,-3.15) [-3.15|3.15] "rad" FLRdpHPA,FLRdpHPB
 SG_ FLR2RdrObject10To11LatAcc0 : 111|10@1+ (0.125,-44.5) [-44.5|44.5] "m/s^2" FLRdpHPA,FLRdpHPB
 SG_ FLR2RdrObject10To11LatAcc1 : 270|10@1+ (0.125,-44.5) [-44.5|44.5] "m/s^2" FLRdpHPA,FLRdpHPB
 SG_ FLR2RdrObject10To11LatPos0 : 121|13@1+ (0.0625,-255.9375) [-255.9375|255.9375] "Unitless" FLRdpHPA,FLRdpHPB
 SG_ FLR2RdrObject10To11LatPos1 : 280|13@1+ (0.0625,-255.9375) [-255.9375|255.9375] "Unitless" FLRdpHPA,FLRdpHPB
 SG_ FLR2RdrObject10To11LatVelo0 : 134|11@1+ (0.125,-128.0) [-128.0|127.875] "m/s" FLRdpHPA,FLRdpHPB
 SG_ FLR2RdrObject10To11LatVelo1 : 293|11@1+ (0.125,-128.0) [-128.0|127.875] "m/s" FLRdpHPA,FLRdpHPB
 SG_ FLR2RdrObject10To11LgtAcc0 : 145|10@1+ (0.125,-44.5) [-44.5|44.5] "m/s^2" FLRdpHPA,FLRdpHPB
 SG_ FLR2RdrObject10To11LgtAcc1 : 304|10@1+ (0.125,-44.5) [-44.5|44.5] "m/s^2" FLRdpHPA,FLRdpHPB
 SG_ FLR2RdrObject10To11LgtPos0 : 155|13@1+ (0.0625,-255.9375) [-255.9375|255.9375] "Unitless" FLRdpHPA,FLRdpHPB
 SG_ FLR2RdrObject10To11LgtPos1 : 314|13@1+ (0.0625,-255.9375) [-255.9375|255.9375] "Unitless" FLRdpHPA,FLRdpHPB
 SG_ FLR2RdrObject10To11LgtVelo0 : 168|11@1+ (0.125,-128.0) [-128.0|127.875] "m/s" FLRdpHPA,FLRdpHPB
 SG_ FLR2RdrObject10To11LgtVelo1 : 327|11@1+ (0.125,-128.0) [-128.0|127.875] "m/s" FLRdpHPA,FLRdpHPB
 SG_ FLR2RdrObject10To11ModeInfo0 : 179|2@1+ (1,0) [0|3] "" FLRdpHPA,FLRdpHPB
 SG_ FLR2RdrObject10To11ModeInfo1 : 338|2@1+ (1,0) [0|3] "" FLRdpHPA,FLRdpHPB
 SG_ FLR2RdrObject10To11MsgCntr : 32|4@1+ (1.0,0.0) [0.0|15.0] "Unitless" FLRdpHPA,FLRdpHPB
 SG_ FLR2RdrObject10To11MtnModel0 : 181|2@1+ (1.0,0.0) [0.0|3.0] "Unitless" FLRdpHPA,FLRdpHPB
 SG_ FLR2RdrObject10To11MtnModel1 : 340|2@1+ (1.0,0.0) [0.0|3.0] "Unitless" FLRdpHPA,FLRdpHPB
 SG_ FLR2RdrObject10To11MtnPattern0 : 183|4@1+ (1,0) [0|15] "" FLRdpHPA,FLRdpHPB
 SG_ FLR2RdrObject10To11MtnPattern1 : 342|4@1+ (1,0) [0|15] "" FLRdpHPA,FLRdpHPB
 SG_ FLR2RdrObject10To11PedMicroDoppler0 : 187|1@1+ (1.0,0.0) [0.0|1.0] "Unitless" FLRdpHPA,FLRdpHPB
 SG_ FLR2RdrObject10To11PedMicroDoppler1 : 346|1@1+ (1.0,0.0) [0.0|1.0] "Unitless" FLRdpHPA,FLRdpHPB
 SG_ FLR2RdrObject10To11Qly0 : 188|7@1+ (1.0,0.0) [0.0|100.0] "Unitless" FLRdpHPA,FLRdpHPB
 SG_ FLR2RdrObject10To11Qly1 : 347|7@1+ (1.0,0.0) [0.0|100.0] "Unitless" FLRdpHPA,FLRdpHPB
 SG_ FLR2RdrObject10To11ScanID : 24|8@1+ (1.0,0.0) [0.0|255.0] "Unitless" FLRdpHPA,FLRdpHPB

BO_ 332 FlrFlr1canFr87 : 64 FLR
 SG_ FLR2RdrObject12To13_UB : 367|1@0+ (1,0) [0|1] "" FLRdpHPA,FLRdpHPB
 SG_ FLR2RdrObject12To13Class0 : 36|2@1+ (1,0) [0|3] "" FLRdpHPA,FLRdpHPB
 SG_ FLR2RdrObject12To13Class1 : 195|2@1+ (1,0) [0|3] "" FLRdpHPA,FLRdpHPB
 SG_ FLR2RdrObject12To13Counter : 16|8@1+ (1.0,0.0) [0.0|255.0] "Unitless" FLRdpHPA,FLRdpHPB
 SG_ FLR2RdrObject12To13CRC : 0|16@1+ (1.0,0.0) [0.0|65535.0] "Unitless" FLRdpHPA,FLRdpHPB
 SG_ FLR2RdrObject12To13DataCoastCntr0 : 38|3@1+ (1,0) [0|7] "" FLRdpHPA,FLRdpHPB
 SG_ FLR2RdrObject12To13DataCoastCntr1 : 197|3@1+ (1,0) [0|7] "" FLRdpHPA,FLRdpHPB
 SG_ FLR2RdrObject12To13DataConf0 : 41|7@1+ (1.0,0.0) [0.0|100.0] "%" FLRdpHPA,FLRdpHPB
 SG_ FLR2RdrObject12To13DataConf1 : 200|7@1+ (1.0,0.0) [0.0|100.0] "%" FLRdpHPA,FLRdpHPB
 SG_ FLR2RdrObject12To13DataLen0 : 48|8@1+ (0.2,0.0) [0.0|30.0] "m" FLRdpHPA,FLRdpHPB
 SG_ FLR2RdrObject12To13DataLen1 : 207|8@1+ (0.2,0.0) [0.0|30.0] "m" FLRdpHPA,FLRdpHPB
 SG_ FLR2RdrObject12To13DataStDLatAcc0 : 56|5@1+ (0.35,0.0) [0.0|10.85] "m/s^2" FLRdpHPA,FLRdpHPB
 SG_ FLR2RdrObject12To13DataStDLatAcc1 : 215|5@1+ (0.35,0.0) [0.0|10.85] "m/s^2" FLRdpHPA,FLRdpHPB
 SG_ FLR2RdrObject12To13DataStDLatPos0 : 61|8@1+ (0.1,0.0) [0.0|25.5] "m" FLRdpHPA,FLRdpHPB
 SG_ FLR2RdrObject12To13DataStDLatPos1 : 220|8@1+ (0.1,0.0) [0.0|25.5] "m" FLRdpHPA,FLRdpHPB
 SG_ FLR2RdrObject12To13DataStDLatVelo0 : 69|6@1+ (0.2,0.0) [0.0|12.600000000000001] "m/s" FLRdpHPA,FLRdpHPB
 SG_ FLR2RdrObject12To13DataStDLatVelo1 : 228|6@1+ (0.2,0.0) [0.0|12.600000000000001] "m/s" FLRdpHPA,FLRdpHPB
 SG_ FLR2RdrObject12To13DataStDLgtAcc0 : 75|5@1+ (0.35,0.0) [0.0|10.85] "m/s^2" FLRdpHPA,FLRdpHPB
 SG_ FLR2RdrObject12To13DataStDLgtAcc1 : 234|5@1+ (0.35,0.0) [0.0|10.85] "m/s^2" FLRdpHPA,FLRdpHPB
 SG_ FLR2RdrObject12To13DataStDLgtPos0 : 80|8@1+ (0.05,0.0) [0.0|12.75] "m" FLRdpHPA,FLRdpHPB
 SG_ FLR2RdrObject12To13DataStDLgtPos1 : 239|8@1+ (0.05,0.0) [0.0|12.75] "m" FLRdpHPA,FLRdpHPB
 SG_ FLR2RdrObject12To13DataStDLgtVelo0 : 88|6@1+ (0.2,0.0) [0.0|12.600000000000001] "m/s" FLRdpHPA,FLRdpHPB
 SG_ FLR2RdrObject12To13DataStDLgtVelo1 : 247|6@1+ (0.2,0.0) [0.0|12.600000000000001] "m/s" FLRdpHPA,FLRdpHPB
 SG_ FLR2RdrObject12To13DataWidth0 : 94|7@1+ (0.2,0.0) [0.0|15.0] "m" FLRdpHPA,FLRdpHPB
 SG_ FLR2RdrObject12To13DataWidth1 : 253|7@1+ (0.2,0.0) [0.0|15.0] "m" FLRdpHPA,FLRdpHPB
 SG_ FLR2RdrObject12To13HeadingAng0 : 101|10@1+ (0.01,-3.15) [-3.15|3.15] "rad" FLRdpHPA,FLRdpHPB
 SG_ FLR2RdrObject12To13HeadingAng1 : 260|10@1+ (0.01,-3.15) [-3.15|3.15] "rad" FLRdpHPA,FLRdpHPB
 SG_ FLR2RdrObject12To13LatAcc0 : 111|10@1+ (0.125,-44.5) [-44.5|44.5] "m/s^2" FLRdpHPA,FLRdpHPB
 SG_ FLR2RdrObject12To13LatAcc1 : 270|10@1+ (0.125,-44.5) [-44.5|44.5] "m/s^2" FLRdpHPA,FLRdpHPB
 SG_ FLR2RdrObject12To13LatPos0 : 121|13@1+ (0.0625,-255.9375) [-255.9375|255.9375] "Unitless" FLRdpHPA,FLRdpHPB
 SG_ FLR2RdrObject12To13LatPos1 : 280|13@1+ (0.0625,-255.9375) [-255.9375|255.9375] "Unitless" FLRdpHPA,FLRdpHPB
 SG_ FLR2RdrObject12To13LatVelo0 : 134|11@1+ (0.125,-128.0) [-128.0|127.875] "m/s" FLRdpHPA,FLRdpHPB
 SG_ FLR2RdrObject12To13LatVelo1 : 293|11@1+ (0.125,-128.0) [-128.0|127.875] "m/s" FLRdpHPA,FLRdpHPB
 SG_ FLR2RdrObject12To13LgtAcc0 : 145|10@1+ (0.125,-44.5) [-44.5|44.5] "m/s^2" FLRdpHPA,FLRdpHPB
 SG_ FLR2RdrObject12To13LgtAcc1 : 304|10@1+ (0.125,-44.5) [-44.5|44.5] "m/s^2" FLRdpHPA,FLRdpHPB
 SG_ FLR2RdrObject12To13LgtPos0 : 155|13@1+ (0.0625,-255.9375) [-255.9375|255.9375] "Unitless" FLRdpHPA,FLRdpHPB
 SG_ FLR2RdrObject12To13LgtPos1 : 314|13@1+ (0.0625,-255.9375) [-255.9375|255.9375] "Unitless" FLRdpHPA,FLRdpHPB
 SG_ FLR2RdrObject12To13LgtVelo0 : 168|11@1+ (0.125,-128.0) [-128.0|127.875] "m/s" FLRdpHPA,FLRdpHPB
 SG_ FLR2RdrObject12To13LgtVelo1 : 327|11@1+ (0.125,-128.0) [-128.0|127.875] "m/s" FLRdpHPA,FLRdpHPB
 SG_ FLR2RdrObject12To13ModeInfo0 : 179|2@1+ (1,0) [0|3] "" FLRdpHPA,FLRdpHPB
 SG_ FLR2RdrObject12To13ModeInfo1 : 338|2@1+ (1,0) [0|3] "" FLRdpHPA,FLRdpHPB
 SG_ FLR2RdrObject12To13MsgCntr : 32|4@1+ (1.0,0.0) [0.0|15.0] "Unitless" FLRdpHPA,FLRdpHPB
 SG_ FLR2RdrObject12To13MtnModel0 : 181|2@1+ (1.0,0.0) [0.0|3.0] "Unitless" FLRdpHPA,FLRdpHPB
 SG_ FLR2RdrObject12To13MtnModel1 : 340|2@1+ (1.0,0.0) [0.0|3.0] "Unitless" FLRdpHPA,FLRdpHPB
 SG_ FLR2RdrObject12To13MtnPattern0 : 183|4@1+ (1,0) [0|15] "" FLRdpHPA,FLRdpHPB
 SG_ FLR2RdrObject12To13MtnPattern1 : 342|4@1+ (1,0) [0|15] "" FLRdpHPA,FLRdpHPB
 SG_ FLR2RdrObject12To13PedMicroDoppler0 : 187|1@1+ (1.0,0.0) [0.0|1.0] "Unitless" FLRdpHPA,FLRdpHPB
 SG_ FLR2RdrObject12To13PedMicroDoppler1 : 346|1@1+ (1.0,0.0) [0.0|1.0] "Unitless" FLRdpHPA,FLRdpHPB
 SG_ FLR2RdrObject12To13Qly0 : 188|7@1+ (1.0,0.0) [0.0|100.0] "Unitless" FLRdpHPA,FLRdpHPB
 SG_ FLR2RdrObject12To13Qly1 : 347|7@1+ (1.0,0.0) [0.0|100.0] "Unitless" FLRdpHPA,FLRdpHPB
 SG_ FLR2RdrObject12To13ScanID : 24|8@1+ (1.0,0.0) [0.0|255.0] "Unitless" FLRdpHPA,FLRdpHPB

BO_ 334 FlrFlr1canFr88 : 64 FLR
 SG_ FLR2RdrObject14To15_UB : 367|1@0+ (1,0) [0|1] "" FLRdpHPA,FLRdpHPB
 SG_ FLR2RdrObject14To15Class0 : 36|2@1+ (1,0) [0|3] "" FLRdpHPA,FLRdpHPB
 SG_ FLR2RdrObject14To15Class1 : 195|2@1+ (1,0) [0|3] "" FLRdpHPA,FLRdpHPB
 SG_ FLR2RdrObject14To15Counter : 16|8@1+ (1.0,0.0) [0.0|255.0] "Unitless" FLRdpHPA,FLRdpHPB
 SG_ FLR2RdrObject14To15CRC : 0|16@1+ (1.0,0.0) [0.0|65535.0] "Unitless" FLRdpHPA,FLRdpHPB
 SG_ FLR2RdrObject14To15DataCoastCntr0 : 38|3@1+ (1,0) [0|7] "" FLRdpHPA,FLRdpHPB
 SG_ FLR2RdrObject14To15DataCoastCntr1 : 197|3@1+ (1,0) [0|7] "" FLRdpHPA,FLRdpHPB
 SG_ FLR2RdrObject14To15DataConf0 : 41|7@1+ (1.0,0.0) [0.0|100.0] "%" FLRdpHPA,FLRdpHPB
 SG_ FLR2RdrObject14To15DataConf1 : 200|7@1+ (1.0,0.0) [0.0|100.0] "%" FLRdpHPA,FLRdpHPB
 SG_ FLR2RdrObject14To15DataLen0 : 48|8@1+ (0.2,0.0) [0.0|30.0] "m" FLRdpHPA,FLRdpHPB
 SG_ FLR2RdrObject14To15DataLen1 : 207|8@1+ (0.2,0.0) [0.0|30.0] "m" FLRdpHPA,FLRdpHPB
 SG_ FLR2RdrObject14To15DataStDLatAcc0 : 56|5@1+ (0.35,0.0) [0.0|10.85] "m/s^2" FLRdpHPA,FLRdpHPB
 SG_ FLR2RdrObject14To15DataStDLatAcc1 : 215|5@1+ (0.35,0.0) [0.0|10.85] "m/s^2" FLRdpHPA,FLRdpHPB
 SG_ FLR2RdrObject14To15DataStDLatPos0 : 61|8@1+ (0.1,0.0) [0.0|25.5] "m" FLRdpHPA,FLRdpHPB
 SG_ FLR2RdrObject14To15DataStDLatPos1 : 220|8@1+ (0.1,0.0) [0.0|25.5] "m" FLRdpHPA,FLRdpHPB
 SG_ FLR2RdrObject14To15DataStDLatVelo0 : 69|6@1+ (0.2,0.0) [0.0|12.600000000000001] "m/s" FLRdpHPA,FLRdpHPB
 SG_ FLR2RdrObject14To15DataStDLatVelo1 : 228|6@1+ (0.2,0.0) [0.0|12.600000000000001] "m/s" FLRdpHPA,FLRdpHPB
 SG_ FLR2RdrObject14To15DataStDLgtAcc0 : 75|5@1+ (0.35,0.0) [0.0|10.85] "m/s^2" FLRdpHPA,FLRdpHPB
 SG_ FLR2RdrObject14To15DataStDLgtAcc1 : 234|5@1+ (0.35,0.0) [0.0|10.85] "m/s^2" FLRdpHPA,FLRdpHPB
 SG_ FLR2RdrObject14To15DataStDLgtPos0 : 80|8@1+ (0.05,0.0) [0.0|12.75] "m" FLRdpHPA,FLRdpHPB
 SG_ FLR2RdrObject14To15DataStDLgtPos1 : 239|8@1+ (0.05,0.0) [0.0|12.75] "m" FLRdpHPA,FLRdpHPB
 SG_ FLR2RdrObject14To15DataStDLgtVelo0 : 88|6@1+ (0.2,0.0) [0.0|12.600000000000001] "m/s" FLRdpHPA,FLRdpHPB
 SG_ FLR2RdrObject14To15DataStDLgtVelo1 : 247|6@1+ (0.2,0.0) [0.0|12.600000000000001] "m/s" FLRdpHPA,FLRdpHPB
 SG_ FLR2RdrObject14To15DataWidth0 : 94|7@1+ (0.2,0.0) [0.0|15.0] "m" FLRdpHPA,FLRdpHPB
 SG_ FLR2RdrObject14To15DataWidth1 : 253|7@1+ (0.2,0.0) [0.0|15.0] "m" FLRdpHPA,FLRdpHPB
 SG_ FLR2RdrObject14To15HeadingAng0 : 101|10@1+ (0.01,-3.15) [-3.15|3.15] "rad" FLRdpHPA,FLRdpHPB
 SG_ FLR2RdrObject14To15HeadingAng1 : 260|10@1+ (0.01,-3.15) [-3.15|3.15] "rad" FLRdpHPA,FLRdpHPB
 SG_ FLR2RdrObject14To15LatAcc0 : 111|10@1+ (0.125,-44.5) [-44.5|44.5] "m/s^2" FLRdpHPA,FLRdpHPB
 SG_ FLR2RdrObject14To15LatAcc1 : 270|10@1+ (0.125,-44.5) [-44.5|44.5] "m/s^2" FLRdpHPA,FLRdpHPB
 SG_ FLR2RdrObject14To15LatPos0 : 121|13@1+ (0.0625,-255.9375) [-255.9375|255.9375] "Unitless" FLRdpHPA,FLRdpHPB
 SG_ FLR2RdrObject14To15LatPos1 : 280|13@1+ (0.0625,-255.9375) [-255.9375|255.9375] "Unitless" FLRdpHPA,FLRdpHPB
 SG_ FLR2RdrObject14To15LatVelo0 : 134|11@1+ (0.125,-128.0) [-128.0|127.875] "m/s" FLRdpHPA,FLRdpHPB
 SG_ FLR2RdrObject14To15LatVelo1 : 293|11@1+ (0.125,-128.0) [-128.0|127.875] "m/s" FLRdpHPA,FLRdpHPB
 SG_ FLR2RdrObject14To15LgtAcc0 : 145|10@1+ (0.125,-44.5) [-44.5|44.5] "m/s^2" FLRdpHPA,FLRdpHPB
 SG_ FLR2RdrObject14To15LgtAcc1 : 304|10@1+ (0.125,-44.5) [-44.5|44.5] "m/s^2" FLRdpHPA,FLRdpHPB
 SG_ FLR2RdrObject14To15LgtPos0 : 155|13@1+ (0.0625,-255.9375) [-255.9375|255.9375] "Unitless" FLRdpHPA,FLRdpHPB
 SG_ FLR2RdrObject14To15LgtPos1 : 314|13@1+ (0.0625,-255.9375) [-255.9375|255.9375] "Unitless" FLRdpHPA,FLRdpHPB
 SG_ FLR2RdrObject14To15LgtVelo0 : 168|11@1+ (0.125,-128.0) [-128.0|127.875] "m/s" FLRdpHPA,FLRdpHPB
 SG_ FLR2RdrObject14To15LgtVelo1 : 327|11@1+ (0.125,-128.0) [-128.0|127.875] "m/s" FLRdpHPA,FLRdpHPB
 SG_ FLR2RdrObject14To15ModeInfo0 : 179|2@1+ (1,0) [0|3] "" FLRdpHPA,FLRdpHPB
 SG_ FLR2RdrObject14To15ModeInfo1 : 338|2@1+ (1,0) [0|3] "" FLRdpHPA,FLRdpHPB
 SG_ FLR2RdrObject14To15MsgCntr : 32|4@1+ (1.0,0.0) [0.0|15.0] "Unitless" FLRdpHPA,FLRdpHPB
 SG_ FLR2RdrObject14To15MtnModel0 : 181|2@1+ (1.0,0.0) [0.0|3.0] "Unitless" FLRdpHPA,FLRdpHPB
 SG_ FLR2RdrObject14To15MtnModel1 : 340|2@1+ (1.0,0.0) [0.0|3.0] "Unitless" FLRdpHPA,FLRdpHPB
 SG_ FLR2RdrObject14To15MtnPattern0 : 183|4@1+ (1,0) [0|15] "" FLRdpHPA,FLRdpHPB
 SG_ FLR2RdrObject14To15MtnPattern1 : 342|4@1+ (1,0) [0|15] "" FLRdpHPA,FLRdpHPB
 SG_ FLR2RdrObject14To15PedMicroDoppler0 : 187|1@1+ (1.0,0.0) [0.0|1.0] "Unitless" FLRdpHPA,FLRdpHPB
 SG_ FLR2RdrObject14To15PedMicroDoppler1 : 346|1@1+ (1.0,0.0) [0.0|1.0] "Unitless" FLRdpHPA,FLRdpHPB
 SG_ FLR2RdrObject14To15Qly0 : 188|7@1+ (1.0,0.0) [0.0|100.0] "Unitless" FLRdpHPA,FLRdpHPB
 SG_ FLR2RdrObject14To15Qly1 : 347|7@1+ (1.0,0.0) [0.0|100.0] "Unitless" FLRdpHPA,FLRdpHPB
 SG_ FLR2RdrObject14To15ScanID : 24|8@1+ (1.0,0.0) [0.0|255.0] "Unitless" FLRdpHPA,FLRdpHPB

BO_ 336 FlrFlr1canFr89 : 64 FLR
 SG_ FLR2RdrObject16To17_UB : 367|1@0+ (1,0) [0|1] "" FLRdpHPA,FLRdpHPB
 SG_ FLR2RdrObject16To17Class0 : 36|2@1+ (1,0) [0|3] "" FLRdpHPA,FLRdpHPB
 SG_ FLR2RdrObject16To17Class1 : 195|2@1+ (1,0) [0|3] "" FLRdpHPA,FLRdpHPB
 SG_ FLR2RdrObject16To17Counter : 16|8@1+ (1.0,0.0) [0.0|255.0] "Unitless" FLRdpHPA,FLRdpHPB
 SG_ FLR2RdrObject16To17CRC : 0|16@1+ (1.0,0.0) [0.0|65535.0] "Unitless" FLRdpHPA,FLRdpHPB
 SG_ FLR2RdrObject16To17DataCoastCntr0 : 38|3@1+ (1,0) [0|7] "" FLRdpHPA,FLRdpHPB
 SG_ FLR2RdrObject16To17DataCoastCntr1 : 197|3@1+ (1,0) [0|7] "" FLRdpHPA,FLRdpHPB
 SG_ FLR2RdrObject16To17DataConf0 : 41|7@1+ (1.0,0.0) [0.0|100.0] "%" FLRdpHPA,FLRdpHPB
 SG_ FLR2RdrObject16To17DataConf1 : 200|7@1+ (1.0,0.0) [0.0|100.0] "%" FLRdpHPA,FLRdpHPB
 SG_ FLR2RdrObject16To17DataLen0 : 48|8@1+ (0.2,0.0) [0.0|30.0] "m" FLRdpHPA,FLRdpHPB
 SG_ FLR2RdrObject16To17DataLen1 : 207|8@1+ (0.2,0.0) [0.0|30.0] "m" FLRdpHPA,FLRdpHPB
 SG_ FLR2RdrObject16To17DataStDLatAcc0 : 56|5@1+ (0.35,0.0) [0.0|10.85] "m/s^2" FLRdpHPA,FLRdpHPB
 SG_ FLR2RdrObject16To17DataStDLatAcc1 : 215|5@1+ (0.35,0.0) [0.0|10.85] "m/s^2" FLRdpHPA,FLRdpHPB
 SG_ FLR2RdrObject16To17DataStDLatPos0 : 61|8@1+ (0.1,0.0) [0.0|25.5] "m" FLRdpHPA,FLRdpHPB
 SG_ FLR2RdrObject16To17DataStDLatPos1 : 220|8@1+ (0.1,0.0) [0.0|25.5] "m" FLRdpHPA,FLRdpHPB
 SG_ FLR2RdrObject16To17DataStDLatVelo0 : 69|6@1+ (0.2,0.0) [0.0|12.600000000000001] "m/s" FLRdpHPA,FLRdpHPB
 SG_ FLR2RdrObject16To17DataStDLatVelo1 : 228|6@1+ (0.2,0.0) [0.0|12.600000000000001] "m/s" FLRdpHPA,FLRdpHPB
 SG_ FLR2RdrObject16To17DataStDLgtAcc0 : 75|5@1+ (0.35,0.0) [0.0|10.85] "m/s^2" FLRdpHPA,FLRdpHPB
 SG_ FLR2RdrObject16To17DataStDLgtAcc1 : 234|5@1+ (0.35,0.0) [0.0|10.85] "m/s^2" FLRdpHPA,FLRdpHPB
 SG_ FLR2RdrObject16To17DataStDLgtPos0 : 80|8@1+ (0.05,0.0) [0.0|12.75] "m" FLRdpHPA,FLRdpHPB
 SG_ FLR2RdrObject16To17DataStDLgtPos1 : 239|8@1+ (0.05,0.0) [0.0|12.75] "m" FLRdpHPA,FLRdpHPB
 SG_ FLR2RdrObject16To17DataStDLgtVelo0 : 88|6@1+ (0.2,0.0) [0.0|12.600000000000001] "m/s" FLRdpHPA,FLRdpHPB
 SG_ FLR2RdrObject16To17DataStDLgtVelo1 : 247|6@1+ (0.2,0.0) [0.0|12.600000000000001] "m/s" FLRdpHPA,FLRdpHPB
 SG_ FLR2RdrObject16To17DataWidth0 : 94|7@1+ (0.2,0.0) [0.0|15.0] "m" FLRdpHPA,FLRdpHPB
 SG_ FLR2RdrObject16To17DataWidth1 : 253|7@1+ (0.2,0.0) [0.0|15.0] "m" FLRdpHPA,FLRdpHPB
 SG_ FLR2RdrObject16To17HeadingAng0 : 101|10@1+ (0.01,-3.15) [-3.15|3.15] "rad" FLRdpHPA,FLRdpHPB
 SG_ FLR2RdrObject16To17HeadingAng1 : 260|10@1+ (0.01,-3.15) [-3.15|3.15] "rad" FLRdpHPA,FLRdpHPB
 SG_ FLR2RdrObject16To17LatAcc0 : 111|10@1+ (0.125,-44.5) [-44.5|44.5] "m/s^2" FLRdpHPA,FLRdpHPB
 SG_ FLR2RdrObject16To17LatAcc1 : 270|10@1+ (0.125,-44.5) [-44.5|44.5] "m/s^2" FLRdpHPA,FLRdpHPB
 SG_ FLR2RdrObject16To17LatPos0 : 121|13@1+ (0.0625,-255.9375) [-255.9375|255.9375] "Unitless" FLRdpHPA,FLRdpHPB
 SG_ FLR2RdrObject16To17LatPos1 : 280|13@1+ (0.0625,-255.9375) [-255.9375|255.9375] "Unitless" FLRdpHPA,FLRdpHPB
 SG_ FLR2RdrObject16To17LatVelo0 : 134|11@1+ (0.125,-128.0) [-128.0|127.875] "m/s" FLRdpHPA,FLRdpHPB
 SG_ FLR2RdrObject16To17LatVelo1 : 293|11@1+ (0.125,-128.0) [-128.0|127.875] "m/s" FLRdpHPA,FLRdpHPB
 SG_ FLR2RdrObject16To17LgtAcc0 : 145|10@1+ (0.125,-44.5) [-44.5|44.5] "m/s^2" FLRdpHPA,FLRdpHPB
 SG_ FLR2RdrObject16To17LgtAcc1 : 304|10@1+ (0.125,-44.5) [-44.5|44.5] "m/s^2" FLRdpHPA,FLRdpHPB
 SG_ FLR2RdrObject16To17LgtPos0 : 155|13@1+ (0.0625,-255.9375) [-255.9375|255.9375] "Unitless" FLRdpHPA,FLRdpHPB
 SG_ FLR2RdrObject16To17LgtPos1 : 314|13@1+ (0.0625,-255.9375) [-255.9375|255.9375] "Unitless" FLRdpHPA,FLRdpHPB
 SG_ FLR2RdrObject16To17LgtVelo0 : 168|11@1+ (0.125,-128.0) [-128.0|127.875] "m/s" FLRdpHPA,FLRdpHPB
 SG_ FLR2RdrObject16To17LgtVelo1 : 327|11@1+ (0.125,-128.0) [-128.0|127.875] "m/s" FLRdpHPA,FLRdpHPB
 SG_ FLR2RdrObject16To17ModeInfo0 : 179|2@1+ (1,0) [0|3] "" FLRdpHPA,FLRdpHPB
 SG_ FLR2RdrObject16To17ModeInfo1 : 338|2@1+ (1,0) [0|3] "" FLRdpHPA,FLRdpHPB
 SG_ FLR2RdrObject16To17MsgCntr : 32|4@1+ (1.0,0.0) [0.0|15.0] "Unitless" FLRdpHPA,FLRdpHPB
 SG_ FLR2RdrObject16To17MtnModel0 : 181|2@1+ (1.0,0.0) [0.0|3.0] "Unitless" FLRdpHPA,FLRdpHPB
 SG_ FLR2RdrObject16To17MtnModel1 : 340|2@1+ (1.0,0.0) [0.0|3.0] "Unitless" FLRdpHPA,FLRdpHPB
 SG_ FLR2RdrObject16To17MtnPattern0 : 183|4@1+ (1,0) [0|15] "" FLRdpHPA,FLRdpHPB
 SG_ FLR2RdrObject16To17MtnPattern1 : 342|4@1+ (1,0) [0|15] "" FLRdpHPA,FLRdpHPB
 SG_ FLR2RdrObject16To17PedMicroDoppler0 : 187|1@1+ (1.0,0.0) [0.0|1.0] "Unitless" FLRdpHPA,FLRdpHPB
 SG_ FLR2RdrObject16To17PedMicroDoppler1 : 346|1@1+ (1.0,0.0) [0.0|1.0] "Unitless" FLRdpHPA,FLRdpHPB
 SG_ FLR2RdrObject16To17Qly0 : 188|7@1+ (1.0,0.0) [0.0|100.0] "Unitless" FLRdpHPA,FLRdpHPB
 SG_ FLR2RdrObject16To17Qly1 : 347|7@1+ (1.0,0.0) [0.0|100.0] "Unitless" FLRdpHPA,FLRdpHPB
 SG_ FLR2RdrObject16To17ScanID : 24|8@1+ (1.0,0.0) [0.0|255.0] "Unitless" FLRdpHPA,FLRdpHPB

BO_ 338 FlrFlr1canFr90 : 64 FLR
 SG_ FLR2RdrObject18To19_UB : 367|1@0+ (1,0) [0|1] "" FLRdpHPA,FLRdpHPB
 SG_ FLR2RdrObject18To19Class0 : 36|2@1+ (1,0) [0|3] "" FLRdpHPA,FLRdpHPB
 SG_ FLR2RdrObject18To19Class1 : 195|2@1+ (1,0) [0|3] "" FLRdpHPA,FLRdpHPB
 SG_ FLR2RdrObject18To19Counter : 16|8@1+ (1.0,0.0) [0.0|255.0] "Unitless" FLRdpHPA,FLRdpHPB
 SG_ FLR2RdrObject18To19CRC : 0|16@1+ (1.0,0.0) [0.0|65535.0] "Unitless" FLRdpHPA,FLRdpHPB
 SG_ FLR2RdrObject18To19DataCoastCntr0 : 38|3@1+ (1,0) [0|7] "" FLRdpHPA,FLRdpHPB
 SG_ FLR2RdrObject18To19DataCoastCntr1 : 197|3@1+ (1,0) [0|7] "" FLRdpHPA,FLRdpHPB
 SG_ FLR2RdrObject18To19DataConf0 : 41|7@1+ (1.0,0.0) [0.0|100.0] "%" FLRdpHPA,FLRdpHPB
 SG_ FLR2RdrObject18To19DataConf1 : 200|7@1+ (1.0,0.0) [0.0|100.0] "%" FLRdpHPA,FLRdpHPB
 SG_ FLR2RdrObject18To19DataLen0 : 48|8@1+ (0.2,0.0) [0.0|30.0] "m" FLRdpHPA,FLRdpHPB
 SG_ FLR2RdrObject18To19DataLen1 : 207|8@1+ (0.2,0.0) [0.0|30.0] "m" FLRdpHPA,FLRdpHPB
 SG_ FLR2RdrObject18To19DataStDLatAcc0 : 56|5@1+ (0.35,0.0) [0.0|10.85] "m/s^2" FLRdpHPA,FLRdpHPB
 SG_ FLR2RdrObject18To19DataStDLatAcc1 : 215|5@1+ (0.35,0.0) [0.0|10.85] "m/s^2" FLRdpHPA,FLRdpHPB
 SG_ FLR2RdrObject18To19DataStDLatPos0 : 61|8@1+ (0.1,0.0) [0.0|25.5] "m" FLRdpHPA,FLRdpHPB
 SG_ FLR2RdrObject18To19DataStDLatPos1 : 220|8@1+ (0.1,0.0) [0.0|25.5] "m" FLRdpHPA,FLRdpHPB
 SG_ FLR2RdrObject18To19DataStDLatVelo0 : 69|6@1+ (0.2,0.0) [0.0|12.600000000000001] "m/s" FLRdpHPA,FLRdpHPB
 SG_ FLR2RdrObject18To19DataStDLatVelo1 : 228|6@1+ (0.2,0.0) [0.0|12.600000000000001] "m/s" FLRdpHPA,FLRdpHPB
 SG_ FLR2RdrObject18To19DataStDLgtAcc0 : 75|5@1+ (0.35,0.0) [0.0|10.85] "m/s^2" FLRdpHPA,FLRdpHPB
 SG_ FLR2RdrObject18To19DataStDLgtAcc1 : 234|5@1+ (0.35,0.0) [0.0|10.85] "m/s^2" FLRdpHPA,FLRdpHPB
 SG_ FLR2RdrObject18To19DataStDLgtPos0 : 80|8@1+ (0.05,0.0) [0.0|12.75] "m" FLRdpHPA,FLRdpHPB
 SG_ FLR2RdrObject18To19DataStDLgtPos1 : 239|8@1+ (0.05,0.0) [0.0|12.75] "m" FLRdpHPA,FLRdpHPB
 SG_ FLR2RdrObject18To19DataStDLgtVelo0 : 88|6@1+ (0.2,0.0) [0.0|12.600000000000001] "m/s" FLRdpHPA,FLRdpHPB
 SG_ FLR2RdrObject18To19DataStDLgtVelo1 : 247|6@1+ (0.2,0.0) [0.0|12.600000000000001] "m/s" FLRdpHPA,FLRdpHPB
 SG_ FLR2RdrObject18To19DataWidth0 : 94|7@1+ (0.2,0.0) [0.0|15.0] "m" FLRdpHPA,FLRdpHPB
 SG_ FLR2RdrObject18To19DataWidth1 : 253|7@1+ (0.2,0.0) [0.0|15.0] "m" FLRdpHPA,FLRdpHPB
 SG_ FLR2RdrObject18To19HeadingAng0 : 101|10@1+ (0.01,-3.15) [-3.15|3.15] "rad" FLRdpHPA,FLRdpHPB
 SG_ FLR2RdrObject18To19HeadingAng1 : 260|10@1+ (0.01,-3.15) [-3.15|3.15] "rad" FLRdpHPA,FLRdpHPB
 SG_ FLR2RdrObject18To19LatAcc0 : 111|10@1+ (0.125,-44.5) [-44.5|44.5] "m/s^2" FLRdpHPA,FLRdpHPB
 SG_ FLR2RdrObject18To19LatAcc1 : 270|10@1+ (0.125,-44.5) [-44.5|44.5] "m/s^2" FLRdpHPA,FLRdpHPB
 SG_ FLR2RdrObject18To19LatPos0 : 121|13@1+ (0.0625,-255.9375) [-255.9375|255.9375] "Unitless" FLRdpHPA,FLRdpHPB
 SG_ FLR2RdrObject18To19LatPos1 : 280|13@1+ (0.0625,-255.9375) [-255.9375|255.9375] "Unitless" FLRdpHPA,FLRdpHPB
 SG_ FLR2RdrObject18To19LatVelo0 : 134|11@1+ (0.125,-128.0) [-128.0|127.875] "m/s" FLRdpHPA,FLRdpHPB
 SG_ FLR2RdrObject18To19LatVelo1 : 293|11@1+ (0.125,-128.0) [-128.0|127.875] "m/s" FLRdpHPA,FLRdpHPB
 SG_ FLR2RdrObject18To19LgtAcc0 : 145|10@1+ (0.125,-44.5) [-44.5|44.5] "m/s^2" FLRdpHPA,FLRdpHPB
 SG_ FLR2RdrObject18To19LgtAcc1 : 304|10@1+ (0.125,-44.5) [-44.5|44.5] "m/s^2" FLRdpHPA,FLRdpHPB
 SG_ FLR2RdrObject18To19LgtPos0 : 155|13@1+ (0.0625,-255.9375) [-255.9375|255.9375] "Unitless" FLRdpHPA,FLRdpHPB
 SG_ FLR2RdrObject18To19LgtPos1 : 314|13@1+ (0.0625,-255.9375) [-255.9375|255.9375] "Unitless" FLRdpHPA,FLRdpHPB
 SG_ FLR2RdrObject18To19LgtVelo0 : 168|11@1+ (0.125,-128.0) [-128.0|127.875] "m/s" FLRdpHPA,FLRdpHPB
 SG_ FLR2RdrObject18To19LgtVelo1 : 327|11@1+ (0.125,-128.0) [-128.0|127.875] "m/s" FLRdpHPA,FLRdpHPB
 SG_ FLR2RdrObject18To19ModeInfo0 : 179|2@1+ (1,0) [0|3] "" FLRdpHPA,FLRdpHPB
 SG_ FLR2RdrObject18To19ModeInfo1 : 338|2@1+ (1,0) [0|3] "" FLRdpHPA,FLRdpHPB
 SG_ FLR2RdrObject18To19MsgCntr : 32|4@1+ (1.0,0.0) [0.0|15.0] "Unitless" FLRdpHPA,FLRdpHPB
 SG_ FLR2RdrObject18To19MtnModel0 : 181|2@1+ (1.0,0.0) [0.0|3.0] "Unitless" FLRdpHPA,FLRdpHPB
 SG_ FLR2RdrObject18To19MtnModel1 : 340|2@1+ (1.0,0.0) [0.0|3.0] "Unitless" FLRdpHPA,FLRdpHPB
 SG_ FLR2RdrObject18To19MtnPattern0 : 183|4@1+ (1,0) [0|15] "" FLRdpHPA,FLRdpHPB
 SG_ FLR2RdrObject18To19MtnPattern1 : 342|4@1+ (1,0) [0|15] "" FLRdpHPA,FLRdpHPB
 SG_ FLR2RdrObject18To19PedMicroDoppler0 : 187|1@1+ (1.0,0.0) [0.0|1.0] "Unitless" FLRdpHPA,FLRdpHPB
 SG_ FLR2RdrObject18To19PedMicroDoppler1 : 346|1@1+ (1.0,0.0) [0.0|1.0] "Unitless" FLRdpHPA,FLRdpHPB
 SG_ FLR2RdrObject18To19Qly0 : 188|7@1+ (1.0,0.0) [0.0|100.0] "Unitless" FLRdpHPA,FLRdpHPB
 SG_ FLR2RdrObject18To19Qly1 : 347|7@1+ (1.0,0.0) [0.0|100.0] "Unitless" FLRdpHPA,FLRdpHPB
 SG_ FLR2RdrObject18To19ScanID : 24|8@1+ (1.0,0.0) [0.0|255.0] "Unitless" FLRdpHPA,FLRdpHPB

BO_ 340 FlrFlr1canFr91 : 64 FLR
 SG_ FLR2RdrObject20To21_UB : 367|1@0+ (1,0) [0|1] "" FLRdpHPA,FLRdpHPB
 SG_ FLR2RdrObject20To21Class0 : 36|2@1+ (1,0) [0|3] "" FLRdpHPA,FLRdpHPB
 SG_ FLR2RdrObject20To21Class1 : 195|2@1+ (1,0) [0|3] "" FLRdpHPA,FLRdpHPB
 SG_ FLR2RdrObject20To21Counter : 16|8@1+ (1.0,0.0) [0.0|255.0] "Unitless" FLRdpHPA,FLRdpHPB
 SG_ FLR2RdrObject20To21CRC : 0|16@1+ (1.0,0.0) [0.0|65535.0] "Unitless" FLRdpHPA,FLRdpHPB
 SG_ FLR2RdrObject20To21DataCoastCntr0 : 38|3@1+ (1,0) [0|7] "" FLRdpHPA,FLRdpHPB
 SG_ FLR2RdrObject20To21DataCoastCntr1 : 197|3@1+ (1,0) [0|7] "" FLRdpHPA,FLRdpHPB
 SG_ FLR2RdrObject20To21DataConf0 : 41|7@1+ (1.0,0.0) [0.0|100.0] "%" FLRdpHPA,FLRdpHPB
 SG_ FLR2RdrObject20To21DataConf1 : 200|7@1+ (1.0,0.0) [0.0|100.0] "%" FLRdpHPA,FLRdpHPB
 SG_ FLR2RdrObject20To21DataLen0 : 48|8@1+ (0.2,0.0) [0.0|30.0] "m" FLRdpHPA,FLRdpHPB
 SG_ FLR2RdrObject20To21DataLen1 : 207|8@1+ (0.2,0.0) [0.0|30.0] "m" FLRdpHPA,FLRdpHPB
 SG_ FLR2RdrObject20To21DataStDLatAcc0 : 56|5@1+ (0.35,0.0) [0.0|10.85] "m/s^2" FLRdpHPA,FLRdpHPB
 SG_ FLR2RdrObject20To21DataStDLatAcc1 : 215|5@1+ (0.35,0.0) [0.0|10.85] "m/s^2" FLRdpHPA,FLRdpHPB
 SG_ FLR2RdrObject20To21DataStDLatPos0 : 61|8@1+ (0.1,0.0) [0.0|25.5] "m" FLRdpHPA,FLRdpHPB
 SG_ FLR2RdrObject20To21DataStDLatPos1 : 220|8@1+ (0.1,0.0) [0.0|25.5] "m" FLRdpHPA,FLRdpHPB
 SG_ FLR2RdrObject20To21DataStDLatVelo0 : 69|6@1+ (0.2,0.0) [0.0|12.600000000000001] "m/s" FLRdpHPA,FLRdpHPB
 SG_ FLR2RdrObject20To21DataStDLatVelo1 : 228|6@1+ (0.2,0.0) [0.0|12.600000000000001] "m/s" FLRdpHPA,FLRdpHPB
 SG_ FLR2RdrObject20To21DataStDLgtAcc0 : 75|5@1+ (0.35,0.0) [0.0|10.85] "m/s^2" FLRdpHPA,FLRdpHPB
 SG_ FLR2RdrObject20To21DataStDLgtAcc1 : 234|5@1+ (0.35,0.0) [0.0|10.85] "m/s^2" FLRdpHPA,FLRdpHPB
 SG_ FLR2RdrObject20To21DataStDLgtPos0 : 80|8@1+ (0.05,0.0) [0.0|12.75] "m" FLRdpHPA,FLRdpHPB
 SG_ FLR2RdrObject20To21DataStDLgtPos1 : 239|8@1+ (0.05,0.0) [0.0|12.75] "m" FLRdpHPA,FLRdpHPB
 SG_ FLR2RdrObject20To21DataStDLgtVelo0 : 88|6@1+ (0.2,0.0) [0.0|12.600000000000001] "m/s" FLRdpHPA,FLRdpHPB
 SG_ FLR2RdrObject20To21DataStDLgtVelo1 : 247|6@1+ (0.2,0.0) [0.0|12.600000000000001] "m/s" FLRdpHPA,FLRdpHPB
 SG_ FLR2RdrObject20To21DataWidth0 : 94|7@1+ (0.2,0.0) [0.0|15.0] "m" FLRdpHPA,FLRdpHPB
 SG_ FLR2RdrObject20To21DataWidth1 : 253|7@1+ (0.2,0.0) [0.0|15.0] "m" FLRdpHPA,FLRdpHPB
 SG_ FLR2RdrObject20To21HeadingAng0 : 101|10@1+ (0.01,-3.15) [-3.15|3.15] "rad" FLRdpHPA,FLRdpHPB
 SG_ FLR2RdrObject20To21HeadingAng1 : 260|10@1+ (0.01,-3.15) [-3.15|3.15] "rad" FLRdpHPA,FLRdpHPB
 SG_ FLR2RdrObject20To21LatAcc0 : 111|10@1+ (0.125,-44.5) [-44.5|44.5] "m/s^2" FLRdpHPA,FLRdpHPB
 SG_ FLR2RdrObject20To21LatAcc1 : 270|10@1+ (0.125,-44.5) [-44.5|44.5] "m/s^2" FLRdpHPA,FLRdpHPB
 SG_ FLR2RdrObject20To21LatPos0 : 121|13@1+ (0.0625,-255.9375) [-255.9375|255.9375] "Unitless" FLRdpHPA,FLRdpHPB
 SG_ FLR2RdrObject20To21LatPos1 : 280|13@1+ (0.0625,-255.9375) [-255.9375|255.9375] "Unitless" FLRdpHPA,FLRdpHPB
 SG_ FLR2RdrObject20To21LatVelo0 : 134|11@1+ (0.125,-128.0) [-128.0|127.875] "m/s" FLRdpHPA,FLRdpHPB
 SG_ FLR2RdrObject20To21LatVelo1 : 293|11@1+ (0.125,-128.0) [-128.0|127.875] "m/s" FLRdpHPA,FLRdpHPB
 SG_ FLR2RdrObject20To21LgtAcc0 : 145|10@1+ (0.125,-44.5) [-44.5|44.5] "m/s^2" FLRdpHPA,FLRdpHPB
 SG_ FLR2RdrObject20To21LgtAcc1 : 304|10@1+ (0.125,-44.5) [-44.5|44.5] "m/s^2" FLRdpHPA,FLRdpHPB
 SG_ FLR2RdrObject20To21LgtPos0 : 155|13@1+ (0.0625,-255.9375) [-255.9375|255.9375] "Unitless" FLRdpHPA,FLRdpHPB
 SG_ FLR2RdrObject20To21LgtPos1 : 314|13@1+ (0.0625,-255.9375) [-255.9375|255.9375] "Unitless" FLRdpHPA,FLRdpHPB
 SG_ FLR2RdrObject20To21LgtVelo0 : 168|11@1+ (0.125,-128.0) [-128.0|127.875] "m/s" FLRdpHPA,FLRdpHPB
 SG_ FLR2RdrObject20To21LgtVelo1 : 327|11@1+ (0.125,-128.0) [-128.0|127.875] "m/s" FLRdpHPA,FLRdpHPB
 SG_ FLR2RdrObject20To21ModeInfo0 : 179|2@1+ (1,0) [0|3] "" FLRdpHPA,FLRdpHPB
 SG_ FLR2RdrObject20To21ModeInfo1 : 338|2@1+ (1,0) [0|3] "" FLRdpHPA,FLRdpHPB
 SG_ FLR2RdrObject20To21MsgCntr : 32|4@1+ (1.0,0.0) [0.0|15.0] "Unitless" FLRdpHPA,FLRdpHPB
 SG_ FLR2RdrObject20To21MtnModel0 : 181|2@1+ (1.0,0.0) [0.0|3.0] "Unitless" FLRdpHPA,FLRdpHPB
 SG_ FLR2RdrObject20To21MtnModel1 : 340|2@1+ (1.0,0.0) [0.0|3.0] "Unitless" FLRdpHPA,FLRdpHPB
 SG_ FLR2RdrObject20To21MtnPattern0 : 183|4@1+ (1,0) [0|15] "" FLRdpHPA,FLRdpHPB
 SG_ FLR2RdrObject20To21MtnPattern1 : 342|4@1+ (1,0) [0|15] "" FLRdpHPA,FLRdpHPB
 SG_ FLR2RdrObject20To21PedMicroDoppler0 : 187|1@1+ (1.0,0.0) [0.0|1.0] "Unitless" FLRdpHPA,FLRdpHPB
 SG_ FLR2RdrObject20To21PedMicroDoppler1 : 346|1@1+ (1.0,0.0) [0.0|1.0] "Unitless" FLRdpHPA,FLRdpHPB
 SG_ FLR2RdrObject20To21Qly0 : 188|7@1+ (1.0,0.0) [0.0|100.0] "Unitless" FLRdpHPA,FLRdpHPB
 SG_ FLR2RdrObject20To21Qly1 : 347|7@1+ (1.0,0.0) [0.0|100.0] "Unitless" FLRdpHPA,FLRdpHPB
 SG_ FLR2RdrObject20To21ScanID : 24|8@1+ (1.0,0.0) [0.0|255.0] "Unitless" FLRdpHPA,FLRdpHPB

BO_ 342 FlrFlr1canFr92 : 64 FLR
 SG_ FLR2RdrObject22To23_UB : 367|1@0+ (1,0) [0|1] "" FLRdpHPA,FLRdpHPB
 SG_ FLR2RdrObject22To23Class0 : 36|2@1+ (1,0) [0|3] "" FLRdpHPA,FLRdpHPB
 SG_ FLR2RdrObject22To23Class1 : 195|2@1+ (1,0) [0|3] "" FLRdpHPA,FLRdpHPB
 SG_ FLR2RdrObject22To23Counter : 16|8@1+ (1.0,0.0) [0.0|255.0] "Unitless" FLRdpHPA,FLRdpHPB
 SG_ FLR2RdrObject22To23CRC : 0|16@1+ (1.0,0.0) [0.0|65535.0] "Unitless" FLRdpHPA,FLRdpHPB
 SG_ FLR2RdrObject22To23DataCoastCntr0 : 38|3@1+ (1,0) [0|7] "" FLRdpHPA,FLRdpHPB
 SG_ FLR2RdrObject22To23DataCoastCntr1 : 197|3@1+ (1,0) [0|7] "" FLRdpHPA,FLRdpHPB
 SG_ FLR2RdrObject22To23DataConf0 : 41|7@1+ (1.0,0.0) [0.0|100.0] "%" FLRdpHPA,FLRdpHPB
 SG_ FLR2RdrObject22To23DataConf1 : 200|7@1+ (1.0,0.0) [0.0|100.0] "%" FLRdpHPA,FLRdpHPB
 SG_ FLR2RdrObject22To23DataLen0 : 48|8@1+ (0.2,0.0) [0.0|30.0] "m" FLRdpHPA,FLRdpHPB
 SG_ FLR2RdrObject22To23DataLen1 : 207|8@1+ (0.2,0.0) [0.0|30.0] "m" FLRdpHPA,FLRdpHPB
 SG_ FLR2RdrObject22To23DataStDLatAcc0 : 56|5@1+ (0.35,0.0) [0.0|10.85] "m/s^2" FLRdpHPA,FLRdpHPB
 SG_ FLR2RdrObject22To23DataStDLatAcc1 : 215|5@1+ (0.35,0.0) [0.0|10.85] "m/s^2" FLRdpHPA,FLRdpHPB
 SG_ FLR2RdrObject22To23DataStDLatPos0 : 61|8@1+ (0.1,0.0) [0.0|25.5] "m" FLRdpHPA,FLRdpHPB
 SG_ FLR2RdrObject22To23DataStDLatPos1 : 220|8@1+ (0.1,0.0) [0.0|25.5] "m" FLRdpHPA,FLRdpHPB
 SG_ FLR2RdrObject22To23DataStDLatVelo0 : 69|6@1+ (0.2,0.0) [0.0|12.600000000000001] "m/s" FLRdpHPA,FLRdpHPB
 SG_ FLR2RdrObject22To23DataStDLatVelo1 : 228|6@1+ (0.2,0.0) [0.0|12.600000000000001] "m/s" FLRdpHPA,FLRdpHPB
 SG_ FLR2RdrObject22To23DataStDLgtAcc0 : 75|5@1+ (0.35,0.0) [0.0|10.85] "m/s^2" FLRdpHPA,FLRdpHPB
 SG_ FLR2RdrObject22To23DataStDLgtAcc1 : 234|5@1+ (0.35,0.0) [0.0|10.85] "m/s^2" FLRdpHPA,FLRdpHPB
 SG_ FLR2RdrObject22To23DataStDLgtPos0 : 80|8@1+ (0.05,0.0) [0.0|12.75] "m" FLRdpHPA,FLRdpHPB
 SG_ FLR2RdrObject22To23DataStDLgtPos1 : 239|8@1+ (0.05,0.0) [0.0|12.75] "m" FLRdpHPA,FLRdpHPB
 SG_ FLR2RdrObject22To23DataStDLgtVelo0 : 88|6@1+ (0.2,0.0) [0.0|12.600000000000001] "m/s" FLRdpHPA,FLRdpHPB
 SG_ FLR2RdrObject22To23DataStDLgtVelo1 : 247|6@1+ (0.2,0.0) [0.0|12.600000000000001] "m/s" FLRdpHPA,FLRdpHPB
 SG_ FLR2RdrObject22To23DataWidth0 : 94|7@1+ (0.2,0.0) [0.0|15.0] "m" FLRdpHPA,FLRdpHPB
 SG_ FLR2RdrObject22To23DataWidth1 : 253|7@1+ (0.2,0.0) [0.0|15.0] "m" FLRdpHPA,FLRdpHPB
 SG_ FLR2RdrObject22To23HeadingAng0 : 101|10@1+ (0.01,-3.15) [-3.15|3.15] "rad" FLRdpHPA,FLRdpHPB
 SG_ FLR2RdrObject22To23HeadingAng1 : 260|10@1+ (0.01,-3.15) [-3.15|3.15] "rad" FLRdpHPA,FLRdpHPB
 SG_ FLR2RdrObject22To23LatAcc0 : 111|10@1+ (0.125,-44.5) [-44.5|44.5] "m/s^2" FLRdpHPA,FLRdpHPB
 SG_ FLR2RdrObject22To23LatAcc1 : 270|10@1+ (0.125,-44.5) [-44.5|44.5] "m/s^2" FLRdpHPA,FLRdpHPB
 SG_ FLR2RdrObject22To23LatPos0 : 121|13@1+ (0.0625,-255.9375) [-255.9375|255.9375] "Unitless" FLRdpHPA,FLRdpHPB
 SG_ FLR2RdrObject22To23LatPos1 : 280|13@1+ (0.0625,-255.9375) [-255.9375|255.9375] "Unitless" FLRdpHPA,FLRdpHPB
 SG_ FLR2RdrObject22To23LatVelo0 : 134|11@1+ (0.125,-128.0) [-128.0|127.875] "m/s" FLRdpHPA,FLRdpHPB
 SG_ FLR2RdrObject22To23LatVelo1 : 293|11@1+ (0.125,-128.0) [-128.0|127.875] "m/s" FLRdpHPA,FLRdpHPB
 SG_ FLR2RdrObject22To23LgtAcc0 : 145|10@1+ (0.125,-44.5) [-44.5|44.5] "m/s^2" FLRdpHPA,FLRdpHPB
 SG_ FLR2RdrObject22To23LgtAcc1 : 304|10@1+ (0.125,-44.5) [-44.5|44.5] "m/s^2" FLRdpHPA,FLRdpHPB
 SG_ FLR2RdrObject22To23LgtPos0 : 155|13@1+ (0.0625,-255.9375) [-255.9375|255.9375] "Unitless" FLRdpHPA,FLRdpHPB
 SG_ FLR2RdrObject22To23LgtPos1 : 314|13@1+ (0.0625,-255.9375) [-255.9375|255.9375] "Unitless" FLRdpHPA,FLRdpHPB
 SG_ FLR2RdrObject22To23LgtVelo0 : 168|11@1+ (0.125,-128.0) [-128.0|127.875] "m/s" FLRdpHPA,FLRdpHPB
 SG_ FLR2RdrObject22To23LgtVelo1 : 327|11@1+ (0.125,-128.0) [-128.0|127.875] "m/s" FLRdpHPA,FLRdpHPB
 SG_ FLR2RdrObject22To23ModeInfo0 : 179|2@1+ (1,0) [0|3] "" FLRdpHPA,FLRdpHPB
 SG_ FLR2RdrObject22To23ModeInfo1 : 338|2@1+ (1,0) [0|3] "" FLRdpHPA,FLRdpHPB
 SG_ FLR2RdrObject22To23MsgCntr : 32|4@1+ (1.0,0.0) [0.0|15.0] "Unitless" FLRdpHPA,FLRdpHPB
 SG_ FLR2RdrObject22To23MtnModel0 : 181|2@1+ (1.0,0.0) [0.0|3.0] "Unitless" FLRdpHPA,FLRdpHPB
 SG_ FLR2RdrObject22To23MtnModel1 : 340|2@1+ (1.0,0.0) [0.0|3.0] "Unitless" FLRdpHPA,FLRdpHPB
 SG_ FLR2RdrObject22To23MtnPattern0 : 183|4@1+ (1,0) [0|15] "" FLRdpHPA,FLRdpHPB
 SG_ FLR2RdrObject22To23MtnPattern1 : 342|4@1+ (1,0) [0|15] "" FLRdpHPA,FLRdpHPB
 SG_ FLR2RdrObject22To23PedMicroDoppler0 : 187|1@1+ (1.0,0.0) [0.0|1.0] "Unitless" FLRdpHPA,FLRdpHPB
 SG_ FLR2RdrObject22To23PedMicroDoppler1 : 346|1@1+ (1.0,0.0) [0.0|1.0] "Unitless" FLRdpHPA,FLRdpHPB
 SG_ FLR2RdrObject22To23Qly0 : 188|7@1+ (1.0,0.0) [0.0|100.0] "Unitless" FLRdpHPA,FLRdpHPB
 SG_ FLR2RdrObject22To23Qly1 : 347|7@1+ (1.0,0.0) [0.0|100.0] "Unitless" FLRdpHPA,FLRdpHPB
 SG_ FLR2RdrObject22To23ScanID : 24|8@1+ (1.0,0.0) [0.0|255.0] "Unitless" FLRdpHPA,FLRdpHPB

BO_ 344 FlrFlr1canFr93 : 64 FLR
 SG_ FLR2RdrObject24To25_UB : 367|1@0+ (1,0) [0|1] "" FLRdpHPA,FLRdpHPB
 SG_ FLR2RdrObject24To25Class0 : 36|2@1+ (1,0) [0|3] "" FLRdpHPA,FLRdpHPB
 SG_ FLR2RdrObject24To25Class1 : 195|2@1+ (1,0) [0|3] "" FLRdpHPA,FLRdpHPB
 SG_ FLR2RdrObject24To25Counter : 16|8@1+ (1.0,0.0) [0.0|255.0] "Unitless" FLRdpHPA,FLRdpHPB
 SG_ FLR2RdrObject24To25CRC : 0|16@1+ (1.0,0.0) [0.0|65535.0] "Unitless" FLRdpHPA,FLRdpHPB
 SG_ FLR2RdrObject24To25DataCoastCntr0 : 38|3@1+ (1,0) [0|7] "" FLRdpHPA,FLRdpHPB
 SG_ FLR2RdrObject24To25DataCoastCntr1 : 197|3@1+ (1,0) [0|7] "" FLRdpHPA,FLRdpHPB
 SG_ FLR2RdrObject24To25DataConf0 : 41|7@1+ (1.0,0.0) [0.0|100.0] "%" FLRdpHPA,FLRdpHPB
 SG_ FLR2RdrObject24To25DataConf1 : 200|7@1+ (1.0,0.0) [0.0|100.0] "%" FLRdpHPA,FLRdpHPB
 SG_ FLR2RdrObject24To25DataLen0 : 48|8@1+ (0.2,0.0) [0.0|30.0] "m" FLRdpHPA,FLRdpHPB
 SG_ FLR2RdrObject24To25DataLen1 : 207|8@1+ (0.2,0.0) [0.0|30.0] "m" FLRdpHPA,FLRdpHPB
 SG_ FLR2RdrObject24To25DataStDLatAcc0 : 56|5@1+ (0.35,0.0) [0.0|10.85] "m/s^2" FLRdpHPA,FLRdpHPB
 SG_ FLR2RdrObject24To25DataStDLatAcc1 : 215|5@1+ (0.35,0.0) [0.0|10.85] "m/s^2" FLRdpHPA,FLRdpHPB
 SG_ FLR2RdrObject24To25DataStDLatPos0 : 61|8@1+ (0.1,0.0) [0.0|25.5] "m" FLRdpHPA,FLRdpHPB
 SG_ FLR2RdrObject24To25DataStDLatPos1 : 220|8@1+ (0.1,0.0) [0.0|25.5] "m" FLRdpHPA,FLRdpHPB
 SG_ FLR2RdrObject24To25DataStDLatVelo0 : 69|6@1+ (0.2,0.0) [0.0|12.600000000000001] "m/s" FLRdpHPA,FLRdpHPB
 SG_ FLR2RdrObject24To25DataStDLatVelo1 : 228|6@1+ (0.2,0.0) [0.0|12.600000000000001] "m/s" FLRdpHPA,FLRdpHPB
 SG_ FLR2RdrObject24To25DataStDLgtAcc0 : 75|5@1+ (0.35,0.0) [0.0|10.85] "m/s^2" FLRdpHPA,FLRdpHPB
 SG_ FLR2RdrObject24To25DataStDLgtAcc1 : 234|5@1+ (0.35,0.0) [0.0|10.85] "m/s^2" FLRdpHPA,FLRdpHPB
 SG_ FLR2RdrObject24To25DataStDLgtPos0 : 80|8@1+ (0.05,0.0) [0.0|12.75] "m" FLRdpHPA,FLRdpHPB
 SG_ FLR2RdrObject24To25DataStDLgtPos1 : 239|8@1+ (0.05,0.0) [0.0|12.75] "m" FLRdpHPA,FLRdpHPB
 SG_ FLR2RdrObject24To25DataStDLgtVelo0 : 88|6@1+ (0.2,0.0) [0.0|12.600000000000001] "m/s" FLRdpHPA,FLRdpHPB
 SG_ FLR2RdrObject24To25DataStDLgtVelo1 : 247|6@1+ (0.2,0.0) [0.0|12.600000000000001] "m/s" FLRdpHPA,FLRdpHPB
 SG_ FLR2RdrObject24To25DataWidth0 : 94|7@1+ (0.2,0.0) [0.0|15.0] "m" FLRdpHPA,FLRdpHPB
 SG_ FLR2RdrObject24To25DataWidth1 : 253|7@1+ (0.2,0.0) [0.0|15.0] "m" FLRdpHPA,FLRdpHPB
 SG_ FLR2RdrObject24To25HeadingAng0 : 101|10@1+ (0.01,-3.15) [-3.15|3.15] "rad" FLRdpHPA,FLRdpHPB
 SG_ FLR2RdrObject24To25HeadingAng1 : 260|10@1+ (0.01,-3.15) [-3.15|3.15] "rad" FLRdpHPA,FLRdpHPB
 SG_ FLR2RdrObject24To25LatAcc0 : 111|10@1+ (0.125,-44.5) [-44.5|44.5] "m/s^2" FLRdpHPA,FLRdpHPB
 SG_ FLR2RdrObject24To25LatAcc1 : 270|10@1+ (0.125,-44.5) [-44.5|44.5] "m/s^2" FLRdpHPA,FLRdpHPB
 SG_ FLR2RdrObject24To25LatPos0 : 121|13@1+ (0.0625,-255.9375) [-255.9375|255.9375] "Unitless" FLRdpHPA,FLRdpHPB
 SG_ FLR2RdrObject24To25LatPos1 : 280|13@1+ (0.0625,-255.9375) [-255.9375|255.9375] "Unitless" FLRdpHPA,FLRdpHPB
 SG_ FLR2RdrObject24To25LatVelo0 : 134|11@1+ (0.125,-128.0) [-128.0|127.875] "m/s" FLRdpHPA,FLRdpHPB
 SG_ FLR2RdrObject24To25LatVelo1 : 293|11@1+ (0.125,-128.0) [-128.0|127.875] "m/s" FLRdpHPA,FLRdpHPB
 SG_ FLR2RdrObject24To25LgtAcc0 : 145|10@1+ (0.125,-44.5) [-44.5|44.5] "m/s^2" FLRdpHPA,FLRdpHPB
 SG_ FLR2RdrObject24To25LgtAcc1 : 304|10@1+ (0.125,-44.5) [-44.5|44.5] "m/s^2" FLRdpHPA,FLRdpHPB
 SG_ FLR2RdrObject24To25LgtPos0 : 155|13@1+ (0.0625,-255.9375) [-255.9375|255.9375] "Unitless" FLRdpHPA,FLRdpHPB
 SG_ FLR2RdrObject24To25LgtPos1 : 314|13@1+ (0.0625,-255.9375) [-255.9375|255.9375] "Unitless" FLRdpHPA,FLRdpHPB
 SG_ FLR2RdrObject24To25LgtVelo0 : 168|11@1+ (0.125,-128.0) [-128.0|127.875] "m/s" FLRdpHPA,FLRdpHPB
 SG_ FLR2RdrObject24To25LgtVelo1 : 327|11@1+ (0.125,-128.0) [-128.0|127.875] "m/s" FLRdpHPA,FLRdpHPB
 SG_ FLR2RdrObject24To25ModeInfo0 : 179|2@1+ (1,0) [0|3] "" FLRdpHPA,FLRdpHPB
 SG_ FLR2RdrObject24To25ModeInfo1 : 338|2@1+ (1,0) [0|3] "" FLRdpHPA,FLRdpHPB
 SG_ FLR2RdrObject24To25MsgCntr : 32|4@1+ (1.0,0.0) [0.0|15.0] "Unitless" FLRdpHPA,FLRdpHPB
 SG_ FLR2RdrObject24To25MtnModel0 : 181|2@1+ (1.0,0.0) [0.0|3.0] "Unitless" FLRdpHPA,FLRdpHPB
 SG_ FLR2RdrObject24To25MtnModel1 : 340|2@1+ (1.0,0.0) [0.0|3.0] "Unitless" FLRdpHPA,FLRdpHPB
 SG_ FLR2RdrObject24To25MtnPattern0 : 183|4@1+ (1,0) [0|15] "" FLRdpHPA,FLRdpHPB
 SG_ FLR2RdrObject24To25MtnPattern1 : 342|4@1+ (1,0) [0|15] "" FLRdpHPA,FLRdpHPB
 SG_ FLR2RdrObject24To25PedMicroDoppler0 : 187|1@1+ (1.0,0.0) [0.0|1.0] "Unitless" FLRdpHPA,FLRdpHPB
 SG_ FLR2RdrObject24To25PedMicroDoppler1 : 346|1@1+ (1.0,0.0) [0.0|1.0] "Unitless" FLRdpHPA,FLRdpHPB
 SG_ FLR2RdrObject24To25Qly0 : 188|7@1+ (1.0,0.0) [0.0|100.0] "Unitless" FLRdpHPA,FLRdpHPB
 SG_ FLR2RdrObject24To25Qly1 : 347|7@1+ (1.0,0.0) [0.0|100.0] "Unitless" FLRdpHPA,FLRdpHPB
 SG_ FLR2RdrObject24To25ScanID : 24|8@1+ (1.0,0.0) [0.0|255.0] "Unitless" FLRdpHPA,FLRdpHPB

BO_ 346 FlrFlr1canFr94 : 64 FLR
 SG_ FLR2RdrObject26To27_UB : 367|1@0+ (1,0) [0|1] "" FLRdpHPA,FLRdpHPB
 SG_ FLR2RdrObject26To27Class0 : 36|2@1+ (1,0) [0|3] "" FLRdpHPA,FLRdpHPB
 SG_ FLR2RdrObject26To27Class1 : 195|2@1+ (1,0) [0|3] "" FLRdpHPA,FLRdpHPB
 SG_ FLR2RdrObject26To27Counter : 16|8@1+ (1.0,0.0) [0.0|255.0] "Unitless" FLRdpHPA,FLRdpHPB
 SG_ FLR2RdrObject26To27CRC : 0|16@1+ (1.0,0.0) [0.0|65535.0] "Unitless" FLRdpHPA,FLRdpHPB
 SG_ FLR2RdrObject26To27DataCoastCntr0 : 38|3@1+ (1,0) [0|7] "" FLRdpHPA,FLRdpHPB
 SG_ FLR2RdrObject26To27DataCoastCntr1 : 197|3@1+ (1,0) [0|7] "" FLRdpHPA,FLRdpHPB
 SG_ FLR2RdrObject26To27DataConf0 : 41|7@1+ (1.0,0.0) [0.0|100.0] "%" FLRdpHPA,FLRdpHPB
 SG_ FLR2RdrObject26To27DataConf1 : 200|7@1+ (1.0,0.0) [0.0|100.0] "%" FLRdpHPA,FLRdpHPB
 SG_ FLR2RdrObject26To27DataLen0 : 48|8@1+ (0.2,0.0) [0.0|30.0] "m" FLRdpHPA,FLRdpHPB
 SG_ FLR2RdrObject26To27DataLen1 : 207|8@1+ (0.2,0.0) [0.0|30.0] "m" FLRdpHPA,FLRdpHPB
 SG_ FLR2RdrObject26To27DataStDLatAcc0 : 56|5@1+ (0.35,0.0) [0.0|10.85] "m/s^2" FLRdpHPA,FLRdpHPB
 SG_ FLR2RdrObject26To27DataStDLatAcc1 : 215|5@1+ (0.35,0.0) [0.0|10.85] "m/s^2" FLRdpHPA,FLRdpHPB
 SG_ FLR2RdrObject26To27DataStDLatPos0 : 61|8@1+ (0.1,0.0) [0.0|25.5] "m" FLRdpHPA,FLRdpHPB
 SG_ FLR2RdrObject26To27DataStDLatPos1 : 220|8@1+ (0.1,0.0) [0.0|25.5] "m" FLRdpHPA,FLRdpHPB
 SG_ FLR2RdrObject26To27DataStDLatVelo0 : 69|6@1+ (0.2,0.0) [0.0|12.600000000000001] "m/s" FLRdpHPA,FLRdpHPB
 SG_ FLR2RdrObject26To27DataStDLatVelo1 : 228|6@1+ (0.2,0.0) [0.0|12.600000000000001] "m/s" FLRdpHPA,FLRdpHPB
 SG_ FLR2RdrObject26To27DataStDLgtAcc0 : 75|5@1+ (0.35,0.0) [0.0|10.85] "m/s^2" FLRdpHPA,FLRdpHPB
 SG_ FLR2RdrObject26To27DataStDLgtAcc1 : 234|5@1+ (0.35,0.0) [0.0|10.85] "m/s^2" FLRdpHPA,FLRdpHPB
 SG_ FLR2RdrObject26To27DataStDLgtPos0 : 80|8@1+ (0.05,0.0) [0.0|12.75] "m" FLRdpHPA,FLRdpHPB
 SG_ FLR2RdrObject26To27DataStDLgtPos1 : 239|8@1+ (0.05,0.0) [0.0|12.75] "m" FLRdpHPA,FLRdpHPB
 SG_ FLR2RdrObject26To27DataStDLgtVelo0 : 88|6@1+ (0.2,0.0) [0.0|12.600000000000001] "m/s" FLRdpHPA,FLRdpHPB
 SG_ FLR2RdrObject26To27DataStDLgtVelo1 : 247|6@1+ (0.2,0.0) [0.0|12.600000000000001] "m/s" FLRdpHPA,FLRdpHPB
 SG_ FLR2RdrObject26To27DataWidth0 : 94|7@1+ (0.2,0.0) [0.0|15.0] "m" FLRdpHPA,FLRdpHPB
 SG_ FLR2RdrObject26To27DataWidth1 : 253|7@1+ (0.2,0.0) [0.0|15.0] "m" FLRdpHPA,FLRdpHPB
 SG_ FLR2RdrObject26To27HeadingAng0 : 101|10@1+ (0.01,-3.15) [-3.15|3.15] "rad" FLRdpHPA,FLRdpHPB
 SG_ FLR2RdrObject26To27HeadingAng1 : 260|10@1+ (0.01,-3.15) [-3.15|3.15] "rad" FLRdpHPA,FLRdpHPB
 SG_ FLR2RdrObject26To27LatAcc0 : 111|10@1+ (0.125,-44.5) [-44.5|44.5] "m/s^2" FLRdpHPA,FLRdpHPB
 SG_ FLR2RdrObject26To27LatAcc1 : 270|10@1+ (0.125,-44.5) [-44.5|44.5] "m/s^2" FLRdpHPA,FLRdpHPB
 SG_ FLR2RdrObject26To27LatPos0 : 121|13@1+ (0.0625,-255.9375) [-255.9375|255.9375] "Unitless" FLRdpHPA,FLRdpHPB
 SG_ FLR2RdrObject26To27LatPos1 : 280|13@1+ (0.0625,-255.9375) [-255.9375|255.9375] "Unitless" FLRdpHPA,FLRdpHPB
 SG_ FLR2RdrObject26To27LatVelo0 : 134|11@1+ (0.125,-128.0) [-128.0|127.875] "m/s" FLRdpHPA,FLRdpHPB
 SG_ FLR2RdrObject26To27LatVelo1 : 293|11@1+ (0.125,-128.0) [-128.0|127.875] "m/s" FLRdpHPA,FLRdpHPB
 SG_ FLR2RdrObject26To27LgtAcc0 : 145|10@1+ (0.125,-44.5) [-44.5|44.5] "m/s^2" FLRdpHPA,FLRdpHPB
 SG_ FLR2RdrObject26To27LgtAcc1 : 304|10@1+ (0.125,-44.5) [-44.5|44.5] "m/s^2" FLRdpHPA,FLRdpHPB
 SG_ FLR2RdrObject26To27LgtPos0 : 155|13@1+ (0.0625,-255.9375) [-255.9375|255.9375] "Unitless" FLRdpHPA,FLRdpHPB
 SG_ FLR2RdrObject26To27LgtPos1 : 314|13@1+ (0.0625,-255.9375) [-255.9375|255.9375] "Unitless" FLRdpHPA,FLRdpHPB
 SG_ FLR2RdrObject26To27LgtVelo0 : 168|11@1+ (0.125,-128.0) [-128.0|127.875] "m/s" FLRdpHPA,FLRdpHPB
 SG_ FLR2RdrObject26To27LgtVelo1 : 327|11@1+ (0.125,-128.0) [-128.0|127.875] "m/s" FLRdpHPA,FLRdpHPB
 SG_ FLR2RdrObject26To27ModeInfo0 : 179|2@1+ (1,0) [0|3] "" FLRdpHPA,FLRdpHPB
 SG_ FLR2RdrObject26To27ModeInfo1 : 338|2@1+ (1,0) [0|3] "" FLRdpHPA,FLRdpHPB
 SG_ FLR2RdrObject26To27MsgCntr : 32|4@1+ (1.0,0.0) [0.0|15.0] "Unitless" FLRdpHPA,FLRdpHPB
 SG_ FLR2RdrObject26To27MtnModel0 : 181|2@1+ (1.0,0.0) [0.0|3.0] "Unitless" FLRdpHPA,FLRdpHPB
 SG_ FLR2RdrObject26To27MtnModel1 : 340|2@1+ (1.0,0.0) [0.0|3.0] "Unitless" FLRdpHPA,FLRdpHPB
 SG_ FLR2RdrObject26To27MtnPattern0 : 183|4@1+ (1,0) [0|15] "" FLRdpHPA,FLRdpHPB
 SG_ FLR2RdrObject26To27MtnPattern1 : 342|4@1+ (1,0) [0|15] "" FLRdpHPA,FLRdpHPB
 SG_ FLR2RdrObject26To27PedMicroDoppler0 : 187|1@1+ (1.0,0.0) [0.0|1.0] "Unitless" FLRdpHPA,FLRdpHPB
 SG_ FLR2RdrObject26To27PedMicroDoppler1 : 346|1@1+ (1.0,0.0) [0.0|1.0] "Unitless" FLRdpHPA,FLRdpHPB
 SG_ FLR2RdrObject26To27Qly0 : 188|7@1+ (1.0,0.0) [0.0|100.0] "Unitless" FLRdpHPA,FLRdpHPB
 SG_ FLR2RdrObject26To27Qly1 : 347|7@1+ (1.0,0.0) [0.0|100.0] "Unitless" FLRdpHPA,FLRdpHPB
 SG_ FLR2RdrObject26To27ScanID : 24|8@1+ (1.0,0.0) [0.0|255.0] "Unitless" FLRdpHPA,FLRdpHPB

BO_ 348 FlrFlr1canFr95 : 64 FLR
 SG_ FLR2RdrObject28To29_UB : 367|1@0+ (1,0) [0|1] "" FLRdpHPA,FLRdpHPB
 SG_ FLR2RdrObject28To29Class0 : 36|2@1+ (1,0) [0|3] "" FLRdpHPA,FLRdpHPB
 SG_ FLR2RdrObject28To29Class1 : 195|2@1+ (1,0) [0|3] "" FLRdpHPA,FLRdpHPB
 SG_ FLR2RdrObject28To29Counter : 16|8@1+ (1.0,0.0) [0.0|255.0] "Unitless" FLRdpHPA,FLRdpHPB
 SG_ FLR2RdrObject28To29CRC : 0|16@1+ (1.0,0.0) [0.0|65535.0] "Unitless" FLRdpHPA,FLRdpHPB
 SG_ FLR2RdrObject28To29DataCoastCntr0 : 38|3@1+ (1,0) [0|7] "" FLRdpHPA,FLRdpHPB
 SG_ FLR2RdrObject28To29DataCoastCntr1 : 197|3@1+ (1,0) [0|7] "" FLRdpHPA,FLRdpHPB
 SG_ FLR2RdrObject28To29DataConf0 : 41|7@1+ (1.0,0.0) [0.0|100.0] "%" FLRdpHPA,FLRdpHPB
 SG_ FLR2RdrObject28To29DataConf1 : 200|7@1+ (1.0,0.0) [0.0|100.0] "%" FLRdpHPA,FLRdpHPB
 SG_ FLR2RdrObject28To29DataLen0 : 48|8@1+ (0.2,0.0) [0.0|30.0] "m" FLRdpHPA,FLRdpHPB
 SG_ FLR2RdrObject28To29DataLen1 : 207|8@1+ (0.2,0.0) [0.0|30.0] "m" FLRdpHPA,FLRdpHPB
 SG_ FLR2RdrObject28To29DataStDLatAcc0 : 56|5@1+ (0.35,0.0) [0.0|10.85] "m/s^2" FLRdpHPA,FLRdpHPB
 SG_ FLR2RdrObject28To29DataStDLatAcc1 : 215|5@1+ (0.35,0.0) [0.0|10.85] "m/s^2" FLRdpHPA,FLRdpHPB
 SG_ FLR2RdrObject28To29DataStDLatPos0 : 61|8@1+ (0.1,0.0) [0.0|25.5] "m" FLRdpHPA,FLRdpHPB
 SG_ FLR2RdrObject28To29DataStDLatPos1 : 220|8@1+ (0.1,0.0) [0.0|25.5] "m" FLRdpHPA,FLRdpHPB
 SG_ FLR2RdrObject28To29DataStDLatVelo0 : 69|6@1+ (0.2,0.0) [0.0|12.600000000000001] "m/s" FLRdpHPA,FLRdpHPB
 SG_ FLR2RdrObject28To29DataStDLatVelo1 : 228|6@1+ (0.2,0.0) [0.0|12.600000000000001] "m/s" FLRdpHPA,FLRdpHPB
 SG_ FLR2RdrObject28To29DataStDLgtAcc0 : 75|5@1+ (0.35,0.0) [0.0|10.85] "m/s^2" FLRdpHPA,FLRdpHPB
 SG_ FLR2RdrObject28To29DataStDLgtAcc1 : 234|5@1+ (0.35,0.0) [0.0|10.85] "m/s^2" FLRdpHPA,FLRdpHPB
 SG_ FLR2RdrObject28To29DataStDLgtPos0 : 80|8@1+ (0.05,0.0) [0.0|12.75] "m" FLRdpHPA,FLRdpHPB
 SG_ FLR2RdrObject28To29DataStDLgtPos1 : 239|8@1+ (0.05,0.0) [0.0|12.75] "m" FLRdpHPA,FLRdpHPB
 SG_ FLR2RdrObject28To29DataStDLgtVelo0 : 88|6@1+ (0.2,0.0) [0.0|12.600000000000001] "m/s" FLRdpHPA,FLRdpHPB
 SG_ FLR2RdrObject28To29DataStDLgtVelo1 : 247|6@1+ (0.2,0.0) [0.0|12.600000000000001] "m/s" FLRdpHPA,FLRdpHPB
 SG_ FLR2RdrObject28To29DataWidth0 : 94|7@1+ (0.2,0.0) [0.0|15.0] "m" FLRdpHPA,FLRdpHPB
 SG_ FLR2RdrObject28To29DataWidth1 : 253|7@1+ (0.2,0.0) [0.0|15.0] "m" FLRdpHPA,FLRdpHPB
 SG_ FLR2RdrObject28To29HeadingAng0 : 101|10@1+ (0.01,-3.15) [-3.15|3.15] "rad" FLRdpHPA,FLRdpHPB
 SG_ FLR2RdrObject28To29HeadingAng1 : 260|10@1+ (0.01,-3.15) [-3.15|3.15] "rad" FLRdpHPA,FLRdpHPB
 SG_ FLR2RdrObject28To29LatAcc0 : 111|10@1+ (0.125,-44.5) [-44.5|44.5] "m/s^2" FLRdpHPA,FLRdpHPB
 SG_ FLR2RdrObject28To29LatAcc1 : 270|10@1+ (0.125,-44.5) [-44.5|44.5] "m/s^2" FLRdpHPA,FLRdpHPB
 SG_ FLR2RdrObject28To29LatPos0 : 121|13@1+ (0.0625,-255.9375) [-255.9375|255.9375] "Unitless" FLRdpHPA,FLRdpHPB
 SG_ FLR2RdrObject28To29LatPos1 : 280|13@1+ (0.0625,-255.9375) [-255.9375|255.9375] "Unitless" FLRdpHPA,FLRdpHPB
 SG_ FLR2RdrObject28To29LatVelo0 : 134|11@1+ (0.125,-128.0) [-128.0|127.875] "m/s" FLRdpHPA,FLRdpHPB
 SG_ FLR2RdrObject28To29LatVelo1 : 293|11@1+ (0.125,-128.0) [-128.0|127.875] "m/s" FLRdpHPA,FLRdpHPB
 SG_ FLR2RdrObject28To29LgtAcc0 : 145|10@1+ (0.125,-44.5) [-44.5|44.5] "m/s^2" FLRdpHPA,FLRdpHPB
 SG_ FLR2RdrObject28To29LgtAcc1 : 304|10@1+ (0.125,-44.5) [-44.5|44.5] "m/s^2" FLRdpHPA,FLRdpHPB
 SG_ FLR2RdrObject28To29LgtPos0 : 155|13@1+ (0.0625,-255.9375) [-255.9375|255.9375] "Unitless" FLRdpHPA,FLRdpHPB
 SG_ FLR2RdrObject28To29LgtPos1 : 314|13@1+ (0.0625,-255.9375) [-255.9375|255.9375] "Unitless" FLRdpHPA,FLRdpHPB
 SG_ FLR2RdrObject28To29LgtVelo0 : 168|11@1+ (0.125,-128.0) [-128.0|127.875] "m/s" FLRdpHPA,FLRdpHPB
 SG_ FLR2RdrObject28To29LgtVelo1 : 327|11@1+ (0.125,-128.0) [-128.0|127.875] "m/s" FLRdpHPA,FLRdpHPB
 SG_ FLR2RdrObject28To29ModeInfo0 : 179|2@1+ (1,0) [0|3] "" FLRdpHPA,FLRdpHPB
 SG_ FLR2RdrObject28To29ModeInfo1 : 338|2@1+ (1,0) [0|3] "" FLRdpHPA,FLRdpHPB
 SG_ FLR2RdrObject28To29MsgCntr : 32|4@1+ (1.0,0.0) [0.0|15.0] "Unitless" FLRdpHPA,FLRdpHPB
 SG_ FLR2RdrObject28To29MtnModel0 : 181|2@1+ (1.0,0.0) [0.0|3.0] "Unitless" FLRdpHPA,FLRdpHPB
 SG_ FLR2RdrObject28To29MtnModel1 : 340|2@1+ (1.0,0.0) [0.0|3.0] "Unitless" FLRdpHPA,FLRdpHPB
 SG_ FLR2RdrObject28To29MtnPattern0 : 183|4@1+ (1,0) [0|15] "" FLRdpHPA,FLRdpHPB
 SG_ FLR2RdrObject28To29MtnPattern1 : 342|4@1+ (1,0) [0|15] "" FLRdpHPA,FLRdpHPB
 SG_ FLR2RdrObject28To29PedMicroDoppler0 : 187|1@1+ (1.0,0.0) [0.0|1.0] "Unitless" FLRdpHPA,FLRdpHPB
 SG_ FLR2RdrObject28To29PedMicroDoppler1 : 346|1@1+ (1.0,0.0) [0.0|1.0] "Unitless" FLRdpHPA,FLRdpHPB
 SG_ FLR2RdrObject28To29Qly0 : 188|7@1+ (1.0,0.0) [0.0|100.0] "Unitless" FLRdpHPA,FLRdpHPB
 SG_ FLR2RdrObject28To29Qly1 : 347|7@1+ (1.0,0.0) [0.0|100.0] "Unitless" FLRdpHPA,FLRdpHPB
 SG_ FLR2RdrObject28To29ScanID : 24|8@1+ (1.0,0.0) [0.0|255.0] "Unitless" FLRdpHPA,FLRdpHPB

BO_ 69 FlrFlr1canFr96 : 64 FLR
 SG_ FLR2SignalStatus_UB : 335|1@0+ (1,0) [0|1] "" FLRdpHPA,FLRdpHPB
 SG_ FLR2SignalStatusAziAngCor : 248|8@1+ (0.1,-12.8) [-12.8|12.7] "Deg" FLRdpHPA,FLRdpHPB
 SG_ FLR2SignalStatusBlockage : 258|2@1+ (1,0) [0|3] "" FLRdpHPA,FLRdpHPB
 SG_ FLR2SignalStatusCalPrgrsSts : 304|8@1+ (1.0,0.0) [0.0|255.0] "Unitless" FLRdpHPA,FLRdpHPB
 SG_ FLR2SignalStatusCalRltSts : 260|2@1+ (1,0) [0|3] "" FLRdpHPA,FLRdpHPB
 SG_ FLR2SignalStatusCalSts : 244|2@1+ (1,0) [0|3] "" FLRdpHPA,FLRdpHPB
 SG_ FLR2SignalStatusCommFltReason : 312|7@1+ (1,0) [0|127] "" FLRdpHPA,FLRdpHPB
 SG_ FLR2SignalStatusCounter : 16|8@1+ (1.0,0.0) [0.0|255.0] "Unitless" FLRdpHPA,FLRdpHPB
 SG_ FLR2SignalStatusCRC : 0|16@1+ (1.0,0.0) [0.0|65535.0] "Unitless" FLRdpHPA,FLRdpHPB
 SG_ FLR2SignalStatusEgoSpdEst : 152|15@1+ (0.00391,0.0) [0.0|125.0027] "m/s" FLRdpHPA,FLRdpHPB
 SG_ FLR2SignalStatusEgoYawRateEst : 272|16@1- (0.000244140625,0.0) [-6.0|6.0] "rad/s" FLRdpHPA,FLRdpHPB
 SG_ FLR2SignalStatusEleAngCor : 320|8@1+ (0.1,-12.8) [-12.8|12.7] "Deg" FLRdpHPA,FLRdpHPB
 SG_ FLR2SignalStatusFltReason : 168|5@1+ (1,0) [0|31] "" FLRdpHPA,FLRdpHPB
 SG_ FLR2SignalStatusIfVersMajor : 212|4@1+ (1.0,0.0) [0.0|15.0] "Unitless" FLRdpHPA,FLRdpHPB
 SG_ FLR2SignalStatusIfVersMinor : 228|4@1+ (1.0,0.0) [0.0|15.0] "Unitless" FLRdpHPA,FLRdpHPB
 SG_ FLR2SignalStatusInterference : 256|2@1+ (1,0) [0|3] "" FLRdpHPA,FLRdpHPB
 SG_ FLR2SignalStatusInternalTemp : 24|15@1+ (0.01,-40.0) [-40.0|215.0] "degC" FLRdpHPA,FLRdpHPB
 SG_ FLR2SignalStatusRdrIntSts : 173|3@1+ (1,0) [0|7] "" FLRdpHPA,FLRdpHPB
 SG_ FLR2SignalStatusRdrSts : 247|1@1+ (1,0) [0|1] "" FLRdpHPA,FLRdpHPB
 SG_ FLR2SignalStatusRdrTransAct : 263|1@1+ (1,0) [0|1] "" FLRdpHPA,FLRdpHPB
 SG_ FLR2SignalStatusScanIDSts : 176|8@1+ (1.0,0.0) [0.0|255.0] "Unitless" FLRdpHPA,FLRdpHPB
 SG_ FLR2SignalStatusSwVersMajor : 184|8@1+ (1.0,0.0) [0.0|255.0] "Unitless" FLRdpHPA,FLRdpHPB
 SG_ FLR2SignalStatusSwVersMinor : 192|8@1+ (1.0,0.0) [0.0|255.0] "Unitless" FLRdpHPA,FLRdpHPB
 SG_ FLR2SignalStatusSysFailFlag : 246|1@1+ (1,0) [0|1] "" FLRdpHPA,FLRdpHPB
 SG_ FLR2SignalStatusTimeStamp : 56|64@1+ (1.0,0.0) [0.0|0.0] "Milliseconds" FLRdpHPA,FLRdpHPB
 SG_ FLR2SignalStatusTimeStampStatus : 167|1@1+ (1,0) [0|1] "" FLRdpHPA,FLRdpHPB
 SG_ FLR2SignalStatusWhlCompFact : 264|5@1+ (0.005,0.92) [0.92|1.075] "Unitless" FLRdpHPA,FLRdpHPB
 SG_ FLR2SignalStatusXAxisOffs : 288|16@1+ (0.00145204372,-25.0) [-25.0|25.001125498200004] "m" FLRdpHPA,FLRdpHPB
 SG_ FLR2SignalStatusXOrientAng : 200|12@1+ (0.1,-180.0) [-180.0|180.0] "Deg" FLRdpHPA,FLRdpHPB
 SG_ FLR2SignalStatusYAxisOffs : 120|16@1+ (0.00145,-25.0) [-25.0|25.000349999999997] "m" FLRdpHPA,FLRdpHPB
 SG_ FLR2SignalStatusYOrientAng : 216|12@1+ (0.1,-180.0) [-180.0|180.0] "Deg" FLRdpHPA,FLRdpHPB
 SG_ FLR2SignalStatusZAxisOffs : 136|16@1+ (0.00145240648,-25.0) [-25.0|25.00054548048] "m" FLRdpHPA,FLRdpHPB
 SG_ FLR2SignalStatusZOrientAng : 232|12@1+ (0.1,-180.0) [-180.0|180.0] "Deg" FLRdpHPA,FLRdpHPB

BO_ 1617 FlrToFlrdpUdsDiagResponseFrame : 64 FLR
 SG_ FlrToFlrdpUdsFlrCanNPdu : 7|512@0+ (1,0) [0|0] "" FLRdpHPA

CM_ SG_ 69 FLR2SignalStatusAziAngCor "azimuth angle correction";
CM_ SG_ 69 FLR2SignalStatusCalPrgrsSts "The progress of current AutoAlignment (AA) or any other calibration processes";
CM_ SG_ 69 FLR2SignalStatusCalRltSts "The Evaluation of current AutoAlignment (AA) or any other calibration processes shall be reported in";
CM_ SG_ 69 FLR2SignalStatusCalSts "The Current status of VCC EOL or Service calibration algorithm shall be reported in FLR2SignalStatusCalSts";
CM_ SG_ 69 FLR2SignalStatusCommFltReason "Bit 0: vehiclemotionstate; Bit 1: CarConfig; Bit 2: VehicleModesProvider; Bit 3: GlobalSnapshot; Bit 4: FunInfo; Bit 5: Autosar Ts";
CM_ SG_ 69 FLR2SignalStatusEleAngCor "Elevation Angle Correction";
CM_ SG_ 69 FLR2SignalStatusFltReason "Bit 0: Comm Fault; Bit 1 :SW Fault ; Bit 2: HW Fault; Bit 3: Safety Fault ; Bit 4 : CarConfig Fault";
CM_ SG_ 69 FLR2SignalStatusIfVersMajor "DBC version indication.";
CM_ SG_ 69 FLR2SignalStatusIfVersMinor "DBC version indication.";
CM_ SG_ 69 FLR2SignalStatusInternalTemp "Internal Temperature";
CM_ SG_ 69 FLR2SignalStatusRdrSts "As long as an error is present, FLR2SignalStatusRdrSts shall be set to Faulty (0). Otherwise, FLR2SignalStatusRdrSts";
CM_ SG_ 69 FLR2SignalStatusRdrTransAct "FLR2SignalStatusRdrTransAct shall be considered a periodical acknologement for RdrActvnReq.";
CM_ SG_ 69 FLR2SignalStatusSwVersMajor "SW version indication";
CM_ SG_ 69 FLR2SignalStatusSwVersMinor "SW version indication";
CM_ SG_ 69 FLR2SignalStatusSysFailFlag "System safety failure indication";
CM_ SG_ 69 FLR2SignalStatusTimeStampStatus "Indication of timestamp status";
BA_DEF_ BO_ "CANFD_BRS" ENUM "0","1";
BA_DEF_ BO_ "GenMsgCycleTime" INT 0 65536; // [ms]
BA_DEF_ BO_ "GenMsgDelayTime" INT 0 65536; // [ms]
BA_DEF_ BO_ "GenMsgSendType" ENUM "cyclic", "spontaneous", "not-used", "not-used", "not-used", "cyclicAndSpontaneous", "not-used", "cyclicIfActive", "NoMsgSendType"; // [us]
BA_DEF_ BO_ "GenMsgStartDelayTime" INT 0 65536; // [ms]
BA_DEF_ BO_ "VFrameFormat" ENUM "StandardCAN","ExtendedCAN","reserved","J1939PG","reserved","reserved","reserved","reserved","reserved","reserved","reserved","reserved","reserved","reserved","StandardCAN_FD","ExtendedCAN_FD";
BA_DEF_ SG_ "GenSigSendType" ENUM "Cyclic","OnWrite","OnWriteWithRepetition","OnChange","OnChangeWithRepetition","IfActive","IfActiveWithRepetition","NoSigSendType";
BA_DEF_ SG_ "GenSigStartValue" HEX 0 80000000;
BA_DEF_ BO_ "GenMsgILSupport" ENUM "No","Yes";
BA_DEF_ BO_ "NmAsrMessage" ENUM "No","Yes";
BA_DEF_ SG_ "GenSigFuncType" ENUM "NoFunction","n/a","n/a","n/a","n/a","n/a","n/a","n/a","n/a","n/a","n/a","n/a","n/a","n/a","n/a","CHK","CNTR","n/a","n/a","n/a","CNTR_AR_01","CRC_AR_01_BOTH","CRC_AR_01_ALT","CRC_AR_01_LOW","CRC_AR_01_NIBBLE","CNTR_AR_04","CRC_AR_04A","CNTR_AR_05","CRC_AR_05";
BA_DEF_ SG_ "GenSigDataID" STRING;
BA_DEF_DEF_ "CANFD_BRS" "1";
BA_DEF_DEF_ "GenSigStartValue" 0;
BA_DEF_DEF_ "VFrameFormat" "J1939PG";
BA_DEF_DEF_ "GenSigSendType" "NoSigSendType";
BA_DEF_DEF_ "GenMsgCycleTime" 0;
BA_DEF_DEF_ "GenMsgDelayTime" 0;
BA_DEF_DEF_ "GenMsgStartDelayTime" 0;
BA_DEF_DEF_ "GenMsgSendType" "NoMsgSendType";
BA_DEF_DEF_ "GenMsgILSupport" "Yes";
BA_DEF_DEF_ "NmAsrMessage" "No";
BA_DEF_DEF_ "GenSigFuncType" "NoFunction";
BA_DEF_DEF_ "GenSigDataID" "";
// Frame: FlrFlr1canFr83
BA_ "GenMsgDelayTime" BO_ 324 40.000;
BA_ "GenMsgSendType" BO_ 324 1;
BA_ "VFrameFormat" BO_ 324 14;
// Frame: FlrFlr1canFr84
BA_ "GenMsgDelayTime" BO_ 326 40.000;
BA_ "GenMsgSendType" BO_ 326 1;
BA_ "VFrameFormat" BO_ 326 14;
// Frame: FlrFlr1canFr85
BA_ "GenMsgDelayTime" BO_ 328 40.000;
BA_ "GenMsgSendType" BO_ 328 1;
BA_ "VFrameFormat" BO_ 328 14;
// Frame: FlrFlr1canFr86
BA_ "GenMsgDelayTime" BO_ 330 40.000;
BA_ "GenMsgSendType" BO_ 330 1;
BA_ "VFrameFormat" BO_ 330 14;
// Frame: FlrFlr1canFr87
BA_ "GenMsgDelayTime" BO_ 332 40.000;
BA_ "GenMsgSendType" BO_ 332 1;
BA_ "VFrameFormat" BO_ 332 14;
// Frame: FlrFlr1canFr88
BA_ "GenMsgDelayTime" BO_ 334 40.000;
BA_ "GenMsgSendType" BO_ 334 1;
BA_ "VFrameFormat" BO_ 334 14;
// Frame: FlrFlr1canFr89
BA_ "GenMsgDelayTime" BO_ 336 40.000;
BA_ "GenMsgSendType" BO_ 336 1;
BA_ "VFrameFormat" BO_ 336 14;
// Frame: FlrFlr1canFr90
BA_ "GenMsgDelayTime" BO_ 338 40.000;
BA_ "GenMsgSendType" BO_ 338 1;
BA_ "VFrameFormat" BO_ 338 14;
// Frame: FlrFlr1canFr91
BA_ "GenMsgDelayTime" BO_ 340 40.000;
BA_ "GenMsgSendType" BO_ 340 1;
BA_ "VFrameFormat" BO_ 340 14;
// Frame: FlrFlr1canFr92
BA_ "GenMsgDelayTime" BO_ 342 40.000;
BA_ "GenMsgSendType" BO_ 342 1;
BA_ "VFrameFormat" BO_ 342 14;
// Frame: FlrFlr1canFr93
BA_ "GenMsgDelayTime" BO_ 344 40.000;
BA_ "GenMsgSendType" BO_ 344 1;
BA_ "VFrameFormat" BO_ 344 14;
// Frame: FlrFlr1canFr94
BA_ "GenMsgDelayTime" BO_ 346 40.000;
BA_ "GenMsgSendType" BO_ 346 1;
BA_ "VFrameFormat" BO_ 346 14;
// Frame: FlrFlr1canFr95
BA_ "GenMsgDelayTime" BO_ 348 40.000;
BA_ "GenMsgSendType" BO_ 348 1;
BA_ "VFrameFormat" BO_ 348 14;
// Frame: FlrFlr1canFr96
BA_ "GenMsgDelayTime" BO_ 69 40.000;
BA_ "GenMsgSendType" BO_ 69 1;
BA_ "VFrameFormat" BO_ 69 14;
// Frame: FlrToFlrdpUdsDiagResponseFrame
BA_ "GenMsgDelayTime" BO_ 1617 5.000;
BA_ "GenMsgSendType" BO_ 1617 1;
BA_ "VFrameFormat" BO_ 1617 14;
BA_ "GenSigDataID" SG_ 330 FLR2RdrObject10To11CRC "0x8D3";
BA_ "GenSigFuncType" SG_ 330 FLR2RdrObject10To11CRC 28;
BA_ "GenSigSendType" SG_ 330 FLR2RdrObject10To11CRC 1;
BA_ "GenSigSendType" SG_ 330 FLR2RdrObject10To11Class0 1;
BA_ "GenSigSendType" SG_ 330 FLR2RdrObject10To11Class1 1;
BA_ "GenSigFuncType" SG_ 330 FLR2RdrObject10To11Counter 27;
BA_ "GenSigSendType" SG_ 330 FLR2RdrObject10To11Counter 1;
BA_ "GenSigSendType" SG_ 330 FLR2RdrObject10To11DataCoastCntr0 1;
BA_ "GenSigSendType" SG_ 330 FLR2RdrObject10To11DataCoastCntr1 1;
BA_ "GenSigSendType" SG_ 330 FLR2RdrObject10To11DataConf0 1;
BA_ "GenSigSendType" SG_ 330 FLR2RdrObject10To11DataConf1 1;
BA_ "GenSigSendType" SG_ 330 FLR2RdrObject10To11DataLen0 1;
BA_ "GenSigSendType" SG_ 330 FLR2RdrObject10To11DataLen1 1;
BA_ "GenSigSendType" SG_ 330 FLR2RdrObject10To11DataStDLatAcc0 1;
BA_ "GenSigSendType" SG_ 330 FLR2RdrObject10To11DataStDLatAcc1 1;
BA_ "GenSigSendType" SG_ 330 FLR2RdrObject10To11DataStDLatPos0 1;
BA_ "GenSigSendType" SG_ 330 FLR2RdrObject10To11DataStDLatPos1 1;
BA_ "GenSigSendType" SG_ 330 FLR2RdrObject10To11DataStDLatVelo0 1;
BA_ "GenSigSendType" SG_ 330 FLR2RdrObject10To11DataStDLatVelo1 1;
BA_ "GenSigSendType" SG_ 330 FLR2RdrObject10To11DataStDLgtAcc0 1;
BA_ "GenSigSendType" SG_ 330 FLR2RdrObject10To11DataStDLgtAcc1 1;
BA_ "GenSigSendType" SG_ 330 FLR2RdrObject10To11DataStDLgtPos0 1;
BA_ "GenSigSendType" SG_ 330 FLR2RdrObject10To11DataStDLgtPos1 1;
BA_ "GenSigSendType" SG_ 330 FLR2RdrObject10To11DataStDLgtVelo0 1;
BA_ "GenSigSendType" SG_ 330 FLR2RdrObject10To11DataStDLgtVelo1 1;
BA_ "GenSigSendType" SG_ 330 FLR2RdrObject10To11DataWidth0 1;
BA_ "GenSigSendType" SG_ 330 FLR2RdrObject10To11DataWidth1 1;
BA_ "GenSigSendType" SG_ 330 FLR2RdrObject10To11HeadingAng0 1;
BA_ "GenSigStartValue" SG_ 330 FLR2RdrObject10To11HeadingAng0 315;
BA_ "GenSigSendType" SG_ 330 FLR2RdrObject10To11HeadingAng1 1;
BA_ "GenSigStartValue" SG_ 330 FLR2RdrObject10To11HeadingAng1 315;
BA_ "GenSigSendType" SG_ 330 FLR2RdrObject10To11LatAcc0 1;
BA_ "GenSigStartValue" SG_ 330 FLR2RdrObject10To11LatAcc0 356;
BA_ "GenSigSendType" SG_ 330 FLR2RdrObject10To11LatAcc1 1;
BA_ "GenSigStartValue" SG_ 330 FLR2RdrObject10To11LatAcc1 356;
BA_ "GenSigSendType" SG_ 330 FLR2RdrObject10To11LatPos0 1;
BA_ "GenSigStartValue" SG_ 330 FLR2RdrObject10To11LatPos0 4095;
BA_ "GenSigSendType" SG_ 330 FLR2RdrObject10To11LatPos1 1;
BA_ "GenSigStartValue" SG_ 330 FLR2RdrObject10To11LatPos1 4095;
BA_ "GenSigSendType" SG_ 330 FLR2RdrObject10To11LatVelo0 1;
BA_ "GenSigStartValue" SG_ 330 FLR2RdrObject10To11LatVelo0 1024;
BA_ "GenSigSendType" SG_ 330 FLR2RdrObject10To11LatVelo1 1;
BA_ "GenSigStartValue" SG_ 330 FLR2RdrObject10To11LatVelo1 1024;
BA_ "GenSigSendType" SG_ 330 FLR2RdrObject10To11LgtAcc0 1;
BA_ "GenSigStartValue" SG_ 330 FLR2RdrObject10To11LgtAcc0 356;
BA_ "GenSigSendType" SG_ 330 FLR2RdrObject10To11LgtAcc1 1;
BA_ "GenSigStartValue" SG_ 330 FLR2RdrObject10To11LgtAcc1 356;
BA_ "GenSigSendType" SG_ 330 FLR2RdrObject10To11LgtPos0 1;
BA_ "GenSigStartValue" SG_ 330 FLR2RdrObject10To11LgtPos0 4095;
BA_ "GenSigSendType" SG_ 330 FLR2RdrObject10To11LgtPos1 1;
BA_ "GenSigStartValue" SG_ 330 FLR2RdrObject10To11LgtPos1 4095;
BA_ "GenSigSendType" SG_ 330 FLR2RdrObject10To11LgtVelo0 1;
BA_ "GenSigStartValue" SG_ 330 FLR2RdrObject10To11LgtVelo0 1024;
BA_ "GenSigSendType" SG_ 330 FLR2RdrObject10To11LgtVelo1 1;
BA_ "GenSigStartValue" SG_ 330 FLR2RdrObject10To11LgtVelo1 1024;
BA_ "GenSigSendType" SG_ 330 FLR2RdrObject10To11ModeInfo0 1;
BA_ "GenSigSendType" SG_ 330 FLR2RdrObject10To11ModeInfo1 1;
BA_ "GenSigSendType" SG_ 330 FLR2RdrObject10To11MsgCntr 1;
BA_ "GenSigSendType" SG_ 330 FLR2RdrObject10To11MtnModel0 1;
BA_ "GenSigSendType" SG_ 330 FLR2RdrObject10To11MtnModel1 1;
BA_ "GenSigSendType" SG_ 330 FLR2RdrObject10To11MtnPattern0 1;
BA_ "GenSigSendType" SG_ 330 FLR2RdrObject10To11MtnPattern1 1;
BA_ "GenSigSendType" SG_ 330 FLR2RdrObject10To11PedMicroDoppler0 1;
BA_ "GenSigSendType" SG_ 330 FLR2RdrObject10To11PedMicroDoppler1 1;
BA_ "GenSigSendType" SG_ 330 FLR2RdrObject10To11Qly0 1;
BA_ "GenSigSendType" SG_ 330 FLR2RdrObject10To11Qly1 1;
BA_ "GenSigSendType" SG_ 330 FLR2RdrObject10To11ScanID 1;
BA_ "GenSigDataID" SG_ 332 FLR2RdrObject12To13CRC "0x8D4";
BA_ "GenSigFuncType" SG_ 332 FLR2RdrObject12To13CRC 28;
BA_ "GenSigSendType" SG_ 332 FLR2RdrObject12To13CRC 1;
BA_ "GenSigSendType" SG_ 332 FLR2RdrObject12To13Class0 1;
BA_ "GenSigSendType" SG_ 332 FLR2RdrObject12To13Class1 1;
BA_ "GenSigFuncType" SG_ 332 FLR2RdrObject12To13Counter 27;
BA_ "GenSigSendType" SG_ 332 FLR2RdrObject12To13Counter 1;
BA_ "GenSigSendType" SG_ 332 FLR2RdrObject12To13DataCoastCntr0 1;
BA_ "GenSigSendType" SG_ 332 FLR2RdrObject12To13DataCoastCntr1 1;
BA_ "GenSigSendType" SG_ 332 FLR2RdrObject12To13DataConf0 1;
BA_ "GenSigSendType" SG_ 332 FLR2RdrObject12To13DataConf1 1;
BA_ "GenSigSendType" SG_ 332 FLR2RdrObject12To13DataLen0 1;
BA_ "GenSigSendType" SG_ 332 FLR2RdrObject12To13DataLen1 1;
BA_ "GenSigSendType" SG_ 332 FLR2RdrObject12To13DataStDLatAcc0 1;
BA_ "GenSigSendType" SG_ 332 FLR2RdrObject12To13DataStDLatAcc1 1;
BA_ "GenSigSendType" SG_ 332 FLR2RdrObject12To13DataStDLatPos0 1;
BA_ "GenSigSendType" SG_ 332 FLR2RdrObject12To13DataStDLatPos1 1;
BA_ "GenSigSendType" SG_ 332 FLR2RdrObject12To13DataStDLatVelo0 1;
BA_ "GenSigSendType" SG_ 332 FLR2RdrObject12To13DataStDLatVelo1 1;
BA_ "GenSigSendType" SG_ 332 FLR2RdrObject12To13DataStDLgtAcc0 1;
BA_ "GenSigSendType" SG_ 332 FLR2RdrObject12To13DataStDLgtAcc1 1;
BA_ "GenSigSendType" SG_ 332 FLR2RdrObject12To13DataStDLgtPos0 1;
BA_ "GenSigSendType" SG_ 332 FLR2RdrObject12To13DataStDLgtPos1 1;
BA_ "GenSigSendType" SG_ 332 FLR2RdrObject12To13DataStDLgtVelo0 1;
BA_ "GenSigSendType" SG_ 332 FLR2RdrObject12To13DataStDLgtVelo1 1;
BA_ "GenSigSendType" SG_ 332 FLR2RdrObject12To13DataWidth0 1;
BA_ "GenSigSendType" SG_ 332 FLR2RdrObject12To13DataWidth1 1;
BA_ "GenSigSendType" SG_ 332 FLR2RdrObject12To13HeadingAng0 1;
BA_ "GenSigStartValue" SG_ 332 FLR2RdrObject12To13HeadingAng0 315;
BA_ "GenSigSendType" SG_ 332 FLR2RdrObject12To13HeadingAng1 1;
BA_ "GenSigStartValue" SG_ 332 FLR2RdrObject12To13HeadingAng1 315;
BA_ "GenSigSendType" SG_ 332 FLR2RdrObject12To13LatAcc0 1;
BA_ "GenSigStartValue" SG_ 332 FLR2RdrObject12To13LatAcc0 356;
BA_ "GenSigSendType" SG_ 332 FLR2RdrObject12To13LatAcc1 1;
BA_ "GenSigStartValue" SG_ 332 FLR2RdrObject12To13LatAcc1 356;
BA_ "GenSigSendType" SG_ 332 FLR2RdrObject12To13LatPos0 1;
BA_ "GenSigStartValue" SG_ 332 FLR2RdrObject12To13LatPos0 4095;
BA_ "GenSigSendType" SG_ 332 FLR2RdrObject12To13LatPos1 1;
BA_ "GenSigStartValue" SG_ 332 FLR2RdrObject12To13LatPos1 4095;
BA_ "GenSigSendType" SG_ 332 FLR2RdrObject12To13LatVelo0 1;
BA_ "GenSigStartValue" SG_ 332 FLR2RdrObject12To13LatVelo0 1024;
BA_ "GenSigSendType" SG_ 332 FLR2RdrObject12To13LatVelo1 1;
BA_ "GenSigStartValue" SG_ 332 FLR2RdrObject12To13LatVelo1 1024;
BA_ "GenSigSendType" SG_ 332 FLR2RdrObject12To13LgtAcc0 1;
BA_ "GenSigStartValue" SG_ 332 FLR2RdrObject12To13LgtAcc0 356;
BA_ "GenSigSendType" SG_ 332 FLR2RdrObject12To13LgtAcc1 1;
BA_ "GenSigStartValue" SG_ 332 FLR2RdrObject12To13LgtAcc1 356;
BA_ "GenSigSendType" SG_ 332 FLR2RdrObject12To13LgtPos0 1;
BA_ "GenSigStartValue" SG_ 332 FLR2RdrObject12To13LgtPos0 4095;
BA_ "GenSigSendType" SG_ 332 FLR2RdrObject12To13LgtPos1 1;
BA_ "GenSigStartValue" SG_ 332 FLR2RdrObject12To13LgtPos1 4095;
BA_ "GenSigSendType" SG_ 332 FLR2RdrObject12To13LgtVelo0 1;
BA_ "GenSigStartValue" SG_ 332 FLR2RdrObject12To13LgtVelo0 1024;
BA_ "GenSigSendType" SG_ 332 FLR2RdrObject12To13LgtVelo1 1;
BA_ "GenSigStartValue" SG_ 332 FLR2RdrObject12To13LgtVelo1 1024;
BA_ "GenSigSendType" SG_ 332 FLR2RdrObject12To13ModeInfo0 1;
BA_ "GenSigSendType" SG_ 332 FLR2RdrObject12To13ModeInfo1 1;
BA_ "GenSigSendType" SG_ 332 FLR2RdrObject12To13MsgCntr 1;
BA_ "GenSigSendType" SG_ 332 FLR2RdrObject12To13MtnModel0 1;
BA_ "GenSigSendType" SG_ 332 FLR2RdrObject12To13MtnModel1 1;
BA_ "GenSigSendType" SG_ 332 FLR2RdrObject12To13MtnPattern0 1;
BA_ "GenSigSendType" SG_ 332 FLR2RdrObject12To13MtnPattern1 1;
BA_ "GenSigSendType" SG_ 332 FLR2RdrObject12To13PedMicroDoppler0 1;
BA_ "GenSigSendType" SG_ 332 FLR2RdrObject12To13PedMicroDoppler1 1;
BA_ "GenSigSendType" SG_ 332 FLR2RdrObject12To13Qly0 1;
BA_ "GenSigSendType" SG_ 332 FLR2RdrObject12To13Qly1 1;
BA_ "GenSigSendType" SG_ 332 FLR2RdrObject12To13ScanID 1;
BA_ "GenSigDataID" SG_ 334 FLR2RdrObject14To15CRC "0x8D5";
BA_ "GenSigFuncType" SG_ 334 FLR2RdrObject14To15CRC 28;
BA_ "GenSigSendType" SG_ 334 FLR2RdrObject14To15CRC 1;
BA_ "GenSigSendType" SG_ 334 FLR2RdrObject14To15Class0 1;
BA_ "GenSigSendType" SG_ 334 FLR2RdrObject14To15Class1 1;
BA_ "GenSigFuncType" SG_ 334 FLR2RdrObject14To15Counter 27;
BA_ "GenSigSendType" SG_ 334 FLR2RdrObject14To15Counter 1;
BA_ "GenSigSendType" SG_ 334 FLR2RdrObject14To15DataCoastCntr0 1;
BA_ "GenSigSendType" SG_ 334 FLR2RdrObject14To15DataCoastCntr1 1;
BA_ "GenSigSendType" SG_ 334 FLR2RdrObject14To15DataConf0 1;
BA_ "GenSigSendType" SG_ 334 FLR2RdrObject14To15DataConf1 1;
BA_ "GenSigSendType" SG_ 334 FLR2RdrObject14To15DataLen0 1;
BA_ "GenSigSendType" SG_ 334 FLR2RdrObject14To15DataLen1 1;
BA_ "GenSigSendType" SG_ 334 FLR2RdrObject14To15DataStDLatAcc0 1;
BA_ "GenSigSendType" SG_ 334 FLR2RdrObject14To15DataStDLatAcc1 1;
BA_ "GenSigSendType" SG_ 334 FLR2RdrObject14To15DataStDLatPos0 1;
BA_ "GenSigSendType" SG_ 334 FLR2RdrObject14To15DataStDLatPos1 1;
BA_ "GenSigSendType" SG_ 334 FLR2RdrObject14To15DataStDLatVelo0 1;
BA_ "GenSigSendType" SG_ 334 FLR2RdrObject14To15DataStDLatVelo1 1;
BA_ "GenSigSendType" SG_ 334 FLR2RdrObject14To15DataStDLgtAcc0 1;
BA_ "GenSigSendType" SG_ 334 FLR2RdrObject14To15DataStDLgtAcc1 1;
BA_ "GenSigSendType" SG_ 334 FLR2RdrObject14To15DataStDLgtPos0 1;
BA_ "GenSigSendType" SG_ 334 FLR2RdrObject14To15DataStDLgtPos1 1;
BA_ "GenSigSendType" SG_ 334 FLR2RdrObject14To15DataStDLgtVelo0 1;
BA_ "GenSigSendType" SG_ 334 FLR2RdrObject14To15DataStDLgtVelo1 1;
BA_ "GenSigSendType" SG_ 334 FLR2RdrObject14To15DataWidth0 1;
BA_ "GenSigSendType" SG_ 334 FLR2RdrObject14To15DataWidth1 1;
BA_ "GenSigSendType" SG_ 334 FLR2RdrObject14To15HeadingAng0 1;
BA_ "GenSigStartValue" SG_ 334 FLR2RdrObject14To15HeadingAng0 315;
BA_ "GenSigSendType" SG_ 334 FLR2RdrObject14To15HeadingAng1 1;
BA_ "GenSigStartValue" SG_ 334 FLR2RdrObject14To15HeadingAng1 315;
BA_ "GenSigSendType" SG_ 334 FLR2RdrObject14To15LatAcc0 1;
BA_ "GenSigStartValue" SG_ 334 FLR2RdrObject14To15LatAcc0 356;
BA_ "GenSigSendType" SG_ 334 FLR2RdrObject14To15LatAcc1 1;
BA_ "GenSigStartValue" SG_ 334 FLR2RdrObject14To15LatAcc1 356;
BA_ "GenSigSendType" SG_ 334 FLR2RdrObject14To15LatPos0 1;
BA_ "GenSigStartValue" SG_ 334 FLR2RdrObject14To15LatPos0 4095;
BA_ "GenSigSendType" SG_ 334 FLR2RdrObject14To15LatPos1 1;
BA_ "GenSigStartValue" SG_ 334 FLR2RdrObject14To15LatPos1 4095;
BA_ "GenSigSendType" SG_ 334 FLR2RdrObject14To15LatVelo0 1;
BA_ "GenSigStartValue" SG_ 334 FLR2RdrObject14To15LatVelo0 1024;
BA_ "GenSigSendType" SG_ 334 FLR2RdrObject14To15LatVelo1 1;
BA_ "GenSigStartValue" SG_ 334 FLR2RdrObject14To15LatVelo1 1024;
BA_ "GenSigSendType" SG_ 334 FLR2RdrObject14To15LgtAcc0 1;
BA_ "GenSigStartValue" SG_ 334 FLR2RdrObject14To15LgtAcc0 356;
BA_ "GenSigSendType" SG_ 334 FLR2RdrObject14To15LgtAcc1 1;
BA_ "GenSigStartValue" SG_ 334 FLR2RdrObject14To15LgtAcc1 356;
BA_ "GenSigSendType" SG_ 334 FLR2RdrObject14To15LgtPos0 1;
BA_ "GenSigStartValue" SG_ 334 FLR2RdrObject14To15LgtPos0 4095;
BA_ "GenSigSendType" SG_ 334 FLR2RdrObject14To15LgtPos1 1;
BA_ "GenSigStartValue" SG_ 334 FLR2RdrObject14To15LgtPos1 4095;
BA_ "GenSigSendType" SG_ 334 FLR2RdrObject14To15LgtVelo0 1;
BA_ "GenSigStartValue" SG_ 334 FLR2RdrObject14To15LgtVelo0 1024;
BA_ "GenSigSendType" SG_ 334 FLR2RdrObject14To15LgtVelo1 1;
BA_ "GenSigStartValue" SG_ 334 FLR2RdrObject14To15LgtVelo1 1024;
BA_ "GenSigSendType" SG_ 334 FLR2RdrObject14To15ModeInfo0 1;
BA_ "GenSigSendType" SG_ 334 FLR2RdrObject14To15ModeInfo1 1;
BA_ "GenSigSendType" SG_ 334 FLR2RdrObject14To15MsgCntr 1;
BA_ "GenSigSendType" SG_ 334 FLR2RdrObject14To15MtnModel0 1;
BA_ "GenSigSendType" SG_ 334 FLR2RdrObject14To15MtnModel1 1;
BA_ "GenSigSendType" SG_ 334 FLR2RdrObject14To15MtnPattern0 1;
BA_ "GenSigSendType" SG_ 334 FLR2RdrObject14To15MtnPattern1 1;
BA_ "GenSigSendType" SG_ 334 FLR2RdrObject14To15PedMicroDoppler0 1;
BA_ "GenSigSendType" SG_ 334 FLR2RdrObject14To15PedMicroDoppler1 1;
BA_ "GenSigSendType" SG_ 334 FLR2RdrObject14To15Qly0 1;
BA_ "GenSigSendType" SG_ 334 FLR2RdrObject14To15Qly1 1;
BA_ "GenSigSendType" SG_ 334 FLR2RdrObject14To15ScanID 1;
BA_ "GenSigDataID" SG_ 336 FLR2RdrObject16To17CRC "0x8D6";
BA_ "GenSigFuncType" SG_ 336 FLR2RdrObject16To17CRC 28;
BA_ "GenSigSendType" SG_ 336 FLR2RdrObject16To17CRC 1;
BA_ "GenSigSendType" SG_ 336 FLR2RdrObject16To17Class0 1;
BA_ "GenSigSendType" SG_ 336 FLR2RdrObject16To17Class1 1;
BA_ "GenSigFuncType" SG_ 336 FLR2RdrObject16To17Counter 27;
BA_ "GenSigSendType" SG_ 336 FLR2RdrObject16To17Counter 1;
BA_ "GenSigSendType" SG_ 336 FLR2RdrObject16To17DataCoastCntr0 1;
BA_ "GenSigSendType" SG_ 336 FLR2RdrObject16To17DataCoastCntr1 1;
BA_ "GenSigSendType" SG_ 336 FLR2RdrObject16To17DataConf0 1;
BA_ "GenSigSendType" SG_ 336 FLR2RdrObject16To17DataConf1 1;
BA_ "GenSigSendType" SG_ 336 FLR2RdrObject16To17DataLen0 1;
BA_ "GenSigSendType" SG_ 336 FLR2RdrObject16To17DataLen1 1;
BA_ "GenSigSendType" SG_ 336 FLR2RdrObject16To17DataStDLatAcc0 1;
BA_ "GenSigSendType" SG_ 336 FLR2RdrObject16To17DataStDLatAcc1 1;
BA_ "GenSigSendType" SG_ 336 FLR2RdrObject16To17DataStDLatPos0 1;
BA_ "GenSigSendType" SG_ 336 FLR2RdrObject16To17DataStDLatPos1 1;
BA_ "GenSigSendType" SG_ 336 FLR2RdrObject16To17DataStDLatVelo0 1;
BA_ "GenSigSendType" SG_ 336 FLR2RdrObject16To17DataStDLatVelo1 1;
BA_ "GenSigSendType" SG_ 336 FLR2RdrObject16To17DataStDLgtAcc0 1;
BA_ "GenSigSendType" SG_ 336 FLR2RdrObject16To17DataStDLgtAcc1 1;
BA_ "GenSigSendType" SG_ 336 FLR2RdrObject16To17DataStDLgtPos0 1;
BA_ "GenSigSendType" SG_ 336 FLR2RdrObject16To17DataStDLgtPos1 1;
BA_ "GenSigSendType" SG_ 336 FLR2RdrObject16To17DataStDLgtVelo0 1;
BA_ "GenSigSendType" SG_ 336 FLR2RdrObject16To17DataStDLgtVelo1 1;
BA_ "GenSigSendType" SG_ 336 FLR2RdrObject16To17DataWidth0 1;
BA_ "GenSigSendType" SG_ 336 FLR2RdrObject16To17DataWidth1 1;
BA_ "GenSigSendType" SG_ 336 FLR2RdrObject16To17HeadingAng0 1;
BA_ "GenSigStartValue" SG_ 336 FLR2RdrObject16To17HeadingAng0 315;
BA_ "GenSigSendType" SG_ 336 FLR2RdrObject16To17HeadingAng1 1;
BA_ "GenSigStartValue" SG_ 336 FLR2RdrObject16To17HeadingAng1 315;
BA_ "GenSigSendType" SG_ 336 FLR2RdrObject16To17LatAcc0 1;
BA_ "GenSigStartValue" SG_ 336 FLR2RdrObject16To17LatAcc0 356;
BA_ "GenSigSendType" SG_ 336 FLR2RdrObject16To17LatAcc1 1;
BA_ "GenSigStartValue" SG_ 336 FLR2RdrObject16To17LatAcc1 356;
BA_ "GenSigSendType" SG_ 336 FLR2RdrObject16To17LatPos0 1;
BA_ "GenSigStartValue" SG_ 336 FLR2RdrObject16To17LatPos0 4095;
BA_ "GenSigSendType" SG_ 336 FLR2RdrObject16To17LatPos1 1;
BA_ "GenSigStartValue" SG_ 336 FLR2RdrObject16To17LatPos1 4095;
BA_ "GenSigSendType" SG_ 336 FLR2RdrObject16To17LatVelo0 1;
BA_ "GenSigStartValue" SG_ 336 FLR2RdrObject16To17LatVelo0 1024;
BA_ "GenSigSendType" SG_ 336 FLR2RdrObject16To17LatVelo1 1;
BA_ "GenSigStartValue" SG_ 336 FLR2RdrObject16To17LatVelo1 1024;
BA_ "GenSigSendType" SG_ 336 FLR2RdrObject16To17LgtAcc0 1;
BA_ "GenSigStartValue" SG_ 336 FLR2RdrObject16To17LgtAcc0 356;
BA_ "GenSigSendType" SG_ 336 FLR2RdrObject16To17LgtAcc1 1;
BA_ "GenSigStartValue" SG_ 336 FLR2RdrObject16To17LgtAcc1 356;
BA_ "GenSigSendType" SG_ 336 FLR2RdrObject16To17LgtPos0 1;
BA_ "GenSigStartValue" SG_ 336 FLR2RdrObject16To17LgtPos0 4095;
BA_ "GenSigSendType" SG_ 336 FLR2RdrObject16To17LgtPos1 1;
BA_ "GenSigStartValue" SG_ 336 FLR2RdrObject16To17LgtPos1 4095;
BA_ "GenSigSendType" SG_ 336 FLR2RdrObject16To17LgtVelo0 1;
BA_ "GenSigStartValue" SG_ 336 FLR2RdrObject16To17LgtVelo0 1024;
BA_ "GenSigSendType" SG_ 336 FLR2RdrObject16To17LgtVelo1 1;
BA_ "GenSigStartValue" SG_ 336 FLR2RdrObject16To17LgtVelo1 1024;
BA_ "GenSigSendType" SG_ 336 FLR2RdrObject16To17ModeInfo0 1;
BA_ "GenSigSendType" SG_ 336 FLR2RdrObject16To17ModeInfo1 1;
BA_ "GenSigSendType" SG_ 336 FLR2RdrObject16To17MsgCntr 1;
BA_ "GenSigSendType" SG_ 336 FLR2RdrObject16To17MtnModel0 1;
BA_ "GenSigSendType" SG_ 336 FLR2RdrObject16To17MtnModel1 1;
BA_ "GenSigSendType" SG_ 336 FLR2RdrObject16To17MtnPattern0 1;
BA_ "GenSigSendType" SG_ 336 FLR2RdrObject16To17MtnPattern1 1;
BA_ "GenSigSendType" SG_ 336 FLR2RdrObject16To17PedMicroDoppler0 1;
BA_ "GenSigSendType" SG_ 336 FLR2RdrObject16To17PedMicroDoppler1 1;
BA_ "GenSigSendType" SG_ 336 FLR2RdrObject16To17Qly0 1;
BA_ "GenSigSendType" SG_ 336 FLR2RdrObject16To17Qly1 1;
BA_ "GenSigSendType" SG_ 336 FLR2RdrObject16To17ScanID 1;
BA_ "GenSigDataID" SG_ 338 FLR2RdrObject18To19CRC "0x8D7";
BA_ "GenSigFuncType" SG_ 338 FLR2RdrObject18To19CRC 28;
BA_ "GenSigSendType" SG_ 338 FLR2RdrObject18To19CRC 1;
BA_ "GenSigSendType" SG_ 338 FLR2RdrObject18To19Class0 1;
BA_ "GenSigSendType" SG_ 338 FLR2RdrObject18To19Class1 1;
BA_ "GenSigFuncType" SG_ 338 FLR2RdrObject18To19Counter 27;
BA_ "GenSigSendType" SG_ 338 FLR2RdrObject18To19Counter 1;
BA_ "GenSigSendType" SG_ 338 FLR2RdrObject18To19DataCoastCntr0 1;
BA_ "GenSigSendType" SG_ 338 FLR2RdrObject18To19DataCoastCntr1 1;
BA_ "GenSigSendType" SG_ 338 FLR2RdrObject18To19DataConf0 1;
BA_ "GenSigSendType" SG_ 338 FLR2RdrObject18To19DataConf1 1;
BA_ "GenSigSendType" SG_ 338 FLR2RdrObject18To19DataLen0 1;
BA_ "GenSigSendType" SG_ 338 FLR2RdrObject18To19DataLen1 1;
BA_ "GenSigSendType" SG_ 338 FLR2RdrObject18To19DataStDLatAcc0 1;
BA_ "GenSigSendType" SG_ 338 FLR2RdrObject18To19DataStDLatAcc1 1;
BA_ "GenSigSendType" SG_ 338 FLR2RdrObject18To19DataStDLatPos0 1;
BA_ "GenSigSendType" SG_ 338 FLR2RdrObject18To19DataStDLatPos1 1;
BA_ "GenSigSendType" SG_ 338 FLR2RdrObject18To19DataStDLatVelo0 1;
BA_ "GenSigSendType" SG_ 338 FLR2RdrObject18To19DataStDLatVelo1 1;
BA_ "GenSigSendType" SG_ 338 FLR2RdrObject18To19DataStDLgtAcc0 1;
BA_ "GenSigSendType" SG_ 338 FLR2RdrObject18To19DataStDLgtAcc1 1;
BA_ "GenSigSendType" SG_ 338 FLR2RdrObject18To19DataStDLgtPos0 1;
BA_ "GenSigSendType" SG_ 338 FLR2RdrObject18To19DataStDLgtPos1 1;
BA_ "GenSigSendType" SG_ 338 FLR2RdrObject18To19DataStDLgtVelo0 1;
BA_ "GenSigSendType" SG_ 338 FLR2RdrObject18To19DataStDLgtVelo1 1;
BA_ "GenSigSendType" SG_ 338 FLR2RdrObject18To19DataWidth0 1;
BA_ "GenSigSendType" SG_ 338 FLR2RdrObject18To19DataWidth1 1;
BA_ "GenSigSendType" SG_ 338 FLR2RdrObject18To19HeadingAng0 1;
BA_ "GenSigStartValue" SG_ 338 FLR2RdrObject18To19HeadingAng0 315;
BA_ "GenSigSendType" SG_ 338 FLR2RdrObject18To19HeadingAng1 1;
BA_ "GenSigStartValue" SG_ 338 FLR2RdrObject18To19HeadingAng1 315;
BA_ "GenSigSendType" SG_ 338 FLR2RdrObject18To19LatAcc0 1;
BA_ "GenSigStartValue" SG_ 338 FLR2RdrObject18To19LatAcc0 356;
BA_ "GenSigSendType" SG_ 338 FLR2RdrObject18To19LatAcc1 1;
BA_ "GenSigStartValue" SG_ 338 FLR2RdrObject18To19LatAcc1 356;
BA_ "GenSigSendType" SG_ 338 FLR2RdrObject18To19LatPos0 1;
BA_ "GenSigStartValue" SG_ 338 FLR2RdrObject18To19LatPos0 4095;
BA_ "GenSigSendType" SG_ 338 FLR2RdrObject18To19LatPos1 1;
BA_ "GenSigStartValue" SG_ 338 FLR2RdrObject18To19LatPos1 4095;
BA_ "GenSigSendType" SG_ 338 FLR2RdrObject18To19LatVelo0 1;
BA_ "GenSigStartValue" SG_ 338 FLR2RdrObject18To19LatVelo0 1024;
BA_ "GenSigSendType" SG_ 338 FLR2RdrObject18To19LatVelo1 1;
BA_ "GenSigStartValue" SG_ 338 FLR2RdrObject18To19LatVelo1 1024;
BA_ "GenSigSendType" SG_ 338 FLR2RdrObject18To19LgtAcc0 1;
BA_ "GenSigStartValue" SG_ 338 FLR2RdrObject18To19LgtAcc0 356;
BA_ "GenSigSendType" SG_ 338 FLR2RdrObject18To19LgtAcc1 1;
BA_ "GenSigStartValue" SG_ 338 FLR2RdrObject18To19LgtAcc1 356;
BA_ "GenSigSendType" SG_ 338 FLR2RdrObject18To19LgtPos0 1;
BA_ "GenSigStartValue" SG_ 338 FLR2RdrObject18To19LgtPos0 4095;
BA_ "GenSigSendType" SG_ 338 FLR2RdrObject18To19LgtPos1 1;
BA_ "GenSigStartValue" SG_ 338 FLR2RdrObject18To19LgtPos1 4095;
BA_ "GenSigSendType" SG_ 338 FLR2RdrObject18To19LgtVelo0 1;
BA_ "GenSigStartValue" SG_ 338 FLR2RdrObject18To19LgtVelo0 1024;
BA_ "GenSigSendType" SG_ 338 FLR2RdrObject18To19LgtVelo1 1;
BA_ "GenSigStartValue" SG_ 338 FLR2RdrObject18To19LgtVelo1 1024;
BA_ "GenSigSendType" SG_ 338 FLR2RdrObject18To19ModeInfo0 1;
BA_ "GenSigSendType" SG_ 338 FLR2RdrObject18To19ModeInfo1 1;
BA_ "GenSigSendType" SG_ 338 FLR2RdrObject18To19MsgCntr 1;
BA_ "GenSigSendType" SG_ 338 FLR2RdrObject18To19MtnModel0 1;
BA_ "GenSigSendType" SG_ 338 FLR2RdrObject18To19MtnModel1 1;
BA_ "GenSigSendType" SG_ 338 FLR2RdrObject18To19MtnPattern0 1;
BA_ "GenSigSendType" SG_ 338 FLR2RdrObject18To19MtnPattern1 1;
BA_ "GenSigSendType" SG_ 338 FLR2RdrObject18To19PedMicroDoppler0 1;
BA_ "GenSigSendType" SG_ 338 FLR2RdrObject18To19PedMicroDoppler1 1;
BA_ "GenSigSendType" SG_ 338 FLR2RdrObject18To19Qly0 1;
BA_ "GenSigSendType" SG_ 338 FLR2RdrObject18To19Qly1 1;
BA_ "GenSigSendType" SG_ 338 FLR2RdrObject18To19ScanID 1;
BA_ "GenSigDataID" SG_ 340 FLR2RdrObject20To21CRC "0x8A9";
BA_ "GenSigFuncType" SG_ 340 FLR2RdrObject20To21CRC 28;
BA_ "GenSigSendType" SG_ 340 FLR2RdrObject20To21CRC 1;
BA_ "GenSigSendType" SG_ 340 FLR2RdrObject20To21Class0 1;
BA_ "GenSigSendType" SG_ 340 FLR2RdrObject20To21Class1 1;
BA_ "GenSigFuncType" SG_ 340 FLR2RdrObject20To21Counter 27;
BA_ "GenSigSendType" SG_ 340 FLR2RdrObject20To21Counter 1;
BA_ "GenSigSendType" SG_ 340 FLR2RdrObject20To21DataCoastCntr0 1;
BA_ "GenSigSendType" SG_ 340 FLR2RdrObject20To21DataCoastCntr1 1;
BA_ "GenSigSendType" SG_ 340 FLR2RdrObject20To21DataConf0 1;
BA_ "GenSigSendType" SG_ 340 FLR2RdrObject20To21DataConf1 1;
BA_ "GenSigSendType" SG_ 340 FLR2RdrObject20To21DataLen0 1;
BA_ "GenSigSendType" SG_ 340 FLR2RdrObject20To21DataLen1 1;
BA_ "GenSigSendType" SG_ 340 FLR2RdrObject20To21DataStDLatAcc0 1;
BA_ "GenSigSendType" SG_ 340 FLR2RdrObject20To21DataStDLatAcc1 1;
BA_ "GenSigSendType" SG_ 340 FLR2RdrObject20To21DataStDLatPos0 1;
BA_ "GenSigSendType" SG_ 340 FLR2RdrObject20To21DataStDLatPos1 1;
BA_ "GenSigSendType" SG_ 340 FLR2RdrObject20To21DataStDLatVelo0 1;
BA_ "GenSigSendType" SG_ 340 FLR2RdrObject20To21DataStDLatVelo1 1;
BA_ "GenSigSendType" SG_ 340 FLR2RdrObject20To21DataStDLgtAcc0 1;
BA_ "GenSigSendType" SG_ 340 FLR2RdrObject20To21DataStDLgtAcc1 1;
BA_ "GenSigSendType" SG_ 340 FLR2RdrObject20To21DataStDLgtPos0 1;
BA_ "GenSigSendType" SG_ 340 FLR2RdrObject20To21DataStDLgtPos1 1;
BA_ "GenSigSendType" SG_ 340 FLR2RdrObject20To21DataStDLgtVelo0 1;
BA_ "GenSigSendType" SG_ 340 FLR2RdrObject20To21DataStDLgtVelo1 1;
BA_ "GenSigSendType" SG_ 340 FLR2RdrObject20To21DataWidth0 1;
BA_ "GenSigSendType" SG_ 340 FLR2RdrObject20To21DataWidth1 1;
BA_ "GenSigSendType" SG_ 340 FLR2RdrObject20To21HeadingAng0 1;
BA_ "GenSigStartValue" SG_ 340 FLR2RdrObject20To21HeadingAng0 315;
BA_ "GenSigSendType" SG_ 340 FLR2RdrObject20To21HeadingAng1 1;
BA_ "GenSigStartValue" SG_ 340 FLR2RdrObject20To21HeadingAng1 315;
BA_ "GenSigSendType" SG_ 340 FLR2RdrObject20To21LatAcc0 1;
BA_ "GenSigStartValue" SG_ 340 FLR2RdrObject20To21LatAcc0 356;
BA_ "GenSigSendType" SG_ 340 FLR2RdrObject20To21LatAcc1 1;
BA_ "GenSigStartValue" SG_ 340 FLR2RdrObject20To21LatAcc1 356;
BA_ "GenSigSendType" SG_ 340 FLR2RdrObject20To21LatPos0 1;
BA_ "GenSigStartValue" SG_ 340 FLR2RdrObject20To21LatPos0 4095;
BA_ "GenSigSendType" SG_ 340 FLR2RdrObject20To21LatPos1 1;
BA_ "GenSigStartValue" SG_ 340 FLR2RdrObject20To21LatPos1 4095;
BA_ "GenSigSendType" SG_ 340 FLR2RdrObject20To21LatVelo0 1;
BA_ "GenSigStartValue" SG_ 340 FLR2RdrObject20To21LatVelo0 1024;
BA_ "GenSigSendType" SG_ 340 FLR2RdrObject20To21LatVelo1 1;
BA_ "GenSigStartValue" SG_ 340 FLR2RdrObject20To21LatVelo1 1024;
BA_ "GenSigSendType" SG_ 340 FLR2RdrObject20To21LgtAcc0 1;
BA_ "GenSigStartValue" SG_ 340 FLR2RdrObject20To21LgtAcc0 356;
BA_ "GenSigSendType" SG_ 340 FLR2RdrObject20To21LgtAcc1 1;
BA_ "GenSigStartValue" SG_ 340 FLR2RdrObject20To21LgtAcc1 356;
BA_ "GenSigSendType" SG_ 340 FLR2RdrObject20To21LgtPos0 1;
BA_ "GenSigStartValue" SG_ 340 FLR2RdrObject20To21LgtPos0 4095;
BA_ "GenSigSendType" SG_ 340 FLR2RdrObject20To21LgtPos1 1;
BA_ "GenSigStartValue" SG_ 340 FLR2RdrObject20To21LgtPos1 4095;
BA_ "GenSigSendType" SG_ 340 FLR2RdrObject20To21LgtVelo0 1;
BA_ "GenSigStartValue" SG_ 340 FLR2RdrObject20To21LgtVelo0 1024;
BA_ "GenSigSendType" SG_ 340 FLR2RdrObject20To21LgtVelo1 1;
BA_ "GenSigStartValue" SG_ 340 FLR2RdrObject20To21LgtVelo1 1024;
BA_ "GenSigSendType" SG_ 340 FLR2RdrObject20To21ModeInfo0 1;
BA_ "GenSigSendType" SG_ 340 FLR2RdrObject20To21ModeInfo1 1;
BA_ "GenSigSendType" SG_ 340 FLR2RdrObject20To21MsgCntr 1;
BA_ "GenSigSendType" SG_ 340 FLR2RdrObject20To21MtnModel0 1;
BA_ "GenSigSendType" SG_ 340 FLR2RdrObject20To21MtnModel1 1;
BA_ "GenSigSendType" SG_ 340 FLR2RdrObject20To21MtnPattern0 1;
BA_ "GenSigSendType" SG_ 340 FLR2RdrObject20To21MtnPattern1 1;
BA_ "GenSigSendType" SG_ 340 FLR2RdrObject20To21PedMicroDoppler0 1;
BA_ "GenSigSendType" SG_ 340 FLR2RdrObject20To21PedMicroDoppler1 1;
BA_ "GenSigSendType" SG_ 340 FLR2RdrObject20To21Qly0 1;
BA_ "GenSigSendType" SG_ 340 FLR2RdrObject20To21Qly1 1;
BA_ "GenSigSendType" SG_ 340 FLR2RdrObject20To21ScanID 1;
BA_ "GenSigDataID" SG_ 342 FLR2RdrObject22To23CRC "0x8AA";
BA_ "GenSigFuncType" SG_ 342 FLR2RdrObject22To23CRC 28;
BA_ "GenSigSendType" SG_ 342 FLR2RdrObject22To23CRC 1;
BA_ "GenSigSendType" SG_ 342 FLR2RdrObject22To23Class0 1;
BA_ "GenSigSendType" SG_ 342 FLR2RdrObject22To23Class1 1;
BA_ "GenSigFuncType" SG_ 342 FLR2RdrObject22To23Counter 27;
BA_ "GenSigSendType" SG_ 342 FLR2RdrObject22To23Counter 1;
BA_ "GenSigSendType" SG_ 342 FLR2RdrObject22To23DataCoastCntr0 1;
BA_ "GenSigSendType" SG_ 342 FLR2RdrObject22To23DataCoastCntr1 1;
BA_ "GenSigSendType" SG_ 342 FLR2RdrObject22To23DataConf0 1;
BA_ "GenSigSendType" SG_ 342 FLR2RdrObject22To23DataConf1 1;
BA_ "GenSigSendType" SG_ 342 FLR2RdrObject22To23DataLen0 1;
BA_ "GenSigSendType" SG_ 342 FLR2RdrObject22To23DataLen1 1;
BA_ "GenSigSendType" SG_ 342 FLR2RdrObject22To23DataStDLatAcc0 1;
BA_ "GenSigSendType" SG_ 342 FLR2RdrObject22To23DataStDLatAcc1 1;
BA_ "GenSigSendType" SG_ 342 FLR2RdrObject22To23DataStDLatPos0 1;
BA_ "GenSigSendType" SG_ 342 FLR2RdrObject22To23DataStDLatPos1 1;
BA_ "GenSigSendType" SG_ 342 FLR2RdrObject22To23DataStDLatVelo0 1;
BA_ "GenSigSendType" SG_ 342 FLR2RdrObject22To23DataStDLatVelo1 1;
BA_ "GenSigSendType" SG_ 342 FLR2RdrObject22To23DataStDLgtAcc0 1;
BA_ "GenSigSendType" SG_ 342 FLR2RdrObject22To23DataStDLgtAcc1 1;
BA_ "GenSigSendType" SG_ 342 FLR2RdrObject22To23DataStDLgtPos0 1;
BA_ "GenSigSendType" SG_ 342 FLR2RdrObject22To23DataStDLgtPos1 1;
BA_ "GenSigSendType" SG_ 342 FLR2RdrObject22To23DataStDLgtVelo0 1;
BA_ "GenSigSendType" SG_ 342 FLR2RdrObject22To23DataStDLgtVelo1 1;
BA_ "GenSigSendType" SG_ 342 FLR2RdrObject22To23DataWidth0 1;
BA_ "GenSigSendType" SG_ 342 FLR2RdrObject22To23DataWidth1 1;
BA_ "GenSigSendType" SG_ 342 FLR2RdrObject22To23HeadingAng0 1;
BA_ "GenSigStartValue" SG_ 342 FLR2RdrObject22To23HeadingAng0 315;
BA_ "GenSigSendType" SG_ 342 FLR2RdrObject22To23HeadingAng1 1;
BA_ "GenSigStartValue" SG_ 342 FLR2RdrObject22To23HeadingAng1 315;
BA_ "GenSigSendType" SG_ 342 FLR2RdrObject22To23LatAcc0 1;
BA_ "GenSigStartValue" SG_ 342 FLR2RdrObject22To23LatAcc0 356;
BA_ "GenSigSendType" SG_ 342 FLR2RdrObject22To23LatAcc1 1;
BA_ "GenSigStartValue" SG_ 342 FLR2RdrObject22To23LatAcc1 356;
BA_ "GenSigSendType" SG_ 342 FLR2RdrObject22To23LatPos0 1;
BA_ "GenSigStartValue" SG_ 342 FLR2RdrObject22To23LatPos0 4095;
BA_ "GenSigSendType" SG_ 342 FLR2RdrObject22To23LatPos1 1;
BA_ "GenSigStartValue" SG_ 342 FLR2RdrObject22To23LatPos1 4095;
BA_ "GenSigSendType" SG_ 342 FLR2RdrObject22To23LatVelo0 1;
BA_ "GenSigStartValue" SG_ 342 FLR2RdrObject22To23LatVelo0 1024;
BA_ "GenSigSendType" SG_ 342 FLR2RdrObject22To23LatVelo1 1;
BA_ "GenSigStartValue" SG_ 342 FLR2RdrObject22To23LatVelo1 1024;
BA_ "GenSigSendType" SG_ 342 FLR2RdrObject22To23LgtAcc0 1;
BA_ "GenSigStartValue" SG_ 342 FLR2RdrObject22To23LgtAcc0 356;
BA_ "GenSigSendType" SG_ 342 FLR2RdrObject22To23LgtAcc1 1;
BA_ "GenSigStartValue" SG_ 342 FLR2RdrObject22To23LgtAcc1 356;
BA_ "GenSigSendType" SG_ 342 FLR2RdrObject22To23LgtPos0 1;
BA_ "GenSigStartValue" SG_ 342 FLR2RdrObject22To23LgtPos0 4095;
BA_ "GenSigSendType" SG_ 342 FLR2RdrObject22To23LgtPos1 1;
BA_ "GenSigStartValue" SG_ 342 FLR2RdrObject22To23LgtPos1 4095;
BA_ "GenSigSendType" SG_ 342 FLR2RdrObject22To23LgtVelo0 1;
BA_ "GenSigStartValue" SG_ 342 FLR2RdrObject22To23LgtVelo0 1024;
BA_ "GenSigSendType" SG_ 342 FLR2RdrObject22To23LgtVelo1 1;
BA_ "GenSigStartValue" SG_ 342 FLR2RdrObject22To23LgtVelo1 1024;
BA_ "GenSigSendType" SG_ 342 FLR2RdrObject22To23ModeInfo0 1;
BA_ "GenSigSendType" SG_ 342 FLR2RdrObject22To23ModeInfo1 1;
BA_ "GenSigSendType" SG_ 342 FLR2RdrObject22To23MsgCntr 1;
BA_ "GenSigSendType" SG_ 342 FLR2RdrObject22To23MtnModel0 1;
BA_ "GenSigSendType" SG_ 342 FLR2RdrObject22To23MtnModel1 1;
BA_ "GenSigSendType" SG_ 342 FLR2RdrObject22To23MtnPattern0 1;
BA_ "GenSigSendType" SG_ 342 FLR2RdrObject22To23MtnPattern1 1;
BA_ "GenSigSendType" SG_ 342 FLR2RdrObject22To23PedMicroDoppler0 1;
BA_ "GenSigSendType" SG_ 342 FLR2RdrObject22To23PedMicroDoppler1 1;
BA_ "GenSigSendType" SG_ 342 FLR2RdrObject22To23Qly0 1;
BA_ "GenSigSendType" SG_ 342 FLR2RdrObject22To23Qly1 1;
BA_ "GenSigSendType" SG_ 342 FLR2RdrObject22To23ScanID 1;
BA_ "GenSigDataID" SG_ 344 FLR2RdrObject24To25CRC "0x8AB";
BA_ "GenSigFuncType" SG_ 344 FLR2RdrObject24To25CRC 28;
BA_ "GenSigSendType" SG_ 344 FLR2RdrObject24To25CRC 1;
BA_ "GenSigSendType" SG_ 344 FLR2RdrObject24To25Class0 1;
BA_ "GenSigSendType" SG_ 344 FLR2RdrObject24To25Class1 1;
BA_ "GenSigFuncType" SG_ 344 FLR2RdrObject24To25Counter 27;
BA_ "GenSigSendType" SG_ 344 FLR2RdrObject24To25Counter 1;
BA_ "GenSigSendType" SG_ 344 FLR2RdrObject24To25DataCoastCntr0 1;
BA_ "GenSigSendType" SG_ 344 FLR2RdrObject24To25DataCoastCntr1 1;
BA_ "GenSigSendType" SG_ 344 FLR2RdrObject24To25DataConf0 1;
BA_ "GenSigSendType" SG_ 344 FLR2RdrObject24To25DataConf1 1;
BA_ "GenSigSendType" SG_ 344 FLR2RdrObject24To25DataLen0 1;
BA_ "GenSigSendType" SG_ 344 FLR2RdrObject24To25DataLen1 1;
BA_ "GenSigSendType" SG_ 344 FLR2RdrObject24To25DataStDLatAcc0 1;
BA_ "GenSigSendType" SG_ 344 FLR2RdrObject24To25DataStDLatAcc1 1;
BA_ "GenSigSendType" SG_ 344 FLR2RdrObject24To25DataStDLatPos0 1;
BA_ "GenSigSendType" SG_ 344 FLR2RdrObject24To25DataStDLatPos1 1;
BA_ "GenSigSendType" SG_ 344 FLR2RdrObject24To25DataStDLatVelo0 1;
BA_ "GenSigSendType" SG_ 344 FLR2RdrObject24To25DataStDLatVelo1 1;
BA_ "GenSigSendType" SG_ 344 FLR2RdrObject24To25DataStDLgtAcc0 1;
BA_ "GenSigSendType" SG_ 344 FLR2RdrObject24To25DataStDLgtAcc1 1;
BA_ "GenSigSendType" SG_ 344 FLR2RdrObject24To25DataStDLgtPos0 1;
BA_ "GenSigSendType" SG_ 344 FLR2RdrObject24To25DataStDLgtPos1 1;
BA_ "GenSigSendType" SG_ 344 FLR2RdrObject24To25DataStDLgtVelo0 1;
BA_ "GenSigSendType" SG_ 344 FLR2RdrObject24To25DataStDLgtVelo1 1;
BA_ "GenSigSendType" SG_ 344 FLR2RdrObject24To25DataWidth0 1;
BA_ "GenSigSendType" SG_ 344 FLR2RdrObject24To25DataWidth1 1;
BA_ "GenSigSendType" SG_ 344 FLR2RdrObject24To25HeadingAng0 1;
BA_ "GenSigStartValue" SG_ 344 FLR2RdrObject24To25HeadingAng0 315;
BA_ "GenSigSendType" SG_ 344 FLR2RdrObject24To25HeadingAng1 1;
BA_ "GenSigStartValue" SG_ 344 FLR2RdrObject24To25HeadingAng1 315;
BA_ "GenSigSendType" SG_ 344 FLR2RdrObject24To25LatAcc0 1;
BA_ "GenSigStartValue" SG_ 344 FLR2RdrObject24To25LatAcc0 356;
BA_ "GenSigSendType" SG_ 344 FLR2RdrObject24To25LatAcc1 1;
BA_ "GenSigStartValue" SG_ 344 FLR2RdrObject24To25LatAcc1 356;
BA_ "GenSigSendType" SG_ 344 FLR2RdrObject24To25LatPos0 1;
BA_ "GenSigStartValue" SG_ 344 FLR2RdrObject24To25LatPos0 4095;
BA_ "GenSigSendType" SG_ 344 FLR2RdrObject24To25LatPos1 1;
BA_ "GenSigStartValue" SG_ 344 FLR2RdrObject24To25LatPos1 4095;
BA_ "GenSigSendType" SG_ 344 FLR2RdrObject24To25LatVelo0 1;
BA_ "GenSigStartValue" SG_ 344 FLR2RdrObject24To25LatVelo0 1024;
BA_ "GenSigSendType" SG_ 344 FLR2RdrObject24To25LatVelo1 1;
BA_ "GenSigStartValue" SG_ 344 FLR2RdrObject24To25LatVelo1 1024;
BA_ "GenSigSendType" SG_ 344 FLR2RdrObject24To25LgtAcc0 1;
BA_ "GenSigStartValue" SG_ 344 FLR2RdrObject24To25LgtAcc0 356;
BA_ "GenSigSendType" SG_ 344 FLR2RdrObject24To25LgtAcc1 1;
BA_ "GenSigStartValue" SG_ 344 FLR2RdrObject24To25LgtAcc1 356;
BA_ "GenSigSendType" SG_ 344 FLR2RdrObject24To25LgtPos0 1;
BA_ "GenSigStartValue" SG_ 344 FLR2RdrObject24To25LgtPos0 4095;
BA_ "GenSigSendType" SG_ 344 FLR2RdrObject24To25LgtPos1 1;
BA_ "GenSigStartValue" SG_ 344 FLR2RdrObject24To25LgtPos1 4095;
BA_ "GenSigSendType" SG_ 344 FLR2RdrObject24To25LgtVelo0 1;
BA_ "GenSigStartValue" SG_ 344 FLR2RdrObject24To25LgtVelo0 1024;
BA_ "GenSigSendType" SG_ 344 FLR2RdrObject24To25LgtVelo1 1;
BA_ "GenSigStartValue" SG_ 344 FLR2RdrObject24To25LgtVelo1 1024;
BA_ "GenSigSendType" SG_ 344 FLR2RdrObject24To25ModeInfo0 1;
BA_ "GenSigSendType" SG_ 344 FLR2RdrObject24To25ModeInfo1 1;
BA_ "GenSigSendType" SG_ 344 FLR2RdrObject24To25MsgCntr 1;
BA_ "GenSigSendType" SG_ 344 FLR2RdrObject24To25MtnModel0 1;
BA_ "GenSigSendType" SG_ 344 FLR2RdrObject24To25MtnModel1 1;
BA_ "GenSigSendType" SG_ 344 FLR2RdrObject24To25MtnPattern0 1;
BA_ "GenSigSendType" SG_ 344 FLR2RdrObject24To25MtnPattern1 1;
BA_ "GenSigSendType" SG_ 344 FLR2RdrObject24To25PedMicroDoppler0 1;
BA_ "GenSigSendType" SG_ 344 FLR2RdrObject24To25PedMicroDoppler1 1;
BA_ "GenSigSendType" SG_ 344 FLR2RdrObject24To25Qly0 1;
BA_ "GenSigSendType" SG_ 344 FLR2RdrObject24To25Qly1 1;
BA_ "GenSigSendType" SG_ 344 FLR2RdrObject24To25ScanID 1;
BA_ "GenSigDataID" SG_ 346 FLR2RdrObject26To27CRC "0x8AC";
BA_ "GenSigFuncType" SG_ 346 FLR2RdrObject26To27CRC 28;
BA_ "GenSigSendType" SG_ 346 FLR2RdrObject26To27CRC 1;
BA_ "GenSigSendType" SG_ 346 FLR2RdrObject26To27Class0 1;
BA_ "GenSigSendType" SG_ 346 FLR2RdrObject26To27Class1 1;
BA_ "GenSigFuncType" SG_ 346 FLR2RdrObject26To27Counter 27;
BA_ "GenSigSendType" SG_ 346 FLR2RdrObject26To27Counter 1;
BA_ "GenSigSendType" SG_ 346 FLR2RdrObject26To27DataCoastCntr0 1;
BA_ "GenSigSendType" SG_ 346 FLR2RdrObject26To27DataCoastCntr1 1;
BA_ "GenSigSendType" SG_ 346 FLR2RdrObject26To27DataConf0 1;
BA_ "GenSigSendType" SG_ 346 FLR2RdrObject26To27DataConf1 1;
BA_ "GenSigSendType" SG_ 346 FLR2RdrObject26To27DataLen0 1;
BA_ "GenSigSendType" SG_ 346 FLR2RdrObject26To27DataLen1 1;
BA_ "GenSigSendType" SG_ 346 FLR2RdrObject26To27DataStDLatAcc0 1;
BA_ "GenSigSendType" SG_ 346 FLR2RdrObject26To27DataStDLatAcc1 1;
BA_ "GenSigSendType" SG_ 346 FLR2RdrObject26To27DataStDLatPos0 1;
BA_ "GenSigSendType" SG_ 346 FLR2RdrObject26To27DataStDLatPos1 1;
BA_ "GenSigSendType" SG_ 346 FLR2RdrObject26To27DataStDLatVelo0 1;
BA_ "GenSigSendType" SG_ 346 FLR2RdrObject26To27DataStDLatVelo1 1;
BA_ "GenSigSendType" SG_ 346 FLR2RdrObject26To27DataStDLgtAcc0 1;
BA_ "GenSigSendType" SG_ 346 FLR2RdrObject26To27DataStDLgtAcc1 1;
BA_ "GenSigSendType" SG_ 346 FLR2RdrObject26To27DataStDLgtPos0 1;
BA_ "GenSigSendType" SG_ 346 FLR2RdrObject26To27DataStDLgtPos1 1;
BA_ "GenSigSendType" SG_ 346 FLR2RdrObject26To27DataStDLgtVelo0 1;
BA_ "GenSigSendType" SG_ 346 FLR2RdrObject26To27DataStDLgtVelo1 1;
BA_ "GenSigSendType" SG_ 346 FLR2RdrObject26To27DataWidth0 1;
BA_ "GenSigSendType" SG_ 346 FLR2RdrObject26To27DataWidth1 1;
BA_ "GenSigSendType" SG_ 346 FLR2RdrObject26To27HeadingAng0 1;
BA_ "GenSigStartValue" SG_ 346 FLR2RdrObject26To27HeadingAng0 315;
BA_ "GenSigSendType" SG_ 346 FLR2RdrObject26To27HeadingAng1 1;
BA_ "GenSigStartValue" SG_ 346 FLR2RdrObject26To27HeadingAng1 315;
BA_ "GenSigSendType" SG_ 346 FLR2RdrObject26To27LatAcc0 1;
BA_ "GenSigStartValue" SG_ 346 FLR2RdrObject26To27LatAcc0 356;
BA_ "GenSigSendType" SG_ 346 FLR2RdrObject26To27LatAcc1 1;
BA_ "GenSigStartValue" SG_ 346 FLR2RdrObject26To27LatAcc1 356;
BA_ "GenSigSendType" SG_ 346 FLR2RdrObject26To27LatPos0 1;
BA_ "GenSigStartValue" SG_ 346 FLR2RdrObject26To27LatPos0 4095;
BA_ "GenSigSendType" SG_ 346 FLR2RdrObject26To27LatPos1 1;
BA_ "GenSigStartValue" SG_ 346 FLR2RdrObject26To27LatPos1 4095;
BA_ "GenSigSendType" SG_ 346 FLR2RdrObject26To27LatVelo0 1;
BA_ "GenSigStartValue" SG_ 346 FLR2RdrObject26To27LatVelo0 1024;
BA_ "GenSigSendType" SG_ 346 FLR2RdrObject26To27LatVelo1 1;
BA_ "GenSigStartValue" SG_ 346 FLR2RdrObject26To27LatVelo1 1024;
BA_ "GenSigSendType" SG_ 346 FLR2RdrObject26To27LgtAcc0 1;
BA_ "GenSigStartValue" SG_ 346 FLR2RdrObject26To27LgtAcc0 356;
BA_ "GenSigSendType" SG_ 346 FLR2RdrObject26To27LgtAcc1 1;
BA_ "GenSigStartValue" SG_ 346 FLR2RdrObject26To27LgtAcc1 356;
BA_ "GenSigSendType" SG_ 346 FLR2RdrObject26To27LgtPos0 1;
BA_ "GenSigStartValue" SG_ 346 FLR2RdrObject26To27LgtPos0 4095;
BA_ "GenSigSendType" SG_ 346 FLR2RdrObject26To27LgtPos1 1;
BA_ "GenSigStartValue" SG_ 346 FLR2RdrObject26To27LgtPos1 4095;
BA_ "GenSigSendType" SG_ 346 FLR2RdrObject26To27LgtVelo0 1;
BA_ "GenSigStartValue" SG_ 346 FLR2RdrObject26To27LgtVelo0 1024;
BA_ "GenSigSendType" SG_ 346 FLR2RdrObject26To27LgtVelo1 1;
BA_ "GenSigStartValue" SG_ 346 FLR2RdrObject26To27LgtVelo1 1024;
BA_ "GenSigSendType" SG_ 346 FLR2RdrObject26To27ModeInfo0 1;
BA_ "GenSigSendType" SG_ 346 FLR2RdrObject26To27ModeInfo1 1;
BA_ "GenSigSendType" SG_ 346 FLR2RdrObject26To27MsgCntr 1;
BA_ "GenSigSendType" SG_ 346 FLR2RdrObject26To27MtnModel0 1;
BA_ "GenSigSendType" SG_ 346 FLR2RdrObject26To27MtnModel1 1;
BA_ "GenSigSendType" SG_ 346 FLR2RdrObject26To27MtnPattern0 1;
BA_ "GenSigSendType" SG_ 346 FLR2RdrObject26To27MtnPattern1 1;
BA_ "GenSigSendType" SG_ 346 FLR2RdrObject26To27PedMicroDoppler0 1;
BA_ "GenSigSendType" SG_ 346 FLR2RdrObject26To27PedMicroDoppler1 1;
BA_ "GenSigSendType" SG_ 346 FLR2RdrObject26To27Qly0 1;
BA_ "GenSigSendType" SG_ 346 FLR2RdrObject26To27Qly1 1;
BA_ "GenSigSendType" SG_ 346 FLR2RdrObject26To27ScanID 1;
BA_ "GenSigDataID" SG_ 348 FLR2RdrObject28To29CRC "0x8AD";
BA_ "GenSigFuncType" SG_ 348 FLR2RdrObject28To29CRC 28;
BA_ "GenSigSendType" SG_ 348 FLR2RdrObject28To29CRC 1;
BA_ "GenSigSendType" SG_ 348 FLR2RdrObject28To29Class0 1;
BA_ "GenSigSendType" SG_ 348 FLR2RdrObject28To29Class1 1;
BA_ "GenSigFuncType" SG_ 348 FLR2RdrObject28To29Counter 27;
BA_ "GenSigSendType" SG_ 348 FLR2RdrObject28To29Counter 1;
BA_ "GenSigSendType" SG_ 348 FLR2RdrObject28To29DataCoastCntr0 1;
BA_ "GenSigSendType" SG_ 348 FLR2RdrObject28To29DataCoastCntr1 1;
BA_ "GenSigSendType" SG_ 348 FLR2RdrObject28To29DataConf0 1;
BA_ "GenSigSendType" SG_ 348 FLR2RdrObject28To29DataConf1 1;
BA_ "GenSigSendType" SG_ 348 FLR2RdrObject28To29DataLen0 1;
BA_ "GenSigSendType" SG_ 348 FLR2RdrObject28To29DataLen1 1;
BA_ "GenSigSendType" SG_ 348 FLR2RdrObject28To29DataStDLatAcc0 1;
BA_ "GenSigSendType" SG_ 348 FLR2RdrObject28To29DataStDLatAcc1 1;
BA_ "GenSigSendType" SG_ 348 FLR2RdrObject28To29DataStDLatPos0 1;
BA_ "GenSigSendType" SG_ 348 FLR2RdrObject28To29DataStDLatPos1 1;
BA_ "GenSigSendType" SG_ 348 FLR2RdrObject28To29DataStDLatVelo0 1;
BA_ "GenSigSendType" SG_ 348 FLR2RdrObject28To29DataStDLatVelo1 1;
BA_ "GenSigSendType" SG_ 348 FLR2RdrObject28To29DataStDLgtAcc0 1;
BA_ "GenSigSendType" SG_ 348 FLR2RdrObject28To29DataStDLgtAcc1 1;
BA_ "GenSigSendType" SG_ 348 FLR2RdrObject28To29DataStDLgtPos0 1;
BA_ "GenSigSendType" SG_ 348 FLR2RdrObject28To29DataStDLgtPos1 1;
BA_ "GenSigSendType" SG_ 348 FLR2RdrObject28To29DataStDLgtVelo0 1;
BA_ "GenSigSendType" SG_ 348 FLR2RdrObject28To29DataStDLgtVelo1 1;
BA_ "GenSigSendType" SG_ 348 FLR2RdrObject28To29DataWidth0 1;
BA_ "GenSigSendType" SG_ 348 FLR2RdrObject28To29DataWidth1 1;
BA_ "GenSigSendType" SG_ 348 FLR2RdrObject28To29HeadingAng0 1;
BA_ "GenSigStartValue" SG_ 348 FLR2RdrObject28To29HeadingAng0 315;
BA_ "GenSigSendType" SG_ 348 FLR2RdrObject28To29HeadingAng1 1;
BA_ "GenSigStartValue" SG_ 348 FLR2RdrObject28To29HeadingAng1 315;
BA_ "GenSigSendType" SG_ 348 FLR2RdrObject28To29LatAcc0 1;
BA_ "GenSigStartValue" SG_ 348 FLR2RdrObject28To29LatAcc0 356;
BA_ "GenSigSendType" SG_ 348 FLR2RdrObject28To29LatAcc1 1;
BA_ "GenSigStartValue" SG_ 348 FLR2RdrObject28To29LatAcc1 356;
BA_ "GenSigSendType" SG_ 348 FLR2RdrObject28To29LatPos0 1;
BA_ "GenSigStartValue" SG_ 348 FLR2RdrObject28To29LatPos0 4095;
BA_ "GenSigSendType" SG_ 348 FLR2RdrObject28To29LatPos1 1;
BA_ "GenSigStartValue" SG_ 348 FLR2RdrObject28To29LatPos1 4095;
BA_ "GenSigSendType" SG_ 348 FLR2RdrObject28To29LatVelo0 1;
BA_ "GenSigStartValue" SG_ 348 FLR2RdrObject28To29LatVelo0 1024;
BA_ "GenSigSendType" SG_ 348 FLR2RdrObject28To29LatVelo1 1;
BA_ "GenSigStartValue" SG_ 348 FLR2RdrObject28To29LatVelo1 1024;
BA_ "GenSigSendType" SG_ 348 FLR2RdrObject28To29LgtAcc0 1;
BA_ "GenSigStartValue" SG_ 348 FLR2RdrObject28To29LgtAcc0 356;
BA_ "GenSigSendType" SG_ 348 FLR2RdrObject28To29LgtAcc1 1;
BA_ "GenSigStartValue" SG_ 348 FLR2RdrObject28To29LgtAcc1 356;
BA_ "GenSigSendType" SG_ 348 FLR2RdrObject28To29LgtPos0 1;
BA_ "GenSigStartValue" SG_ 348 FLR2RdrObject28To29LgtPos0 4095;
BA_ "GenSigSendType" SG_ 348 FLR2RdrObject28To29LgtPos1 1;
BA_ "GenSigStartValue" SG_ 348 FLR2RdrObject28To29LgtPos1 4095;
BA_ "GenSigSendType" SG_ 348 FLR2RdrObject28To29LgtVelo0 1;
BA_ "GenSigStartValue" SG_ 348 FLR2RdrObject28To29LgtVelo0 1024;
BA_ "GenSigSendType" SG_ 348 FLR2RdrObject28To29LgtVelo1 1;
BA_ "GenSigStartValue" SG_ 348 FLR2RdrObject28To29LgtVelo1 1024;
BA_ "GenSigSendType" SG_ 348 FLR2RdrObject28To29ModeInfo0 1;
BA_ "GenSigSendType" SG_ 348 FLR2RdrObject28To29ModeInfo1 1;
BA_ "GenSigSendType" SG_ 348 FLR2RdrObject28To29MsgCntr 1;
BA_ "GenSigSendType" SG_ 348 FLR2RdrObject28To29MtnModel0 1;
BA_ "GenSigSendType" SG_ 348 FLR2RdrObject28To29MtnModel1 1;
BA_ "GenSigSendType" SG_ 348 FLR2RdrObject28To29MtnPattern0 1;
BA_ "GenSigSendType" SG_ 348 FLR2RdrObject28To29MtnPattern1 1;
BA_ "GenSigSendType" SG_ 348 FLR2RdrObject28To29PedMicroDoppler0 1;
BA_ "GenSigSendType" SG_ 348 FLR2RdrObject28To29PedMicroDoppler1 1;
BA_ "GenSigSendType" SG_ 348 FLR2RdrObject28To29Qly0 1;
BA_ "GenSigSendType" SG_ 348 FLR2RdrObject28To29Qly1 1;
BA_ "GenSigSendType" SG_ 348 FLR2RdrObject28To29ScanID 1;
BA_ "GenSigDataID" SG_ 324 FLR2RdrObject4To5CRC "0x8D0";
BA_ "GenSigFuncType" SG_ 324 FLR2RdrObject4To5CRC 28;
BA_ "GenSigSendType" SG_ 324 FLR2RdrObject4To5CRC 1;
BA_ "GenSigSendType" SG_ 324 FLR2RdrObject4To5Class0 1;
BA_ "GenSigSendType" SG_ 324 FLR2RdrObject4To5Class1 1;
BA_ "GenSigFuncType" SG_ 324 FLR2RdrObject4To5Counter 27;
BA_ "GenSigSendType" SG_ 324 FLR2RdrObject4To5Counter 1;
BA_ "GenSigSendType" SG_ 324 FLR2RdrObject4To5DataCoastCntr0 1;
BA_ "GenSigSendType" SG_ 324 FLR2RdrObject4To5DataCoastCntr1 1;
BA_ "GenSigSendType" SG_ 324 FLR2RdrObject4To5DataConf0 1;
BA_ "GenSigSendType" SG_ 324 FLR2RdrObject4To5DataConf1 1;
BA_ "GenSigSendType" SG_ 324 FLR2RdrObject4To5DataLen0 1;
BA_ "GenSigSendType" SG_ 324 FLR2RdrObject4To5DataLen1 1;
BA_ "GenSigSendType" SG_ 324 FLR2RdrObject4To5DataStDLatAcc0 1;
BA_ "GenSigSendType" SG_ 324 FLR2RdrObject4To5DataStDLatAcc1 1;
BA_ "GenSigSendType" SG_ 324 FLR2RdrObject4To5DataStDLatPos0 1;
BA_ "GenSigSendType" SG_ 324 FLR2RdrObject4To5DataStDLatPos1 1;
BA_ "GenSigSendType" SG_ 324 FLR2RdrObject4To5DataStDLatVelo0 1;
BA_ "GenSigSendType" SG_ 324 FLR2RdrObject4To5DataStDLatVelo1 1;
BA_ "GenSigSendType" SG_ 324 FLR2RdrObject4To5DataStDLgtAcc0 1;
BA_ "GenSigSendType" SG_ 324 FLR2RdrObject4To5DataStDLgtAcc1 1;
BA_ "GenSigSendType" SG_ 324 FLR2RdrObject4To5DataStDLgtPos0 1;
BA_ "GenSigSendType" SG_ 324 FLR2RdrObject4To5DataStDLgtPos1 1;
BA_ "GenSigSendType" SG_ 324 FLR2RdrObject4To5DataStDLgtVelo0 1;
BA_ "GenSigSendType" SG_ 324 FLR2RdrObject4To5DataStDLgtVelo1 1;
BA_ "GenSigSendType" SG_ 324 FLR2RdrObject4To5DataWidth0 1;
BA_ "GenSigSendType" SG_ 324 FLR2RdrObject4To5DataWidth1 1;
BA_ "GenSigSendType" SG_ 324 FLR2RdrObject4To5HeadingAng0 1;
BA_ "GenSigStartValue" SG_ 324 FLR2RdrObject4To5HeadingAng0 315;
BA_ "GenSigSendType" SG_ 324 FLR2RdrObject4To5HeadingAng1 1;
BA_ "GenSigStartValue" SG_ 324 FLR2RdrObject4To5HeadingAng1 315;
BA_ "GenSigSendType" SG_ 324 FLR2RdrObject4To5LatAcc0 1;
BA_ "GenSigStartValue" SG_ 324 FLR2RdrObject4To5LatAcc0 356;
BA_ "GenSigSendType" SG_ 324 FLR2RdrObject4To5LatAcc1 1;
BA_ "GenSigStartValue" SG_ 324 FLR2RdrObject4To5LatAcc1 356;
BA_ "GenSigSendType" SG_ 324 FLR2RdrObject4To5LatPos0 1;
BA_ "GenSigStartValue" SG_ 324 FLR2RdrObject4To5LatPos0 4095;
BA_ "GenSigSendType" SG_ 324 FLR2RdrObject4To5LatPos1 1;
BA_ "GenSigStartValue" SG_ 324 FLR2RdrObject4To5LatPos1 4095;
BA_ "GenSigSendType" SG_ 324 FLR2RdrObject4To5LatVelo0 1;
BA_ "GenSigStartValue" SG_ 324 FLR2RdrObject4To5LatVelo0 1024;
BA_ "GenSigSendType" SG_ 324 FLR2RdrObject4To5LatVelo1 1;
BA_ "GenSigStartValue" SG_ 324 FLR2RdrObject4To5LatVelo1 1024;
BA_ "GenSigSendType" SG_ 324 FLR2RdrObject4To5LgtAcc0 1;
BA_ "GenSigStartValue" SG_ 324 FLR2RdrObject4To5LgtAcc0 356;
BA_ "GenSigSendType" SG_ 324 FLR2RdrObject4To5LgtAcc1 1;
BA_ "GenSigStartValue" SG_ 324 FLR2RdrObject4To5LgtAcc1 356;
BA_ "GenSigSendType" SG_ 324 FLR2RdrObject4To5LgtPos0 1;
BA_ "GenSigStartValue" SG_ 324 FLR2RdrObject4To5LgtPos0 4095;
BA_ "GenSigSendType" SG_ 324 FLR2RdrObject4To5LgtPos1 1;
BA_ "GenSigStartValue" SG_ 324 FLR2RdrObject4To5LgtPos1 4095;
BA_ "GenSigSendType" SG_ 324 FLR2RdrObject4To5LgtVelo0 1;
BA_ "GenSigStartValue" SG_ 324 FLR2RdrObject4To5LgtVelo0 1024;
BA_ "GenSigSendType" SG_ 324 FLR2RdrObject4To5LgtVelo1 1;
BA_ "GenSigStartValue" SG_ 324 FLR2RdrObject4To5LgtVelo1 1024;
BA_ "GenSigSendType" SG_ 324 FLR2RdrObject4To5ModeInfo0 1;
BA_ "GenSigSendType" SG_ 324 FLR2RdrObject4To5ModeInfo1 1;
BA_ "GenSigSendType" SG_ 324 FLR2RdrObject4To5MsgCntr 1;
BA_ "GenSigSendType" SG_ 324 FLR2RdrObject4To5MtnModel0 1;
BA_ "GenSigSendType" SG_ 324 FLR2RdrObject4To5MtnModel1 1;
BA_ "GenSigSendType" SG_ 324 FLR2RdrObject4To5MtnPattern0 1;
BA_ "GenSigSendType" SG_ 324 FLR2RdrObject4To5MtnPattern1 1;
BA_ "GenSigSendType" SG_ 324 FLR2RdrObject4To5PedMicroDoppler0 1;
BA_ "GenSigSendType" SG_ 324 FLR2RdrObject4To5PedMicroDoppler1 1;
BA_ "GenSigSendType" SG_ 324 FLR2RdrObject4To5Qly0 1;
BA_ "GenSigSendType" SG_ 324 FLR2RdrObject4To5Qly1 1;
BA_ "GenSigSendType" SG_ 324 FLR2RdrObject4To5ScanID 1;
BA_ "GenSigDataID" SG_ 326 FLR2RdrObject6To7CRC "0x8D1";
BA_ "GenSigFuncType" SG_ 326 FLR2RdrObject6To7CRC 28;
BA_ "GenSigSendType" SG_ 326 FLR2RdrObject6To7CRC 1;
BA_ "GenSigSendType" SG_ 326 FLR2RdrObject6To7Class0 1;
BA_ "GenSigSendType" SG_ 326 FLR2RdrObject6To7Class1 1;
BA_ "GenSigFuncType" SG_ 326 FLR2RdrObject6To7Counter 27;
BA_ "GenSigSendType" SG_ 326 FLR2RdrObject6To7Counter 1;
BA_ "GenSigSendType" SG_ 326 FLR2RdrObject6To7DataCoastCntr0 1;
BA_ "GenSigSendType" SG_ 326 FLR2RdrObject6To7DataCoastCntr1 1;
BA_ "GenSigSendType" SG_ 326 FLR2RdrObject6To7DataConf0 1;
BA_ "GenSigSendType" SG_ 326 FLR2RdrObject6To7DataConf1 1;
BA_ "GenSigSendType" SG_ 326 FLR2RdrObject6To7DataLen0 1;
BA_ "GenSigSendType" SG_ 326 FLR2RdrObject6To7DataLen1 1;
BA_ "GenSigSendType" SG_ 326 FLR2RdrObject6To7DataStDLatAcc0 1;
BA_ "GenSigSendType" SG_ 326 FLR2RdrObject6To7DataStDLatAcc1 1;
BA_ "GenSigSendType" SG_ 326 FLR2RdrObject6To7DataStDLatPos0 1;
BA_ "GenSigSendType" SG_ 326 FLR2RdrObject6To7DataStDLatPos1 1;
BA_ "GenSigSendType" SG_ 326 FLR2RdrObject6To7DataStDLatVelo0 1;
BA_ "GenSigSendType" SG_ 326 FLR2RdrObject6To7DataStDLatVelo1 1;
BA_ "GenSigSendType" SG_ 326 FLR2RdrObject6To7DataStDLgtAcc0 1;
BA_ "GenSigSendType" SG_ 326 FLR2RdrObject6To7DataStDLgtAcc1 1;
BA_ "GenSigSendType" SG_ 326 FLR2RdrObject6To7DataStDLgtPos0 1;
BA_ "GenSigSendType" SG_ 326 FLR2RdrObject6To7DataStDLgtPos1 1;
BA_ "GenSigSendType" SG_ 326 FLR2RdrObject6To7DataStDLgtVelo0 1;
BA_ "GenSigSendType" SG_ 326 FLR2RdrObject6To7DataStDLgtVelo1 1;
BA_ "GenSigSendType" SG_ 326 FLR2RdrObject6To7DataWidth0 1;
BA_ "GenSigSendType" SG_ 326 FLR2RdrObject6To7DataWidth1 1;
BA_ "GenSigSendType" SG_ 326 FLR2RdrObject6To7HeadingAng0 1;
BA_ "GenSigStartValue" SG_ 326 FLR2RdrObject6To7HeadingAng0 315;
BA_ "GenSigSendType" SG_ 326 FLR2RdrObject6To7HeadingAng1 1;
BA_ "GenSigStartValue" SG_ 326 FLR2RdrObject6To7HeadingAng1 315;
BA_ "GenSigSendType" SG_ 326 FLR2RdrObject6To7LatAcc0 1;
BA_ "GenSigStartValue" SG_ 326 FLR2RdrObject6To7LatAcc0 356;
BA_ "GenSigSendType" SG_ 326 FLR2RdrObject6To7LatAcc1 1;
BA_ "GenSigStartValue" SG_ 326 FLR2RdrObject6To7LatAcc1 356;
BA_ "GenSigSendType" SG_ 326 FLR2RdrObject6To7LatPos0 1;
BA_ "GenSigStartValue" SG_ 326 FLR2RdrObject6To7LatPos0 4095;
BA_ "GenSigSendType" SG_ 326 FLR2RdrObject6To7LatPos1 1;
BA_ "GenSigStartValue" SG_ 326 FLR2RdrObject6To7LatPos1 4095;
BA_ "GenSigSendType" SG_ 326 FLR2RdrObject6To7LatVelo0 1;
BA_ "GenSigStartValue" SG_ 326 FLR2RdrObject6To7LatVelo0 1024;
BA_ "GenSigSendType" SG_ 326 FLR2RdrObject6To7LatVelo1 1;
BA_ "GenSigStartValue" SG_ 326 FLR2RdrObject6To7LatVelo1 1024;
BA_ "GenSigSendType" SG_ 326 FLR2RdrObject6To7LgtAcc0 1;
BA_ "GenSigStartValue" SG_ 326 FLR2RdrObject6To7LgtAcc0 356;
BA_ "GenSigSendType" SG_ 326 FLR2RdrObject6To7LgtAcc1 1;
BA_ "GenSigStartValue" SG_ 326 FLR2RdrObject6To7LgtAcc1 356;
BA_ "GenSigSendType" SG_ 326 FLR2RdrObject6To7LgtPos0 1;
BA_ "GenSigStartValue" SG_ 326 FLR2RdrObject6To7LgtPos0 4095;
BA_ "GenSigSendType" SG_ 326 FLR2RdrObject6To7LgtPos1 1;
BA_ "GenSigStartValue" SG_ 326 FLR2RdrObject6To7LgtPos1 4095;
BA_ "GenSigSendType" SG_ 326 FLR2RdrObject6To7LgtVelo0 1;
BA_ "GenSigStartValue" SG_ 326 FLR2RdrObject6To7LgtVelo0 1024;
BA_ "GenSigSendType" SG_ 326 FLR2RdrObject6To7LgtVelo1 1;
BA_ "GenSigStartValue" SG_ 326 FLR2RdrObject6To7LgtVelo1 1024;
BA_ "GenSigSendType" SG_ 326 FLR2RdrObject6To7ModeInfo0 1;
BA_ "GenSigSendType" SG_ 326 FLR2RdrObject6To7ModeInfo1 1;
BA_ "GenSigSendType" SG_ 326 FLR2RdrObject6To7MsgCntr 1;
BA_ "GenSigSendType" SG_ 326 FLR2RdrObject6To7MtnModel0 1;
BA_ "GenSigSendType" SG_ 326 FLR2RdrObject6To7MtnModel1 1;
BA_ "GenSigSendType" SG_ 326 FLR2RdrObject6To7MtnPattern0 1;
BA_ "GenSigSendType" SG_ 326 FLR2RdrObject6To7MtnPattern1 1;
BA_ "GenSigSendType" SG_ 326 FLR2RdrObject6To7PedMicroDoppler0 1;
BA_ "GenSigSendType" SG_ 326 FLR2RdrObject6To7PedMicroDoppler1 1;
BA_ "GenSigSendType" SG_ 326 FLR2RdrObject6To7Qly0 1;
BA_ "GenSigSendType" SG_ 326 FLR2RdrObject6To7Qly1 1;
BA_ "GenSigSendType" SG_ 326 FLR2RdrObject6To7ScanID 1;
BA_ "GenSigDataID" SG_ 328 FLR2RdrObject8To9CRC "0x8D2";
BA_ "GenSigFuncType" SG_ 328 FLR2RdrObject8To9CRC 28;
BA_ "GenSigSendType" SG_ 328 FLR2RdrObject8To9CRC 1;
BA_ "GenSigSendType" SG_ 328 FLR2RdrObject8To9Class0 1;
BA_ "GenSigSendType" SG_ 328 FLR2RdrObject8To9Class1 1;
BA_ "GenSigFuncType" SG_ 328 FLR2RdrObject8To9Counter 27;
BA_ "GenSigSendType" SG_ 328 FLR2RdrObject8To9Counter 1;
BA_ "GenSigSendType" SG_ 328 FLR2RdrObject8To9DataCoastCntr0 1;
BA_ "GenSigSendType" SG_ 328 FLR2RdrObject8To9DataCoastCntr1 1;
BA_ "GenSigSendType" SG_ 328 FLR2RdrObject8To9DataConf0 1;
BA_ "GenSigSendType" SG_ 328 FLR2RdrObject8To9DataConf1 1;
BA_ "GenSigSendType" SG_ 328 FLR2RdrObject8To9DataLen0 1;
BA_ "GenSigSendType" SG_ 328 FLR2RdrObject8To9DataLen1 1;
BA_ "GenSigSendType" SG_ 328 FLR2RdrObject8To9DataStDLatAcc0 1;
BA_ "GenSigSendType" SG_ 328 FLR2RdrObject8To9DataStDLatAcc1 1;
BA_ "GenSigSendType" SG_ 328 FLR2RdrObject8To9DataStDLatPos0 1;
BA_ "GenSigSendType" SG_ 328 FLR2RdrObject8To9DataStDLatPos1 1;
BA_ "GenSigSendType" SG_ 328 FLR2RdrObject8To9DataStDLatVelo0 1;
BA_ "GenSigSendType" SG_ 328 FLR2RdrObject8To9DataStDLatVelo1 1;
BA_ "GenSigSendType" SG_ 328 FLR2RdrObject8To9DataStDLgtAcc0 1;
BA_ "GenSigSendType" SG_ 328 FLR2RdrObject8To9DataStDLgtAcc1 1;
BA_ "GenSigSendType" SG_ 328 FLR2RdrObject8To9DataStDLgtPos0 1;
BA_ "GenSigSendType" SG_ 328 FLR2RdrObject8To9DataStDLgtPos1 1;
BA_ "GenSigSendType" SG_ 328 FLR2RdrObject8To9DataStDLgtVelo0 1;
BA_ "GenSigSendType" SG_ 328 FLR2RdrObject8To9DataStDLgtVelo1 1;
BA_ "GenSigSendType" SG_ 328 FLR2RdrObject8To9DataWidth0 1;
BA_ "GenSigSendType" SG_ 328 FLR2RdrObject8To9DataWidth1 1;
BA_ "GenSigSendType" SG_ 328 FLR2RdrObject8To9HeadingAng0 1;
BA_ "GenSigStartValue" SG_ 328 FLR2RdrObject8To9HeadingAng0 315;
BA_ "GenSigSendType" SG_ 328 FLR2RdrObject8To9HeadingAng1 1;
BA_ "GenSigStartValue" SG_ 328 FLR2RdrObject8To9HeadingAng1 315;
BA_ "GenSigSendType" SG_ 328 FLR2RdrObject8To9LatAcc0 1;
BA_ "GenSigStartValue" SG_ 328 FLR2RdrObject8To9LatAcc0 356;
BA_ "GenSigSendType" SG_ 328 FLR2RdrObject8To9LatAcc1 1;
BA_ "GenSigStartValue" SG_ 328 FLR2RdrObject8To9LatAcc1 356;
BA_ "GenSigSendType" SG_ 328 FLR2RdrObject8To9LatPos0 1;
BA_ "GenSigStartValue" SG_ 328 FLR2RdrObject8To9LatPos0 4095;
BA_ "GenSigSendType" SG_ 328 FLR2RdrObject8To9LatPos1 1;
BA_ "GenSigStartValue" SG_ 328 FLR2RdrObject8To9LatPos1 4095;
BA_ "GenSigSendType" SG_ 328 FLR2RdrObject8To9LatVelo0 1;
BA_ "GenSigStartValue" SG_ 328 FLR2RdrObject8To9LatVelo0 1024;
BA_ "GenSigSendType" SG_ 328 FLR2RdrObject8To9LatVelo1 1;
BA_ "GenSigStartValue" SG_ 328 FLR2RdrObject8To9LatVelo1 1024;
BA_ "GenSigSendType" SG_ 328 FLR2RdrObject8To9LgtAcc0 1;
BA_ "GenSigStartValue" SG_ 328 FLR2RdrObject8To9LgtAcc0 356;
BA_ "GenSigSendType" SG_ 328 FLR2RdrObject8To9LgtAcc1 1;
BA_ "GenSigStartValue" SG_ 328 FLR2RdrObject8To9LgtAcc1 356;
BA_ "GenSigSendType" SG_ 328 FLR2RdrObject8To9LgtPos0 1;
BA_ "GenSigStartValue" SG_ 328 FLR2RdrObject8To9LgtPos0 4095;
BA_ "GenSigSendType" SG_ 328 FLR2RdrObject8To9LgtPos1 1;
BA_ "GenSigStartValue" SG_ 328 FLR2RdrObject8To9LgtPos1 4095;
BA_ "GenSigSendType" SG_ 328 FLR2RdrObject8To9LgtVelo0 1;
BA_ "GenSigStartValue" SG_ 328 FLR2RdrObject8To9LgtVelo0 1024;
BA_ "GenSigSendType" SG_ 328 FLR2RdrObject8To9LgtVelo1 1;
BA_ "GenSigStartValue" SG_ 328 FLR2RdrObject8To9LgtVelo1 1024;
BA_ "GenSigSendType" SG_ 328 FLR2RdrObject8To9ModeInfo0 1;
BA_ "GenSigSendType" SG_ 328 FLR2RdrObject8To9ModeInfo1 1;
BA_ "GenSigSendType" SG_ 328 FLR2RdrObject8To9MsgCntr 1;
BA_ "GenSigSendType" SG_ 328 FLR2RdrObject8To9MtnModel0 1;
BA_ "GenSigSendType" SG_ 328 FLR2RdrObject8To9MtnModel1 1;
BA_ "GenSigSendType" SG_ 328 FLR2RdrObject8To9MtnPattern0 1;
BA_ "GenSigSendType" SG_ 328 FLR2RdrObject8To9MtnPattern1 1;
BA_ "GenSigSendType" SG_ 328 FLR2RdrObject8To9PedMicroDoppler0 1;
BA_ "GenSigSendType" SG_ 328 FLR2RdrObject8To9PedMicroDoppler1 1;
BA_ "GenSigSendType" SG_ 328 FLR2RdrObject8To9Qly0 1;
BA_ "GenSigSendType" SG_ 328 FLR2RdrObject8To9Qly1 1;
BA_ "GenSigSendType" SG_ 328 FLR2RdrObject8To9ScanID 1;
BA_ "GenSigSendType" SG_ 69 FLR2SignalStatusAziAngCor 1;
BA_ "GenSigStartValue" SG_ 69 FLR2SignalStatusAziAngCor 128;
BA_ "GenSigSendType" SG_ 69 FLR2SignalStatusBlockage 1;
BA_ "GenSigDataID" SG_ 69 FLR2SignalStatusCRC "0x8D8";
BA_ "GenSigFuncType" SG_ 69 FLR2SignalStatusCRC 28;
BA_ "GenSigSendType" SG_ 69 FLR2SignalStatusCRC 1;
BA_ "GenSigSendType" SG_ 69 FLR2SignalStatusCalPrgrsSts 1;
BA_ "GenSigSendType" SG_ 69 FLR2SignalStatusCalRltSts 1;
BA_ "GenSigStartValue" SG_ 69 FLR2SignalStatusCalRltSts 1;
BA_ "GenSigSendType" SG_ 69 FLR2SignalStatusCalSts 1;
BA_ "GenSigSendType" SG_ 69 FLR2SignalStatusCommFltReason 1;
BA_ "GenSigFuncType" SG_ 69 FLR2SignalStatusCounter 27;
BA_ "GenSigSendType" SG_ 69 FLR2SignalStatusCounter 1;
BA_ "GenSigSendType" SG_ 69 FLR2SignalStatusEgoSpdEst 1;
BA_ "GenSigSendType" SG_ 69 FLR2SignalStatusEgoYawRateEst 1;
BA_ "GenSigSendType" SG_ 69 FLR2SignalStatusEleAngCor 1;
BA_ "GenSigStartValue" SG_ 69 FLR2SignalStatusEleAngCor 128;
BA_ "GenSigSendType" SG_ 69 FLR2SignalStatusFltReason 1;
BA_ "GenSigSendType" SG_ 69 FLR2SignalStatusIfVersMajor 1;
BA_ "GenSigSendType" SG_ 69 FLR2SignalStatusIfVersMinor 1;
BA_ "GenSigSendType" SG_ 69 FLR2SignalStatusInterference 1;
BA_ "GenSigSendType" SG_ 69 FLR2SignalStatusInternalTemp 1;
BA_ "GenSigStartValue" SG_ 69 FLR2SignalStatusInternalTemp 4000;
BA_ "GenSigSendType" SG_ 69 FLR2SignalStatusRdrIntSts 1;
BA_ "GenSigSendType" SG_ 69 FLR2SignalStatusRdrSts 1;
BA_ "GenSigSendType" SG_ 69 FLR2SignalStatusRdrTransAct 1;
BA_ "GenSigSendType" SG_ 69 FLR2SignalStatusScanIDSts 1;
BA_ "GenSigSendType" SG_ 69 FLR2SignalStatusSwVersMajor 1;
BA_ "GenSigSendType" SG_ 69 FLR2SignalStatusSwVersMinor 1;
BA_ "GenSigSendType" SG_ 69 FLR2SignalStatusSysFailFlag 1;
BA_ "GenSigSendType" SG_ 69 FLR2SignalStatusTimeStamp 1;
BA_ "GenSigSendType" SG_ 69 FLR2SignalStatusTimeStampStatus 1;
BA_ "GenSigSendType" SG_ 69 FLR2SignalStatusWhlCompFact 1;
BA_ "GenSigStartValue" SG_ 69 FLR2SignalStatusWhlCompFact 31;
BA_ "GenSigSendType" SG_ 69 FLR2SignalStatusXAxisOffs 1;
BA_ "GenSigSendType" SG_ 69 FLR2SignalStatusXOrientAng 1;
BA_ "GenSigStartValue" SG_ 69 FLR2SignalStatusXOrientAng 1800;
BA_ "GenSigSendType" SG_ 69 FLR2SignalStatusYAxisOffs 1;
BA_ "GenSigSendType" SG_ 69 FLR2SignalStatusYOrientAng 1;
BA_ "GenSigStartValue" SG_ 69 FLR2SignalStatusYOrientAng 1800;
BA_ "GenSigSendType" SG_ 69 FLR2SignalStatusZAxisOffs 1;
BA_ "GenSigSendType" SG_ 69 FLR2SignalStatusZOrientAng 1;
BA_ "GenSigStartValue" SG_ 69 FLR2SignalStatusZOrientAng 1800;
VAL_ 324 FLR2RdrObject4To5Class0 0 "FLR2ObjectClassification2_Unknown" 1 "FLR2ObjectClassification2_MotVeh" 2 "FLR2ObjectClassification2_Bicycle" 3 "FLR2ObjectClassification2_Ped";
VAL_ 324 FLR2RdrObject4To5Class1 0 "FLR2ObjectClassification2_Unknown" 1 "FLR2ObjectClassification2_MotVeh" 2 "FLR2ObjectClassification2_Bicycle" 3 "FLR2ObjectClassification2_Ped";
VAL_ 324 FLR2RdrObject4To5DataCoastCntr0 0 "FLR2ObjDataCoastingCntr_DeletedMaintainanceState" 1 "FLR2ObjDataCoastingCntr_NewMaintainanceState" 2 "FLR2ObjDataCoastingCntr_MeasuredMaintainanceState" 3 "FLR2ObjDataCoastingCntr_PredictedMaintainanceState";
VAL_ 324 FLR2RdrObject4To5DataCoastCntr1 0 "FLR2ObjDataCoastingCntr_DeletedMaintainanceState" 1 "FLR2ObjDataCoastingCntr_NewMaintainanceState" 2 "FLR2ObjDataCoastingCntr_MeasuredMaintainanceState" 3 "FLR2ObjDataCoastingCntr_PredictedMaintainanceState";
VAL_ 324 FLR2RdrObject4To5ModeInfo0 0 "FLR2Modeinfo_RngNearResl" 1 "FLR2Modeinfo_RngMidReslMod" 2 "FLR2Modeinfo_RngLongReslMod";
VAL_ 324 FLR2RdrObject4To5ModeInfo1 0 "FLR2Modeinfo_RngNearResl" 1 "FLR2Modeinfo_RngMidReslMod" 2 "FLR2Modeinfo_RngLongReslMod";
VAL_ 324 FLR2RdrObject4To5MtnPattern0 0 "FLR2MotionPattern_Movg" 1 "FLR2MotionPattern_Staty" 2 "FLR2MotionPattern_OnCmgn" 3 "FLR2MotionPattern_MovgLeToRi" 4 "FLR2MotionPattern_MovgRiToLe" 5 "FLR2MotionPattern_UkwnToRadarSnsr" 6 "FLR2MotionPattern_Stop" 7 "FLR2MotionPattern_StopNotSafe";
VAL_ 324 FLR2RdrObject4To5MtnPattern1 0 "FLR2MotionPattern_Movg" 1 "FLR2MotionPattern_Staty" 2 "FLR2MotionPattern_OnCmgn" 3 "FLR2MotionPattern_MovgLeToRi" 4 "FLR2MotionPattern_MovgRiToLe" 5 "FLR2MotionPattern_UkwnToRadarSnsr" 6 "FLR2MotionPattern_Stop" 7 "FLR2MotionPattern_StopNotSafe";
VAL_ 326 FLR2RdrObject6To7Class0 0 "FLR2ObjectClassification2_Unknown" 1 "FLR2ObjectClassification2_MotVeh" 2 "FLR2ObjectClassification2_Bicycle" 3 "FLR2ObjectClassification2_Ped";
VAL_ 326 FLR2RdrObject6To7Class1 0 "FLR2ObjectClassification2_Unknown" 1 "FLR2ObjectClassification2_MotVeh" 2 "FLR2ObjectClassification2_Bicycle" 3 "FLR2ObjectClassification2_Ped";
VAL_ 326 FLR2RdrObject6To7DataCoastCntr0 0 "FLR2ObjDataCoastingCntr_DeletedMaintainanceState" 1 "FLR2ObjDataCoastingCntr_NewMaintainanceState" 2 "FLR2ObjDataCoastingCntr_MeasuredMaintainanceState" 3 "FLR2ObjDataCoastingCntr_PredictedMaintainanceState";
VAL_ 326 FLR2RdrObject6To7DataCoastCntr1 0 "FLR2ObjDataCoastingCntr_DeletedMaintainanceState" 1 "FLR2ObjDataCoastingCntr_NewMaintainanceState" 2 "FLR2ObjDataCoastingCntr_MeasuredMaintainanceState" 3 "FLR2ObjDataCoastingCntr_PredictedMaintainanceState";
VAL_ 326 FLR2RdrObject6To7ModeInfo0 0 "FLR2Modeinfo_RngNearResl" 1 "FLR2Modeinfo_RngMidReslMod" 2 "FLR2Modeinfo_RngLongReslMod";
VAL_ 326 FLR2RdrObject6To7ModeInfo1 0 "FLR2Modeinfo_RngNearResl" 1 "FLR2Modeinfo_RngMidReslMod" 2 "FLR2Modeinfo_RngLongReslMod";
VAL_ 326 FLR2RdrObject6To7MtnPattern0 0 "FLR2MotionPattern_Movg" 1 "FLR2MotionPattern_Staty" 2 "FLR2MotionPattern_OnCmgn" 3 "FLR2MotionPattern_MovgLeToRi" 4 "FLR2MotionPattern_MovgRiToLe" 5 "FLR2MotionPattern_UkwnToRadarSnsr" 6 "FLR2MotionPattern_Stop" 7 "FLR2MotionPattern_StopNotSafe";
VAL_ 326 FLR2RdrObject6To7MtnPattern1 0 "FLR2MotionPattern_Movg" 1 "FLR2MotionPattern_Staty" 2 "FLR2MotionPattern_OnCmgn" 3 "FLR2MotionPattern_MovgLeToRi" 4 "FLR2MotionPattern_MovgRiToLe" 5 "FLR2MotionPattern_UkwnToRadarSnsr" 6 "FLR2MotionPattern_Stop" 7 "FLR2MotionPattern_StopNotSafe";
VAL_ 328 FLR2RdrObject8To9Class0 0 "FLR2ObjectClassification2_Unknown" 1 "FLR2ObjectClassification2_MotVeh" 2 "FLR2ObjectClassification2_Bicycle" 3 "FLR2ObjectClassification2_Ped";
VAL_ 328 FLR2RdrObject8To9Class1 0 "FLR2ObjectClassification2_Unknown" 1 "FLR2ObjectClassification2_MotVeh" 2 "FLR2ObjectClassification2_Bicycle" 3 "FLR2ObjectClassification2_Ped";
VAL_ 328 FLR2RdrObject8To9DataCoastCntr0 0 "FLR2ObjDataCoastingCntr_DeletedMaintainanceState" 1 "FLR2ObjDataCoastingCntr_NewMaintainanceState" 2 "FLR2ObjDataCoastingCntr_MeasuredMaintainanceState" 3 "FLR2ObjDataCoastingCntr_PredictedMaintainanceState";
VAL_ 328 FLR2RdrObject8To9DataCoastCntr1 0 "FLR2ObjDataCoastingCntr_DeletedMaintainanceState" 1 "FLR2ObjDataCoastingCntr_NewMaintainanceState" 2 "FLR2ObjDataCoastingCntr_MeasuredMaintainanceState" 3 "FLR2ObjDataCoastingCntr_PredictedMaintainanceState";
VAL_ 328 FLR2RdrObject8To9ModeInfo0 0 "FLR2Modeinfo_RngNearResl" 1 "FLR2Modeinfo_RngMidReslMod" 2 "FLR2Modeinfo_RngLongReslMod";
VAL_ 328 FLR2RdrObject8To9ModeInfo1 0 "FLR2Modeinfo_RngNearResl" 1 "FLR2Modeinfo_RngMidReslMod" 2 "FLR2Modeinfo_RngLongReslMod";
VAL_ 328 FLR2RdrObject8To9MtnPattern0 0 "FLR2MotionPattern_Movg" 1 "FLR2MotionPattern_Staty" 2 "FLR2MotionPattern_OnCmgn" 3 "FLR2MotionPattern_MovgLeToRi" 4 "FLR2MotionPattern_MovgRiToLe" 5 "FLR2MotionPattern_UkwnToRadarSnsr" 6 "FLR2MotionPattern_Stop" 7 "FLR2MotionPattern_StopNotSafe";
VAL_ 328 FLR2RdrObject8To9MtnPattern1 0 "FLR2MotionPattern_Movg" 1 "FLR2MotionPattern_Staty" 2 "FLR2MotionPattern_OnCmgn" 3 "FLR2MotionPattern_MovgLeToRi" 4 "FLR2MotionPattern_MovgRiToLe" 5 "FLR2MotionPattern_UkwnToRadarSnsr" 6 "FLR2MotionPattern_Stop" 7 "FLR2MotionPattern_StopNotSafe";
VAL_ 330 FLR2RdrObject10To11Class0 0 "FLR2ObjectClassification2_Unknown" 1 "FLR2ObjectClassification2_MotVeh" 2 "FLR2ObjectClassification2_Bicycle" 3 "FLR2ObjectClassification2_Ped";
VAL_ 330 FLR2RdrObject10To11Class1 0 "FLR2ObjectClassification2_Unknown" 1 "FLR2ObjectClassification2_MotVeh" 2 "FLR2ObjectClassification2_Bicycle" 3 "FLR2ObjectClassification2_Ped";
VAL_ 330 FLR2RdrObject10To11DataCoastCntr0 0 "FLR2ObjDataCoastingCntr_DeletedMaintainanceState" 1 "FLR2ObjDataCoastingCntr_NewMaintainanceState" 2 "FLR2ObjDataCoastingCntr_MeasuredMaintainanceState" 3 "FLR2ObjDataCoastingCntr_PredictedMaintainanceState";
VAL_ 330 FLR2RdrObject10To11DataCoastCntr1 0 "FLR2ObjDataCoastingCntr_DeletedMaintainanceState" 1 "FLR2ObjDataCoastingCntr_NewMaintainanceState" 2 "FLR2ObjDataCoastingCntr_MeasuredMaintainanceState" 3 "FLR2ObjDataCoastingCntr_PredictedMaintainanceState";
VAL_ 330 FLR2RdrObject10To11ModeInfo0 0 "FLR2Modeinfo_RngNearResl" 1 "FLR2Modeinfo_RngMidReslMod" 2 "FLR2Modeinfo_RngLongReslMod";
VAL_ 330 FLR2RdrObject10To11ModeInfo1 0 "FLR2Modeinfo_RngNearResl" 1 "FLR2Modeinfo_RngMidReslMod" 2 "FLR2Modeinfo_RngLongReslMod";
VAL_ 330 FLR2RdrObject10To11MtnPattern0 0 "FLR2MotionPattern_Movg" 1 "FLR2MotionPattern_Staty" 2 "FLR2MotionPattern_OnCmgn" 3 "FLR2MotionPattern_MovgLeToRi" 4 "FLR2MotionPattern_MovgRiToLe" 5 "FLR2MotionPattern_UkwnToRadarSnsr" 6 "FLR2MotionPattern_Stop" 7 "FLR2MotionPattern_StopNotSafe";
VAL_ 330 FLR2RdrObject10To11MtnPattern1 0 "FLR2MotionPattern_Movg" 1 "FLR2MotionPattern_Staty" 2 "FLR2MotionPattern_OnCmgn" 3 "FLR2MotionPattern_MovgLeToRi" 4 "FLR2MotionPattern_MovgRiToLe" 5 "FLR2MotionPattern_UkwnToRadarSnsr" 6 "FLR2MotionPattern_Stop" 7 "FLR2MotionPattern_StopNotSafe";
VAL_ 332 FLR2RdrObject12To13Class0 0 "FLR2ObjectClassification2_Unknown" 1 "FLR2ObjectClassification2_MotVeh" 2 "FLR2ObjectClassification2_Bicycle" 3 "FLR2ObjectClassification2_Ped";
VAL_ 332 FLR2RdrObject12To13Class1 0 "FLR2ObjectClassification2_Unknown" 1 "FLR2ObjectClassification2_MotVeh" 2 "FLR2ObjectClassification2_Bicycle" 3 "FLR2ObjectClassification2_Ped";
VAL_ 332 FLR2RdrObject12To13DataCoastCntr0 0 "FLR2ObjDataCoastingCntr_DeletedMaintainanceState" 1 "FLR2ObjDataCoastingCntr_NewMaintainanceState" 2 "FLR2ObjDataCoastingCntr_MeasuredMaintainanceState" 3 "FLR2ObjDataCoastingCntr_PredictedMaintainanceState";
VAL_ 332 FLR2RdrObject12To13DataCoastCntr1 0 "FLR2ObjDataCoastingCntr_DeletedMaintainanceState" 1 "FLR2ObjDataCoastingCntr_NewMaintainanceState" 2 "FLR2ObjDataCoastingCntr_MeasuredMaintainanceState" 3 "FLR2ObjDataCoastingCntr_PredictedMaintainanceState";
VAL_ 332 FLR2RdrObject12To13ModeInfo0 0 "FLR2Modeinfo_RngNearResl" 1 "FLR2Modeinfo_RngMidReslMod" 2 "FLR2Modeinfo_RngLongReslMod";
VAL_ 332 FLR2RdrObject12To13ModeInfo1 0 "FLR2Modeinfo_RngNearResl" 1 "FLR2Modeinfo_RngMidReslMod" 2 "FLR2Modeinfo_RngLongReslMod";
VAL_ 332 FLR2RdrObject12To13MtnPattern0 0 "FLR2MotionPattern_Movg" 1 "FLR2MotionPattern_Staty" 2 "FLR2MotionPattern_OnCmgn" 3 "FLR2MotionPattern_MovgLeToRi" 4 "FLR2MotionPattern_MovgRiToLe" 5 "FLR2MotionPattern_UkwnToRadarSnsr" 6 "FLR2MotionPattern_Stop" 7 "FLR2MotionPattern_StopNotSafe";
VAL_ 332 FLR2RdrObject12To13MtnPattern1 0 "FLR2MotionPattern_Movg" 1 "FLR2MotionPattern_Staty" 2 "FLR2MotionPattern_OnCmgn" 3 "FLR2MotionPattern_MovgLeToRi" 4 "FLR2MotionPattern_MovgRiToLe" 5 "FLR2MotionPattern_UkwnToRadarSnsr" 6 "FLR2MotionPattern_Stop" 7 "FLR2MotionPattern_StopNotSafe";
VAL_ 334 FLR2RdrObject14To15Class0 0 "FLR2ObjectClassification2_Unknown" 1 "FLR2ObjectClassification2_MotVeh" 2 "FLR2ObjectClassification2_Bicycle" 3 "FLR2ObjectClassification2_Ped";
VAL_ 334 FLR2RdrObject14To15Class1 0 "FLR2ObjectClassification2_Unknown" 1 "FLR2ObjectClassification2_MotVeh" 2 "FLR2ObjectClassification2_Bicycle" 3 "FLR2ObjectClassification2_Ped";
VAL_ 334 FLR2RdrObject14To15DataCoastCntr0 0 "FLR2ObjDataCoastingCntr_DeletedMaintainanceState" 1 "FLR2ObjDataCoastingCntr_NewMaintainanceState" 2 "FLR2ObjDataCoastingCntr_MeasuredMaintainanceState" 3 "FLR2ObjDataCoastingCntr_PredictedMaintainanceState";
VAL_ 334 FLR2RdrObject14To15DataCoastCntr1 0 "FLR2ObjDataCoastingCntr_DeletedMaintainanceState" 1 "FLR2ObjDataCoastingCntr_NewMaintainanceState" 2 "FLR2ObjDataCoastingCntr_MeasuredMaintainanceState" 3 "FLR2ObjDataCoastingCntr_PredictedMaintainanceState";
VAL_ 334 FLR2RdrObject14To15ModeInfo0 0 "FLR2Modeinfo_RngNearResl" 1 "FLR2Modeinfo_RngMidReslMod" 2 "FLR2Modeinfo_RngLongReslMod";
VAL_ 334 FLR2RdrObject14To15ModeInfo1 0 "FLR2Modeinfo_RngNearResl" 1 "FLR2Modeinfo_RngMidReslMod" 2 "FLR2Modeinfo_RngLongReslMod";
VAL_ 334 FLR2RdrObject14To15MtnPattern0 0 "FLR2MotionPattern_Movg" 1 "FLR2MotionPattern_Staty" 2 "FLR2MotionPattern_OnCmgn" 3 "FLR2MotionPattern_MovgLeToRi" 4 "FLR2MotionPattern_MovgRiToLe" 5 "FLR2MotionPattern_UkwnToRadarSnsr" 6 "FLR2MotionPattern_Stop" 7 "FLR2MotionPattern_StopNotSafe";
VAL_ 334 FLR2RdrObject14To15MtnPattern1 0 "FLR2MotionPattern_Movg" 1 "FLR2MotionPattern_Staty" 2 "FLR2MotionPattern_OnCmgn" 3 "FLR2MotionPattern_MovgLeToRi" 4 "FLR2MotionPattern_MovgRiToLe" 5 "FLR2MotionPattern_UkwnToRadarSnsr" 6 "FLR2MotionPattern_Stop" 7 "FLR2MotionPattern_StopNotSafe";
VAL_ 336 FLR2RdrObject16To17Class0 0 "FLR2ObjectClassification2_Unknown" 1 "FLR2ObjectClassification2_MotVeh" 2 "FLR2ObjectClassification2_Bicycle" 3 "FLR2ObjectClassification2_Ped";
VAL_ 336 FLR2RdrObject16To17Class1 0 "FLR2ObjectClassification2_Unknown" 1 "FLR2ObjectClassification2_MotVeh" 2 "FLR2ObjectClassification2_Bicycle" 3 "FLR2ObjectClassification2_Ped";
VAL_ 336 FLR2RdrObject16To17DataCoastCntr0 0 "FLR2ObjDataCoastingCntr_DeletedMaintainanceState" 1 "FLR2ObjDataCoastingCntr_NewMaintainanceState" 2 "FLR2ObjDataCoastingCntr_MeasuredMaintainanceState" 3 "FLR2ObjDataCoastingCntr_PredictedMaintainanceState";
VAL_ 336 FLR2RdrObject16To17DataCoastCntr1 0 "FLR2ObjDataCoastingCntr_DeletedMaintainanceState" 1 "FLR2ObjDataCoastingCntr_NewMaintainanceState" 2 "FLR2ObjDataCoastingCntr_MeasuredMaintainanceState" 3 "FLR2ObjDataCoastingCntr_PredictedMaintainanceState";
VAL_ 336 FLR2RdrObject16To17ModeInfo0 0 "FLR2Modeinfo_RngNearResl" 1 "FLR2Modeinfo_RngMidReslMod" 2 "FLR2Modeinfo_RngLongReslMod";
VAL_ 336 FLR2RdrObject16To17ModeInfo1 0 "FLR2Modeinfo_RngNearResl" 1 "FLR2Modeinfo_RngMidReslMod" 2 "FLR2Modeinfo_RngLongReslMod";
VAL_ 336 FLR2RdrObject16To17MtnPattern0 0 "FLR2MotionPattern_Movg" 1 "FLR2MotionPattern_Staty" 2 "FLR2MotionPattern_OnCmgn" 3 "FLR2MotionPattern_MovgLeToRi" 4 "FLR2MotionPattern_MovgRiToLe" 5 "FLR2MotionPattern_UkwnToRadarSnsr" 6 "FLR2MotionPattern_Stop" 7 "FLR2MotionPattern_StopNotSafe";
VAL_ 336 FLR2RdrObject16To17MtnPattern1 0 "FLR2MotionPattern_Movg" 1 "FLR2MotionPattern_Staty" 2 "FLR2MotionPattern_OnCmgn" 3 "FLR2MotionPattern_MovgLeToRi" 4 "FLR2MotionPattern_MovgRiToLe" 5 "FLR2MotionPattern_UkwnToRadarSnsr" 6 "FLR2MotionPattern_Stop" 7 "FLR2MotionPattern_StopNotSafe";
VAL_ 338 FLR2RdrObject18To19Class0 0 "FLR2ObjectClassification2_Unknown" 1 "FLR2ObjectClassification2_MotVeh" 2 "FLR2ObjectClassification2_Bicycle" 3 "FLR2ObjectClassification2_Ped";
VAL_ 338 FLR2RdrObject18To19Class1 0 "FLR2ObjectClassification2_Unknown" 1 "FLR2ObjectClassification2_MotVeh" 2 "FLR2ObjectClassification2_Bicycle" 3 "FLR2ObjectClassification2_Ped";
VAL_ 338 FLR2RdrObject18To19DataCoastCntr0 0 "FLR2ObjDataCoastingCntr_DeletedMaintainanceState" 1 "FLR2ObjDataCoastingCntr_NewMaintainanceState" 2 "FLR2ObjDataCoastingCntr_MeasuredMaintainanceState" 3 "FLR2ObjDataCoastingCntr_PredictedMaintainanceState";
VAL_ 338 FLR2RdrObject18To19DataCoastCntr1 0 "FLR2ObjDataCoastingCntr_DeletedMaintainanceState" 1 "FLR2ObjDataCoastingCntr_NewMaintainanceState" 2 "FLR2ObjDataCoastingCntr_MeasuredMaintainanceState" 3 "FLR2ObjDataCoastingCntr_PredictedMaintainanceState";
VAL_ 338 FLR2RdrObject18To19ModeInfo0 0 "FLR2Modeinfo_RngNearResl" 1 "FLR2Modeinfo_RngMidReslMod" 2 "FLR2Modeinfo_RngLongReslMod";
VAL_ 338 FLR2RdrObject18To19ModeInfo1 0 "FLR2Modeinfo_RngNearResl" 1 "FLR2Modeinfo_RngMidReslMod" 2 "FLR2Modeinfo_RngLongReslMod";
VAL_ 338 FLR2RdrObject18To19MtnPattern0 0 "FLR2MotionPattern_Movg" 1 "FLR2MotionPattern_Staty" 2 "FLR2MotionPattern_OnCmgn" 3 "FLR2MotionPattern_MovgLeToRi" 4 "FLR2MotionPattern_MovgRiToLe" 5 "FLR2MotionPattern_UkwnToRadarSnsr" 6 "FLR2MotionPattern_Stop" 7 "FLR2MotionPattern_StopNotSafe";
VAL_ 338 FLR2RdrObject18To19MtnPattern1 0 "FLR2MotionPattern_Movg" 1 "FLR2MotionPattern_Staty" 2 "FLR2MotionPattern_OnCmgn" 3 "FLR2MotionPattern_MovgLeToRi" 4 "FLR2MotionPattern_MovgRiToLe" 5 "FLR2MotionPattern_UkwnToRadarSnsr" 6 "FLR2MotionPattern_Stop" 7 "FLR2MotionPattern_StopNotSafe";
VAL_ 340 FLR2RdrObject20To21Class0 0 "FLR2ObjectClassification2_Unknown" 1 "FLR2ObjectClassification2_MotVeh" 2 "FLR2ObjectClassification2_Bicycle" 3 "FLR2ObjectClassification2_Ped";
VAL_ 340 FLR2RdrObject20To21Class1 0 "FLR2ObjectClassification2_Unknown" 1 "FLR2ObjectClassification2_MotVeh" 2 "FLR2ObjectClassification2_Bicycle" 3 "FLR2ObjectClassification2_Ped";
VAL_ 340 FLR2RdrObject20To21DataCoastCntr0 0 "FLR2ObjDataCoastingCntr_DeletedMaintainanceState" 1 "FLR2ObjDataCoastingCntr_NewMaintainanceState" 2 "FLR2ObjDataCoastingCntr_MeasuredMaintainanceState" 3 "FLR2ObjDataCoastingCntr_PredictedMaintainanceState";
VAL_ 340 FLR2RdrObject20To21DataCoastCntr1 0 "FLR2ObjDataCoastingCntr_DeletedMaintainanceState" 1 "FLR2ObjDataCoastingCntr_NewMaintainanceState" 2 "FLR2ObjDataCoastingCntr_MeasuredMaintainanceState" 3 "FLR2ObjDataCoastingCntr_PredictedMaintainanceState";
VAL_ 340 FLR2RdrObject20To21ModeInfo0 0 "FLR2Modeinfo_RngNearResl" 1 "FLR2Modeinfo_RngMidReslMod" 2 "FLR2Modeinfo_RngLongReslMod";
VAL_ 340 FLR2RdrObject20To21ModeInfo1 0 "FLR2Modeinfo_RngNearResl" 1 "FLR2Modeinfo_RngMidReslMod" 2 "FLR2Modeinfo_RngLongReslMod";
VAL_ 340 FLR2RdrObject20To21MtnPattern0 0 "FLR2MotionPattern_Movg" 1 "FLR2MotionPattern_Staty" 2 "FLR2MotionPattern_OnCmgn" 3 "FLR2MotionPattern_MovgLeToRi" 4 "FLR2MotionPattern_MovgRiToLe" 5 "FLR2MotionPattern_UkwnToRadarSnsr" 6 "FLR2MotionPattern_Stop" 7 "FLR2MotionPattern_StopNotSafe";
VAL_ 340 FLR2RdrObject20To21MtnPattern1 0 "FLR2MotionPattern_Movg" 1 "FLR2MotionPattern_Staty" 2 "FLR2MotionPattern_OnCmgn" 3 "FLR2MotionPattern_MovgLeToRi" 4 "FLR2MotionPattern_MovgRiToLe" 5 "FLR2MotionPattern_UkwnToRadarSnsr" 6 "FLR2MotionPattern_Stop" 7 "FLR2MotionPattern_StopNotSafe";
VAL_ 342 FLR2RdrObject22To23Class0 0 "FLR2ObjectClassification2_Unknown" 1 "FLR2ObjectClassification2_MotVeh" 2 "FLR2ObjectClassification2_Bicycle" 3 "FLR2ObjectClassification2_Ped";
VAL_ 342 FLR2RdrObject22To23Class1 0 "FLR2ObjectClassification2_Unknown" 1 "FLR2ObjectClassification2_MotVeh" 2 "FLR2ObjectClassification2_Bicycle" 3 "FLR2ObjectClassification2_Ped";
VAL_ 342 FLR2RdrObject22To23DataCoastCntr0 0 "FLR2ObjDataCoastingCntr_DeletedMaintainanceState" 1 "FLR2ObjDataCoastingCntr_NewMaintainanceState" 2 "FLR2ObjDataCoastingCntr_MeasuredMaintainanceState" 3 "FLR2ObjDataCoastingCntr_PredictedMaintainanceState";
VAL_ 342 FLR2RdrObject22To23DataCoastCntr1 0 "FLR2ObjDataCoastingCntr_DeletedMaintainanceState" 1 "FLR2ObjDataCoastingCntr_NewMaintainanceState" 2 "FLR2ObjDataCoastingCntr_MeasuredMaintainanceState" 3 "FLR2ObjDataCoastingCntr_PredictedMaintainanceState";
VAL_ 342 FLR2RdrObject22To23ModeInfo0 0 "FLR2Modeinfo_RngNearResl" 1 "FLR2Modeinfo_RngMidReslMod" 2 "FLR2Modeinfo_RngLongReslMod";
VAL_ 342 FLR2RdrObject22To23ModeInfo1 0 "FLR2Modeinfo_RngNearResl" 1 "FLR2Modeinfo_RngMidReslMod" 2 "FLR2Modeinfo_RngLongReslMod";
VAL_ 342 FLR2RdrObject22To23MtnPattern0 0 "FLR2MotionPattern_Movg" 1 "FLR2MotionPattern_Staty" 2 "FLR2MotionPattern_OnCmgn" 3 "FLR2MotionPattern_MovgLeToRi" 4 "FLR2MotionPattern_MovgRiToLe" 5 "FLR2MotionPattern_UkwnToRadarSnsr" 6 "FLR2MotionPattern_Stop" 7 "FLR2MotionPattern_StopNotSafe";
VAL_ 342 FLR2RdrObject22To23MtnPattern1 0 "FLR2MotionPattern_Movg" 1 "FLR2MotionPattern_Staty" 2 "FLR2MotionPattern_OnCmgn" 3 "FLR2MotionPattern_MovgLeToRi" 4 "FLR2MotionPattern_MovgRiToLe" 5 "FLR2MotionPattern_UkwnToRadarSnsr" 6 "FLR2MotionPattern_Stop" 7 "FLR2MotionPattern_StopNotSafe";
VAL_ 344 FLR2RdrObject24To25Class0 0 "FLR2ObjectClassification2_Unknown" 1 "FLR2ObjectClassification2_MotVeh" 2 "FLR2ObjectClassification2_Bicycle" 3 "FLR2ObjectClassification2_Ped";
VAL_ 344 FLR2RdrObject24To25Class1 0 "FLR2ObjectClassification2_Unknown" 1 "FLR2ObjectClassification2_MotVeh" 2 "FLR2ObjectClassification2_Bicycle" 3 "FLR2ObjectClassification2_Ped";
VAL_ 344 FLR2RdrObject24To25DataCoastCntr0 0 "FLR2ObjDataCoastingCntr_DeletedMaintainanceState" 1 "FLR2ObjDataCoastingCntr_NewMaintainanceState" 2 "FLR2ObjDataCoastingCntr_MeasuredMaintainanceState" 3 "FLR2ObjDataCoastingCntr_PredictedMaintainanceState";
VAL_ 344 FLR2RdrObject24To25DataCoastCntr1 0 "FLR2ObjDataCoastingCntr_DeletedMaintainanceState" 1 "FLR2ObjDataCoastingCntr_NewMaintainanceState" 2 "FLR2ObjDataCoastingCntr_MeasuredMaintainanceState" 3 "FLR2ObjDataCoastingCntr_PredictedMaintainanceState";
VAL_ 344 FLR2RdrObject24To25ModeInfo0 0 "FLR2Modeinfo_RngNearResl" 1 "FLR2Modeinfo_RngMidReslMod" 2 "FLR2Modeinfo_RngLongReslMod";
VAL_ 344 FLR2RdrObject24To25ModeInfo1 0 "FLR2Modeinfo_RngNearResl" 1 "FLR2Modeinfo_RngMidReslMod" 2 "FLR2Modeinfo_RngLongReslMod";
VAL_ 344 FLR2RdrObject24To25MtnPattern0 0 "FLR2MotionPattern_Movg" 1 "FLR2MotionPattern_Staty" 2 "FLR2MotionPattern_OnCmgn" 3 "FLR2MotionPattern_MovgLeToRi" 4 "FLR2MotionPattern_MovgRiToLe" 5 "FLR2MotionPattern_UkwnToRadarSnsr" 6 "FLR2MotionPattern_Stop" 7 "FLR2MotionPattern_StopNotSafe";
VAL_ 344 FLR2RdrObject24To25MtnPattern1 0 "FLR2MotionPattern_Movg" 1 "FLR2MotionPattern_Staty" 2 "FLR2MotionPattern_OnCmgn" 3 "FLR2MotionPattern_MovgLeToRi" 4 "FLR2MotionPattern_MovgRiToLe" 5 "FLR2MotionPattern_UkwnToRadarSnsr" 6 "FLR2MotionPattern_Stop" 7 "FLR2MotionPattern_StopNotSafe";
VAL_ 346 FLR2RdrObject26To27Class0 0 "FLR2ObjectClassification2_Unknown" 1 "FLR2ObjectClassification2_MotVeh" 2 "FLR2ObjectClassification2_Bicycle" 3 "FLR2ObjectClassification2_Ped";
VAL_ 346 FLR2RdrObject26To27Class1 0 "FLR2ObjectClassification2_Unknown" 1 "FLR2ObjectClassification2_MotVeh" 2 "FLR2ObjectClassification2_Bicycle" 3 "FLR2ObjectClassification2_Ped";
VAL_ 346 FLR2RdrObject26To27DataCoastCntr0 0 "FLR2ObjDataCoastingCntr_DeletedMaintainanceState" 1 "FLR2ObjDataCoastingCntr_NewMaintainanceState" 2 "FLR2ObjDataCoastingCntr_MeasuredMaintainanceState" 3 "FLR2ObjDataCoastingCntr_PredictedMaintainanceState";
VAL_ 346 FLR2RdrObject26To27DataCoastCntr1 0 "FLR2ObjDataCoastingCntr_DeletedMaintainanceState" 1 "FLR2ObjDataCoastingCntr_NewMaintainanceState" 2 "FLR2ObjDataCoastingCntr_MeasuredMaintainanceState" 3 "FLR2ObjDataCoastingCntr_PredictedMaintainanceState";
VAL_ 346 FLR2RdrObject26To27ModeInfo0 0 "FLR2Modeinfo_RngNearResl" 1 "FLR2Modeinfo_RngMidReslMod" 2 "FLR2Modeinfo_RngLongReslMod";
VAL_ 346 FLR2RdrObject26To27ModeInfo1 0 "FLR2Modeinfo_RngNearResl" 1 "FLR2Modeinfo_RngMidReslMod" 2 "FLR2Modeinfo_RngLongReslMod";
VAL_ 346 FLR2RdrObject26To27MtnPattern0 0 "FLR2MotionPattern_Movg" 1 "FLR2MotionPattern_Staty" 2 "FLR2MotionPattern_OnCmgn" 3 "FLR2MotionPattern_MovgLeToRi" 4 "FLR2MotionPattern_MovgRiToLe" 5 "FLR2MotionPattern_UkwnToRadarSnsr" 6 "FLR2MotionPattern_Stop" 7 "FLR2MotionPattern_StopNotSafe";
VAL_ 346 FLR2RdrObject26To27MtnPattern1 0 "FLR2MotionPattern_Movg" 1 "FLR2MotionPattern_Staty" 2 "FLR2MotionPattern_OnCmgn" 3 "FLR2MotionPattern_MovgLeToRi" 4 "FLR2MotionPattern_MovgRiToLe" 5 "FLR2MotionPattern_UkwnToRadarSnsr" 6 "FLR2MotionPattern_Stop" 7 "FLR2MotionPattern_StopNotSafe";
VAL_ 348 FLR2RdrObject28To29Class0 0 "FLR2ObjectClassification2_Unknown" 1 "FLR2ObjectClassification2_MotVeh" 2 "FLR2ObjectClassification2_Bicycle" 3 "FLR2ObjectClassification2_Ped";
VAL_ 348 FLR2RdrObject28To29Class1 0 "FLR2ObjectClassification2_Unknown" 1 "FLR2ObjectClassification2_MotVeh" 2 "FLR2ObjectClassification2_Bicycle" 3 "FLR2ObjectClassification2_Ped";
VAL_ 348 FLR2RdrObject28To29DataCoastCntr0 0 "FLR2ObjDataCoastingCntr_DeletedMaintainanceState" 1 "FLR2ObjDataCoastingCntr_NewMaintainanceState" 2 "FLR2ObjDataCoastingCntr_MeasuredMaintainanceState" 3 "FLR2ObjDataCoastingCntr_PredictedMaintainanceState";
VAL_ 348 FLR2RdrObject28To29DataCoastCntr1 0 "FLR2ObjDataCoastingCntr_DeletedMaintainanceState" 1 "FLR2ObjDataCoastingCntr_NewMaintainanceState" 2 "FLR2ObjDataCoastingCntr_MeasuredMaintainanceState" 3 "FLR2ObjDataCoastingCntr_PredictedMaintainanceState";
VAL_ 348 FLR2RdrObject28To29ModeInfo0 0 "FLR2Modeinfo_RngNearResl" 1 "FLR2Modeinfo_RngMidReslMod" 2 "FLR2Modeinfo_RngLongReslMod";
VAL_ 348 FLR2RdrObject28To29ModeInfo1 0 "FLR2Modeinfo_RngNearResl" 1 "FLR2Modeinfo_RngMidReslMod" 2 "FLR2Modeinfo_RngLongReslMod";
VAL_ 348 FLR2RdrObject28To29MtnPattern0 0 "FLR2MotionPattern_Movg" 1 "FLR2MotionPattern_Staty" 2 "FLR2MotionPattern_OnCmgn" 3 "FLR2MotionPattern_MovgLeToRi" 4 "FLR2MotionPattern_MovgRiToLe" 5 "FLR2MotionPattern_UkwnToRadarSnsr" 6 "FLR2MotionPattern_Stop" 7 "FLR2MotionPattern_StopNotSafe";
VAL_ 348 FLR2RdrObject28To29MtnPattern1 0 "FLR2MotionPattern_Movg" 1 "FLR2MotionPattern_Staty" 2 "FLR2MotionPattern_OnCmgn" 3 "FLR2MotionPattern_MovgLeToRi" 4 "FLR2MotionPattern_MovgRiToLe" 5 "FLR2MotionPattern_UkwnToRadarSnsr" 6 "FLR2MotionPattern_Stop" 7 "FLR2MotionPattern_StopNotSafe";
VAL_ 69 FLR2SignalStatusBlockage 0 "FLRBlockage_StatusBlockageUnknown" 1 "FLRBlockage_StatusFullBlockage" 2 "FLRBlockage_StatusNoBlockage";
VAL_ 69 FLR2SignalStatusCalRltSts 0 "FLR2SignalStatusCalRltSts_Ok" 1 "FLR2SignalStatusCalRltSts_Nok" 2 "FLR2SignalStatusCalRltSts_CorrUnknown" 3 "FLR2SignalStatusCalRltSts_VCCAIAPartialCorrActv";
VAL_ 69 FLR2SignalStatusCalSts 0 "FLR2CalibrationStatus_NotStarted" 1 "FLR2CalibrationStatus_NotOngoing" 2 "FLR2CalibrationStatus_Ongoing";
VAL_ 69 FLR2SignalStatusCommFltReason 0 "ComFltReason_NotApplicable" 1 "ComFltReason_ComFltReasonVehicleMotionState" 2 "ComFltReason_ComFltReasonCarConfig" 4 "ComFltReason_ComFltReasonVehicleModesProvider" 8 "ComFltReason_ComFltReasonGlobalSnapshot" 16 "ComFltReason_ComFltReasonFuncInfo" 32 "ComFltReason_ComFltReasonAutosarTs" 64 "ComFltReason_CommFltReasonPowerMode";
VAL_ 69 FLR2SignalStatusFltReason 0 "FLRFltReason_NotApplicable" 1 "FLRFltReason_CommFault" 2 "FLRFltReason_SWFault" 4 "FLRFltReason_HWFault" 8 "FLRFltReason_SafetyFault" 16 "FLRFltReason_CarConfigFault";
VAL_ 69 FLR2SignalStatusInterference 0 "FLRInterference_FLR2UnknownInterferenceStatus" 1 "FLRInterference_FLR2FullInterferenceStatus" 2 "FLRInterference_FLR2NoInterferenceStatus";
VAL_ 69 FLR2SignalStatusRdrIntSts 0 "RdrIntSts_Normal" 1 "RdrIntSts_EOLCal" 2 "RdrIntSts_HCC" 3 "RdrIntSts_ServiceCal" 4 "RdrIntSts_VCCAIACal" 5 "RdrIntSts_NA";
VAL_ 69 FLR2SignalStatusRdrSts 0 "RadarStatus_Faulty" 1 "RadarStatus_Normal";
VAL_ 69 FLR2SignalStatusRdrTransAct 0 "RadarTransmissionActive_NotActive" 1 "RadarTransmissionActive_Active";
VAL_ 69 FLR2SignalStatusSysFailFlag 0 "SystemFailureIndication_NoFault" 1 "SystemFailureIndication_Fault";
VAL_ 69 FLR2SignalStatusTimeStampStatus 0 "FLR2TimeStampStatus_NotOK" 1 "FLR2TimeStampStatus_Ok";
SIG_GROUP_ 330 FLR2RdrObject10To11 1 : FLR2RdrObject10To11Class0 FLR2RdrObject10To11Class1 FLR2RdrObject10To11Counter FLR2RdrObject10To11CRC FLR2RdrObject10To11DataCoastCntr0 FLR2RdrObject10To11DataCoastCntr1 FLR2RdrObject10To11DataConf0 FLR2RdrObject10To11DataConf1 FLR2RdrObject10To11DataLen0 FLR2RdrObject10To11DataLen1 FLR2RdrObject10To11DataStDLatAcc0 FLR2RdrObject10To11DataStDLatAcc1 FLR2RdrObject10To11DataStDLatPos0 FLR2RdrObject10To11DataStDLatPos1 FLR2RdrObject10To11DataStDLatVelo0 FLR2RdrObject10To11DataStDLatVelo1 FLR2RdrObject10To11DataStDLgtAcc0 FLR2RdrObject10To11DataStDLgtAcc1 FLR2RdrObject10To11DataStDLgtPos0 FLR2RdrObject10To11DataStDLgtPos1 FLR2RdrObject10To11DataStDLgtVelo0 FLR2RdrObject10To11DataStDLgtVelo1 FLR2RdrObject10To11DataWidth0 FLR2RdrObject10To11DataWidth1 FLR2RdrObject10To11HeadingAng0 FLR2RdrObject10To11HeadingAng1 FLR2RdrObject10To11LatAcc0 FLR2RdrObject10To11LatAcc1 FLR2RdrObject10To11LatPos0 FLR2RdrObject10To11LatPos1 FLR2RdrObject10To11LatVelo0 FLR2RdrObject10To11LatVelo1 FLR2RdrObject10To11LgtAcc0 FLR2RdrObject10To11LgtAcc1 FLR2RdrObject10To11LgtPos0 FLR2RdrObject10To11LgtPos1 FLR2RdrObject10To11LgtVelo0 FLR2RdrObject10To11LgtVelo1 FLR2RdrObject10To11ModeInfo0 FLR2RdrObject10To11ModeInfo1 FLR2RdrObject10To11MsgCntr FLR2RdrObject10To11MtnModel0 FLR2RdrObject10To11MtnModel1 FLR2RdrObject10To11MtnPattern0 FLR2RdrObject10To11MtnPattern1 FLR2RdrObject10To11PedMicroDoppler0 FLR2RdrObject10To11PedMicroDoppler1 FLR2RdrObject10To11Qly0 FLR2RdrObject10To11Qly1 FLR2RdrObject10To11ScanID;
SIG_GROUP_ 332 FLR2RdrObject12To13 1 : FLR2RdrObject12To13Class0 FLR2RdrObject12To13Class1 FLR2RdrObject12To13Counter FLR2RdrObject12To13CRC FLR2RdrObject12To13DataCoastCntr0 FLR2RdrObject12To13DataCoastCntr1 FLR2RdrObject12To13DataConf0 FLR2RdrObject12To13DataConf1 FLR2RdrObject12To13DataLen0 FLR2RdrObject12To13DataLen1 FLR2RdrObject12To13DataStDLatAcc0 FLR2RdrObject12To13DataStDLatAcc1 FLR2RdrObject12To13DataStDLatPos0 FLR2RdrObject12To13DataStDLatPos1 FLR2RdrObject12To13DataStDLatVelo0 FLR2RdrObject12To13DataStDLatVelo1 FLR2RdrObject12To13DataStDLgtAcc0 FLR2RdrObject12To13DataStDLgtAcc1 FLR2RdrObject12To13DataStDLgtPos0 FLR2RdrObject12To13DataStDLgtPos1 FLR2RdrObject12To13DataStDLgtVelo0 FLR2RdrObject12To13DataStDLgtVelo1 FLR2RdrObject12To13DataWidth0 FLR2RdrObject12To13DataWidth1 FLR2RdrObject12To13HeadingAng0 FLR2RdrObject12To13HeadingAng1 FLR2RdrObject12To13LatAcc0 FLR2RdrObject12To13LatAcc1 FLR2RdrObject12To13LatPos0 FLR2RdrObject12To13LatPos1 FLR2RdrObject12To13LatVelo0 FLR2RdrObject12To13LatVelo1 FLR2RdrObject12To13LgtAcc0 FLR2RdrObject12To13LgtAcc1 FLR2RdrObject12To13LgtPos0 FLR2RdrObject12To13LgtPos1 FLR2RdrObject12To13LgtVelo0 FLR2RdrObject12To13LgtVelo1 FLR2RdrObject12To13ModeInfo0 FLR2RdrObject12To13ModeInfo1 FLR2RdrObject12To13MsgCntr FLR2RdrObject12To13MtnModel0 FLR2RdrObject12To13MtnModel1 FLR2RdrObject12To13MtnPattern0 FLR2RdrObject12To13MtnPattern1 FLR2RdrObject12To13PedMicroDoppler0 FLR2RdrObject12To13PedMicroDoppler1 FLR2RdrObject12To13Qly0 FLR2RdrObject12To13Qly1 FLR2RdrObject12To13ScanID;
SIG_GROUP_ 334 FLR2RdrObject14To15 1 : FLR2RdrObject14To15Class0 FLR2RdrObject14To15Class1 FLR2RdrObject14To15Counter FLR2RdrObject14To15CRC FLR2RdrObject14To15DataCoastCntr0 FLR2RdrObject14To15DataCoastCntr1 FLR2RdrObject14To15DataConf0 FLR2RdrObject14To15DataConf1 FLR2RdrObject14To15DataLen0 FLR2RdrObject14To15DataLen1 FLR2RdrObject14To15DataStDLatAcc0 FLR2RdrObject14To15DataStDLatAcc1 FLR2RdrObject14To15DataStDLatPos0 FLR2RdrObject14To15DataStDLatPos1 FLR2RdrObject14To15DataStDLatVelo0 FLR2RdrObject14To15DataStDLatVelo1 FLR2RdrObject14To15DataStDLgtAcc0 FLR2RdrObject14To15DataStDLgtAcc1 FLR2RdrObject14To15DataStDLgtPos0 FLR2RdrObject14To15DataStDLgtPos1 FLR2RdrObject14To15DataStDLgtVelo0 FLR2RdrObject14To15DataStDLgtVelo1 FLR2RdrObject14To15DataWidth0 FLR2RdrObject14To15DataWidth1 FLR2RdrObject14To15HeadingAng0 FLR2RdrObject14To15HeadingAng1 FLR2RdrObject14To15LatAcc0 FLR2RdrObject14To15LatAcc1 FLR2RdrObject14To15LatPos0 FLR2RdrObject14To15LatPos1 FLR2RdrObject14To15LatVelo0 FLR2RdrObject14To15LatVelo1 FLR2RdrObject14To15LgtAcc0 FLR2RdrObject14To15LgtAcc1 FLR2RdrObject14To15LgtPos0 FLR2RdrObject14To15LgtPos1 FLR2RdrObject14To15LgtVelo0 FLR2RdrObject14To15LgtVelo1 FLR2RdrObject14To15ModeInfo0 FLR2RdrObject14To15ModeInfo1 FLR2RdrObject14To15MsgCntr FLR2RdrObject14To15MtnModel0 FLR2RdrObject14To15MtnModel1 FLR2RdrObject14To15MtnPattern0 FLR2RdrObject14To15MtnPattern1 FLR2RdrObject14To15PedMicroDoppler0 FLR2RdrObject14To15PedMicroDoppler1 FLR2RdrObject14To15Qly0 FLR2RdrObject14To15Qly1 FLR2RdrObject14To15ScanID;
SIG_GROUP_ 336 FLR2RdrObject16To17 1 : FLR2RdrObject16To17Class0 FLR2RdrObject16To17Class1 FLR2RdrObject16To17Counter FLR2RdrObject16To17CRC FLR2RdrObject16To17DataCoastCntr0 FLR2RdrObject16To17DataCoastCntr1 FLR2RdrObject16To17DataConf0 FLR2RdrObject16To17DataConf1 FLR2RdrObject16To17DataLen0 FLR2RdrObject16To17DataLen1 FLR2RdrObject16To17DataStDLatAcc0 FLR2RdrObject16To17DataStDLatAcc1 FLR2RdrObject16To17DataStDLatPos0 FLR2RdrObject16To17DataStDLatPos1 FLR2RdrObject16To17DataStDLatVelo0 FLR2RdrObject16To17DataStDLatVelo1 FLR2RdrObject16To17DataStDLgtAcc0 FLR2RdrObject16To17DataStDLgtAcc1 FLR2RdrObject16To17DataStDLgtPos0 FLR2RdrObject16To17DataStDLgtPos1 FLR2RdrObject16To17DataStDLgtVelo0 FLR2RdrObject16To17DataStDLgtVelo1 FLR2RdrObject16To17DataWidth0 FLR2RdrObject16To17DataWidth1 FLR2RdrObject16To17HeadingAng0 FLR2RdrObject16To17HeadingAng1 FLR2RdrObject16To17LatAcc0 FLR2RdrObject16To17LatAcc1 FLR2RdrObject16To17LatPos0 FLR2RdrObject16To17LatPos1 FLR2RdrObject16To17LatVelo0 FLR2RdrObject16To17LatVelo1 FLR2RdrObject16To17LgtAcc0 FLR2RdrObject16To17LgtAcc1 FLR2RdrObject16To17LgtPos0 FLR2RdrObject16To17LgtPos1 FLR2RdrObject16To17LgtVelo0 FLR2RdrObject16To17LgtVelo1 FLR2RdrObject16To17ModeInfo0 FLR2RdrObject16To17ModeInfo1 FLR2RdrObject16To17MsgCntr FLR2RdrObject16To17MtnModel0 FLR2RdrObject16To17MtnModel1 FLR2RdrObject16To17MtnPattern0 FLR2RdrObject16To17MtnPattern1 FLR2RdrObject16To17PedMicroDoppler0 FLR2RdrObject16To17PedMicroDoppler1 FLR2RdrObject16To17Qly0 FLR2RdrObject16To17Qly1 FLR2RdrObject16To17ScanID;
SIG_GROUP_ 338 FLR2RdrObject18To19 1 : FLR2RdrObject18To19Class0 FLR2RdrObject18To19Class1 FLR2RdrObject18To19Counter FLR2RdrObject18To19CRC FLR2RdrObject18To19DataCoastCntr0 FLR2RdrObject18To19DataCoastCntr1 FLR2RdrObject18To19DataConf0 FLR2RdrObject18To19DataConf1 FLR2RdrObject18To19DataLen0 FLR2RdrObject18To19DataLen1 FLR2RdrObject18To19DataStDLatAcc0 FLR2RdrObject18To19DataStDLatAcc1 FLR2RdrObject18To19DataStDLatPos0 FLR2RdrObject18To19DataStDLatPos1 FLR2RdrObject18To19DataStDLatVelo0 FLR2RdrObject18To19DataStDLatVelo1 FLR2RdrObject18To19DataStDLgtAcc0 FLR2RdrObject18To19DataStDLgtAcc1 FLR2RdrObject18To19DataStDLgtPos0 FLR2RdrObject18To19DataStDLgtPos1 FLR2RdrObject18To19DataStDLgtVelo0 FLR2RdrObject18To19DataStDLgtVelo1 FLR2RdrObject18To19DataWidth0 FLR2RdrObject18To19DataWidth1 FLR2RdrObject18To19HeadingAng0 FLR2RdrObject18To19HeadingAng1 FLR2RdrObject18To19LatAcc0 FLR2RdrObject18To19LatAcc1 FLR2RdrObject18To19LatPos0 FLR2RdrObject18To19LatPos1 FLR2RdrObject18To19LatVelo0 FLR2RdrObject18To19LatVelo1 FLR2RdrObject18To19LgtAcc0 FLR2RdrObject18To19LgtAcc1 FLR2RdrObject18To19LgtPos0 FLR2RdrObject18To19LgtPos1 FLR2RdrObject18To19LgtVelo0 FLR2RdrObject18To19LgtVelo1 FLR2RdrObject18To19ModeInfo0 FLR2RdrObject18To19ModeInfo1 FLR2RdrObject18To19MsgCntr FLR2RdrObject18To19MtnModel0 FLR2RdrObject18To19MtnModel1 FLR2RdrObject18To19MtnPattern0 FLR2RdrObject18To19MtnPattern1 FLR2RdrObject18To19PedMicroDoppler0 FLR2RdrObject18To19PedMicroDoppler1 FLR2RdrObject18To19Qly0 FLR2RdrObject18To19Qly1 FLR2RdrObject18To19ScanID;
SIG_GROUP_ 340 FLR2RdrObject20To21 1 : FLR2RdrObject20To21Class0 FLR2RdrObject20To21Class1 FLR2RdrObject20To21Counter FLR2RdrObject20To21CRC FLR2RdrObject20To21DataCoastCntr0 FLR2RdrObject20To21DataCoastCntr1 FLR2RdrObject20To21DataConf0 FLR2RdrObject20To21DataConf1 FLR2RdrObject20To21DataLen0 FLR2RdrObject20To21DataLen1 FLR2RdrObject20To21DataStDLatAcc0 FLR2RdrObject20To21DataStDLatAcc1 FLR2RdrObject20To21DataStDLatPos0 FLR2RdrObject20To21DataStDLatPos1 FLR2RdrObject20To21DataStDLatVelo0 FLR2RdrObject20To21DataStDLatVelo1 FLR2RdrObject20To21DataStDLgtAcc0 FLR2RdrObject20To21DataStDLgtAcc1 FLR2RdrObject20To21DataStDLgtPos0 FLR2RdrObject20To21DataStDLgtPos1 FLR2RdrObject20To21DataStDLgtVelo0 FLR2RdrObject20To21DataStDLgtVelo1 FLR2RdrObject20To21DataWidth0 FLR2RdrObject20To21DataWidth1 FLR2RdrObject20To21HeadingAng0 FLR2RdrObject20To21HeadingAng1 FLR2RdrObject20To21LatAcc0 FLR2RdrObject20To21LatAcc1 FLR2RdrObject20To21LatPos0 FLR2RdrObject20To21LatPos1 FLR2RdrObject20To21LatVelo0 FLR2RdrObject20To21LatVelo1 FLR2RdrObject20To21LgtAcc0 FLR2RdrObject20To21LgtAcc1 FLR2RdrObject20To21LgtPos0 FLR2RdrObject20To21LgtPos1 FLR2RdrObject20To21LgtVelo0 FLR2RdrObject20To21LgtVelo1 FLR2RdrObject20To21ModeInfo0 FLR2RdrObject20To21ModeInfo1 FLR2RdrObject20To21MsgCntr FLR2RdrObject20To21MtnModel0 FLR2RdrObject20To21MtnModel1 FLR2RdrObject20To21MtnPattern0 FLR2RdrObject20To21MtnPattern1 FLR2RdrObject20To21PedMicroDoppler0 FLR2RdrObject20To21PedMicroDoppler1 FLR2RdrObject20To21Qly0 FLR2RdrObject20To21Qly1 FLR2RdrObject20To21ScanID;
SIG_GROUP_ 342 FLR2RdrObject22To23 1 : FLR2RdrObject22To23Class0 FLR2RdrObject22To23Class1 FLR2RdrObject22To23Counter FLR2RdrObject22To23CRC FLR2RdrObject22To23DataCoastCntr0 FLR2RdrObject22To23DataCoastCntr1 FLR2RdrObject22To23DataConf0 FLR2RdrObject22To23DataConf1 FLR2RdrObject22To23DataLen0 FLR2RdrObject22To23DataLen1 FLR2RdrObject22To23DataStDLatAcc0 FLR2RdrObject22To23DataStDLatAcc1 FLR2RdrObject22To23DataStDLatPos0 FLR2RdrObject22To23DataStDLatPos1 FLR2RdrObject22To23DataStDLatVelo0 FLR2RdrObject22To23DataStDLatVelo1 FLR2RdrObject22To23DataStDLgtAcc0 FLR2RdrObject22To23DataStDLgtAcc1 FLR2RdrObject22To23DataStDLgtPos0 FLR2RdrObject22To23DataStDLgtPos1 FLR2RdrObject22To23DataStDLgtVelo0 FLR2RdrObject22To23DataStDLgtVelo1 FLR2RdrObject22To23DataWidth0 FLR2RdrObject22To23DataWidth1 FLR2RdrObject22To23HeadingAng0 FLR2RdrObject22To23HeadingAng1 FLR2RdrObject22To23LatAcc0 FLR2RdrObject22To23LatAcc1 FLR2RdrObject22To23LatPos0 FLR2RdrObject22To23LatPos1 FLR2RdrObject22To23LatVelo0 FLR2RdrObject22To23LatVelo1 FLR2RdrObject22To23LgtAcc0 FLR2RdrObject22To23LgtAcc1 FLR2RdrObject22To23LgtPos0 FLR2RdrObject22To23LgtPos1 FLR2RdrObject22To23LgtVelo0 FLR2RdrObject22To23LgtVelo1 FLR2RdrObject22To23ModeInfo0 FLR2RdrObject22To23ModeInfo1 FLR2RdrObject22To23MsgCntr FLR2RdrObject22To23MtnModel0 FLR2RdrObject22To23MtnModel1 FLR2RdrObject22To23MtnPattern0 FLR2RdrObject22To23MtnPattern1 FLR2RdrObject22To23PedMicroDoppler0 FLR2RdrObject22To23PedMicroDoppler1 FLR2RdrObject22To23Qly0 FLR2RdrObject22To23Qly1 FLR2RdrObject22To23ScanID;
SIG_GROUP_ 344 FLR2RdrObject24To25 1 : FLR2RdrObject24To25Class0 FLR2RdrObject24To25Class1 FLR2RdrObject24To25Counter FLR2RdrObject24To25CRC FLR2RdrObject24To25DataCoastCntr0 FLR2RdrObject24To25DataCoastCntr1 FLR2RdrObject24To25DataConf0 FLR2RdrObject24To25DataConf1 FLR2RdrObject24To25DataLen0 FLR2RdrObject24To25DataLen1 FLR2RdrObject24To25DataStDLatAcc0 FLR2RdrObject24To25DataStDLatAcc1 FLR2RdrObject24To25DataStDLatPos0 FLR2RdrObject24To25DataStDLatPos1 FLR2RdrObject24To25DataStDLatVelo0 FLR2RdrObject24To25DataStDLatVelo1 FLR2RdrObject24To25DataStDLgtAcc0 FLR2RdrObject24To25DataStDLgtAcc1 FLR2RdrObject24To25DataStDLgtPos0 FLR2RdrObject24To25DataStDLgtPos1 FLR2RdrObject24To25DataStDLgtVelo0 FLR2RdrObject24To25DataStDLgtVelo1 FLR2RdrObject24To25DataWidth0 FLR2RdrObject24To25DataWidth1 FLR2RdrObject24To25HeadingAng0 FLR2RdrObject24To25HeadingAng1 FLR2RdrObject24To25LatAcc0 FLR2RdrObject24To25LatAcc1 FLR2RdrObject24To25LatPos0 FLR2RdrObject24To25LatPos1 FLR2RdrObject24To25LatVelo0 FLR2RdrObject24To25LatVelo1 FLR2RdrObject24To25LgtAcc0 FLR2RdrObject24To25LgtAcc1 FLR2RdrObject24To25LgtPos0 FLR2RdrObject24To25LgtPos1 FLR2RdrObject24To25LgtVelo0 FLR2RdrObject24To25LgtVelo1 FLR2RdrObject24To25ModeInfo0 FLR2RdrObject24To25ModeInfo1 FLR2RdrObject24To25MsgCntr FLR2RdrObject24To25MtnModel0 FLR2RdrObject24To25MtnModel1 FLR2RdrObject24To25MtnPattern0 FLR2RdrObject24To25MtnPattern1 FLR2RdrObject24To25PedMicroDoppler0 FLR2RdrObject24To25PedMicroDoppler1 FLR2RdrObject24To25Qly0 FLR2RdrObject24To25Qly1 FLR2RdrObject24To25ScanID;
SIG_GROUP_ 346 FLR2RdrObject26To27 1 : FLR2RdrObject26To27Class0 FLR2RdrObject26To27Class1 FLR2RdrObject26To27Counter FLR2RdrObject26To27CRC FLR2RdrObject26To27DataCoastCntr0 FLR2RdrObject26To27DataCoastCntr1 FLR2RdrObject26To27DataConf0 FLR2RdrObject26To27DataConf1 FLR2RdrObject26To27DataLen0 FLR2RdrObject26To27DataLen1 FLR2RdrObject26To27DataStDLatAcc0 FLR2RdrObject26To27DataStDLatAcc1 FLR2RdrObject26To27DataStDLatPos0 FLR2RdrObject26To27DataStDLatPos1 FLR2RdrObject26To27DataStDLatVelo0 FLR2RdrObject26To27DataStDLatVelo1 FLR2RdrObject26To27DataStDLgtAcc0 FLR2RdrObject26To27DataStDLgtAcc1 FLR2RdrObject26To27DataStDLgtPos0 FLR2RdrObject26To27DataStDLgtPos1 FLR2RdrObject26To27DataStDLgtVelo0 FLR2RdrObject26To27DataStDLgtVelo1 FLR2RdrObject26To27DataWidth0 FLR2RdrObject26To27DataWidth1 FLR2RdrObject26To27HeadingAng0 FLR2RdrObject26To27HeadingAng1 FLR2RdrObject26To27LatAcc0 FLR2RdrObject26To27LatAcc1 FLR2RdrObject26To27LatPos0 FLR2RdrObject26To27LatPos1 FLR2RdrObject26To27LatVelo0 FLR2RdrObject26To27LatVelo1 FLR2RdrObject26To27LgtAcc0 FLR2RdrObject26To27LgtAcc1 FLR2RdrObject26To27LgtPos0 FLR2RdrObject26To27LgtPos1 FLR2RdrObject26To27LgtVelo0 FLR2RdrObject26To27LgtVelo1 FLR2RdrObject26To27ModeInfo0 FLR2RdrObject26To27ModeInfo1 FLR2RdrObject26To27MsgCntr FLR2RdrObject26To27MtnModel0 FLR2RdrObject26To27MtnModel1 FLR2RdrObject26To27MtnPattern0 FLR2RdrObject26To27MtnPattern1 FLR2RdrObject26To27PedMicroDoppler0 FLR2RdrObject26To27PedMicroDoppler1 FLR2RdrObject26To27Qly0 FLR2RdrObject26To27Qly1 FLR2RdrObject26To27ScanID;
SIG_GROUP_ 348 FLR2RdrObject28To29 1 : FLR2RdrObject28To29Class0 FLR2RdrObject28To29Class1 FLR2RdrObject28To29Counter FLR2RdrObject28To29CRC FLR2RdrObject28To29DataCoastCntr0 FLR2RdrObject28To29DataCoastCntr1 FLR2RdrObject28To29DataConf0 FLR2RdrObject28To29DataConf1 FLR2RdrObject28To29DataLen0 FLR2RdrObject28To29DataLen1 FLR2RdrObject28To29DataStDLatAcc0 FLR2RdrObject28To29DataStDLatAcc1 FLR2RdrObject28To29DataStDLatPos0 FLR2RdrObject28To29DataStDLatPos1 FLR2RdrObject28To29DataStDLatVelo0 FLR2RdrObject28To29DataStDLatVelo1 FLR2RdrObject28To29DataStDLgtAcc0 FLR2RdrObject28To29DataStDLgtAcc1 FLR2RdrObject28To29DataStDLgtPos0 FLR2RdrObject28To29DataStDLgtPos1 FLR2RdrObject28To29DataStDLgtVelo0 FLR2RdrObject28To29DataStDLgtVelo1 FLR2RdrObject28To29DataWidth0 FLR2RdrObject28To29DataWidth1 FLR2RdrObject28To29HeadingAng0 FLR2RdrObject28To29HeadingAng1 FLR2RdrObject28To29LatAcc0 FLR2RdrObject28To29LatAcc1 FLR2RdrObject28To29LatPos0 FLR2RdrObject28To29LatPos1 FLR2RdrObject28To29LatVelo0 FLR2RdrObject28To29LatVelo1 FLR2RdrObject28To29LgtAcc0 FLR2RdrObject28To29LgtAcc1 FLR2RdrObject28To29LgtPos0 FLR2RdrObject28To29LgtPos1 FLR2RdrObject28To29LgtVelo0 FLR2RdrObject28To29LgtVelo1 FLR2RdrObject28To29ModeInfo0 FLR2RdrObject28To29ModeInfo1 FLR2RdrObject28To29MsgCntr FLR2RdrObject28To29MtnModel0 FLR2RdrObject28To29MtnModel1 FLR2RdrObject28To29MtnPattern0 FLR2RdrObject28To29MtnPattern1 FLR2RdrObject28To29PedMicroDoppler0 FLR2RdrObject28To29PedMicroDoppler1 FLR2RdrObject28To29Qly0 FLR2RdrObject28To29Qly1 FLR2RdrObject28To29ScanID;
SIG_GROUP_ 324 FLR2RdrObject4To5 1 : FLR2RdrObject4To5Class0 FLR2RdrObject4To5Class1 FLR2RdrObject4To5Counter FLR2RdrObject4To5CRC FLR2RdrObject4To5DataCoastCntr0 FLR2RdrObject4To5DataCoastCntr1 FLR2RdrObject4To5DataConf0 FLR2RdrObject4To5DataConf1 FLR2RdrObject4To5DataLen0 FLR2RdrObject4To5DataLen1 FLR2RdrObject4To5DataStDLatAcc0 FLR2RdrObject4To5DataStDLatAcc1 FLR2RdrObject4To5DataStDLatPos0 FLR2RdrObject4To5DataStDLatPos1 FLR2RdrObject4To5DataStDLatVelo0 FLR2RdrObject4To5DataStDLatVelo1 FLR2RdrObject4To5DataStDLgtAcc0 FLR2RdrObject4To5DataStDLgtAcc1 FLR2RdrObject4To5DataStDLgtPos0 FLR2RdrObject4To5DataStDLgtPos1 FLR2RdrObject4To5DataStDLgtVelo0 FLR2RdrObject4To5DataStDLgtVelo1 FLR2RdrObject4To5DataWidth0 FLR2RdrObject4To5DataWidth1 FLR2RdrObject4To5HeadingAng0 FLR2RdrObject4To5HeadingAng1 FLR2RdrObject4To5LatAcc0 FLR2RdrObject4To5LatAcc1 FLR2RdrObject4To5LatPos0 FLR2RdrObject4To5LatPos1 FLR2RdrObject4To5LatVelo0 FLR2RdrObject4To5LatVelo1 FLR2RdrObject4To5LgtAcc0 FLR2RdrObject4To5LgtAcc1 FLR2RdrObject4To5LgtPos0 FLR2RdrObject4To5LgtPos1 FLR2RdrObject4To5LgtVelo0 FLR2RdrObject4To5LgtVelo1 FLR2RdrObject4To5ModeInfo0 FLR2RdrObject4To5ModeInfo1 FLR2RdrObject4To5MsgCntr FLR2RdrObject4To5MtnModel0 FLR2RdrObject4To5MtnModel1 FLR2RdrObject4To5MtnPattern0 FLR2RdrObject4To5MtnPattern1 FLR2RdrObject4To5PedMicroDoppler0 FLR2RdrObject4To5PedMicroDoppler1 FLR2RdrObject4To5Qly0 FLR2RdrObject4To5Qly1 FLR2RdrObject4To5ScanID;
SIG_GROUP_ 326 FLR2RdrObject6To7 1 : FLR2RdrObject6To7Class0 FLR2RdrObject6To7Class1 FLR2RdrObject6To7Counter FLR2RdrObject6To7CRC FLR2RdrObject6To7DataCoastCntr0 FLR2RdrObject6To7DataCoastCntr1 FLR2RdrObject6To7DataConf0 FLR2RdrObject6To7DataConf1 FLR2RdrObject6To7DataLen0 FLR2RdrObject6To7DataLen1 FLR2RdrObject6To7DataStDLatAcc0 FLR2RdrObject6To7DataStDLatAcc1 FLR2RdrObject6To7DataStDLatPos0 FLR2RdrObject6To7DataStDLatPos1 FLR2RdrObject6To7DataStDLatVelo0 FLR2RdrObject6To7DataStDLatVelo1 FLR2RdrObject6To7DataStDLgtAcc0 FLR2RdrObject6To7DataStDLgtAcc1 FLR2RdrObject6To7DataStDLgtPos0 FLR2RdrObject6To7DataStDLgtPos1 FLR2RdrObject6To7DataStDLgtVelo0 FLR2RdrObject6To7DataStDLgtVelo1 FLR2RdrObject6To7DataWidth0 FLR2RdrObject6To7DataWidth1 FLR2RdrObject6To7HeadingAng0 FLR2RdrObject6To7HeadingAng1 FLR2RdrObject6To7LatAcc0 FLR2RdrObject6To7LatAcc1 FLR2RdrObject6To7LatPos0 FLR2RdrObject6To7LatPos1 FLR2RdrObject6To7LatVelo0 FLR2RdrObject6To7LatVelo1 FLR2RdrObject6To7LgtAcc0 FLR2RdrObject6To7LgtAcc1 FLR2RdrObject6To7LgtPos0 FLR2RdrObject6To7LgtPos1 FLR2RdrObject6To7LgtVelo0 FLR2RdrObject6To7LgtVelo1 FLR2RdrObject6To7ModeInfo0 FLR2RdrObject6To7ModeInfo1 FLR2RdrObject6To7MsgCntr FLR2RdrObject6To7MtnModel0 FLR2RdrObject6To7MtnModel1 FLR2RdrObject6To7MtnPattern0 FLR2RdrObject6To7MtnPattern1 FLR2RdrObject6To7PedMicroDoppler0 FLR2RdrObject6To7PedMicroDoppler1 FLR2RdrObject6To7Qly0 FLR2RdrObject6To7Qly1 FLR2RdrObject6To7ScanID;
SIG_GROUP_ 328 FLR2RdrObject8To9 1 : FLR2RdrObject8To9Class0 FLR2RdrObject8To9Class1 FLR2RdrObject8To9Counter FLR2RdrObject8To9CRC FLR2RdrObject8To9DataCoastCntr0 FLR2RdrObject8To9DataCoastCntr1 FLR2RdrObject8To9DataConf0 FLR2RdrObject8To9DataConf1 FLR2RdrObject8To9DataLen0 FLR2RdrObject8To9DataLen1 FLR2RdrObject8To9DataStDLatAcc0 FLR2RdrObject8To9DataStDLatAcc1 FLR2RdrObject8To9DataStDLatPos0 FLR2RdrObject8To9DataStDLatPos1 FLR2RdrObject8To9DataStDLatVelo0 FLR2RdrObject8To9DataStDLatVelo1 FLR2RdrObject8To9DataStDLgtAcc0 FLR2RdrObject8To9DataStDLgtAcc1 FLR2RdrObject8To9DataStDLgtPos0 FLR2RdrObject8To9DataStDLgtPos1 FLR2RdrObject8To9DataStDLgtVelo0 FLR2RdrObject8To9DataStDLgtVelo1 FLR2RdrObject8To9DataWidth0 FLR2RdrObject8To9DataWidth1 FLR2RdrObject8To9HeadingAng0 FLR2RdrObject8To9HeadingAng1 FLR2RdrObject8To9LatAcc0 FLR2RdrObject8To9LatAcc1 FLR2RdrObject8To9LatPos0 FLR2RdrObject8To9LatPos1 FLR2RdrObject8To9LatVelo0 FLR2RdrObject8To9LatVelo1 FLR2RdrObject8To9LgtAcc0 FLR2RdrObject8To9LgtAcc1 FLR2RdrObject8To9LgtPos0 FLR2RdrObject8To9LgtPos1 FLR2RdrObject8To9LgtVelo0 FLR2RdrObject8To9LgtVelo1 FLR2RdrObject8To9ModeInfo0 FLR2RdrObject8To9ModeInfo1 FLR2RdrObject8To9MsgCntr FLR2RdrObject8To9MtnModel0 FLR2RdrObject8To9MtnModel1 FLR2RdrObject8To9MtnPattern0 FLR2RdrObject8To9MtnPattern1 FLR2RdrObject8To9PedMicroDoppler0 FLR2RdrObject8To9PedMicroDoppler1 FLR2RdrObject8To9Qly0 FLR2RdrObject8To9Qly1 FLR2RdrObject8To9ScanID;
SIG_GROUP_ 69 FLR2SignalStatus 1 : FLR2SignalStatusAziAngCor FLR2SignalStatusBlockage FLR2SignalStatusCalPrgrsSts FLR2SignalStatusCalRltSts FLR2SignalStatusCalSts FLR2SignalStatusCommFltReason FLR2SignalStatusCounter FLR2SignalStatusCRC FLR2SignalStatusEgoSpdEst FLR2SignalStatusEgoYawRateEst FLR2SignalStatusEleAngCor FLR2SignalStatusFltReason FLR2SignalStatusIfVersMajor FLR2SignalStatusIfVersMinor FLR2SignalStatusInterference FLR2SignalStatusInternalTemp FLR2SignalStatusRdrIntSts FLR2SignalStatusRdrSts FLR2SignalStatusRdrTransAct FLR2SignalStatusScanIDSts FLR2SignalStatusSwVersMajor FLR2SignalStatusSwVersMinor FLR2SignalStatusSysFailFlag FLR2SignalStatusTimeStamp FLR2SignalStatusTimeStampStatus FLR2SignalStatusWhlCompFact FLR2SignalStatusXAxisOffs FLR2SignalStatusXOrientAng FLR2SignalStatusYAxisOffs FLR2SignalStatusYOrientAng FLR2SignalStatusZAxisOffs FLR2SignalStatusZOrientAng;
