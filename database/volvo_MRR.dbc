// *************************************************************************** *
// *                                                                           *
// * Description:         CANDB File                                           *
// * Generated at:        2023-01-05 13:51                                     *
// * System:              FLRsystem_MAIN_26                                    *
// * Network:             FLR1CAN                                              *
// *                                                                           *
// *************************************************************************** *
VERSION "FLR1CAN"

NS_ :

BS_ :

BU_ :  FLR FLRdpHPA FLRdpHPB

BO_ 250 FlrFlr1canFr55 : 64 FLR
 SG_ FLR2RdrDetn270To274_UB : 359|1@0+ (1,0) [0|1] "" FLRdpHPA,FLRdpHPB
 SG_ FLR2RdrDetn270To274AziAng0 : 32|9@1+ (0.0035,-0.87266) [-0.87266|0.91584] "rad" FLRdpHPA,FLRdpHPB
 SG_ FLR2RdrDetn270To274AziAng1 : 96|9@1+ (0.0035,-0.87266) [-0.87266|0.91584] "rad" FLRdpHPA,FLRdpHPB
 SG_ FLR2RdrDetn270To274AziAng2 : 160|9@1+ (0.0035,-0.87266) [-0.87266|0.91584] "rad" FLRdpHPA,FLRdpHPB
 SG_ FLR2RdrDetn270To274AziAng3 : 224|9@1+ (0.0035,-0.87266) [-0.87266|0.91584] "rad" FLRdpHPA,FLRdpHPB
 SG_ FLR2RdrDetn270To274AziAng4 : 288|9@1+ (0.0035,-0.87266) [-0.87266|0.91584] "rad" FLRdpHPA,FLRdpHPB
 SG_ FLR2RdrDetn270To274Counter : 16|8@1+ (1.0,0.0) [0.0|255.0] "Unitless" FLRdpHPA,FLRdpHPB
 SG_ FLR2RdrDetn270To274CRC : 0|16@1+ (1.0,0.0) [0.0|65535.0] "Unitless" FLRdpHPA,FLRdpHPB
 SG_ FLR2RdrDetn270To274DynPrpty0 : 93|1@1+ (1.0,0.0) [0.0|1.0] "Unitless" FLRdpHPA,FLRdpHPB
 SG_ FLR2RdrDetn270To274DynPrpty1 : 157|1@1+ (1.0,0.0) [0.0|1.0] "Unitless" FLRdpHPA,FLRdpHPB
 SG_ FLR2RdrDetn270To274DynPrpty2 : 221|1@1+ (1.0,0.0) [0.0|1.0] "Unitless" FLRdpHPA,FLRdpHPB
 SG_ FLR2RdrDetn270To274DynPrpty3 : 285|1@1+ (1.0,0.0) [0.0|1.0] "Unitless" FLRdpHPA,FLRdpHPB
 SG_ FLR2RdrDetn270To274DynPrpty4 : 349|1@1+ (1.0,0.0) [0.0|1.0] "Unitless" FLRdpHPA,FLRdpHPB
 SG_ FLR2RdrDetn270To274EleAng0 : 64|8@1+ (0.002,0.0) [0.0|0.5] "rad" FLRdpHPA,FLRdpHPB
 SG_ FLR2RdrDetn270To274EleAng1 : 128|8@1+ (0.002,0.0) [0.0|0.5] "rad" FLRdpHPA,FLRdpHPB
 SG_ FLR2RdrDetn270To274EleAng2 : 192|8@1+ (0.002,0.0) [0.0|0.5] "rad" FLRdpHPA,FLRdpHPB
 SG_ FLR2RdrDetn270To274EleAng3 : 256|8@1+ (0.002,0.0) [0.0|0.5] "rad" FLRdpHPA,FLRdpHPB
 SG_ FLR2RdrDetn270To274EleAng4 : 320|8@1+ (0.002,0.0) [0.0|0.5] "rad" FLRdpHPA,FLRdpHPB
 SG_ FLR2RdrDetn270To274Mode0 : 60|2@1+ (1,0) [0|3] "" FLRdpHPA,FLRdpHPB
 SG_ FLR2RdrDetn270To274Mode1 : 124|2@1+ (1,0) [0|3] "" FLRdpHPA,FLRdpHPB
 SG_ FLR2RdrDetn270To274Mode2 : 188|2@1+ (1,0) [0|3] "" FLRdpHPA,FLRdpHPB
 SG_ FLR2RdrDetn270To274Mode3 : 252|2@1+ (1,0) [0|3] "" FLRdpHPA,FLRdpHPB
 SG_ FLR2RdrDetn270To274Mode4 : 316|2@1+ (1,0) [0|3] "" FLRdpHPA,FLRdpHPB
 SG_ FLR2RdrDetn270To274Quality0 : 62|2@1+ (1,0) [0|3] "" FLRdpHPA,FLRdpHPB
 SG_ FLR2RdrDetn270To274Quality1 : 126|2@1+ (1,0) [0|3] "" FLRdpHPA,FLRdpHPB
 SG_ FLR2RdrDetn270To274Quality2 : 190|2@1+ (1,0) [0|3] "" FLRdpHPA,FLRdpHPB
 SG_ FLR2RdrDetn270To274Quality3 : 254|2@1+ (1,0) [0|3] "" FLRdpHPA,FLRdpHPB
 SG_ FLR2RdrDetn270To274Quality4 : 318|2@1+ (1,0) [0|3] "" FLRdpHPA,FLRdpHPB
 SG_ FLR2RdrDetn270To274Range0 : 48|12@1+ (0.1,0.4) [0.4|300.0] "m" FLRdpHPA,FLRdpHPB
 SG_ FLR2RdrDetn270To274Range1 : 112|12@1+ (0.1,0.4) [0.4|300.0] "m" FLRdpHPA,FLRdpHPB
 SG_ FLR2RdrDetn270To274Range2 : 176|12@1+ (0.1,0.4) [0.4|300.0] "m" FLRdpHPA,FLRdpHPB
 SG_ FLR2RdrDetn270To274Range3 : 240|12@1+ (0.1,0.4) [0.4|300.0] "m" FLRdpHPA,FLRdpHPB
 SG_ FLR2RdrDetn270To274Range4 : 304|12@1+ (0.1,0.4) [0.4|300.0] "m" FLRdpHPA,FLRdpHPB
 SG_ FLR2RdrDetn270To274RCS0 : 83|10@1+ (0.2,-100.0) [-100.0|70.0] "dBsm" FLRdpHPA,FLRdpHPB
 SG_ FLR2RdrDetn270To274RCS1 : 147|10@1+ (0.2,-100.0) [-100.0|70.0] "dBsm" FLRdpHPA,FLRdpHPB
 SG_ FLR2RdrDetn270To274RCS2 : 211|10@1+ (0.2,-100.0) [-100.0|70.0] "dBsm" FLRdpHPA,FLRdpHPB
 SG_ FLR2RdrDetn270To274RCS3 : 275|10@1+ (0.2,-100.0) [-100.0|70.0] "dBsm" FLRdpHPA,FLRdpHPB
 SG_ FLR2RdrDetn270To274RCS4 : 339|10@1+ (0.2,-100.0) [-100.0|70.0] "dBsm" FLRdpHPA,FLRdpHPB
 SG_ FLR2RdrDetn270To274RngRt0 : 72|11@1+ (0.1,-111.11) [-111.11|55.59000000000002] "m/s" FLRdpHPA,FLRdpHPB
 SG_ FLR2RdrDetn270To274RngRt1 : 136|11@1+ (0.1,-111.11) [-111.11|55.59000000000002] "m/s" FLRdpHPA,FLRdpHPB
 SG_ FLR2RdrDetn270To274RngRt2 : 200|11@1+ (0.1,-111.11) [-111.11|55.59000000000002] "m/s" FLRdpHPA,FLRdpHPB
 SG_ FLR2RdrDetn270To274RngRt3 : 264|11@1+ (0.1,-111.11) [-111.11|55.59000000000002] "m/s" FLRdpHPA,FLRdpHPB
 SG_ FLR2RdrDetn270To274RngRt4 : 328|11@1+ (0.1,-111.11) [-111.11|55.59000000000002] "m/s" FLRdpHPA,FLRdpHPB
 SG_ FLR2RdrDetn270To274ScanID : 24|8@1+ (1.0,0.0) [0.0|255.0] "Unitless" FLRdpHPA,FLRdpHPB
 SG_ FLR2RdrDetn270To274SNR0 : 41|7@1+ (0.5,0.0) [0.0|63.5] "dB" FLRdpHPA,FLRdpHPB
 SG_ FLR2RdrDetn270To274SNR1 : 105|7@1+ (0.5,0.0) [0.0|63.5] "dB" FLRdpHPA,FLRdpHPB
 SG_ FLR2RdrDetn270To274SNR2 : 169|7@1+ (0.5,0.0) [0.0|63.5] "dB" FLRdpHPA,FLRdpHPB
 SG_ FLR2RdrDetn270To274SNR3 : 233|7@1+ (0.5,0.0) [0.0|63.5] "dB" FLRdpHPA,FLRdpHPB
 SG_ FLR2RdrDetn270To274SNR4 : 297|7@1+ (0.5,0.0) [0.0|63.5] "dB" FLRdpHPA,FLRdpHPB

BO_ 252 FlrFlr1canFr56 : 64 FLR
 SG_ FLR2RdrDetn275To279_UB : 359|1@0+ (1,0) [0|1] "" FLRdpHPA,FLRdpHPB
 SG_ FLR2RdrDetn275To279AziAng0 : 32|9@1+ (0.0035,-0.87266) [-0.87266|0.91584] "rad" FLRdpHPA,FLRdpHPB
 SG_ FLR2RdrDetn275To279AziAng1 : 96|9@1+ (0.0035,-0.87266) [-0.87266|0.91584] "rad" FLRdpHPA,FLRdpHPB
 SG_ FLR2RdrDetn275To279AziAng2 : 160|9@1+ (0.0035,-0.87266) [-0.87266|0.91584] "rad" FLRdpHPA,FLRdpHPB
 SG_ FLR2RdrDetn275To279AziAng3 : 224|9@1+ (0.0035,-0.87266) [-0.87266|0.91584] "rad" FLRdpHPA,FLRdpHPB
 SG_ FLR2RdrDetn275To279AziAng4 : 288|9@1+ (0.0035,-0.87266) [-0.87266|0.91584] "rad" FLRdpHPA,FLRdpHPB
 SG_ FLR2RdrDetn275To279Counter : 16|8@1+ (1.0,0.0) [0.0|255.0] "Unitless" FLRdpHPA,FLRdpHPB
 SG_ FLR2RdrDetn275To279CRC : 0|16@1+ (1.0,0.0) [0.0|65535.0] "Unitless" FLRdpHPA,FLRdpHPB
 SG_ FLR2RdrDetn275To279DynPrpty0 : 93|1@1+ (1.0,0.0) [0.0|1.0] "Unitless" FLRdpHPA,FLRdpHPB
 SG_ FLR2RdrDetn275To279DynPrpty1 : 157|1@1+ (1.0,0.0) [0.0|1.0] "Unitless" FLRdpHPA,FLRdpHPB
 SG_ FLR2RdrDetn275To279DynPrpty2 : 221|1@1+ (1.0,0.0) [0.0|1.0] "Unitless" FLRdpHPA,FLRdpHPB
 SG_ FLR2RdrDetn275To279DynPrpty3 : 285|1@1+ (1.0,0.0) [0.0|1.0] "Unitless" FLRdpHPA,FLRdpHPB
 SG_ FLR2RdrDetn275To279DynPrpty4 : 349|1@1+ (1.0,0.0) [0.0|1.0] "Unitless" FLRdpHPA,FLRdpHPB
 SG_ FLR2RdrDetn275To279EleAng0 : 64|8@1+ (0.002,0.0) [0.0|0.5] "rad" FLRdpHPA,FLRdpHPB
 SG_ FLR2RdrDetn275To279EleAng1 : 128|8@1+ (0.002,0.0) [0.0|0.5] "rad" FLRdpHPA,FLRdpHPB
 SG_ FLR2RdrDetn275To279EleAng2 : 192|8@1+ (0.002,0.0) [0.0|0.5] "rad" FLRdpHPA,FLRdpHPB
 SG_ FLR2RdrDetn275To279EleAng3 : 256|8@1+ (0.002,0.0) [0.0|0.5] "rad" FLRdpHPA,FLRdpHPB
 SG_ FLR2RdrDetn275To279EleAng4 : 320|8@1+ (0.002,0.0) [0.0|0.5] "rad" FLRdpHPA,FLRdpHPB
 SG_ FLR2RdrDetn275To279Mode0 : 60|2@1+ (1,0) [0|3] "" FLRdpHPA,FLRdpHPB
 SG_ FLR2RdrDetn275To279Mode1 : 124|2@1+ (1,0) [0|3] "" FLRdpHPA,FLRdpHPB
 SG_ FLR2RdrDetn275To279Mode2 : 188|2@1+ (1,0) [0|3] "" FLRdpHPA,FLRdpHPB
 SG_ FLR2RdrDetn275To279Mode3 : 252|2@1+ (1,0) [0|3] "" FLRdpHPA,FLRdpHPB
 SG_ FLR2RdrDetn275To279Mode4 : 316|2@1+ (1,0) [0|3] "" FLRdpHPA,FLRdpHPB
 SG_ FLR2RdrDetn275To279Quality0 : 62|2@1+ (1,0) [0|3] "" FLRdpHPA,FLRdpHPB
 SG_ FLR2RdrDetn275To279Quality1 : 126|2@1+ (1,0) [0|3] "" FLRdpHPA,FLRdpHPB
 SG_ FLR2RdrDetn275To279Quality2 : 190|2@1+ (1,0) [0|3] "" FLRdpHPA,FLRdpHPB
 SG_ FLR2RdrDetn275To279Quality3 : 254|2@1+ (1,0) [0|3] "" FLRdpHPA,FLRdpHPB
 SG_ FLR2RdrDetn275To279Quality4 : 318|2@1+ (1,0) [0|3] "" FLRdpHPA,FLRdpHPB
 SG_ FLR2RdrDetn275To279Range0 : 48|12@1+ (0.1,0.4) [0.4|300.0] "m" FLRdpHPA,FLRdpHPB
 SG_ FLR2RdrDetn275To279Range1 : 112|12@1+ (0.1,0.4) [0.4|300.0] "m" FLRdpHPA,FLRdpHPB
 SG_ FLR2RdrDetn275To279Range2 : 176|12@1+ (0.1,0.4) [0.4|300.0] "m" FLRdpHPA,FLRdpHPB
 SG_ FLR2RdrDetn275To279Range3 : 240|12@1+ (0.1,0.4) [0.4|300.0] "m" FLRdpHPA,FLRdpHPB
 SG_ FLR2RdrDetn275To279Range4 : 304|12@1+ (0.1,0.4) [0.4|300.0] "m" FLRdpHPA,FLRdpHPB
 SG_ FLR2RdrDetn275To279RCS0 : 83|10@1+ (0.2,-100.0) [-100.0|70.0] "dBsm" FLRdpHPA,FLRdpHPB
 SG_ FLR2RdrDetn275To279RCS1 : 147|10@1+ (0.2,-100.0) [-100.0|70.0] "dBsm" FLRdpHPA,FLRdpHPB
 SG_ FLR2RdrDetn275To279RCS2 : 211|10@1+ (0.2,-100.0) [-100.0|70.0] "dBsm" FLRdpHPA,FLRdpHPB
 SG_ FLR2RdrDetn275To279RCS3 : 275|10@1+ (0.2,-100.0) [-100.0|70.0] "dBsm" FLRdpHPA,FLRdpHPB
 SG_ FLR2RdrDetn275To279RCS4 : 339|10@1+ (0.2,-100.0) [-100.0|70.0] "dBsm" FLRdpHPA,FLRdpHPB
 SG_ FLR2RdrDetn275To279RngRt0 : 72|11@1+ (0.1,-111.11) [-111.11|55.59000000000002] "m/s" FLRdpHPA,FLRdpHPB
 SG_ FLR2RdrDetn275To279RngRt1 : 136|11@1+ (0.1,-111.11) [-111.11|55.59000000000002] "m/s" FLRdpHPA,FLRdpHPB
 SG_ FLR2RdrDetn275To279RngRt2 : 200|11@1+ (0.1,-111.11) [-111.11|55.59000000000002] "m/s" FLRdpHPA,FLRdpHPB
 SG_ FLR2RdrDetn275To279RngRt3 : 264|11@1+ (0.1,-111.11) [-111.11|55.59000000000002] "m/s" FLRdpHPA,FLRdpHPB
 SG_ FLR2RdrDetn275To279RngRt4 : 328|11@1+ (0.1,-111.11) [-111.11|55.59000000000002] "m/s" FLRdpHPA,FLRdpHPB
 SG_ FLR2RdrDetn275To279ScanID : 24|8@1+ (1.0,0.0) [0.0|255.0] "Unitless" FLRdpHPA,FLRdpHPB
 SG_ FLR2RdrDetn275To279SNR0 : 41|7@1+ (0.5,0.0) [0.0|63.5] "dB" FLRdpHPA,FLRdpHPB
 SG_ FLR2RdrDetn275To279SNR1 : 105|7@1+ (0.5,0.0) [0.0|63.5] "dB" FLRdpHPA,FLRdpHPB
 SG_ FLR2RdrDetn275To279SNR2 : 169|7@1+ (0.5,0.0) [0.0|63.5] "dB" FLRdpHPA,FLRdpHPB
 SG_ FLR2RdrDetn275To279SNR3 : 233|7@1+ (0.5,0.0) [0.0|63.5] "dB" FLRdpHPA,FLRdpHPB
 SG_ FLR2RdrDetn275To279SNR4 : 297|7@1+ (0.5,0.0) [0.0|63.5] "dB" FLRdpHPA,FLRdpHPB

BO_ 254 FlrFlr1canFr57 : 64 FLR
 SG_ FLR2RdrDetn280To284_UB : 359|1@0+ (1,0) [0|1] "" FLRdpHPA,FLRdpHPB
 SG_ FLR2RdrDetn280To284AziAng0 : 32|9@1+ (0.0035,-0.87266) [-0.87266|0.91584] "rad" FLRdpHPA,FLRdpHPB
 SG_ FLR2RdrDetn280To284AziAng1 : 96|9@1+ (0.0035,-0.87266) [-0.87266|0.91584] "rad" FLRdpHPA,FLRdpHPB
 SG_ FLR2RdrDetn280To284AziAng2 : 160|9@1+ (0.0035,-0.87266) [-0.87266|0.91584] "rad" FLRdpHPA,FLRdpHPB
 SG_ FLR2RdrDetn280To284AziAng3 : 224|9@1+ (0.0035,-0.87266) [-0.87266|0.91584] "rad" FLRdpHPA,FLRdpHPB
 SG_ FLR2RdrDetn280To284AziAng4 : 288|9@1+ (0.0035,-0.87266) [-0.87266|0.91584] "rad" FLRdpHPA,FLRdpHPB
 SG_ FLR2RdrDetn280To284Counter : 16|8@1+ (1.0,0.0) [0.0|255.0] "Unitless" FLRdpHPA,FLRdpHPB
 SG_ FLR2RdrDetn280To284CRC : 0|16@1+ (1.0,0.0) [0.0|65535.0] "Unitless" FLRdpHPA,FLRdpHPB
 SG_ FLR2RdrDetn280To284DynPrpty0 : 93|1@1+ (1.0,0.0) [0.0|1.0] "Unitless" FLRdpHPA,FLRdpHPB
 SG_ FLR2RdrDetn280To284DynPrpty1 : 157|1@1+ (1.0,0.0) [0.0|1.0] "Unitless" FLRdpHPA,FLRdpHPB
 SG_ FLR2RdrDetn280To284DynPrpty2 : 221|1@1+ (1.0,0.0) [0.0|1.0] "Unitless" FLRdpHPA,FLRdpHPB
 SG_ FLR2RdrDetn280To284DynPrpty3 : 285|1@1+ (1.0,0.0) [0.0|1.0] "Unitless" FLRdpHPA,FLRdpHPB
 SG_ FLR2RdrDetn280To284DynPrpty4 : 349|1@1+ (1.0,0.0) [0.0|1.0] "Unitless" FLRdpHPA,FLRdpHPB
 SG_ FLR2RdrDetn280To284EleAng0 : 64|8@1+ (0.002,0.0) [0.0|0.5] "rad" FLRdpHPA,FLRdpHPB
 SG_ FLR2RdrDetn280To284EleAng1 : 128|8@1+ (0.002,0.0) [0.0|0.5] "rad" FLRdpHPA,FLRdpHPB
 SG_ FLR2RdrDetn280To284EleAng2 : 192|8@1+ (0.002,0.0) [0.0|0.5] "rad" FLRdpHPA,FLRdpHPB
 SG_ FLR2RdrDetn280To284EleAng3 : 256|8@1+ (0.002,0.0) [0.0|0.5] "rad" FLRdpHPA,FLRdpHPB
 SG_ FLR2RdrDetn280To284EleAng4 : 320|8@1+ (0.002,0.0) [0.0|0.5] "rad" FLRdpHPA,FLRdpHPB
 SG_ FLR2RdrDetn280To284Mode0 : 60|2@1+ (1,0) [0|3] "" FLRdpHPA,FLRdpHPB
 SG_ FLR2RdrDetn280To284Mode1 : 124|2@1+ (1,0) [0|3] "" FLRdpHPA,FLRdpHPB
 SG_ FLR2RdrDetn280To284Mode2 : 188|2@1+ (1,0) [0|3] "" FLRdpHPA,FLRdpHPB
 SG_ FLR2RdrDetn280To284Mode3 : 252|2@1+ (1,0) [0|3] "" FLRdpHPA,FLRdpHPB
 SG_ FLR2RdrDetn280To284Mode4 : 316|2@1+ (1,0) [0|3] "" FLRdpHPA,FLRdpHPB
 SG_ FLR2RdrDetn280To284Quality0 : 62|2@1+ (1,0) [0|3] "" FLRdpHPA,FLRdpHPB
 SG_ FLR2RdrDetn280To284Quality1 : 126|2@1+ (1,0) [0|3] "" FLRdpHPA,FLRdpHPB
 SG_ FLR2RdrDetn280To284Quality2 : 190|2@1+ (1,0) [0|3] "" FLRdpHPA,FLRdpHPB
 SG_ FLR2RdrDetn280To284Quality3 : 254|2@1+ (1,0) [0|3] "" FLRdpHPA,FLRdpHPB
 SG_ FLR2RdrDetn280To284Quality4 : 318|2@1+ (1,0) [0|3] "" FLRdpHPA,FLRdpHPB
 SG_ FLR2RdrDetn280To284Range0 : 48|12@1+ (0.1,0.4) [0.4|300.0] "m" FLRdpHPA,FLRdpHPB
 SG_ FLR2RdrDetn280To284Range1 : 112|12@1+ (0.1,0.4) [0.4|300.0] "m" FLRdpHPA,FLRdpHPB
 SG_ FLR2RdrDetn280To284Range2 : 176|12@1+ (0.1,0.4) [0.4|300.0] "m" FLRdpHPA,FLRdpHPB
 SG_ FLR2RdrDetn280To284Range3 : 240|12@1+ (0.1,0.4) [0.4|300.0] "m" FLRdpHPA,FLRdpHPB
 SG_ FLR2RdrDetn280To284Range4 : 304|12@1+ (0.1,0.4) [0.4|300.0] "m" FLRdpHPA,FLRdpHPB
 SG_ FLR2RdrDetn280To284RCS0 : 83|10@1+ (0.2,-100.0) [-100.0|70.0] "dBsm" FLRdpHPA,FLRdpHPB
 SG_ FLR2RdrDetn280To284RCS1 : 147|10@1+ (0.2,-100.0) [-100.0|70.0] "dBsm" FLRdpHPA,FLRdpHPB
 SG_ FLR2RdrDetn280To284RCS2 : 211|10@1+ (0.2,-100.0) [-100.0|70.0] "dBsm" FLRdpHPA,FLRdpHPB
 SG_ FLR2RdrDetn280To284RCS3 : 275|10@1+ (0.2,-100.0) [-100.0|70.0] "dBsm" FLRdpHPA,FLRdpHPB
 SG_ FLR2RdrDetn280To284RCS4 : 339|10@1+ (0.2,-100.0) [-100.0|70.0] "dBsm" FLRdpHPA,FLRdpHPB
 SG_ FLR2RdrDetn280To284RngRt0 : 72|11@1+ (0.1,-111.11) [-111.11|55.59000000000002] "m/s" FLRdpHPA,FLRdpHPB
 SG_ FLR2RdrDetn280To284RngRt1 : 136|11@1+ (0.1,-111.11) [-111.11|55.59000000000002] "m/s" FLRdpHPA,FLRdpHPB
 SG_ FLR2RdrDetn280To284RngRt2 : 200|11@1+ (0.1,-111.11) [-111.11|55.59000000000002] "m/s" FLRdpHPA,FLRdpHPB
 SG_ FLR2RdrDetn280To284RngRt3 : 264|11@1+ (0.1,-111.11) [-111.11|55.59000000000002] "m/s" FLRdpHPA,FLRdpHPB
 SG_ FLR2RdrDetn280To284RngRt4 : 328|11@1+ (0.1,-111.11) [-111.11|55.59000000000002] "m/s" FLRdpHPA,FLRdpHPB
 SG_ FLR2RdrDetn280To284ScanID : 24|8@1+ (1.0,0.0) [0.0|255.0] "Unitless" FLRdpHPA,FLRdpHPB
 SG_ FLR2RdrDetn280To284SNR0 : 41|7@1+ (0.5,0.0) [0.0|63.5] "dB" FLRdpHPA,FLRdpHPB
 SG_ FLR2RdrDetn280To284SNR1 : 105|7@1+ (0.5,0.0) [0.0|63.5] "dB" FLRdpHPA,FLRdpHPB
 SG_ FLR2RdrDetn280To284SNR2 : 169|7@1+ (0.5,0.0) [0.0|63.5] "dB" FLRdpHPA,FLRdpHPB
 SG_ FLR2RdrDetn280To284SNR3 : 233|7@1+ (0.5,0.0) [0.0|63.5] "dB" FLRdpHPA,FLRdpHPB
 SG_ FLR2RdrDetn280To284SNR4 : 297|7@1+ (0.5,0.0) [0.0|63.5] "dB" FLRdpHPA,FLRdpHPB

BO_ 256 FlrFlr1canFr58 : 64 FLR
 SG_ FLR2RdrDetn285To289_UB : 359|1@0+ (1,0) [0|1] "" FLRdpHPA,FLRdpHPB
 SG_ FLR2RdrDetn285To289AziAng0 : 32|9@1+ (0.0035,-0.87266) [-0.87266|0.91584] "rad" FLRdpHPA,FLRdpHPB
 SG_ FLR2RdrDetn285To289AziAng1 : 96|9@1+ (0.0035,-0.87266) [-0.87266|0.91584] "rad" FLRdpHPA,FLRdpHPB
 SG_ FLR2RdrDetn285To289AziAng2 : 160|9@1+ (0.0035,-0.87266) [-0.87266|0.91584] "rad" FLRdpHPA,FLRdpHPB
 SG_ FLR2RdrDetn285To289AziAng3 : 224|9@1+ (0.0035,-0.87266) [-0.87266|0.91584] "rad" FLRdpHPA,FLRdpHPB
 SG_ FLR2RdrDetn285To289AziAng4 : 288|9@1+ (0.0035,-0.87266) [-0.87266|0.91584] "rad" FLRdpHPA,FLRdpHPB
 SG_ FLR2RdrDetn285To289Counter : 16|8@1+ (1.0,0.0) [0.0|255.0] "Unitless" FLRdpHPA,FLRdpHPB
 SG_ FLR2RdrDetn285To289CRC : 0|16@1+ (1.0,0.0) [0.0|65535.0] "Unitless" FLRdpHPA,FLRdpHPB
 SG_ FLR2RdrDetn285To289DynPrpty0 : 93|1@1+ (1.0,0.0) [0.0|1.0] "Unitless" FLRdpHPA,FLRdpHPB
 SG_ FLR2RdrDetn285To289DynPrpty1 : 157|1@1+ (1.0,0.0) [0.0|1.0] "Unitless" FLRdpHPA,FLRdpHPB
 SG_ FLR2RdrDetn285To289DynPrpty2 : 221|1@1+ (1.0,0.0) [0.0|1.0] "Unitless" FLRdpHPA,FLRdpHPB
 SG_ FLR2RdrDetn285To289DynPrpty3 : 285|1@1+ (1.0,0.0) [0.0|1.0] "Unitless" FLRdpHPA,FLRdpHPB
 SG_ FLR2RdrDetn285To289DynPrpty4 : 349|1@1+ (1.0,0.0) [0.0|1.0] "Unitless" FLRdpHPA,FLRdpHPB
 SG_ FLR2RdrDetn285To289EleAng0 : 64|8@1+ (0.002,0.0) [0.0|0.5] "rad" FLRdpHPA,FLRdpHPB
 SG_ FLR2RdrDetn285To289EleAng1 : 128|8@1+ (0.002,0.0) [0.0|0.5] "rad" FLRdpHPA,FLRdpHPB
 SG_ FLR2RdrDetn285To289EleAng2 : 192|8@1+ (0.002,0.0) [0.0|0.5] "rad" FLRdpHPA,FLRdpHPB
 SG_ FLR2RdrDetn285To289EleAng3 : 256|8@1+ (0.002,0.0) [0.0|0.5] "rad" FLRdpHPA,FLRdpHPB
 SG_ FLR2RdrDetn285To289EleAng4 : 320|8@1+ (0.002,0.0) [0.0|0.5] "rad" FLRdpHPA,FLRdpHPB
 SG_ FLR2RdrDetn285To289Mode0 : 60|2@1+ (1,0) [0|3] "" FLRdpHPA,FLRdpHPB
 SG_ FLR2RdrDetn285To289Mode1 : 124|2@1+ (1,0) [0|3] "" FLRdpHPA,FLRdpHPB
 SG_ FLR2RdrDetn285To289Mode2 : 188|2@1+ (1,0) [0|3] "" FLRdpHPA,FLRdpHPB
 SG_ FLR2RdrDetn285To289Mode3 : 252|2@1+ (1,0) [0|3] "" FLRdpHPA,FLRdpHPB
 SG_ FLR2RdrDetn285To289Mode4 : 316|2@1+ (1,0) [0|3] "" FLRdpHPA,FLRdpHPB
 SG_ FLR2RdrDetn285To289Quality0 : 62|2@1+ (1,0) [0|3] "" FLRdpHPA,FLRdpHPB
 SG_ FLR2RdrDetn285To289Quality1 : 126|2@1+ (1,0) [0|3] "" FLRdpHPA,FLRdpHPB
 SG_ FLR2RdrDetn285To289Quality2 : 190|2@1+ (1,0) [0|3] "" FLRdpHPA,FLRdpHPB
 SG_ FLR2RdrDetn285To289Quality3 : 254|2@1+ (1,0) [0|3] "" FLRdpHPA,FLRdpHPB
 SG_ FLR2RdrDetn285To289Quality4 : 318|2@1+ (1,0) [0|3] "" FLRdpHPA,FLRdpHPB
 SG_ FLR2RdrDetn285To289Range0 : 48|12@1+ (0.1,0.4) [0.4|300.0] "m" FLRdpHPA,FLRdpHPB
 SG_ FLR2RdrDetn285To289Range1 : 112|12@1+ (0.1,0.4) [0.4|300.0] "m" FLRdpHPA,FLRdpHPB
 SG_ FLR2RdrDetn285To289Range2 : 176|12@1+ (0.1,0.4) [0.4|300.0] "m" FLRdpHPA,FLRdpHPB
 SG_ FLR2RdrDetn285To289Range3 : 240|12@1+ (0.1,0.4) [0.4|300.0] "m" FLRdpHPA,FLRdpHPB
 SG_ FLR2RdrDetn285To289Range4 : 304|12@1+ (0.1,0.4) [0.4|300.0] "m" FLRdpHPA,FLRdpHPB
 SG_ FLR2RdrDetn285To289RCS0 : 83|10@1+ (0.2,-100.0) [-100.0|70.0] "dBsm" FLRdpHPA,FLRdpHPB
 SG_ FLR2RdrDetn285To289RCS1 : 147|10@1+ (0.2,-100.0) [-100.0|70.0] "dBsm" FLRdpHPA,FLRdpHPB
 SG_ FLR2RdrDetn285To289RCS2 : 211|10@1+ (0.2,-100.0) [-100.0|70.0] "dBsm" FLRdpHPA,FLRdpHPB
 SG_ FLR2RdrDetn285To289RCS3 : 275|10@1+ (0.2,-100.0) [-100.0|70.0] "dBsm" FLRdpHPA,FLRdpHPB
 SG_ FLR2RdrDetn285To289RCS4 : 339|10@1+ (0.2,-100.0) [-100.0|70.0] "dBsm" FLRdpHPA,FLRdpHPB
 SG_ FLR2RdrDetn285To289RngRt0 : 72|11@1+ (0.1,-111.11) [-111.11|55.59000000000002] "m/s" FLRdpHPA,FLRdpHPB
 SG_ FLR2RdrDetn285To289RngRt1 : 136|11@1+ (0.1,-111.11) [-111.11|55.59000000000002] "m/s" FLRdpHPA,FLRdpHPB
 SG_ FLR2RdrDetn285To289RngRt2 : 200|11@1+ (0.1,-111.11) [-111.11|55.59000000000002] "m/s" FLRdpHPA,FLRdpHPB
 SG_ FLR2RdrDetn285To289RngRt3 : 264|11@1+ (0.1,-111.11) [-111.11|55.59000000000002] "m/s" FLRdpHPA,FLRdpHPB
 SG_ FLR2RdrDetn285To289RngRt4 : 328|11@1+ (0.1,-111.11) [-111.11|55.59000000000002] "m/s" FLRdpHPA,FLRdpHPB
 SG_ FLR2RdrDetn285To289ScanID : 24|8@1+ (1.0,0.0) [0.0|255.0] "Unitless" FLRdpHPA,FLRdpHPB
 SG_ FLR2RdrDetn285To289SNR0 : 41|7@1+ (0.5,0.0) [0.0|63.5] "dB" FLRdpHPA,FLRdpHPB
 SG_ FLR2RdrDetn285To289SNR1 : 105|7@1+ (0.5,0.0) [0.0|63.5] "dB" FLRdpHPA,FLRdpHPB
 SG_ FLR2RdrDetn285To289SNR2 : 169|7@1+ (0.5,0.0) [0.0|63.5] "dB" FLRdpHPA,FLRdpHPB
 SG_ FLR2RdrDetn285To289SNR3 : 233|7@1+ (0.5,0.0) [0.0|63.5] "dB" FLRdpHPA,FLRdpHPB
 SG_ FLR2RdrDetn285To289SNR4 : 297|7@1+ (0.5,0.0) [0.0|63.5] "dB" FLRdpHPA,FLRdpHPB

BO_ 258 FlrFlr1canFr59 : 64 FLR
 SG_ FLR2RdrDetn290To294_UB : 359|1@0+ (1,0) [0|1] "" FLRdpHPA,FLRdpHPB
 SG_ FLR2RdrDetn290To294AziAng0 : 32|9@1+ (0.0035,-0.87266) [-0.87266|0.91584] "rad" FLRdpHPA,FLRdpHPB
 SG_ FLR2RdrDetn290To294AziAng1 : 96|9@1+ (0.0035,-0.87266) [-0.87266|0.91584] "rad" FLRdpHPA,FLRdpHPB
 SG_ FLR2RdrDetn290To294AziAng2 : 160|9@1+ (0.0035,-0.87266) [-0.87266|0.91584] "rad" FLRdpHPA,FLRdpHPB
 SG_ FLR2RdrDetn290To294AziAng3 : 224|9@1+ (0.0035,-0.87266) [-0.87266|0.91584] "rad" FLRdpHPA,FLRdpHPB
 SG_ FLR2RdrDetn290To294AziAng4 : 288|9@1+ (0.0035,-0.87266) [-0.87266|0.91584] "rad" FLRdpHPA,FLRdpHPB
 SG_ FLR2RdrDetn290To294Counter : 16|8@1+ (1.0,0.0) [0.0|255.0] "Unitless" FLRdpHPA,FLRdpHPB
 SG_ FLR2RdrDetn290To294CRC : 0|16@1+ (1.0,0.0) [0.0|65535.0] "Unitless" FLRdpHPA,FLRdpHPB
 SG_ FLR2RdrDetn290To294DynPrpty0 : 93|1@1+ (1.0,0.0) [0.0|1.0] "Unitless" FLRdpHPA,FLRdpHPB
 SG_ FLR2RdrDetn290To294DynPrpty1 : 157|1@1+ (1.0,0.0) [0.0|1.0] "Unitless" FLRdpHPA,FLRdpHPB
 SG_ FLR2RdrDetn290To294DynPrpty2 : 221|1@1+ (1.0,0.0) [0.0|1.0] "Unitless" FLRdpHPA,FLRdpHPB
 SG_ FLR2RdrDetn290To294DynPrpty3 : 285|1@1+ (1.0,0.0) [0.0|1.0] "Unitless" FLRdpHPA,FLRdpHPB
 SG_ FLR2RdrDetn290To294DynPrpty4 : 349|1@1+ (1.0,0.0) [0.0|1.0] "Unitless" FLRdpHPA,FLRdpHPB
 SG_ FLR2RdrDetn290To294EleAng0 : 64|8@1+ (0.002,0.0) [0.0|0.5] "rad" FLRdpHPA,FLRdpHPB
 SG_ FLR2RdrDetn290To294EleAng1 : 128|8@1+ (0.002,0.0) [0.0|0.5] "rad" FLRdpHPA,FLRdpHPB
 SG_ FLR2RdrDetn290To294EleAng2 : 192|8@1+ (0.002,0.0) [0.0|0.5] "rad" FLRdpHPA,FLRdpHPB
 SG_ FLR2RdrDetn290To294EleAng3 : 256|8@1+ (0.002,0.0) [0.0|0.5] "rad" FLRdpHPA,FLRdpHPB
 SG_ FLR2RdrDetn290To294EleAng4 : 320|8@1+ (0.002,0.0) [0.0|0.5] "rad" FLRdpHPA,FLRdpHPB
 SG_ FLR2RdrDetn290To294Mode0 : 60|2@1+ (1,0) [0|3] "" FLRdpHPA,FLRdpHPB
 SG_ FLR2RdrDetn290To294Mode1 : 124|2@1+ (1,0) [0|3] "" FLRdpHPA,FLRdpHPB
 SG_ FLR2RdrDetn290To294Mode2 : 188|2@1+ (1,0) [0|3] "" FLRdpHPA,FLRdpHPB
 SG_ FLR2RdrDetn290To294Mode3 : 252|2@1+ (1,0) [0|3] "" FLRdpHPA,FLRdpHPB
 SG_ FLR2RdrDetn290To294Mode4 : 316|2@1+ (1,0) [0|3] "" FLRdpHPA,FLRdpHPB
 SG_ FLR2RdrDetn290To294Quality0 : 62|2@1+ (1,0) [0|3] "" FLRdpHPA,FLRdpHPB
 SG_ FLR2RdrDetn290To294Quality1 : 126|2@1+ (1,0) [0|3] "" FLRdpHPA,FLRdpHPB
 SG_ FLR2RdrDetn290To294Quality2 : 190|2@1+ (1,0) [0|3] "" FLRdpHPA,FLRdpHPB
 SG_ FLR2RdrDetn290To294Quality3 : 254|2@1+ (1,0) [0|3] "" FLRdpHPA,FLRdpHPB
 SG_ FLR2RdrDetn290To294Quality4 : 318|2@1+ (1,0) [0|3] "" FLRdpHPA,FLRdpHPB
 SG_ FLR2RdrDetn290To294Range0 : 48|12@1+ (0.1,0.4) [0.4|300.0] "m" FLRdpHPA,FLRdpHPB
 SG_ FLR2RdrDetn290To294Range1 : 112|12@1+ (0.1,0.4) [0.4|300.0] "m" FLRdpHPA,FLRdpHPB
 SG_ FLR2RdrDetn290To294Range2 : 176|12@1+ (0.1,0.4) [0.4|300.0] "m" FLRdpHPA,FLRdpHPB
 SG_ FLR2RdrDetn290To294Range3 : 240|12@1+ (0.1,0.4) [0.4|300.0] "m" FLRdpHPA,FLRdpHPB
 SG_ FLR2RdrDetn290To294Range4 : 304|12@1+ (0.1,0.4) [0.4|300.0] "m" FLRdpHPA,FLRdpHPB
 SG_ FLR2RdrDetn290To294RCS0 : 83|10@1+ (0.2,-100.0) [-100.0|70.0] "dBsm" FLRdpHPA,FLRdpHPB
 SG_ FLR2RdrDetn290To294RCS1 : 147|10@1+ (0.2,-100.0) [-100.0|70.0] "dBsm" FLRdpHPA,FLRdpHPB
 SG_ FLR2RdrDetn290To294RCS2 : 211|10@1+ (0.2,-100.0) [-100.0|70.0] "dBsm" FLRdpHPA,FLRdpHPB
 SG_ FLR2RdrDetn290To294RCS3 : 275|10@1+ (0.2,-100.0) [-100.0|70.0] "dBsm" FLRdpHPA,FLRdpHPB
 SG_ FLR2RdrDetn290To294RCS4 : 339|10@1+ (0.2,-100.0) [-100.0|70.0] "dBsm" FLRdpHPA,FLRdpHPB
 SG_ FLR2RdrDetn290To294RngRt0 : 72|11@1+ (0.1,-111.11) [-111.11|55.59000000000002] "m/s" FLRdpHPA,FLRdpHPB
 SG_ FLR2RdrDetn290To294RngRt1 : 136|11@1+ (0.1,-111.11) [-111.11|55.59000000000002] "m/s" FLRdpHPA,FLRdpHPB
 SG_ FLR2RdrDetn290To294RngRt2 : 200|11@1+ (0.1,-111.11) [-111.11|55.59000000000002] "m/s" FLRdpHPA,FLRdpHPB
 SG_ FLR2RdrDetn290To294RngRt3 : 264|11@1+ (0.1,-111.11) [-111.11|55.59000000000002] "m/s" FLRdpHPA,FLRdpHPB
 SG_ FLR2RdrDetn290To294RngRt4 : 328|11@1+ (0.1,-111.11) [-111.11|55.59000000000002] "m/s" FLRdpHPA,FLRdpHPB
 SG_ FLR2RdrDetn290To294ScanID : 24|8@1+ (1.0,0.0) [0.0|255.0] "Unitless" FLRdpHPA,FLRdpHPB
 SG_ FLR2RdrDetn290To294SNR0 : 41|7@1+ (0.5,0.0) [0.0|63.5] "dB" FLRdpHPA,FLRdpHPB
 SG_ FLR2RdrDetn290To294SNR1 : 105|7@1+ (0.5,0.0) [0.0|63.5] "dB" FLRdpHPA,FLRdpHPB
 SG_ FLR2RdrDetn290To294SNR2 : 169|7@1+ (0.5,0.0) [0.0|63.5] "dB" FLRdpHPA,FLRdpHPB
 SG_ FLR2RdrDetn290To294SNR3 : 233|7@1+ (0.5,0.0) [0.0|63.5] "dB" FLRdpHPA,FLRdpHPB
 SG_ FLR2RdrDetn290To294SNR4 : 297|7@1+ (0.5,0.0) [0.0|63.5] "dB" FLRdpHPA,FLRdpHPB

BO_ 260 FlrFlr1canFr60 : 64 FLR
 SG_ FLR2RdrDetn295To299_UB : 359|1@0+ (1,0) [0|1] "" FLRdpHPA,FLRdpHPB
 SG_ FLR2RdrDetn295To299AziAng0 : 32|9@1+ (0.0035,-0.87266) [-0.87266|0.91584] "rad" FLRdpHPA,FLRdpHPB
 SG_ FLR2RdrDetn295To299AziAng1 : 96|9@1+ (0.0035,-0.87266) [-0.87266|0.91584] "rad" FLRdpHPA,FLRdpHPB
 SG_ FLR2RdrDetn295To299AziAng2 : 160|9@1+ (0.0035,-0.87266) [-0.87266|0.91584] "rad" FLRdpHPA,FLRdpHPB
 SG_ FLR2RdrDetn295To299AziAng3 : 224|9@1+ (0.0035,-0.87266) [-0.87266|0.91584] "rad" FLRdpHPA,FLRdpHPB
 SG_ FLR2RdrDetn295To299AziAng4 : 288|9@1+ (0.0035,-0.87266) [-0.87266|0.91584] "rad" FLRdpHPA,FLRdpHPB
 SG_ FLR2RdrDetn295To299Counter : 16|8@1+ (1.0,0.0) [0.0|255.0] "Unitless" FLRdpHPA,FLRdpHPB
 SG_ FLR2RdrDetn295To299CRC : 0|16@1+ (1.0,0.0) [0.0|65535.0] "Unitless" FLRdpHPA,FLRdpHPB
 SG_ FLR2RdrDetn295To299DynPrpty0 : 93|1@1+ (1.0,0.0) [0.0|1.0] "Unitless" FLRdpHPA,FLRdpHPB
 SG_ FLR2RdrDetn295To299DynPrpty1 : 157|1@1+ (1.0,0.0) [0.0|1.0] "Unitless" FLRdpHPA,FLRdpHPB
 SG_ FLR2RdrDetn295To299DynPrpty2 : 221|1@1+ (1.0,0.0) [0.0|1.0] "Unitless" FLRdpHPA,FLRdpHPB
 SG_ FLR2RdrDetn295To299DynPrpty3 : 285|1@1+ (1.0,0.0) [0.0|1.0] "Unitless" FLRdpHPA,FLRdpHPB
 SG_ FLR2RdrDetn295To299DynPrpty4 : 349|1@1+ (1.0,0.0) [0.0|1.0] "Unitless" FLRdpHPA,FLRdpHPB
 SG_ FLR2RdrDetn295To299EleAng0 : 64|8@1+ (0.002,0.0) [0.0|0.5] "rad" FLRdpHPA,FLRdpHPB
 SG_ FLR2RdrDetn295To299EleAng1 : 128|8@1+ (0.002,0.0) [0.0|0.5] "rad" FLRdpHPA,FLRdpHPB
 SG_ FLR2RdrDetn295To299EleAng2 : 192|8@1+ (0.002,0.0) [0.0|0.5] "rad" FLRdpHPA,FLRdpHPB
 SG_ FLR2RdrDetn295To299EleAng3 : 256|8@1+ (0.002,0.0) [0.0|0.5] "rad" FLRdpHPA,FLRdpHPB
 SG_ FLR2RdrDetn295To299EleAng4 : 320|8@1+ (0.002,0.0) [0.0|0.5] "rad" FLRdpHPA,FLRdpHPB
 SG_ FLR2RdrDetn295To299Mode0 : 60|2@1+ (1,0) [0|3] "" FLRdpHPA,FLRdpHPB
 SG_ FLR2RdrDetn295To299Mode1 : 124|2@1+ (1,0) [0|3] "" FLRdpHPA,FLRdpHPB
 SG_ FLR2RdrDetn295To299Mode2 : 188|2@1+ (1,0) [0|3] "" FLRdpHPA,FLRdpHPB
 SG_ FLR2RdrDetn295To299Mode3 : 252|2@1+ (1,0) [0|3] "" FLRdpHPA,FLRdpHPB
 SG_ FLR2RdrDetn295To299Mode4 : 316|2@1+ (1,0) [0|3] "" FLRdpHPA,FLRdpHPB
 SG_ FLR2RdrDetn295To299Quality0 : 62|2@1+ (1,0) [0|3] "" FLRdpHPA,FLRdpHPB
 SG_ FLR2RdrDetn295To299Quality1 : 126|2@1+ (1,0) [0|3] "" FLRdpHPA,FLRdpHPB
 SG_ FLR2RdrDetn295To299Quality2 : 190|2@1+ (1,0) [0|3] "" FLRdpHPA,FLRdpHPB
 SG_ FLR2RdrDetn295To299Quality3 : 254|2@1+ (1,0) [0|3] "" FLRdpHPA,FLRdpHPB
 SG_ FLR2RdrDetn295To299Quality4 : 318|2@1+ (1,0) [0|3] "" FLRdpHPA,FLRdpHPB
 SG_ FLR2RdrDetn295To299Range0 : 48|12@1+ (0.1,0.4) [0.4|300.0] "m" FLRdpHPA,FLRdpHPB
 SG_ FLR2RdrDetn295To299Range1 : 112|12@1+ (0.1,0.4) [0.4|300.0] "m" FLRdpHPA,FLRdpHPB
 SG_ FLR2RdrDetn295To299Range2 : 176|12@1+ (0.1,0.4) [0.4|300.0] "m" FLRdpHPA,FLRdpHPB
 SG_ FLR2RdrDetn295To299Range3 : 240|12@1+ (0.1,0.4) [0.4|300.0] "m" FLRdpHPA,FLRdpHPB
 SG_ FLR2RdrDetn295To299Range4 : 304|12@1+ (0.1,0.4) [0.4|300.0] "m" FLRdpHPA,FLRdpHPB
 SG_ FLR2RdrDetn295To299RCS0 : 83|10@1+ (0.2,-100.0) [-100.0|70.0] "dBsm" FLRdpHPA,FLRdpHPB
 SG_ FLR2RdrDetn295To299RCS1 : 147|10@1+ (0.2,-100.0) [-100.0|70.0] "dBsm" FLRdpHPA,FLRdpHPB
 SG_ FLR2RdrDetn295To299RCS2 : 211|10@1+ (0.2,-100.0) [-100.0|70.0] "dBsm" FLRdpHPA,FLRdpHPB
 SG_ FLR2RdrDetn295To299RCS3 : 275|10@1+ (0.2,-100.0) [-100.0|70.0] "dBsm" FLRdpHPA,FLRdpHPB
 SG_ FLR2RdrDetn295To299RCS4 : 339|10@1+ (0.2,-100.0) [-100.0|70.0] "dBsm" FLRdpHPA,FLRdpHPB
 SG_ FLR2RdrDetn295To299RngRt0 : 72|11@1+ (0.1,-111.11) [-111.11|55.59000000000002] "m/s" FLRdpHPA,FLRdpHPB
 SG_ FLR2RdrDetn295To299RngRt1 : 136|11@1+ (0.1,-111.11) [-111.11|55.59000000000002] "m/s" FLRdpHPA,FLRdpHPB
 SG_ FLR2RdrDetn295To299RngRt2 : 200|11@1+ (0.1,-111.11) [-111.11|55.59000000000002] "m/s" FLRdpHPA,FLRdpHPB
 SG_ FLR2RdrDetn295To299RngRt3 : 264|11@1+ (0.1,-111.11) [-111.11|55.59000000000002] "m/s" FLRdpHPA,FLRdpHPB
 SG_ FLR2RdrDetn295To299RngRt4 : 328|11@1+ (0.1,-111.11) [-111.11|55.59000000000002] "m/s" FLRdpHPA,FLRdpHPB
 SG_ FLR2RdrDetn295To299ScanID : 24|8@1+ (1.0,0.0) [0.0|255.0] "Unitless" FLRdpHPA,FLRdpHPB
 SG_ FLR2RdrDetn295To299SNR0 : 41|7@1+ (0.5,0.0) [0.0|63.5] "dB" FLRdpHPA,FLRdpHPB
 SG_ FLR2RdrDetn295To299SNR1 : 105|7@1+ (0.5,0.0) [0.0|63.5] "dB" FLRdpHPA,FLRdpHPB
 SG_ FLR2RdrDetn295To299SNR2 : 169|7@1+ (0.5,0.0) [0.0|63.5] "dB" FLRdpHPA,FLRdpHPB
 SG_ FLR2RdrDetn295To299SNR3 : 233|7@1+ (0.5,0.0) [0.0|63.5] "dB" FLRdpHPA,FLRdpHPB
 SG_ FLR2RdrDetn295To299SNR4 : 297|7@1+ (0.5,0.0) [0.0|63.5] "dB" FLRdpHPA,FLRdpHPB

BO_ 262 FlrFlr1canFr61 : 64 FLR
 SG_ FLR2RdrDetn300To304_UB : 359|1@0+ (1,0) [0|1] "" FLRdpHPA,FLRdpHPB
 SG_ FLR2RdrDetn300To304AziAng0 : 32|9@1+ (0.0035,-0.87266) [-0.87266|0.91584] "rad" FLRdpHPA,FLRdpHPB
 SG_ FLR2RdrDetn300To304AziAng1 : 96|9@1+ (0.0035,-0.87266) [-0.87266|0.91584] "rad" FLRdpHPA,FLRdpHPB
 SG_ FLR2RdrDetn300To304AziAng2 : 160|9@1+ (0.0035,-0.87266) [-0.87266|0.91584] "rad" FLRdpHPA,FLRdpHPB
 SG_ FLR2RdrDetn300To304AziAng3 : 224|9@1+ (0.0035,-0.87266) [-0.87266|0.91584] "rad" FLRdpHPA,FLRdpHPB
 SG_ FLR2RdrDetn300To304AziAng4 : 288|9@1+ (0.0035,-0.87266) [-0.87266|0.91584] "rad" FLRdpHPA,FLRdpHPB
 SG_ FLR2RdrDetn300To304Counter : 16|8@1+ (1.0,0.0) [0.0|255.0] "Unitless" FLRdpHPA,FLRdpHPB
 SG_ FLR2RdrDetn300To304CRC : 0|16@1+ (1.0,0.0) [0.0|65535.0] "Unitless" FLRdpHPA,FLRdpHPB
 SG_ FLR2RdrDetn300To304DynPrpty0 : 93|1@1+ (1.0,0.0) [0.0|1.0] "Unitless" FLRdpHPA,FLRdpHPB
 SG_ FLR2RdrDetn300To304DynPrpty1 : 157|1@1+ (1.0,0.0) [0.0|1.0] "Unitless" FLRdpHPA,FLRdpHPB
 SG_ FLR2RdrDetn300To304DynPrpty2 : 221|1@1+ (1.0,0.0) [0.0|1.0] "Unitless" FLRdpHPA,FLRdpHPB
 SG_ FLR2RdrDetn300To304DynPrpty3 : 285|1@1+ (1.0,0.0) [0.0|1.0] "Unitless" FLRdpHPA,FLRdpHPB
 SG_ FLR2RdrDetn300To304DynPrpty4 : 349|1@1+ (1.0,0.0) [0.0|1.0] "Unitless" FLRdpHPA,FLRdpHPB
 SG_ FLR2RdrDetn300To304EleAng0 : 64|8@1+ (0.002,0.0) [0.0|0.5] "rad" FLRdpHPA,FLRdpHPB
 SG_ FLR2RdrDetn300To304EleAng1 : 128|8@1+ (0.002,0.0) [0.0|0.5] "rad" FLRdpHPA,FLRdpHPB
 SG_ FLR2RdrDetn300To304EleAng2 : 192|8@1+ (0.002,0.0) [0.0|0.5] "rad" FLRdpHPA,FLRdpHPB
 SG_ FLR2RdrDetn300To304EleAng3 : 256|8@1+ (0.002,0.0) [0.0|0.5] "rad" FLRdpHPA,FLRdpHPB
 SG_ FLR2RdrDetn300To304EleAng4 : 320|8@1+ (0.002,0.0) [0.0|0.5] "rad" FLRdpHPA,FLRdpHPB
 SG_ FLR2RdrDetn300To304Mode0 : 60|2@1+ (1,0) [0|3] "" FLRdpHPA,FLRdpHPB
 SG_ FLR2RdrDetn300To304Mode1 : 124|2@1+ (1,0) [0|3] "" FLRdpHPA,FLRdpHPB
 SG_ FLR2RdrDetn300To304Mode2 : 188|2@1+ (1,0) [0|3] "" FLRdpHPA,FLRdpHPB
 SG_ FLR2RdrDetn300To304Mode3 : 252|2@1+ (1,0) [0|3] "" FLRdpHPA,FLRdpHPB
 SG_ FLR2RdrDetn300To304Mode4 : 316|2@1+ (1,0) [0|3] "" FLRdpHPA,FLRdpHPB
 SG_ FLR2RdrDetn300To304Quality0 : 62|2@1+ (1,0) [0|3] "" FLRdpHPA,FLRdpHPB
 SG_ FLR2RdrDetn300To304Quality1 : 126|2@1+ (1,0) [0|3] "" FLRdpHPA,FLRdpHPB
 SG_ FLR2RdrDetn300To304Quality2 : 190|2@1+ (1,0) [0|3] "" FLRdpHPA,FLRdpHPB
 SG_ FLR2RdrDetn300To304Quality3 : 254|2@1+ (1,0) [0|3] "" FLRdpHPA,FLRdpHPB
 SG_ FLR2RdrDetn300To304Quality4 : 318|2@1+ (1,0) [0|3] "" FLRdpHPA,FLRdpHPB
 SG_ FLR2RdrDetn300To304Range0 : 48|12@1+ (0.1,0.4) [0.4|300.0] "m" FLRdpHPA,FLRdpHPB
 SG_ FLR2RdrDetn300To304Range1 : 112|12@1+ (0.1,0.4) [0.4|300.0] "m" FLRdpHPA,FLRdpHPB
 SG_ FLR2RdrDetn300To304Range2 : 176|12@1+ (0.1,0.4) [0.4|300.0] "m" FLRdpHPA,FLRdpHPB
 SG_ FLR2RdrDetn300To304Range3 : 240|12@1+ (0.1,0.4) [0.4|300.0] "m" FLRdpHPA,FLRdpHPB
 SG_ FLR2RdrDetn300To304Range4 : 304|12@1+ (0.1,0.4) [0.4|300.0] "m" FLRdpHPA,FLRdpHPB
 SG_ FLR2RdrDetn300To304RCS0 : 83|10@1+ (0.2,-100.0) [-100.0|70.0] "dBsm" FLRdpHPA,FLRdpHPB
 SG_ FLR2RdrDetn300To304RCS1 : 147|10@1+ (0.2,-100.0) [-100.0|70.0] "dBsm" FLRdpHPA,FLRdpHPB
 SG_ FLR2RdrDetn300To304RCS2 : 211|10@1+ (0.2,-100.0) [-100.0|70.0] "dBsm" FLRdpHPA,FLRdpHPB
 SG_ FLR2RdrDetn300To304RCS3 : 275|10@1+ (0.2,-100.0) [-100.0|70.0] "dBsm" FLRdpHPA,FLRdpHPB
 SG_ FLR2RdrDetn300To304RCS4 : 339|10@1+ (0.2,-100.0) [-100.0|70.0] "dBsm" FLRdpHPA,FLRdpHPB
 SG_ FLR2RdrDetn300To304RngRt0 : 72|11@1+ (0.1,-111.11) [-111.11|55.59000000000002] "m/s" FLRdpHPA,FLRdpHPB
 SG_ FLR2RdrDetn300To304RngRt1 : 136|11@1+ (0.1,-111.11) [-111.11|55.59000000000002] "m/s" FLRdpHPA,FLRdpHPB
 SG_ FLR2RdrDetn300To304RngRt2 : 200|11@1+ (0.1,-111.11) [-111.11|55.59000000000002] "m/s" FLRdpHPA,FLRdpHPB
 SG_ FLR2RdrDetn300To304RngRt3 : 264|11@1+ (0.1,-111.11) [-111.11|55.59000000000002] "m/s" FLRdpHPA,FLRdpHPB
 SG_ FLR2RdrDetn300To304RngRt4 : 328|11@1+ (0.1,-111.11) [-111.11|55.59000000000002] "m/s" FLRdpHPA,FLRdpHPB
 SG_ FLR2RdrDetn300To304ScanID : 24|8@1+ (1.0,0.0) [0.0|255.0] "Unitless" FLRdpHPA,FLRdpHPB
 SG_ FLR2RdrDetn300To304SNR0 : 41|7@1+ (0.5,0.0) [0.0|63.5] "dB" FLRdpHPA,FLRdpHPB
 SG_ FLR2RdrDetn300To304SNR1 : 105|7@1+ (0.5,0.0) [0.0|63.5] "dB" FLRdpHPA,FLRdpHPB
 SG_ FLR2RdrDetn300To304SNR2 : 169|7@1+ (0.5,0.0) [0.0|63.5] "dB" FLRdpHPA,FLRdpHPB
 SG_ FLR2RdrDetn300To304SNR3 : 233|7@1+ (0.5,0.0) [0.0|63.5] "dB" FLRdpHPA,FLRdpHPB
 SG_ FLR2RdrDetn300To304SNR4 : 297|7@1+ (0.5,0.0) [0.0|63.5] "dB" FLRdpHPA,FLRdpHPB

BO_ 264 FlrFlr1canFr62 : 64 FLR
 SG_ FLR2RdrDetn305To309_UB : 359|1@0+ (1,0) [0|1] "" FLRdpHPA,FLRdpHPB
 SG_ FLR2RdrDetn305To309AziAng0 : 32|9@1+ (0.0035,-0.87266) [-0.87266|0.91584] "rad" FLRdpHPA,FLRdpHPB
 SG_ FLR2RdrDetn305To309AziAng1 : 96|9@1+ (0.0035,-0.87266) [-0.87266|0.91584] "rad" FLRdpHPA,FLRdpHPB
 SG_ FLR2RdrDetn305To309AziAng2 : 160|9@1+ (0.0035,-0.87266) [-0.87266|0.91584] "rad" FLRdpHPA,FLRdpHPB
 SG_ FLR2RdrDetn305To309AziAng3 : 224|9@1+ (0.0035,-0.87266) [-0.87266|0.91584] "rad" FLRdpHPA,FLRdpHPB
 SG_ FLR2RdrDetn305To309AziAng4 : 288|9@1+ (0.0035,-0.87266) [-0.87266|0.91584] "rad" FLRdpHPA,FLRdpHPB
 SG_ FLR2RdrDetn305To309Counter : 16|8@1+ (1.0,0.0) [0.0|255.0] "Unitless" FLRdpHPA,FLRdpHPB
 SG_ FLR2RdrDetn305To309CRC : 0|16@1+ (1.0,0.0) [0.0|65535.0] "Unitless" FLRdpHPA,FLRdpHPB
 SG_ FLR2RdrDetn305To309DynPrpty0 : 93|1@1+ (1.0,0.0) [0.0|1.0] "Unitless" FLRdpHPA,FLRdpHPB
 SG_ FLR2RdrDetn305To309DynPrpty1 : 157|1@1+ (1.0,0.0) [0.0|1.0] "Unitless" FLRdpHPA,FLRdpHPB
 SG_ FLR2RdrDetn305To309DynPrpty2 : 221|1@1+ (1.0,0.0) [0.0|1.0] "Unitless" FLRdpHPA,FLRdpHPB
 SG_ FLR2RdrDetn305To309DynPrpty3 : 285|1@1+ (1.0,0.0) [0.0|1.0] "Unitless" FLRdpHPA,FLRdpHPB
 SG_ FLR2RdrDetn305To309DynPrpty4 : 349|1@1+ (1.0,0.0) [0.0|1.0] "Unitless" FLRdpHPA,FLRdpHPB
 SG_ FLR2RdrDetn305To309EleAng0 : 64|8@1+ (0.002,0.0) [0.0|0.5] "rad" FLRdpHPA,FLRdpHPB
 SG_ FLR2RdrDetn305To309EleAng1 : 128|8@1+ (0.002,0.0) [0.0|0.5] "rad" FLRdpHPA,FLRdpHPB
 SG_ FLR2RdrDetn305To309EleAng2 : 192|8@1+ (0.002,0.0) [0.0|0.5] "rad" FLRdpHPA,FLRdpHPB
 SG_ FLR2RdrDetn305To309EleAng3 : 256|8@1+ (0.002,0.0) [0.0|0.5] "rad" FLRdpHPA,FLRdpHPB
 SG_ FLR2RdrDetn305To309EleAng4 : 320|8@1+ (0.002,0.0) [0.0|0.5] "rad" FLRdpHPA,FLRdpHPB
 SG_ FLR2RdrDetn305To309Mode0 : 60|2@1+ (1,0) [0|3] "" FLRdpHPA,FLRdpHPB
 SG_ FLR2RdrDetn305To309Mode1 : 124|2@1+ (1,0) [0|3] "" FLRdpHPA,FLRdpHPB
 SG_ FLR2RdrDetn305To309Mode2 : 188|2@1+ (1,0) [0|3] "" FLRdpHPA,FLRdpHPB
 SG_ FLR2RdrDetn305To309Mode3 : 252|2@1+ (1,0) [0|3] "" FLRdpHPA,FLRdpHPB
 SG_ FLR2RdrDetn305To309Mode4 : 316|2@1+ (1,0) [0|3] "" FLRdpHPA,FLRdpHPB
 SG_ FLR2RdrDetn305To309Quality0 : 62|2@1+ (1,0) [0|3] "" FLRdpHPA,FLRdpHPB
 SG_ FLR2RdrDetn305To309Quality1 : 126|2@1+ (1,0) [0|3] "" FLRdpHPA,FLRdpHPB
 SG_ FLR2RdrDetn305To309Quality2 : 190|2@1+ (1,0) [0|3] "" FLRdpHPA,FLRdpHPB
 SG_ FLR2RdrDetn305To309Quality3 : 254|2@1+ (1,0) [0|3] "" FLRdpHPA,FLRdpHPB
 SG_ FLR2RdrDetn305To309Quality4 : 318|2@1+ (1,0) [0|3] "" FLRdpHPA,FLRdpHPB
 SG_ FLR2RdrDetn305To309Range0 : 48|12@1+ (0.1,0.4) [0.4|300.0] "m" FLRdpHPA,FLRdpHPB
 SG_ FLR2RdrDetn305To309Range1 : 112|12@1+ (0.1,0.4) [0.4|300.0] "m" FLRdpHPA,FLRdpHPB
 SG_ FLR2RdrDetn305To309Range2 : 176|12@1+ (0.1,0.4) [0.4|300.0] "m" FLRdpHPA,FLRdpHPB
 SG_ FLR2RdrDetn305To309Range3 : 240|12@1+ (0.1,0.4) [0.4|300.0] "m" FLRdpHPA,FLRdpHPB
 SG_ FLR2RdrDetn305To309Range4 : 304|12@1+ (0.1,0.4) [0.4|300.0] "m" FLRdpHPA,FLRdpHPB
 SG_ FLR2RdrDetn305To309RCS0 : 83|10@1+ (0.2,-100.0) [-100.0|70.0] "dBsm" FLRdpHPA,FLRdpHPB
 SG_ FLR2RdrDetn305To309RCS1 : 147|10@1+ (0.2,-100.0) [-100.0|70.0] "dBsm" FLRdpHPA,FLRdpHPB
 SG_ FLR2RdrDetn305To309RCS2 : 211|10@1+ (0.2,-100.0) [-100.0|70.0] "dBsm" FLRdpHPA,FLRdpHPB
 SG_ FLR2RdrDetn305To309RCS3 : 275|10@1+ (0.2,-100.0) [-100.0|70.0] "dBsm" FLRdpHPA,FLRdpHPB
 SG_ FLR2RdrDetn305To309RCS4 : 339|10@1+ (0.2,-100.0) [-100.0|70.0] "dBsm" FLRdpHPA,FLRdpHPB
 SG_ FLR2RdrDetn305To309RngRt0 : 72|11@1+ (0.1,-111.11) [-111.11|55.59000000000002] "m/s" FLRdpHPA,FLRdpHPB
 SG_ FLR2RdrDetn305To309RngRt1 : 136|11@1+ (0.1,-111.11) [-111.11|55.59000000000002] "m/s" FLRdpHPA,FLRdpHPB
 SG_ FLR2RdrDetn305To309RngRt2 : 200|11@1+ (0.1,-111.11) [-111.11|55.59000000000002] "m/s" FLRdpHPA,FLRdpHPB
 SG_ FLR2RdrDetn305To309RngRt3 : 264|11@1+ (0.1,-111.11) [-111.11|55.59000000000002] "m/s" FLRdpHPA,FLRdpHPB
 SG_ FLR2RdrDetn305To309RngRt4 : 328|11@1+ (0.1,-111.11) [-111.11|55.59000000000002] "m/s" FLRdpHPA,FLRdpHPB
 SG_ FLR2RdrDetn305To309ScanID : 24|8@1+ (1.0,0.0) [0.0|255.0] "Unitless" FLRdpHPA,FLRdpHPB
 SG_ FLR2RdrDetn305To309SNR0 : 41|7@1+ (0.5,0.0) [0.0|63.5] "dB" FLRdpHPA,FLRdpHPB
 SG_ FLR2RdrDetn305To309SNR1 : 105|7@1+ (0.5,0.0) [0.0|63.5] "dB" FLRdpHPA,FLRdpHPB
 SG_ FLR2RdrDetn305To309SNR2 : 169|7@1+ (0.5,0.0) [0.0|63.5] "dB" FLRdpHPA,FLRdpHPB
 SG_ FLR2RdrDetn305To309SNR3 : 233|7@1+ (0.5,0.0) [0.0|63.5] "dB" FLRdpHPA,FLRdpHPB
 SG_ FLR2RdrDetn305To309SNR4 : 297|7@1+ (0.5,0.0) [0.0|63.5] "dB" FLRdpHPA,FLRdpHPB

BO_ 266 FlrFlr1canFr63 : 64 FLR
 SG_ FLR2RdrDetn310To314_UB : 359|1@0+ (1,0) [0|1] "" FLRdpHPA,FLRdpHPB
 SG_ FLR2RdrDetn310To314AziAng0 : 32|9@1+ (0.0035,-0.87266) [-0.87266|0.91584] "rad" FLRdpHPA,FLRdpHPB
 SG_ FLR2RdrDetn310To314AziAng1 : 96|9@1+ (0.0035,-0.87266) [-0.87266|0.91584] "rad" FLRdpHPA,FLRdpHPB
 SG_ FLR2RdrDetn310To314AziAng2 : 160|9@1+ (0.0035,-0.87266) [-0.87266|0.91584] "rad" FLRdpHPA,FLRdpHPB
 SG_ FLR2RdrDetn310To314AziAng3 : 224|9@1+ (0.0035,-0.87266) [-0.87266|0.91584] "rad" FLRdpHPA,FLRdpHPB
 SG_ FLR2RdrDetn310To314AziAng4 : 288|9@1+ (0.0035,-0.87266) [-0.87266|0.91584] "rad" FLRdpHPA,FLRdpHPB
 SG_ FLR2RdrDetn310To314Counter : 16|8@1+ (1.0,0.0) [0.0|255.0] "Unitless" FLRdpHPA,FLRdpHPB
 SG_ FLR2RdrDetn310To314CRC : 0|16@1+ (1.0,0.0) [0.0|65535.0] "Unitless" FLRdpHPA,FLRdpHPB
 SG_ FLR2RdrDetn310To314DynPrpty0 : 93|1@1+ (1.0,0.0) [0.0|1.0] "Unitless" FLRdpHPA,FLRdpHPB
 SG_ FLR2RdrDetn310To314DynPrpty1 : 157|1@1+ (1.0,0.0) [0.0|1.0] "Unitless" FLRdpHPA,FLRdpHPB
 SG_ FLR2RdrDetn310To314DynPrpty2 : 221|1@1+ (1.0,0.0) [0.0|1.0] "Unitless" FLRdpHPA,FLRdpHPB
 SG_ FLR2RdrDetn310To314DynPrpty3 : 285|1@1+ (1.0,0.0) [0.0|1.0] "Unitless" FLRdpHPA,FLRdpHPB
 SG_ FLR2RdrDetn310To314DynPrpty4 : 349|1@1+ (1.0,0.0) [0.0|1.0] "Unitless" FLRdpHPA,FLRdpHPB
 SG_ FLR2RdrDetn310To314EleAng0 : 64|8@1+ (0.002,0.0) [0.0|0.5] "rad" FLRdpHPA,FLRdpHPB
 SG_ FLR2RdrDetn310To314EleAng1 : 128|8@1+ (0.002,0.0) [0.0|0.5] "rad" FLRdpHPA,FLRdpHPB
 SG_ FLR2RdrDetn310To314EleAng2 : 192|8@1+ (0.002,0.0) [0.0|0.5] "rad" FLRdpHPA,FLRdpHPB
 SG_ FLR2RdrDetn310To314EleAng3 : 256|8@1+ (0.002,0.0) [0.0|0.5] "rad" FLRdpHPA,FLRdpHPB
 SG_ FLR2RdrDetn310To314EleAng4 : 320|8@1+ (0.002,0.0) [0.0|0.5] "rad" FLRdpHPA,FLRdpHPB
 SG_ FLR2RdrDetn310To314Mode0 : 60|2@1+ (1,0) [0|3] "" FLRdpHPA,FLRdpHPB
 SG_ FLR2RdrDetn310To314Mode1 : 124|2@1+ (1,0) [0|3] "" FLRdpHPA,FLRdpHPB
 SG_ FLR2RdrDetn310To314Mode2 : 188|2@1+ (1,0) [0|3] "" FLRdpHPA,FLRdpHPB
 SG_ FLR2RdrDetn310To314Mode3 : 252|2@1+ (1,0) [0|3] "" FLRdpHPA,FLRdpHPB
 SG_ FLR2RdrDetn310To314Mode4 : 316|2@1+ (1,0) [0|3] "" FLRdpHPA,FLRdpHPB
 SG_ FLR2RdrDetn310To314Quality0 : 62|2@1+ (1,0) [0|3] "" FLRdpHPA,FLRdpHPB
 SG_ FLR2RdrDetn310To314Quality1 : 126|2@1+ (1,0) [0|3] "" FLRdpHPA,FLRdpHPB
 SG_ FLR2RdrDetn310To314Quality2 : 190|2@1+ (1,0) [0|3] "" FLRdpHPA,FLRdpHPB
 SG_ FLR2RdrDetn310To314Quality3 : 254|2@1+ (1,0) [0|3] "" FLRdpHPA,FLRdpHPB
 SG_ FLR2RdrDetn310To314Quality4 : 318|2@1+ (1,0) [0|3] "" FLRdpHPA,FLRdpHPB
 SG_ FLR2RdrDetn310To314Range0 : 48|12@1+ (0.1,0.4) [0.4|300.0] "m" FLRdpHPA,FLRdpHPB
 SG_ FLR2RdrDetn310To314Range1 : 112|12@1+ (0.1,0.4) [0.4|300.0] "m" FLRdpHPA,FLRdpHPB
 SG_ FLR2RdrDetn310To314Range2 : 176|12@1+ (0.1,0.4) [0.4|300.0] "m" FLRdpHPA,FLRdpHPB
 SG_ FLR2RdrDetn310To314Range3 : 240|12@1+ (0.1,0.4) [0.4|300.0] "m" FLRdpHPA,FLRdpHPB
 SG_ FLR2RdrDetn310To314Range4 : 304|12@1+ (0.1,0.4) [0.4|300.0] "m" FLRdpHPA,FLRdpHPB
 SG_ FLR2RdrDetn310To314RCS0 : 83|10@1+ (0.2,-100.0) [-100.0|70.0] "dBsm" FLRdpHPA,FLRdpHPB
 SG_ FLR2RdrDetn310To314RCS1 : 147|10@1+ (0.2,-100.0) [-100.0|70.0] "dBsm" FLRdpHPA,FLRdpHPB
 SG_ FLR2RdrDetn310To314RCS2 : 211|10@1+ (0.2,-100.0) [-100.0|70.0] "dBsm" FLRdpHPA,FLRdpHPB
 SG_ FLR2RdrDetn310To314RCS3 : 275|10@1+ (0.2,-100.0) [-100.0|70.0] "dBsm" FLRdpHPA,FLRdpHPB
 SG_ FLR2RdrDetn310To314RCS4 : 339|10@1+ (0.2,-100.0) [-100.0|70.0] "dBsm" FLRdpHPA,FLRdpHPB
 SG_ FLR2RdrDetn310To314RngRt0 : 72|11@1+ (0.1,-111.11) [-111.11|55.59000000000002] "m/s" FLRdpHPA,FLRdpHPB
 SG_ FLR2RdrDetn310To314RngRt1 : 136|11@1+ (0.1,-111.11) [-111.11|55.59000000000002] "m/s" FLRdpHPA,FLRdpHPB
 SG_ FLR2RdrDetn310To314RngRt2 : 200|11@1+ (0.1,-111.11) [-111.11|55.59000000000002] "m/s" FLRdpHPA,FLRdpHPB
 SG_ FLR2RdrDetn310To314RngRt3 : 264|11@1+ (0.1,-111.11) [-111.11|55.59000000000002] "m/s" FLRdpHPA,FLRdpHPB
 SG_ FLR2RdrDetn310To314RngRt4 : 328|11@1+ (0.1,-111.11) [-111.11|55.59000000000002] "m/s" FLRdpHPA,FLRdpHPB
 SG_ FLR2RdrDetn310To314ScanID : 24|8@1+ (1.0,0.0) [0.0|255.0] "Unitless" FLRdpHPA,FLRdpHPB
 SG_ FLR2RdrDetn310To314SNR0 : 41|7@1+ (0.5,0.0) [0.0|63.5] "dB" FLRdpHPA,FLRdpHPB
 SG_ FLR2RdrDetn310To314SNR1 : 105|7@1+ (0.5,0.0) [0.0|63.5] "dB" FLRdpHPA,FLRdpHPB
 SG_ FLR2RdrDetn310To314SNR2 : 169|7@1+ (0.5,0.0) [0.0|63.5] "dB" FLRdpHPA,FLRdpHPB
 SG_ FLR2RdrDetn310To314SNR3 : 233|7@1+ (0.5,0.0) [0.0|63.5] "dB" FLRdpHPA,FLRdpHPB
 SG_ FLR2RdrDetn310To314SNR4 : 297|7@1+ (0.5,0.0) [0.0|63.5] "dB" FLRdpHPA,FLRdpHPB

BO_ 268 FlrFlr1canFr64 : 64 FLR
 SG_ FLR2RdrDetn315To319_UB : 359|1@0+ (1,0) [0|1] "" FLRdpHPA,FLRdpHPB
 SG_ FLR2RdrDetn315To319AziAng0 : 32|9@1+ (0.0035,-0.87266) [-0.87266|0.91584] "rad" FLRdpHPA,FLRdpHPB
 SG_ FLR2RdrDetn315To319AziAng1 : 96|9@1+ (0.0035,-0.87266) [-0.87266|0.91584] "rad" FLRdpHPA,FLRdpHPB
 SG_ FLR2RdrDetn315To319AziAng2 : 160|9@1+ (0.0035,-0.87266) [-0.87266|0.91584] "rad" FLRdpHPA,FLRdpHPB
 SG_ FLR2RdrDetn315To319AziAng3 : 224|9@1+ (0.0035,-0.87266) [-0.87266|0.91584] "rad" FLRdpHPA,FLRdpHPB
 SG_ FLR2RdrDetn315To319AziAng4 : 288|9@1+ (0.0035,-0.87266) [-0.87266|0.91584] "rad" FLRdpHPA,FLRdpHPB
 SG_ FLR2RdrDetn315To319Counter : 16|8@1+ (1.0,0.0) [0.0|255.0] "Unitless" FLRdpHPA,FLRdpHPB
 SG_ FLR2RdrDetn315To319CRC : 0|16@1+ (1.0,0.0) [0.0|65535.0] "Unitless" FLRdpHPA,FLRdpHPB
 SG_ FLR2RdrDetn315To319DynPrpty0 : 93|1@1+ (1.0,0.0) [0.0|1.0] "Unitless" FLRdpHPA,FLRdpHPB
 SG_ FLR2RdrDetn315To319DynPrpty1 : 157|1@1+ (1.0,0.0) [0.0|1.0] "Unitless" FLRdpHPA,FLRdpHPB
 SG_ FLR2RdrDetn315To319DynPrpty2 : 221|1@1+ (1.0,0.0) [0.0|1.0] "Unitless" FLRdpHPA,FLRdpHPB
 SG_ FLR2RdrDetn315To319DynPrpty3 : 285|1@1+ (1.0,0.0) [0.0|1.0] "Unitless" FLRdpHPA,FLRdpHPB
 SG_ FLR2RdrDetn315To319DynPrpty4 : 349|1@1+ (1.0,0.0) [0.0|1.0] "Unitless" FLRdpHPA,FLRdpHPB
 SG_ FLR2RdrDetn315To319EleAng0 : 64|8@1+ (0.002,0.0) [0.0|0.5] "rad" FLRdpHPA,FLRdpHPB
 SG_ FLR2RdrDetn315To319EleAng1 : 128|8@1+ (0.002,0.0) [0.0|0.5] "rad" FLRdpHPA,FLRdpHPB
 SG_ FLR2RdrDetn315To319EleAng2 : 192|8@1+ (0.002,0.0) [0.0|0.5] "rad" FLRdpHPA,FLRdpHPB
 SG_ FLR2RdrDetn315To319EleAng3 : 256|8@1+ (0.002,0.0) [0.0|0.5] "rad" FLRdpHPA,FLRdpHPB
 SG_ FLR2RdrDetn315To319EleAng4 : 320|8@1+ (0.002,0.0) [0.0|0.5] "rad" FLRdpHPA,FLRdpHPB
 SG_ FLR2RdrDetn315To319Mode0 : 60|2@1+ (1,0) [0|3] "" FLRdpHPA,FLRdpHPB
 SG_ FLR2RdrDetn315To319Mode1 : 124|2@1+ (1,0) [0|3] "" FLRdpHPA,FLRdpHPB
 SG_ FLR2RdrDetn315To319Mode2 : 188|2@1+ (1,0) [0|3] "" FLRdpHPA,FLRdpHPB
 SG_ FLR2RdrDetn315To319Mode3 : 252|2@1+ (1,0) [0|3] "" FLRdpHPA,FLRdpHPB
 SG_ FLR2RdrDetn315To319Mode4 : 316|2@1+ (1,0) [0|3] "" FLRdpHPA,FLRdpHPB
 SG_ FLR2RdrDetn315To319Quality0 : 62|2@1+ (1,0) [0|3] "" FLRdpHPA,FLRdpHPB
 SG_ FLR2RdrDetn315To319Quality1 : 126|2@1+ (1,0) [0|3] "" FLRdpHPA,FLRdpHPB
 SG_ FLR2RdrDetn315To319Quality2 : 190|2@1+ (1,0) [0|3] "" FLRdpHPA,FLRdpHPB
 SG_ FLR2RdrDetn315To319Quality3 : 254|2@1+ (1,0) [0|3] "" FLRdpHPA,FLRdpHPB
 SG_ FLR2RdrDetn315To319Quality4 : 318|2@1+ (1,0) [0|3] "" FLRdpHPA,FLRdpHPB
 SG_ FLR2RdrDetn315To319Range0 : 48|12@1+ (0.1,0.4) [0.4|300.0] "m" FLRdpHPA,FLRdpHPB
 SG_ FLR2RdrDetn315To319Range1 : 112|12@1+ (0.1,0.4) [0.4|300.0] "m" FLRdpHPA,FLRdpHPB
 SG_ FLR2RdrDetn315To319Range2 : 176|12@1+ (0.1,0.4) [0.4|300.0] "m" FLRdpHPA,FLRdpHPB
 SG_ FLR2RdrDetn315To319Range3 : 240|12@1+ (0.1,0.4) [0.4|300.0] "m" FLRdpHPA,FLRdpHPB
 SG_ FLR2RdrDetn315To319Range4 : 304|12@1+ (0.1,0.4) [0.4|300.0] "m" FLRdpHPA,FLRdpHPB
 SG_ FLR2RdrDetn315To319RCS0 : 83|10@1+ (0.2,-100.0) [-100.0|70.0] "dBsm" FLRdpHPA,FLRdpHPB
 SG_ FLR2RdrDetn315To319RCS1 : 147|10@1+ (0.2,-100.0) [-100.0|70.0] "dBsm" FLRdpHPA,FLRdpHPB
 SG_ FLR2RdrDetn315To319RCS2 : 211|10@1+ (0.2,-100.0) [-100.0|70.0] "dBsm" FLRdpHPA,FLRdpHPB
 SG_ FLR2RdrDetn315To319RCS3 : 275|10@1+ (0.2,-100.0) [-100.0|70.0] "dBsm" FLRdpHPA,FLRdpHPB
 SG_ FLR2RdrDetn315To319RCS4 : 339|10@1+ (0.2,-100.0) [-100.0|70.0] "dBsm" FLRdpHPA,FLRdpHPB
 SG_ FLR2RdrDetn315To319RngRt0 : 72|11@1+ (0.1,-111.11) [-111.11|55.59000000000002] "m/s" FLRdpHPA,FLRdpHPB
 SG_ FLR2RdrDetn315To319RngRt1 : 136|11@1+ (0.1,-111.11) [-111.11|55.59000000000002] "m/s" FLRdpHPA,FLRdpHPB
 SG_ FLR2RdrDetn315To319RngRt2 : 200|11@1+ (0.1,-111.11) [-111.11|55.59000000000002] "m/s" FLRdpHPA,FLRdpHPB
 SG_ FLR2RdrDetn315To319RngRt3 : 264|11@1+ (0.1,-111.11) [-111.11|55.59000000000002] "m/s" FLRdpHPA,FLRdpHPB
 SG_ FLR2RdrDetn315To319RngRt4 : 328|11@1+ (0.1,-111.11) [-111.11|55.59000000000002] "m/s" FLRdpHPA,FLRdpHPB
 SG_ FLR2RdrDetn315To319ScanID : 24|8@1+ (1.0,0.0) [0.0|255.0] "Unitless" FLRdpHPA,FLRdpHPB
 SG_ FLR2RdrDetn315To319SNR0 : 41|7@1+ (0.5,0.0) [0.0|63.5] "dB" FLRdpHPA,FLRdpHPB
 SG_ FLR2RdrDetn315To319SNR1 : 105|7@1+ (0.5,0.0) [0.0|63.5] "dB" FLRdpHPA,FLRdpHPB
 SG_ FLR2RdrDetn315To319SNR2 : 169|7@1+ (0.5,0.0) [0.0|63.5] "dB" FLRdpHPA,FLRdpHPB
 SG_ FLR2RdrDetn315To319SNR3 : 233|7@1+ (0.5,0.0) [0.0|63.5] "dB" FLRdpHPA,FLRdpHPB
 SG_ FLR2RdrDetn315To319SNR4 : 297|7@1+ (0.5,0.0) [0.0|63.5] "dB" FLRdpHPA,FLRdpHPB

BO_ 270 FlrFlr1canFr65 : 64 FLR
 SG_ FLR2RdrDetn320To324_UB : 359|1@0+ (1,0) [0|1] "" FLRdpHPA,FLRdpHPB
 SG_ FLR2RdrDetn320To324AziAng0 : 32|9@1+ (0.0035,-0.87266) [-0.87266|0.91584] "rad" FLRdpHPA,FLRdpHPB
 SG_ FLR2RdrDetn320To324AziAng1 : 96|9@1+ (0.0035,-0.87266) [-0.87266|0.91584] "rad" FLRdpHPA,FLRdpHPB
 SG_ FLR2RdrDetn320To324AziAng2 : 160|9@1+ (0.0035,-0.87266) [-0.87266|0.91584] "rad" FLRdpHPA,FLRdpHPB
 SG_ FLR2RdrDetn320To324AziAng3 : 224|9@1+ (0.0035,-0.87266) [-0.87266|0.91584] "rad" FLRdpHPA,FLRdpHPB
 SG_ FLR2RdrDetn320To324AziAng4 : 288|9@1+ (0.0035,-0.87266) [-0.87266|0.91584] "rad" FLRdpHPA,FLRdpHPB
 SG_ FLR2RdrDetn320To324Counter : 16|8@1+ (1.0,0.0) [0.0|255.0] "Unitless" FLRdpHPA,FLRdpHPB
 SG_ FLR2RdrDetn320To324CRC : 0|16@1+ (1.0,0.0) [0.0|65535.0] "Unitless" FLRdpHPA,FLRdpHPB
 SG_ FLR2RdrDetn320To324DynPrpty0 : 93|1@1+ (1.0,0.0) [0.0|1.0] "Unitless" FLRdpHPA,FLRdpHPB
 SG_ FLR2RdrDetn320To324DynPrpty1 : 157|1@1+ (1.0,0.0) [0.0|1.0] "Unitless" FLRdpHPA,FLRdpHPB
 SG_ FLR2RdrDetn320To324DynPrpty2 : 221|1@1+ (1.0,0.0) [0.0|1.0] "Unitless" FLRdpHPA,FLRdpHPB
 SG_ FLR2RdrDetn320To324DynPrpty3 : 285|1@1+ (1.0,0.0) [0.0|1.0] "Unitless" FLRdpHPA,FLRdpHPB
 SG_ FLR2RdrDetn320To324DynPrpty4 : 349|1@1+ (1.0,0.0) [0.0|1.0] "Unitless" FLRdpHPA,FLRdpHPB
 SG_ FLR2RdrDetn320To324EleAng0 : 64|8@1+ (0.002,0.0) [0.0|0.5] "rad" FLRdpHPA,FLRdpHPB
 SG_ FLR2RdrDetn320To324EleAng1 : 128|8@1+ (0.002,0.0) [0.0|0.5] "rad" FLRdpHPA,FLRdpHPB
 SG_ FLR2RdrDetn320To324EleAng2 : 192|8@1+ (0.002,0.0) [0.0|0.5] "rad" FLRdpHPA,FLRdpHPB
 SG_ FLR2RdrDetn320To324EleAng3 : 256|8@1+ (0.002,0.0) [0.0|0.5] "rad" FLRdpHPA,FLRdpHPB
 SG_ FLR2RdrDetn320To324EleAng4 : 320|8@1+ (0.002,0.0) [0.0|0.5] "rad" FLRdpHPA,FLRdpHPB
 SG_ FLR2RdrDetn320To324Mode0 : 60|2@1+ (1,0) [0|3] "" FLRdpHPA,FLRdpHPB
 SG_ FLR2RdrDetn320To324Mode1 : 124|2@1+ (1,0) [0|3] "" FLRdpHPA,FLRdpHPB
 SG_ FLR2RdrDetn320To324Mode2 : 188|2@1+ (1,0) [0|3] "" FLRdpHPA,FLRdpHPB
 SG_ FLR2RdrDetn320To324Mode3 : 252|2@1+ (1,0) [0|3] "" FLRdpHPA,FLRdpHPB
 SG_ FLR2RdrDetn320To324Mode4 : 316|2@1+ (1,0) [0|3] "" FLRdpHPA,FLRdpHPB
 SG_ FLR2RdrDetn320To324Quality0 : 62|2@1+ (1,0) [0|3] "" FLRdpHPA,FLRdpHPB
 SG_ FLR2RdrDetn320To324Quality1 : 126|2@1+ (1,0) [0|3] "" FLRdpHPA,FLRdpHPB
 SG_ FLR2RdrDetn320To324Quality2 : 190|2@1+ (1,0) [0|3] "" FLRdpHPA,FLRdpHPB
 SG_ FLR2RdrDetn320To324Quality3 : 254|2@1+ (1,0) [0|3] "" FLRdpHPA,FLRdpHPB
 SG_ FLR2RdrDetn320To324Quality4 : 318|2@1+ (1,0) [0|3] "" FLRdpHPA,FLRdpHPB
 SG_ FLR2RdrDetn320To324Range0 : 48|12@1+ (0.1,0.4) [0.4|300.0] "m" FLRdpHPA,FLRdpHPB
 SG_ FLR2RdrDetn320To324Range1 : 112|12@1+ (0.1,0.4) [0.4|300.0] "m" FLRdpHPA,FLRdpHPB
 SG_ FLR2RdrDetn320To324Range2 : 176|12@1+ (0.1,0.4) [0.4|300.0] "m" FLRdpHPA,FLRdpHPB
 SG_ FLR2RdrDetn320To324Range3 : 240|12@1+ (0.1,0.4) [0.4|300.0] "m" FLRdpHPA,FLRdpHPB
 SG_ FLR2RdrDetn320To324Range4 : 304|12@1+ (0.1,0.4) [0.4|300.0] "m" FLRdpHPA,FLRdpHPB
 SG_ FLR2RdrDetn320To324RCS0 : 83|10@1+ (0.2,-100.0) [-100.0|70.0] "dBsm" FLRdpHPA,FLRdpHPB
 SG_ FLR2RdrDetn320To324RCS1 : 147|10@1+ (0.2,-100.0) [-100.0|70.0] "dBsm" FLRdpHPA,FLRdpHPB
 SG_ FLR2RdrDetn320To324RCS2 : 211|10@1+ (0.2,-100.0) [-100.0|70.0] "dBsm" FLRdpHPA,FLRdpHPB
 SG_ FLR2RdrDetn320To324RCS3 : 275|10@1+ (0.2,-100.0) [-100.0|70.0] "dBsm" FLRdpHPA,FLRdpHPB
 SG_ FLR2RdrDetn320To324RCS4 : 339|10@1+ (0.2,-100.0) [-100.0|70.0] "dBsm" FLRdpHPA,FLRdpHPB
 SG_ FLR2RdrDetn320To324RngRt0 : 72|11@1+ (0.1,-111.11) [-111.11|55.59000000000002] "m/s" FLRdpHPA,FLRdpHPB
 SG_ FLR2RdrDetn320To324RngRt1 : 136|11@1+ (0.1,-111.11) [-111.11|55.59000000000002] "m/s" FLRdpHPA,FLRdpHPB
 SG_ FLR2RdrDetn320To324RngRt2 : 200|11@1+ (0.1,-111.11) [-111.11|55.59000000000002] "m/s" FLRdpHPA,FLRdpHPB
 SG_ FLR2RdrDetn320To324RngRt3 : 264|11@1+ (0.1,-111.11) [-111.11|55.59000000000002] "m/s" FLRdpHPA,FLRdpHPB
 SG_ FLR2RdrDetn320To324RngRt4 : 328|11@1+ (0.1,-111.11) [-111.11|55.59000000000002] "m/s" FLRdpHPA,FLRdpHPB
 SG_ FLR2RdrDetn320To324ScanID : 24|8@1+ (1.0,0.0) [0.0|255.0] "Unitless" FLRdpHPA,FLRdpHPB
 SG_ FLR2RdrDetn320To324SNR0 : 41|7@1+ (0.5,0.0) [0.0|63.5] "dB" FLRdpHPA,FLRdpHPB
 SG_ FLR2RdrDetn320To324SNR1 : 105|7@1+ (0.5,0.0) [0.0|63.5] "dB" FLRdpHPA,FLRdpHPB
 SG_ FLR2RdrDetn320To324SNR2 : 169|7@1+ (0.5,0.0) [0.0|63.5] "dB" FLRdpHPA,FLRdpHPB
 SG_ FLR2RdrDetn320To324SNR3 : 233|7@1+ (0.5,0.0) [0.0|63.5] "dB" FLRdpHPA,FLRdpHPB
 SG_ FLR2RdrDetn320To324SNR4 : 297|7@1+ (0.5,0.0) [0.0|63.5] "dB" FLRdpHPA,FLRdpHPB

BO_ 272 FlrFlr1canFr66 : 64 FLR
 SG_ FLR2RdrDetn325To329_UB : 359|1@0+ (1,0) [0|1] "" FLRdpHPA,FLRdpHPB
 SG_ FLR2RdrDetn325To329AziAng0 : 32|9@1+ (0.0035,-0.87266) [-0.87266|0.91584] "rad" FLRdpHPA,FLRdpHPB
 SG_ FLR2RdrDetn325To329AziAng1 : 96|9@1+ (0.0035,-0.87266) [-0.87266|0.91584] "rad" FLRdpHPA,FLRdpHPB
 SG_ FLR2RdrDetn325To329AziAng2 : 160|9@1+ (0.0035,-0.87266) [-0.87266|0.91584] "rad" FLRdpHPA,FLRdpHPB
 SG_ FLR2RdrDetn325To329AziAng3 : 224|9@1+ (0.0035,-0.87266) [-0.87266|0.91584] "rad" FLRdpHPA,FLRdpHPB
 SG_ FLR2RdrDetn325To329AziAng4 : 288|9@1+ (0.0035,-0.87266) [-0.87266|0.91584] "rad" FLRdpHPA,FLRdpHPB
 SG_ FLR2RdrDetn325To329Counter : 16|8@1+ (1.0,0.0) [0.0|255.0] "Unitless" FLRdpHPA,FLRdpHPB
 SG_ FLR2RdrDetn325To329CRC : 0|16@1+ (1.0,0.0) [0.0|65535.0] "Unitless" FLRdpHPA,FLRdpHPB
 SG_ FLR2RdrDetn325To329DynPrpty0 : 93|1@1+ (1.0,0.0) [0.0|1.0] "Unitless" FLRdpHPA,FLRdpHPB
 SG_ FLR2RdrDetn325To329DynPrpty1 : 157|1@1+ (1.0,0.0) [0.0|1.0] "Unitless" FLRdpHPA,FLRdpHPB
 SG_ FLR2RdrDetn325To329DynPrpty2 : 221|1@1+ (1.0,0.0) [0.0|1.0] "Unitless" FLRdpHPA,FLRdpHPB
 SG_ FLR2RdrDetn325To329DynPrpty3 : 285|1@1+ (1.0,0.0) [0.0|1.0] "Unitless" FLRdpHPA,FLRdpHPB
 SG_ FLR2RdrDetn325To329DynPrpty4 : 349|1@1+ (1.0,0.0) [0.0|1.0] "Unitless" FLRdpHPA,FLRdpHPB
 SG_ FLR2RdrDetn325To329EleAng0 : 64|8@1+ (0.002,0.0) [0.0|0.5] "rad" FLRdpHPA,FLRdpHPB
 SG_ FLR2RdrDetn325To329EleAng1 : 128|8@1+ (0.002,0.0) [0.0|0.5] "rad" FLRdpHPA,FLRdpHPB
 SG_ FLR2RdrDetn325To329EleAng2 : 192|8@1+ (0.002,0.0) [0.0|0.5] "rad" FLRdpHPA,FLRdpHPB
 SG_ FLR2RdrDetn325To329EleAng3 : 256|8@1+ (0.002,0.0) [0.0|0.5] "rad" FLRdpHPA,FLRdpHPB
 SG_ FLR2RdrDetn325To329EleAng4 : 320|8@1+ (0.002,0.0) [0.0|0.5] "rad" FLRdpHPA,FLRdpHPB
 SG_ FLR2RdrDetn325To329Mode0 : 60|2@1+ (1,0) [0|3] "" FLRdpHPA,FLRdpHPB
 SG_ FLR2RdrDetn325To329Mode1 : 124|2@1+ (1,0) [0|3] "" FLRdpHPA,FLRdpHPB
 SG_ FLR2RdrDetn325To329Mode2 : 188|2@1+ (1,0) [0|3] "" FLRdpHPA,FLRdpHPB
 SG_ FLR2RdrDetn325To329Mode3 : 252|2@1+ (1,0) [0|3] "" FLRdpHPA,FLRdpHPB
 SG_ FLR2RdrDetn325To329Mode4 : 316|2@1+ (1,0) [0|3] "" FLRdpHPA,FLRdpHPB
 SG_ FLR2RdrDetn325To329Quality0 : 62|2@1+ (1,0) [0|3] "" FLRdpHPA,FLRdpHPB
 SG_ FLR2RdrDetn325To329Quality1 : 126|2@1+ (1,0) [0|3] "" FLRdpHPA,FLRdpHPB
 SG_ FLR2RdrDetn325To329Quality2 : 190|2@1+ (1,0) [0|3] "" FLRdpHPA,FLRdpHPB
 SG_ FLR2RdrDetn325To329Quality3 : 254|2@1+ (1,0) [0|3] "" FLRdpHPA,FLRdpHPB
 SG_ FLR2RdrDetn325To329Quality4 : 318|2@1+ (1,0) [0|3] "" FLRdpHPA,FLRdpHPB
 SG_ FLR2RdrDetn325To329Range0 : 48|12@1+ (0.1,0.4) [0.4|300.0] "m" FLRdpHPA,FLRdpHPB
 SG_ FLR2RdrDetn325To329Range1 : 112|12@1+ (0.1,0.4) [0.4|300.0] "m" FLRdpHPA,FLRdpHPB
 SG_ FLR2RdrDetn325To329Range2 : 176|12@1+ (0.1,0.4) [0.4|300.0] "m" FLRdpHPA,FLRdpHPB
 SG_ FLR2RdrDetn325To329Range3 : 240|12@1+ (0.1,0.4) [0.4|300.0] "m" FLRdpHPA,FLRdpHPB
 SG_ FLR2RdrDetn325To329Range4 : 304|12@1+ (0.1,0.4) [0.4|300.0] "m" FLRdpHPA,FLRdpHPB
 SG_ FLR2RdrDetn325To329RCS0 : 83|10@1+ (0.2,-100.0) [-100.0|70.0] "dBsm" FLRdpHPA,FLRdpHPB
 SG_ FLR2RdrDetn325To329RCS1 : 147|10@1+ (0.2,-100.0) [-100.0|70.0] "dBsm" FLRdpHPA,FLRdpHPB
 SG_ FLR2RdrDetn325To329RCS2 : 211|10@1+ (0.2,-100.0) [-100.0|70.0] "dBsm" FLRdpHPA,FLRdpHPB
 SG_ FLR2RdrDetn325To329RCS3 : 275|10@1+ (0.2,-100.0) [-100.0|70.0] "dBsm" FLRdpHPA,FLRdpHPB
 SG_ FLR2RdrDetn325To329RCS4 : 339|10@1+ (0.2,-100.0) [-100.0|70.0] "dBsm" FLRdpHPA,FLRdpHPB
 SG_ FLR2RdrDetn325To329RngRt0 : 72|11@1+ (0.1,-111.11) [-111.11|55.59000000000002] "m/s" FLRdpHPA,FLRdpHPB
 SG_ FLR2RdrDetn325To329RngRt1 : 136|11@1+ (0.1,-111.11) [-111.11|55.59000000000002] "m/s" FLRdpHPA,FLRdpHPB
 SG_ FLR2RdrDetn325To329RngRt2 : 200|11@1+ (0.1,-111.11) [-111.11|55.59000000000002] "m/s" FLRdpHPA,FLRdpHPB
 SG_ FLR2RdrDetn325To329RngRt3 : 264|11@1+ (0.1,-111.11) [-111.11|55.59000000000002] "m/s" FLRdpHPA,FLRdpHPB
 SG_ FLR2RdrDetn325To329RngRt4 : 328|11@1+ (0.1,-111.11) [-111.11|55.59000000000002] "m/s" FLRdpHPA,FLRdpHPB
 SG_ FLR2RdrDetn325To329ScanID : 24|8@1+ (1.0,0.0) [0.0|255.0] "Unitless" FLRdpHPA,FLRdpHPB
 SG_ FLR2RdrDetn325To329SNR0 : 41|7@1+ (0.5,0.0) [0.0|63.5] "dB" FLRdpHPA,FLRdpHPB
 SG_ FLR2RdrDetn325To329SNR1 : 105|7@1+ (0.5,0.0) [0.0|63.5] "dB" FLRdpHPA,FLRdpHPB
 SG_ FLR2RdrDetn325To329SNR2 : 169|7@1+ (0.5,0.0) [0.0|63.5] "dB" FLRdpHPA,FLRdpHPB
 SG_ FLR2RdrDetn325To329SNR3 : 233|7@1+ (0.5,0.0) [0.0|63.5] "dB" FLRdpHPA,FLRdpHPB
 SG_ FLR2RdrDetn325To329SNR4 : 297|7@1+ (0.5,0.0) [0.0|63.5] "dB" FLRdpHPA,FLRdpHPB

BO_ 274 FlrFlr1canFr67 : 64 FLR
 SG_ FLR2RdrDetn330To334_UB : 359|1@0+ (1,0) [0|1] "" FLRdpHPA,FLRdpHPB
 SG_ FLR2RdrDetn330To334AziAng0 : 32|9@1+ (0.0035,-0.87266) [-0.87266|0.91584] "rad" FLRdpHPA,FLRdpHPB
 SG_ FLR2RdrDetn330To334AziAng1 : 96|9@1+ (0.0035,-0.87266) [-0.87266|0.91584] "rad" FLRdpHPA,FLRdpHPB
 SG_ FLR2RdrDetn330To334AziAng2 : 160|9@1+ (0.0035,-0.87266) [-0.87266|0.91584] "rad" FLRdpHPA,FLRdpHPB
 SG_ FLR2RdrDetn330To334AziAng3 : 224|9@1+ (0.0035,-0.87266) [-0.87266|0.91584] "rad" FLRdpHPA,FLRdpHPB
 SG_ FLR2RdrDetn330To334AziAng4 : 288|9@1+ (0.0035,-0.87266) [-0.87266|0.91584] "rad" FLRdpHPA,FLRdpHPB
 SG_ FLR2RdrDetn330To334Counter : 16|8@1+ (1.0,0.0) [0.0|255.0] "Unitless" FLRdpHPA,FLRdpHPB
 SG_ FLR2RdrDetn330To334CRC : 0|16@1+ (1.0,0.0) [0.0|65535.0] "Unitless" FLRdpHPA,FLRdpHPB
 SG_ FLR2RdrDetn330To334DynPrpty0 : 93|1@1+ (1.0,0.0) [0.0|1.0] "Unitless" FLRdpHPA,FLRdpHPB
 SG_ FLR2RdrDetn330To334DynPrpty1 : 157|1@1+ (1.0,0.0) [0.0|1.0] "Unitless" FLRdpHPA,FLRdpHPB
 SG_ FLR2RdrDetn330To334DynPrpty2 : 221|1@1+ (1.0,0.0) [0.0|1.0] "Unitless" FLRdpHPA,FLRdpHPB
 SG_ FLR2RdrDetn330To334DynPrpty3 : 285|1@1+ (1.0,0.0) [0.0|1.0] "Unitless" FLRdpHPA,FLRdpHPB
 SG_ FLR2RdrDetn330To334DynPrpty4 : 349|1@1+ (1.0,0.0) [0.0|1.0] "Unitless" FLRdpHPA,FLRdpHPB
 SG_ FLR2RdrDetn330To334EleAng0 : 64|8@1+ (0.002,0.0) [0.0|0.5] "rad" FLRdpHPA,FLRdpHPB
 SG_ FLR2RdrDetn330To334EleAng1 : 128|8@1+ (0.002,0.0) [0.0|0.5] "rad" FLRdpHPA,FLRdpHPB
 SG_ FLR2RdrDetn330To334EleAng2 : 192|8@1+ (0.002,0.0) [0.0|0.5] "rad" FLRdpHPA,FLRdpHPB
 SG_ FLR2RdrDetn330To334EleAng3 : 256|8@1+ (0.002,0.0) [0.0|0.5] "rad" FLRdpHPA,FLRdpHPB
 SG_ FLR2RdrDetn330To334EleAng4 : 320|8@1+ (0.002,0.0) [0.0|0.5] "rad" FLRdpHPA,FLRdpHPB
 SG_ FLR2RdrDetn330To334Mode0 : 60|2@1+ (1,0) [0|3] "" FLRdpHPA,FLRdpHPB
 SG_ FLR2RdrDetn330To334Mode1 : 124|2@1+ (1,0) [0|3] "" FLRdpHPA,FLRdpHPB
 SG_ FLR2RdrDetn330To334Mode2 : 188|2@1+ (1,0) [0|3] "" FLRdpHPA,FLRdpHPB
 SG_ FLR2RdrDetn330To334Mode3 : 252|2@1+ (1,0) [0|3] "" FLRdpHPA,FLRdpHPB
 SG_ FLR2RdrDetn330To334Mode4 : 316|2@1+ (1,0) [0|3] "" FLRdpHPA,FLRdpHPB
 SG_ FLR2RdrDetn330To334Quality0 : 62|2@1+ (1,0) [0|3] "" FLRdpHPA,FLRdpHPB
 SG_ FLR2RdrDetn330To334Quality1 : 126|2@1+ (1,0) [0|3] "" FLRdpHPA,FLRdpHPB
 SG_ FLR2RdrDetn330To334Quality2 : 190|2@1+ (1,0) [0|3] "" FLRdpHPA,FLRdpHPB
 SG_ FLR2RdrDetn330To334Quality3 : 254|2@1+ (1,0) [0|3] "" FLRdpHPA,FLRdpHPB
 SG_ FLR2RdrDetn330To334Quality4 : 318|2@1+ (1,0) [0|3] "" FLRdpHPA,FLRdpHPB
 SG_ FLR2RdrDetn330To334Range0 : 48|12@1+ (0.1,0.4) [0.4|300.0] "m" FLRdpHPA,FLRdpHPB
 SG_ FLR2RdrDetn330To334Range1 : 112|12@1+ (0.1,0.4) [0.4|300.0] "m" FLRdpHPA,FLRdpHPB
 SG_ FLR2RdrDetn330To334Range2 : 176|12@1+ (0.1,0.4) [0.4|300.0] "m" FLRdpHPA,FLRdpHPB
 SG_ FLR2RdrDetn330To334Range3 : 240|12@1+ (0.1,0.4) [0.4|300.0] "m" FLRdpHPA,FLRdpHPB
 SG_ FLR2RdrDetn330To334Range4 : 304|12@1+ (0.1,0.4) [0.4|300.0] "m" FLRdpHPA,FLRdpHPB
 SG_ FLR2RdrDetn330To334RCS0 : 83|10@1+ (0.2,-100.0) [-100.0|70.0] "dBsm" FLRdpHPA,FLRdpHPB
 SG_ FLR2RdrDetn330To334RCS1 : 147|10@1+ (0.2,-100.0) [-100.0|70.0] "dBsm" FLRdpHPA,FLRdpHPB
 SG_ FLR2RdrDetn330To334RCS2 : 211|10@1+ (0.2,-100.0) [-100.0|70.0] "dBsm" FLRdpHPA,FLRdpHPB
 SG_ FLR2RdrDetn330To334RCS3 : 275|10@1+ (0.2,-100.0) [-100.0|70.0] "dBsm" FLRdpHPA,FLRdpHPB
 SG_ FLR2RdrDetn330To334RCS4 : 339|10@1+ (0.2,-100.0) [-100.0|70.0] "dBsm" FLRdpHPA,FLRdpHPB
 SG_ FLR2RdrDetn330To334RngRt0 : 72|11@1+ (0.1,-111.11) [-111.11|55.59000000000002] "m/s" FLRdpHPA,FLRdpHPB
 SG_ FLR2RdrDetn330To334RngRt1 : 136|11@1+ (0.1,-111.11) [-111.11|55.59000000000002] "m/s" FLRdpHPA,FLRdpHPB
 SG_ FLR2RdrDetn330To334RngRt2 : 200|11@1+ (0.1,-111.11) [-111.11|55.59000000000002] "m/s" FLRdpHPA,FLRdpHPB
 SG_ FLR2RdrDetn330To334RngRt3 : 264|11@1+ (0.1,-111.11) [-111.11|55.59000000000002] "m/s" FLRdpHPA,FLRdpHPB
 SG_ FLR2RdrDetn330To334RngRt4 : 328|11@1+ (0.1,-111.11) [-111.11|55.59000000000002] "m/s" FLRdpHPA,FLRdpHPB
 SG_ FLR2RdrDetn330To334ScanID : 24|8@1+ (1.0,0.0) [0.0|255.0] "Unitless" FLRdpHPA,FLRdpHPB
 SG_ FLR2RdrDetn330To334SNR0 : 41|7@1+ (0.5,0.0) [0.0|63.5] "dB" FLRdpHPA,FLRdpHPB
 SG_ FLR2RdrDetn330To334SNR1 : 105|7@1+ (0.5,0.0) [0.0|63.5] "dB" FLRdpHPA,FLRdpHPB
 SG_ FLR2RdrDetn330To334SNR2 : 169|7@1+ (0.5,0.0) [0.0|63.5] "dB" FLRdpHPA,FLRdpHPB
 SG_ FLR2RdrDetn330To334SNR3 : 233|7@1+ (0.5,0.0) [0.0|63.5] "dB" FLRdpHPA,FLRdpHPB
 SG_ FLR2RdrDetn330To334SNR4 : 297|7@1+ (0.5,0.0) [0.0|63.5] "dB" FLRdpHPA,FLRdpHPB

BO_ 276 FlrFlr1canFr68 : 64 FLR
 SG_ FLR2RdrDetn335To339_UB : 359|1@0+ (1,0) [0|1] "" FLRdpHPA,FLRdpHPB
 SG_ FLR2RdrDetn335To339AziAng0 : 32|9@1+ (0.0035,-0.87266) [-0.87266|0.91584] "rad" FLRdpHPA,FLRdpHPB
 SG_ FLR2RdrDetn335To339AziAng1 : 96|9@1+ (0.0035,-0.87266) [-0.87266|0.91584] "rad" FLRdpHPA,FLRdpHPB
 SG_ FLR2RdrDetn335To339AziAng2 : 160|9@1+ (0.0035,-0.87266) [-0.87266|0.91584] "rad" FLRdpHPA,FLRdpHPB
 SG_ FLR2RdrDetn335To339AziAng3 : 224|9@1+ (0.0035,-0.87266) [-0.87266|0.91584] "rad" FLRdpHPA,FLRdpHPB
 SG_ FLR2RdrDetn335To339AziAng4 : 288|9@1+ (0.0035,-0.87266) [-0.87266|0.91584] "rad" FLRdpHPA,FLRdpHPB
 SG_ FLR2RdrDetn335To339Counter : 16|8@1+ (1.0,0.0) [0.0|255.0] "Unitless" FLRdpHPA,FLRdpHPB
 SG_ FLR2RdrDetn335To339CRC : 0|16@1+ (1.0,0.0) [0.0|65535.0] "Unitless" FLRdpHPA,FLRdpHPB
 SG_ FLR2RdrDetn335To339DynPrpty0 : 93|1@1+ (1.0,0.0) [0.0|1.0] "Unitless" FLRdpHPA,FLRdpHPB
 SG_ FLR2RdrDetn335To339DynPrpty1 : 157|1@1+ (1.0,0.0) [0.0|1.0] "Unitless" FLRdpHPA,FLRdpHPB
 SG_ FLR2RdrDetn335To339DynPrpty2 : 221|1@1+ (1.0,0.0) [0.0|1.0] "Unitless" FLRdpHPA,FLRdpHPB
 SG_ FLR2RdrDetn335To339DynPrpty3 : 285|1@1+ (1.0,0.0) [0.0|1.0] "Unitless" FLRdpHPA,FLRdpHPB
 SG_ FLR2RdrDetn335To339DynPrpty4 : 349|1@1+ (1.0,0.0) [0.0|1.0] "Unitless" FLRdpHPA,FLRdpHPB
 SG_ FLR2RdrDetn335To339EleAng0 : 64|8@1+ (0.002,0.0) [0.0|0.5] "rad" FLRdpHPA,FLRdpHPB
 SG_ FLR2RdrDetn335To339EleAng1 : 128|8@1+ (0.002,0.0) [0.0|0.5] "rad" FLRdpHPA,FLRdpHPB
 SG_ FLR2RdrDetn335To339EleAng2 : 192|8@1+ (0.002,0.0) [0.0|0.5] "rad" FLRdpHPA,FLRdpHPB
 SG_ FLR2RdrDetn335To339EleAng3 : 256|8@1+ (0.002,0.0) [0.0|0.5] "rad" FLRdpHPA,FLRdpHPB
 SG_ FLR2RdrDetn335To339EleAng4 : 320|8@1+ (0.002,0.0) [0.0|0.5] "rad" FLRdpHPA,FLRdpHPB
 SG_ FLR2RdrDetn335To339Mode0 : 60|2@1+ (1,0) [0|3] "" FLRdpHPA,FLRdpHPB
 SG_ FLR2RdrDetn335To339Mode1 : 124|2@1+ (1,0) [0|3] "" FLRdpHPA,FLRdpHPB
 SG_ FLR2RdrDetn335To339Mode2 : 188|2@1+ (1,0) [0|3] "" FLRdpHPA,FLRdpHPB
 SG_ FLR2RdrDetn335To339Mode3 : 252|2@1+ (1,0) [0|3] "" FLRdpHPA,FLRdpHPB
 SG_ FLR2RdrDetn335To339Mode4 : 316|2@1+ (1,0) [0|3] "" FLRdpHPA,FLRdpHPB
 SG_ FLR2RdrDetn335To339Quality0 : 62|2@1+ (1,0) [0|3] "" FLRdpHPA,FLRdpHPB
 SG_ FLR2RdrDetn335To339Quality1 : 126|2@1+ (1,0) [0|3] "" FLRdpHPA,FLRdpHPB
 SG_ FLR2RdrDetn335To339Quality2 : 190|2@1+ (1,0) [0|3] "" FLRdpHPA,FLRdpHPB
 SG_ FLR2RdrDetn335To339Quality3 : 254|2@1+ (1,0) [0|3] "" FLRdpHPA,FLRdpHPB
 SG_ FLR2RdrDetn335To339Quality4 : 318|2@1+ (1,0) [0|3] "" FLRdpHPA,FLRdpHPB
 SG_ FLR2RdrDetn335To339Range0 : 48|12@1+ (0.1,0.4) [0.4|300.0] "m" FLRdpHPA,FLRdpHPB
 SG_ FLR2RdrDetn335To339Range1 : 112|12@1+ (0.1,0.4) [0.4|300.0] "m" FLRdpHPA,FLRdpHPB
 SG_ FLR2RdrDetn335To339Range2 : 176|12@1+ (0.1,0.4) [0.4|300.0] "m" FLRdpHPA,FLRdpHPB
 SG_ FLR2RdrDetn335To339Range3 : 240|12@1+ (0.1,0.4) [0.4|300.0] "m" FLRdpHPA,FLRdpHPB
 SG_ FLR2RdrDetn335To339Range4 : 304|12@1+ (0.1,0.4) [0.4|300.0] "m" FLRdpHPA,FLRdpHPB
 SG_ FLR2RdrDetn335To339RCS0 : 83|10@1+ (0.2,-100.0) [-100.0|70.0] "dBsm" FLRdpHPA,FLRdpHPB
 SG_ FLR2RdrDetn335To339RCS1 : 147|10@1+ (0.2,-100.0) [-100.0|70.0] "dBsm" FLRdpHPA,FLRdpHPB
 SG_ FLR2RdrDetn335To339RCS2 : 211|10@1+ (0.2,-100.0) [-100.0|70.0] "dBsm" FLRdpHPA,FLRdpHPB
 SG_ FLR2RdrDetn335To339RCS3 : 275|10@1+ (0.2,-100.0) [-100.0|70.0] "dBsm" FLRdpHPA,FLRdpHPB
 SG_ FLR2RdrDetn335To339RCS4 : 339|10@1+ (0.2,-100.0) [-100.0|70.0] "dBsm" FLRdpHPA,FLRdpHPB
 SG_ FLR2RdrDetn335To339RngRt0 : 72|11@1+ (0.1,-111.11) [-111.11|55.59000000000002] "m/s" FLRdpHPA,FLRdpHPB
 SG_ FLR2RdrDetn335To339RngRt1 : 136|11@1+ (0.1,-111.11) [-111.11|55.59000000000002] "m/s" FLRdpHPA,FLRdpHPB
 SG_ FLR2RdrDetn335To339RngRt2 : 200|11@1+ (0.1,-111.11) [-111.11|55.59000000000002] "m/s" FLRdpHPA,FLRdpHPB
 SG_ FLR2RdrDetn335To339RngRt3 : 264|11@1+ (0.1,-111.11) [-111.11|55.59000000000002] "m/s" FLRdpHPA,FLRdpHPB
 SG_ FLR2RdrDetn335To339RngRt4 : 328|11@1+ (0.1,-111.11) [-111.11|55.59000000000002] "m/s" FLRdpHPA,FLRdpHPB
 SG_ FLR2RdrDetn335To339ScanID : 24|8@1+ (1.0,0.0) [0.0|255.0] "Unitless" FLRdpHPA,FLRdpHPB
 SG_ FLR2RdrDetn335To339SNR0 : 41|7@1+ (0.5,0.0) [0.0|63.5] "dB" FLRdpHPA,FLRdpHPB
 SG_ FLR2RdrDetn335To339SNR1 : 105|7@1+ (0.5,0.0) [0.0|63.5] "dB" FLRdpHPA,FLRdpHPB
 SG_ FLR2RdrDetn335To339SNR2 : 169|7@1+ (0.5,0.0) [0.0|63.5] "dB" FLRdpHPA,FLRdpHPB
 SG_ FLR2RdrDetn335To339SNR3 : 233|7@1+ (0.5,0.0) [0.0|63.5] "dB" FLRdpHPA,FLRdpHPB
 SG_ FLR2RdrDetn335To339SNR4 : 297|7@1+ (0.5,0.0) [0.0|63.5] "dB" FLRdpHPA,FLRdpHPB

CM_ SG_ 250 FLR2RdrDetn270To274AziAng0 "Azimuth Angle";
CM_ SG_ 250 FLR2RdrDetn270To274AziAng1 "Azimuth Angle";
CM_ SG_ 250 FLR2RdrDetn270To274AziAng2 "Azimuth Angle";
CM_ SG_ 250 FLR2RdrDetn270To274AziAng3 "Azimuth Angle";
CM_ SG_ 250 FLR2RdrDetn270To274AziAng4 "Azimuth Angle";
CM_ SG_ 250 FLR2RdrDetn270To274DynPrpty0 "Moving/Stationary";
CM_ SG_ 250 FLR2RdrDetn270To274DynPrpty1 "Moving/Stationary";
CM_ SG_ 250 FLR2RdrDetn270To274DynPrpty2 "Moving/Stationary";
CM_ SG_ 250 FLR2RdrDetn270To274DynPrpty3 "Moving/Stationary";
CM_ SG_ 250 FLR2RdrDetn270To274DynPrpty4 "Moving/Stationary";
CM_ SG_ 250 FLR2RdrDetn270To274EleAng0 "Elevation angle";
CM_ SG_ 250 FLR2RdrDetn270To274EleAng1 "Elevation angle";
CM_ SG_ 250 FLR2RdrDetn270To274EleAng2 "Elevation angle";
CM_ SG_ 250 FLR2RdrDetn270To274EleAng3 "Elevation angle";
CM_ SG_ 250 FLR2RdrDetn270To274EleAng4 "Elevation angle";
CM_ SG_ 250 FLR2RdrDetn270To274Mode0 "What chirp mode the detection is from";
CM_ SG_ 250 FLR2RdrDetn270To274Mode1 "What chirp mode the detection is from";
CM_ SG_ 250 FLR2RdrDetn270To274Mode2 "What chirp mode the detection is from";
CM_ SG_ 250 FLR2RdrDetn270To274Mode3 "What chirp mode the detection is from";
CM_ SG_ 250 FLR2RdrDetn270To274Mode4 "What chirp mode the detection is from";
CM_ SG_ 250 FLR2RdrDetn270To274Quality0 "Quality";
CM_ SG_ 250 FLR2RdrDetn270To274Quality1 "Quality";
CM_ SG_ 250 FLR2RdrDetn270To274Quality2 "Quality";
CM_ SG_ 250 FLR2RdrDetn270To274Quality3 "Quality";
CM_ SG_ 250 FLR2RdrDetn270To274Quality4 "Quality";
CM_ SG_ 250 FLR2RdrDetn270To274Range0 "Range from sensor to object";
CM_ SG_ 250 FLR2RdrDetn270To274Range1 "Range from sensor to object";
CM_ SG_ 250 FLR2RdrDetn270To274Range2 "Range from sensor to object";
CM_ SG_ 250 FLR2RdrDetn270To274Range3 "Range from sensor to object";
CM_ SG_ 250 FLR2RdrDetn270To274Range4 "Range from sensor to object";
CM_ SG_ 250 FLR2RdrDetn270To274RCS0 "RCS";
CM_ SG_ 250 FLR2RdrDetn270To274RCS1 "RCS";
CM_ SG_ 250 FLR2RdrDetn270To274RCS2 "RCS";
CM_ SG_ 250 FLR2RdrDetn270To274RCS3 "RCS";
CM_ SG_ 250 FLR2RdrDetn270To274RCS4 "RCS";
CM_ SG_ 250 FLR2RdrDetn270To274RngRt0 "Speed towards/away from the sensor";
CM_ SG_ 250 FLR2RdrDetn270To274RngRt1 "Speed towards/away from the sensor";
CM_ SG_ 250 FLR2RdrDetn270To274RngRt2 "Speed towards/away from the sensor";
CM_ SG_ 250 FLR2RdrDetn270To274RngRt3 "Speed towards/away from the sensor";
CM_ SG_ 250 FLR2RdrDetn270To274RngRt4 "Speed towards/away from the sensor";
CM_ SG_ 250 FLR2RdrDetn270To274ScanID "Value to tie status, detection data and object data frames together";
CM_ SG_ 250 FLR2RdrDetn270To274SNR0 "Signal to Noise Ratio";
CM_ SG_ 250 FLR2RdrDetn270To274SNR1 "Signal to Noise Ration";
CM_ SG_ 250 FLR2RdrDetn270To274SNR2 "Signal to Noise Ration";
CM_ SG_ 250 FLR2RdrDetn270To274SNR3 "Signal to Noise Ration";
CM_ SG_ 250 FLR2RdrDetn270To274SNR4 "Signal to Noise Ration";
CM_ SG_ 252 FLR2RdrDetn275To279AziAng0 "Azimuth Angle";
CM_ SG_ 252 FLR2RdrDetn275To279AziAng1 "Azimuth Angle";
CM_ SG_ 252 FLR2RdrDetn275To279AziAng2 "Azimuth Angle";
CM_ SG_ 252 FLR2RdrDetn275To279AziAng3 "Azimuth Angle";
CM_ SG_ 252 FLR2RdrDetn275To279AziAng4 "Azimuth Angle";
CM_ SG_ 252 FLR2RdrDetn275To279DynPrpty0 "Moving/Stationary";
CM_ SG_ 252 FLR2RdrDetn275To279DynPrpty1 "Moving/Stationary";
CM_ SG_ 252 FLR2RdrDetn275To279DynPrpty2 "Moving/Stationary";
CM_ SG_ 252 FLR2RdrDetn275To279DynPrpty3 "Moving/Stationary";
CM_ SG_ 252 FLR2RdrDetn275To279DynPrpty4 "Moving/Stationary";
CM_ SG_ 252 FLR2RdrDetn275To279EleAng0 "Elevation angle";
CM_ SG_ 252 FLR2RdrDetn275To279EleAng1 "Elevation angle";
CM_ SG_ 252 FLR2RdrDetn275To279EleAng2 "Elevation angle";
CM_ SG_ 252 FLR2RdrDetn275To279EleAng3 "Elevation angle";
CM_ SG_ 252 FLR2RdrDetn275To279EleAng4 "Elevation angle";
CM_ SG_ 252 FLR2RdrDetn275To279Mode0 "What chirp mode the detection is from";
CM_ SG_ 252 FLR2RdrDetn275To279Mode1 "What chirp mode the detection is from";
CM_ SG_ 252 FLR2RdrDetn275To279Mode2 "What chirp mode the detection is from";
CM_ SG_ 252 FLR2RdrDetn275To279Mode3 "What chirp mode the detection is from";
CM_ SG_ 252 FLR2RdrDetn275To279Mode4 "What chirp mode the detection is from";
CM_ SG_ 252 FLR2RdrDetn275To279Quality0 "Quality";
CM_ SG_ 252 FLR2RdrDetn275To279Quality1 "Quality";
CM_ SG_ 252 FLR2RdrDetn275To279Quality2 "Quality";
CM_ SG_ 252 FLR2RdrDetn275To279Quality3 "Quality";
CM_ SG_ 252 FLR2RdrDetn275To279Quality4 "Quality";
CM_ SG_ 252 FLR2RdrDetn275To279Range0 "Range from sensor to object";
CM_ SG_ 252 FLR2RdrDetn275To279Range1 "Range from sensor to object";
CM_ SG_ 252 FLR2RdrDetn275To279Range2 "Range from sensor to object";
CM_ SG_ 252 FLR2RdrDetn275To279Range3 "Range from sensor to object";
CM_ SG_ 252 FLR2RdrDetn275To279Range4 "Range from sensor to object";
CM_ SG_ 252 FLR2RdrDetn275To279RCS0 "RCS";
CM_ SG_ 252 FLR2RdrDetn275To279RCS1 "RCS";
CM_ SG_ 252 FLR2RdrDetn275To279RCS2 "RCS";
CM_ SG_ 252 FLR2RdrDetn275To279RCS3 "RCS";
CM_ SG_ 252 FLR2RdrDetn275To279RCS4 "RCS";
CM_ SG_ 252 FLR2RdrDetn275To279RngRt0 "Speed towards/away from the sensor";
CM_ SG_ 252 FLR2RdrDetn275To279RngRt1 "Speed towards/away from the sensor";
CM_ SG_ 252 FLR2RdrDetn275To279RngRt2 "Speed towards/away from the sensor";
CM_ SG_ 252 FLR2RdrDetn275To279RngRt3 "Speed towards/away from the sensor";
CM_ SG_ 252 FLR2RdrDetn275To279RngRt4 "Speed towards/away from the sensor";
CM_ SG_ 252 FLR2RdrDetn275To279ScanID "Value to tie status, detection data and object data frames together";
CM_ SG_ 252 FLR2RdrDetn275To279SNR0 "Signal to Noise Ratio";
CM_ SG_ 252 FLR2RdrDetn275To279SNR1 "Signal to Noise Ration";
CM_ SG_ 252 FLR2RdrDetn275To279SNR2 "Signal to Noise Ration";
CM_ SG_ 252 FLR2RdrDetn275To279SNR3 "Signal to Noise Ration";
CM_ SG_ 252 FLR2RdrDetn275To279SNR4 "Signal to Noise Ration";
CM_ SG_ 254 FLR2RdrDetn280To284AziAng0 "Azimuth Angle";
CM_ SG_ 254 FLR2RdrDetn280To284AziAng1 "Azimuth Angle";
CM_ SG_ 254 FLR2RdrDetn280To284AziAng2 "Azimuth Angle";
CM_ SG_ 254 FLR2RdrDetn280To284AziAng3 "Azimuth Angle";
CM_ SG_ 254 FLR2RdrDetn280To284AziAng4 "Azimuth Angle";
CM_ SG_ 254 FLR2RdrDetn280To284DynPrpty0 "Moving/Stationary";
CM_ SG_ 254 FLR2RdrDetn280To284DynPrpty1 "Moving/Stationary";
CM_ SG_ 254 FLR2RdrDetn280To284DynPrpty2 "Moving/Stationary";
CM_ SG_ 254 FLR2RdrDetn280To284DynPrpty3 "Moving/Stationary";
CM_ SG_ 254 FLR2RdrDetn280To284DynPrpty4 "Moving/Stationary";
CM_ SG_ 254 FLR2RdrDetn280To284EleAng0 "Elevation angle";
CM_ SG_ 254 FLR2RdrDetn280To284EleAng1 "Elevation angle";
CM_ SG_ 254 FLR2RdrDetn280To284EleAng2 "Elevation angle";
CM_ SG_ 254 FLR2RdrDetn280To284EleAng3 "Elevation angle";
CM_ SG_ 254 FLR2RdrDetn280To284EleAng4 "Elevation angle";
CM_ SG_ 254 FLR2RdrDetn280To284Mode0 "What chirp mode the detection is from";
CM_ SG_ 254 FLR2RdrDetn280To284Mode1 "What chirp mode the detection is from";
CM_ SG_ 254 FLR2RdrDetn280To284Mode2 "What chirp mode the detection is from";
CM_ SG_ 254 FLR2RdrDetn280To284Mode3 "What chirp mode the detection is from";
CM_ SG_ 254 FLR2RdrDetn280To284Mode4 "What chirp mode the detection is from";
CM_ SG_ 254 FLR2RdrDetn280To284Quality0 "Quality";
CM_ SG_ 254 FLR2RdrDetn280To284Quality1 "Quality";
CM_ SG_ 254 FLR2RdrDetn280To284Quality2 "Quality";
CM_ SG_ 254 FLR2RdrDetn280To284Quality3 "Quality";
CM_ SG_ 254 FLR2RdrDetn280To284Quality4 "Quality";
CM_ SG_ 254 FLR2RdrDetn280To284Range0 "Range from sensor to object";
CM_ SG_ 254 FLR2RdrDetn280To284Range1 "Range from sensor to object";
CM_ SG_ 254 FLR2RdrDetn280To284Range2 "Range from sensor to object";
CM_ SG_ 254 FLR2RdrDetn280To284Range3 "Range from sensor to object";
CM_ SG_ 254 FLR2RdrDetn280To284Range4 "Range from sensor to object";
CM_ SG_ 254 FLR2RdrDetn280To284RCS0 "RCS";
CM_ SG_ 254 FLR2RdrDetn280To284RCS1 "RCS";
CM_ SG_ 254 FLR2RdrDetn280To284RCS2 "RCS";
CM_ SG_ 254 FLR2RdrDetn280To284RCS3 "RCS";
CM_ SG_ 254 FLR2RdrDetn280To284RCS4 "RCS";
CM_ SG_ 254 FLR2RdrDetn280To284RngRt0 "Speed towards/away from the sensor";
CM_ SG_ 254 FLR2RdrDetn280To284RngRt1 "Speed towards/away from the sensor";
CM_ SG_ 254 FLR2RdrDetn280To284RngRt2 "Speed towards/away from the sensor";
CM_ SG_ 254 FLR2RdrDetn280To284RngRt3 "Speed towards/away from the sensor";
CM_ SG_ 254 FLR2RdrDetn280To284RngRt4 "Speed towards/away from the sensor";
CM_ SG_ 254 FLR2RdrDetn280To284ScanID "Value to tie status, detection data and object data frames together";
CM_ SG_ 254 FLR2RdrDetn280To284SNR0 "Signal to Noise Ratio";
CM_ SG_ 254 FLR2RdrDetn280To284SNR1 "Signal to Noise Ration";
CM_ SG_ 254 FLR2RdrDetn280To284SNR2 "Signal to Noise Ration";
CM_ SG_ 254 FLR2RdrDetn280To284SNR3 "Signal to Noise Ration";
CM_ SG_ 254 FLR2RdrDetn280To284SNR4 "Signal to Noise Ration";
CM_ SG_ 256 FLR2RdrDetn285To289AziAng0 "Azimuth Angle";
CM_ SG_ 256 FLR2RdrDetn285To289AziAng1 "Azimuth Angle";
CM_ SG_ 256 FLR2RdrDetn285To289AziAng2 "Azimuth Angle";
CM_ SG_ 256 FLR2RdrDetn285To289AziAng3 "Azimuth Angle";
CM_ SG_ 256 FLR2RdrDetn285To289AziAng4 "Azimuth Angle";
CM_ SG_ 256 FLR2RdrDetn285To289DynPrpty0 "Moving/Stationary";
CM_ SG_ 256 FLR2RdrDetn285To289DynPrpty1 "Moving/Stationary";
CM_ SG_ 256 FLR2RdrDetn285To289DynPrpty2 "Moving/Stationary";
CM_ SG_ 256 FLR2RdrDetn285To289DynPrpty3 "Moving/Stationary";
CM_ SG_ 256 FLR2RdrDetn285To289DynPrpty4 "Moving/Stationary";
CM_ SG_ 256 FLR2RdrDetn285To289EleAng0 "Elevation angle";
CM_ SG_ 256 FLR2RdrDetn285To289EleAng1 "Elevation angle";
CM_ SG_ 256 FLR2RdrDetn285To289EleAng2 "Elevation angle";
CM_ SG_ 256 FLR2RdrDetn285To289EleAng3 "Elevation angle";
CM_ SG_ 256 FLR2RdrDetn285To289EleAng4 "Elevation angle";
CM_ SG_ 256 FLR2RdrDetn285To289Mode0 "What chirp mode the detection is from";
CM_ SG_ 256 FLR2RdrDetn285To289Mode1 "What chirp mode the detection is from";
CM_ SG_ 256 FLR2RdrDetn285To289Mode2 "What chirp mode the detection is from";
CM_ SG_ 256 FLR2RdrDetn285To289Mode3 "What chirp mode the detection is from";
CM_ SG_ 256 FLR2RdrDetn285To289Mode4 "What chirp mode the detection is from";
CM_ SG_ 256 FLR2RdrDetn285To289Quality0 "Quality";
CM_ SG_ 256 FLR2RdrDetn285To289Quality1 "Quality";
CM_ SG_ 256 FLR2RdrDetn285To289Quality2 "Quality";
CM_ SG_ 256 FLR2RdrDetn285To289Quality3 "Quality";
CM_ SG_ 256 FLR2RdrDetn285To289Quality4 "Quality";
CM_ SG_ 256 FLR2RdrDetn285To289Range0 "Range from sensor to object";
CM_ SG_ 256 FLR2RdrDetn285To289Range1 "Range from sensor to object";
CM_ SG_ 256 FLR2RdrDetn285To289Range2 "Range from sensor to object";
CM_ SG_ 256 FLR2RdrDetn285To289Range3 "Range from sensor to object";
CM_ SG_ 256 FLR2RdrDetn285To289Range4 "Range from sensor to object";
CM_ SG_ 256 FLR2RdrDetn285To289RCS0 "RCS";
CM_ SG_ 256 FLR2RdrDetn285To289RCS1 "RCS";
CM_ SG_ 256 FLR2RdrDetn285To289RCS2 "RCS";
CM_ SG_ 256 FLR2RdrDetn285To289RCS3 "RCS";
CM_ SG_ 256 FLR2RdrDetn285To289RCS4 "RCS";
CM_ SG_ 256 FLR2RdrDetn285To289RngRt0 "Speed towards/away from the sensor";
CM_ SG_ 256 FLR2RdrDetn285To289RngRt1 "Speed towards/away from the sensor";
CM_ SG_ 256 FLR2RdrDetn285To289RngRt2 "Speed towards/away from the sensor";
CM_ SG_ 256 FLR2RdrDetn285To289RngRt3 "Speed towards/away from the sensor";
CM_ SG_ 256 FLR2RdrDetn285To289RngRt4 "Speed towards/away from the sensor";
CM_ SG_ 256 FLR2RdrDetn285To289ScanID "Value to tie status, detection data and object data frames together";
CM_ SG_ 256 FLR2RdrDetn285To289SNR0 "Signal to Noise Ratio";
CM_ SG_ 256 FLR2RdrDetn285To289SNR1 "Signal to Noise Ration";
CM_ SG_ 256 FLR2RdrDetn285To289SNR2 "Signal to Noise Ration";
CM_ SG_ 256 FLR2RdrDetn285To289SNR3 "Signal to Noise Ration";
CM_ SG_ 256 FLR2RdrDetn285To289SNR4 "Signal to Noise Ration";
CM_ SG_ 258 FLR2RdrDetn290To294AziAng0 "Azimuth Angle";
CM_ SG_ 258 FLR2RdrDetn290To294AziAng1 "Azimuth Angle";
CM_ SG_ 258 FLR2RdrDetn290To294AziAng2 "Azimuth Angle";
CM_ SG_ 258 FLR2RdrDetn290To294AziAng3 "Azimuth Angle";
CM_ SG_ 258 FLR2RdrDetn290To294AziAng4 "Azimuth Angle";
CM_ SG_ 258 FLR2RdrDetn290To294DynPrpty0 "Moving/Stationary";
CM_ SG_ 258 FLR2RdrDetn290To294DynPrpty1 "Moving/Stationary";
CM_ SG_ 258 FLR2RdrDetn290To294DynPrpty2 "Moving/Stationary";
CM_ SG_ 258 FLR2RdrDetn290To294DynPrpty3 "Moving/Stationary";
CM_ SG_ 258 FLR2RdrDetn290To294DynPrpty4 "Moving/Stationary";
CM_ SG_ 258 FLR2RdrDetn290To294EleAng0 "Elevation angle";
CM_ SG_ 258 FLR2RdrDetn290To294EleAng1 "Elevation angle";
CM_ SG_ 258 FLR2RdrDetn290To294EleAng2 "Elevation angle";
CM_ SG_ 258 FLR2RdrDetn290To294EleAng3 "Elevation angle";
CM_ SG_ 258 FLR2RdrDetn290To294EleAng4 "Elevation angle";
CM_ SG_ 258 FLR2RdrDetn290To294Mode0 "What chirp mode the detection is from";
CM_ SG_ 258 FLR2RdrDetn290To294Mode1 "What chirp mode the detection is from";
CM_ SG_ 258 FLR2RdrDetn290To294Mode2 "What chirp mode the detection is from";
CM_ SG_ 258 FLR2RdrDetn290To294Mode3 "What chirp mode the detection is from";
CM_ SG_ 258 FLR2RdrDetn290To294Mode4 "What chirp mode the detection is from";
CM_ SG_ 258 FLR2RdrDetn290To294Quality0 "Quality";
CM_ SG_ 258 FLR2RdrDetn290To294Quality1 "Quality";
CM_ SG_ 258 FLR2RdrDetn290To294Quality2 "Quality";
CM_ SG_ 258 FLR2RdrDetn290To294Quality3 "Quality";
CM_ SG_ 258 FLR2RdrDetn290To294Quality4 "Quality";
CM_ SG_ 258 FLR2RdrDetn290To294Range0 "Range from sensor to object";
CM_ SG_ 258 FLR2RdrDetn290To294Range1 "Range from sensor to object";
CM_ SG_ 258 FLR2RdrDetn290To294Range2 "Range from sensor to object";
CM_ SG_ 258 FLR2RdrDetn290To294Range3 "Range from sensor to object";
CM_ SG_ 258 FLR2RdrDetn290To294Range4 "Range from sensor to object";
CM_ SG_ 258 FLR2RdrDetn290To294RCS0 "RCS";
CM_ SG_ 258 FLR2RdrDetn290To294RCS1 "RCS";
CM_ SG_ 258 FLR2RdrDetn290To294RCS2 "RCS";
CM_ SG_ 258 FLR2RdrDetn290To294RCS3 "RCS";
CM_ SG_ 258 FLR2RdrDetn290To294RCS4 "RCS";
CM_ SG_ 258 FLR2RdrDetn290To294RngRt0 "Speed towards/away from the sensor";
CM_ SG_ 258 FLR2RdrDetn290To294RngRt1 "Speed towards/away from the sensor";
CM_ SG_ 258 FLR2RdrDetn290To294RngRt2 "Speed towards/away from the sensor";
CM_ SG_ 258 FLR2RdrDetn290To294RngRt3 "Speed towards/away from the sensor";
CM_ SG_ 258 FLR2RdrDetn290To294RngRt4 "Speed towards/away from the sensor";
CM_ SG_ 258 FLR2RdrDetn290To294ScanID "Value to tie status, detection data and object data frames together";
CM_ SG_ 258 FLR2RdrDetn290To294SNR0 "Signal to Noise Ratio";
CM_ SG_ 258 FLR2RdrDetn290To294SNR1 "Signal to Noise Ration";
CM_ SG_ 258 FLR2RdrDetn290To294SNR2 "Signal to Noise Ration";
CM_ SG_ 258 FLR2RdrDetn290To294SNR3 "Signal to Noise Ration";
CM_ SG_ 258 FLR2RdrDetn290To294SNR4 "Signal to Noise Ration";
CM_ SG_ 260 FLR2RdrDetn295To299AziAng0 "Azimuth Angle";
CM_ SG_ 260 FLR2RdrDetn295To299AziAng1 "Azimuth Angle";
CM_ SG_ 260 FLR2RdrDetn295To299AziAng2 "Azimuth Angle";
CM_ SG_ 260 FLR2RdrDetn295To299AziAng3 "Azimuth Angle";
CM_ SG_ 260 FLR2RdrDetn295To299AziAng4 "Azimuth Angle";
CM_ SG_ 260 FLR2RdrDetn295To299DynPrpty0 "Moving/Stationary";
CM_ SG_ 260 FLR2RdrDetn295To299DynPrpty1 "Moving/Stationary";
CM_ SG_ 260 FLR2RdrDetn295To299DynPrpty2 "Moving/Stationary";
CM_ SG_ 260 FLR2RdrDetn295To299DynPrpty3 "Moving/Stationary";
CM_ SG_ 260 FLR2RdrDetn295To299DynPrpty4 "Moving/Stationary";
CM_ SG_ 260 FLR2RdrDetn295To299EleAng0 "Elevation angle";
CM_ SG_ 260 FLR2RdrDetn295To299EleAng1 "Elevation angle";
CM_ SG_ 260 FLR2RdrDetn295To299EleAng2 "Elevation angle";
CM_ SG_ 260 FLR2RdrDetn295To299EleAng3 "Elevation angle";
CM_ SG_ 260 FLR2RdrDetn295To299EleAng4 "Elevation angle";
CM_ SG_ 260 FLR2RdrDetn295To299Mode0 "What chirp mode the detection is from";
CM_ SG_ 260 FLR2RdrDetn295To299Mode1 "What chirp mode the detection is from";
CM_ SG_ 260 FLR2RdrDetn295To299Mode2 "What chirp mode the detection is from";
CM_ SG_ 260 FLR2RdrDetn295To299Mode3 "What chirp mode the detection is from";
CM_ SG_ 260 FLR2RdrDetn295To299Mode4 "What chirp mode the detection is from";
CM_ SG_ 260 FLR2RdrDetn295To299Quality0 "Quality";
CM_ SG_ 260 FLR2RdrDetn295To299Quality1 "Quality";
CM_ SG_ 260 FLR2RdrDetn295To299Quality2 "Quality";
CM_ SG_ 260 FLR2RdrDetn295To299Quality3 "Quality";
CM_ SG_ 260 FLR2RdrDetn295To299Quality4 "Quality";
CM_ SG_ 260 FLR2RdrDetn295To299Range0 "Range from sensor to object";
CM_ SG_ 260 FLR2RdrDetn295To299Range1 "Range from sensor to object";
CM_ SG_ 260 FLR2RdrDetn295To299Range2 "Range from sensor to object";
CM_ SG_ 260 FLR2RdrDetn295To299Range3 "Range from sensor to object";
CM_ SG_ 260 FLR2RdrDetn295To299Range4 "Range from sensor to object";
CM_ SG_ 260 FLR2RdrDetn295To299RCS0 "RCS";
CM_ SG_ 260 FLR2RdrDetn295To299RCS1 "RCS";
CM_ SG_ 260 FLR2RdrDetn295To299RCS2 "RCS";
CM_ SG_ 260 FLR2RdrDetn295To299RCS3 "RCS";
CM_ SG_ 260 FLR2RdrDetn295To299RCS4 "RCS";
CM_ SG_ 260 FLR2RdrDetn295To299RngRt0 "Speed towards/away from the sensor";
CM_ SG_ 260 FLR2RdrDetn295To299RngRt1 "Speed towards/away from the sensor";
CM_ SG_ 260 FLR2RdrDetn295To299RngRt2 "Speed towards/away from the sensor";
CM_ SG_ 260 FLR2RdrDetn295To299RngRt3 "Speed towards/away from the sensor";
CM_ SG_ 260 FLR2RdrDetn295To299RngRt4 "Speed towards/away from the sensor";
CM_ SG_ 260 FLR2RdrDetn295To299ScanID "Value to tie status, detection data and object data frames together";
CM_ SG_ 260 FLR2RdrDetn295To299SNR0 "Signal to Noise Ratio";
CM_ SG_ 260 FLR2RdrDetn295To299SNR1 "Signal to Noise Ration";
CM_ SG_ 260 FLR2RdrDetn295To299SNR2 "Signal to Noise Ration";
CM_ SG_ 260 FLR2RdrDetn295To299SNR3 "Signal to Noise Ration";
CM_ SG_ 260 FLR2RdrDetn295To299SNR4 "Signal to Noise Ration";
CM_ SG_ 262 FLR2RdrDetn300To304AziAng0 "Azimuth Angle";
CM_ SG_ 262 FLR2RdrDetn300To304AziAng1 "Azimuth Angle";
CM_ SG_ 262 FLR2RdrDetn300To304AziAng2 "Azimuth Angle";
CM_ SG_ 262 FLR2RdrDetn300To304AziAng3 "Azimuth Angle";
CM_ SG_ 262 FLR2RdrDetn300To304AziAng4 "Azimuth Angle";
CM_ SG_ 262 FLR2RdrDetn300To304DynPrpty0 "Moving/Stationary";
CM_ SG_ 262 FLR2RdrDetn300To304DynPrpty1 "Moving/Stationary";
CM_ SG_ 262 FLR2RdrDetn300To304DynPrpty2 "Moving/Stationary";
CM_ SG_ 262 FLR2RdrDetn300To304DynPrpty3 "Moving/Stationary";
CM_ SG_ 262 FLR2RdrDetn300To304DynPrpty4 "Moving/Stationary";
CM_ SG_ 262 FLR2RdrDetn300To304EleAng0 "Elevation angle";
CM_ SG_ 262 FLR2RdrDetn300To304EleAng1 "Elevation angle";
CM_ SG_ 262 FLR2RdrDetn300To304EleAng2 "Elevation angle";
CM_ SG_ 262 FLR2RdrDetn300To304EleAng3 "Elevation angle";
CM_ SG_ 262 FLR2RdrDetn300To304EleAng4 "Elevation angle";
CM_ SG_ 262 FLR2RdrDetn300To304Mode0 "What chirp mode the detection is from";
CM_ SG_ 262 FLR2RdrDetn300To304Mode1 "What chirp mode the detection is from";
CM_ SG_ 262 FLR2RdrDetn300To304Mode2 "What chirp mode the detection is from";
CM_ SG_ 262 FLR2RdrDetn300To304Mode3 "What chirp mode the detection is from";
CM_ SG_ 262 FLR2RdrDetn300To304Mode4 "What chirp mode the detection is from";
CM_ SG_ 262 FLR2RdrDetn300To304Quality0 "Quality";
CM_ SG_ 262 FLR2RdrDetn300To304Quality1 "Quality";
CM_ SG_ 262 FLR2RdrDetn300To304Quality2 "Quality";
CM_ SG_ 262 FLR2RdrDetn300To304Quality3 "Quality";
CM_ SG_ 262 FLR2RdrDetn300To304Quality4 "Quality";
CM_ SG_ 262 FLR2RdrDetn300To304Range0 "Range from sensor to object";
CM_ SG_ 262 FLR2RdrDetn300To304Range1 "Range from sensor to object";
CM_ SG_ 262 FLR2RdrDetn300To304Range2 "Range from sensor to object";
CM_ SG_ 262 FLR2RdrDetn300To304Range3 "Range from sensor to object";
CM_ SG_ 262 FLR2RdrDetn300To304Range4 "Range from sensor to object";
CM_ SG_ 262 FLR2RdrDetn300To304RCS0 "RCS";
CM_ SG_ 262 FLR2RdrDetn300To304RCS1 "RCS";
CM_ SG_ 262 FLR2RdrDetn300To304RCS2 "RCS";
CM_ SG_ 262 FLR2RdrDetn300To304RCS3 "RCS";
CM_ SG_ 262 FLR2RdrDetn300To304RCS4 "RCS";
CM_ SG_ 262 FLR2RdrDetn300To304RngRt0 "Speed towards/away from the sensor";
CM_ SG_ 262 FLR2RdrDetn300To304RngRt1 "Speed towards/away from the sensor";
CM_ SG_ 262 FLR2RdrDetn300To304RngRt2 "Speed towards/away from the sensor";
CM_ SG_ 262 FLR2RdrDetn300To304RngRt3 "Speed towards/away from the sensor";
CM_ SG_ 262 FLR2RdrDetn300To304RngRt4 "Speed towards/away from the sensor";
CM_ SG_ 262 FLR2RdrDetn300To304ScanID "Value to tie status, detection data and object data frames together";
CM_ SG_ 262 FLR2RdrDetn300To304SNR0 "Signal to Noise Ratio";
CM_ SG_ 262 FLR2RdrDetn300To304SNR1 "Signal to Noise Ration";
CM_ SG_ 262 FLR2RdrDetn300To304SNR2 "Signal to Noise Ration";
CM_ SG_ 262 FLR2RdrDetn300To304SNR3 "Signal to Noise Ration";
CM_ SG_ 262 FLR2RdrDetn300To304SNR4 "Signal to Noise Ration";
CM_ SG_ 264 FLR2RdrDetn305To309AziAng0 "Azimuth Angle";
CM_ SG_ 264 FLR2RdrDetn305To309AziAng1 "Azimuth Angle";
CM_ SG_ 264 FLR2RdrDetn305To309AziAng2 "Azimuth Angle";
CM_ SG_ 264 FLR2RdrDetn305To309AziAng3 "Azimuth Angle";
CM_ SG_ 264 FLR2RdrDetn305To309AziAng4 "Azimuth Angle";
CM_ SG_ 264 FLR2RdrDetn305To309DynPrpty0 "Moving/Stationary";
CM_ SG_ 264 FLR2RdrDetn305To309DynPrpty1 "Moving/Stationary";
CM_ SG_ 264 FLR2RdrDetn305To309DynPrpty2 "Moving/Stationary";
CM_ SG_ 264 FLR2RdrDetn305To309DynPrpty3 "Moving/Stationary";
CM_ SG_ 264 FLR2RdrDetn305To309DynPrpty4 "Moving/Stationary";
CM_ SG_ 264 FLR2RdrDetn305To309EleAng0 "Elevation angle";
CM_ SG_ 264 FLR2RdrDetn305To309EleAng1 "Elevation angle";
CM_ SG_ 264 FLR2RdrDetn305To309EleAng2 "Elevation angle";
CM_ SG_ 264 FLR2RdrDetn305To309EleAng3 "Elevation angle";
CM_ SG_ 264 FLR2RdrDetn305To309EleAng4 "Elevation angle";
CM_ SG_ 264 FLR2RdrDetn305To309Mode0 "What chirp mode the detection is from";
CM_ SG_ 264 FLR2RdrDetn305To309Mode1 "What chirp mode the detection is from";
CM_ SG_ 264 FLR2RdrDetn305To309Mode2 "What chirp mode the detection is from";
CM_ SG_ 264 FLR2RdrDetn305To309Mode3 "What chirp mode the detection is from";
CM_ SG_ 264 FLR2RdrDetn305To309Mode4 "What chirp mode the detection is from";
CM_ SG_ 264 FLR2RdrDetn305To309Quality0 "Quality";
CM_ SG_ 264 FLR2RdrDetn305To309Quality1 "Quality";
CM_ SG_ 264 FLR2RdrDetn305To309Quality2 "Quality";
CM_ SG_ 264 FLR2RdrDetn305To309Quality3 "Quality";
CM_ SG_ 264 FLR2RdrDetn305To309Quality4 "Quality";
CM_ SG_ 264 FLR2RdrDetn305To309Range0 "Range from sensor to object";
CM_ SG_ 264 FLR2RdrDetn305To309Range1 "Range from sensor to object";
CM_ SG_ 264 FLR2RdrDetn305To309Range2 "Range from sensor to object";
CM_ SG_ 264 FLR2RdrDetn305To309Range3 "Range from sensor to object";
CM_ SG_ 264 FLR2RdrDetn305To309Range4 "Range from sensor to object";
CM_ SG_ 264 FLR2RdrDetn305To309RCS0 "RCS";
CM_ SG_ 264 FLR2RdrDetn305To309RCS1 "RCS";
CM_ SG_ 264 FLR2RdrDetn305To309RCS2 "RCS";
CM_ SG_ 264 FLR2RdrDetn305To309RCS3 "RCS";
CM_ SG_ 264 FLR2RdrDetn305To309RCS4 "RCS";
CM_ SG_ 264 FLR2RdrDetn305To309RngRt0 "Speed towards/away from the sensor";
CM_ SG_ 264 FLR2RdrDetn305To309RngRt1 "Speed towards/away from the sensor";
CM_ SG_ 264 FLR2RdrDetn305To309RngRt2 "Speed towards/away from the sensor";
CM_ SG_ 264 FLR2RdrDetn305To309RngRt3 "Speed towards/away from the sensor";
CM_ SG_ 264 FLR2RdrDetn305To309RngRt4 "Speed towards/away from the sensor";
CM_ SG_ 264 FLR2RdrDetn305To309ScanID "Value to tie status, detection data and object data frames together";
CM_ SG_ 264 FLR2RdrDetn305To309SNR0 "Signal to Noise Ratio";
CM_ SG_ 264 FLR2RdrDetn305To309SNR1 "Signal to Noise Ration";
CM_ SG_ 264 FLR2RdrDetn305To309SNR2 "Signal to Noise Ration";
CM_ SG_ 264 FLR2RdrDetn305To309SNR3 "Signal to Noise Ration";
CM_ SG_ 264 FLR2RdrDetn305To309SNR4 "Signal to Noise Ration";
CM_ SG_ 266 FLR2RdrDetn310To314AziAng0 "Azimuth Angle";
CM_ SG_ 266 FLR2RdrDetn310To314AziAng1 "Azimuth Angle";
CM_ SG_ 266 FLR2RdrDetn310To314AziAng2 "Azimuth Angle";
CM_ SG_ 266 FLR2RdrDetn310To314AziAng3 "Azimuth Angle";
CM_ SG_ 266 FLR2RdrDetn310To314AziAng4 "Azimuth Angle";
CM_ SG_ 266 FLR2RdrDetn310To314DynPrpty0 "Moving/Stationary";
CM_ SG_ 266 FLR2RdrDetn310To314DynPrpty1 "Moving/Stationary";
CM_ SG_ 266 FLR2RdrDetn310To314DynPrpty2 "Moving/Stationary";
CM_ SG_ 266 FLR2RdrDetn310To314DynPrpty3 "Moving/Stationary";
CM_ SG_ 266 FLR2RdrDetn310To314DynPrpty4 "Moving/Stationary";
CM_ SG_ 266 FLR2RdrDetn310To314EleAng0 "Elevation angle";
CM_ SG_ 266 FLR2RdrDetn310To314EleAng1 "Elevation angle";
CM_ SG_ 266 FLR2RdrDetn310To314EleAng2 "Elevation angle";
CM_ SG_ 266 FLR2RdrDetn310To314EleAng3 "Elevation angle";
CM_ SG_ 266 FLR2RdrDetn310To314EleAng4 "Elevation angle";
CM_ SG_ 266 FLR2RdrDetn310To314Mode0 "What chirp mode the detection is from";
CM_ SG_ 266 FLR2RdrDetn310To314Mode1 "What chirp mode the detection is from";
CM_ SG_ 266 FLR2RdrDetn310To314Mode2 "What chirp mode the detection is from";
CM_ SG_ 266 FLR2RdrDetn310To314Mode3 "What chirp mode the detection is from";
CM_ SG_ 266 FLR2RdrDetn310To314Mode4 "What chirp mode the detection is from";
CM_ SG_ 266 FLR2RdrDetn310To314Quality0 "Quality";
CM_ SG_ 266 FLR2RdrDetn310To314Quality1 "Quality";
CM_ SG_ 266 FLR2RdrDetn310To314Quality2 "Quality";
CM_ SG_ 266 FLR2RdrDetn310To314Quality3 "Quality";
CM_ SG_ 266 FLR2RdrDetn310To314Quality4 "Quality";
CM_ SG_ 266 FLR2RdrDetn310To314Range0 "Range from sensor to object";
CM_ SG_ 266 FLR2RdrDetn310To314Range1 "Range from sensor to object";
CM_ SG_ 266 FLR2RdrDetn310To314Range2 "Range from sensor to object";
CM_ SG_ 266 FLR2RdrDetn310To314Range3 "Range from sensor to object";
CM_ SG_ 266 FLR2RdrDetn310To314Range4 "Range from sensor to object";
CM_ SG_ 266 FLR2RdrDetn310To314RCS0 "RCS";
CM_ SG_ 266 FLR2RdrDetn310To314RCS1 "RCS";
CM_ SG_ 266 FLR2RdrDetn310To314RCS2 "RCS";
CM_ SG_ 266 FLR2RdrDetn310To314RCS3 "RCS";
CM_ SG_ 266 FLR2RdrDetn310To314RCS4 "RCS";
CM_ SG_ 266 FLR2RdrDetn310To314RngRt0 "Speed towards/away from the sensor";
CM_ SG_ 266 FLR2RdrDetn310To314RngRt1 "Speed towards/away from the sensor";
CM_ SG_ 266 FLR2RdrDetn310To314RngRt2 "Speed towards/away from the sensor";
CM_ SG_ 266 FLR2RdrDetn310To314RngRt3 "Speed towards/away from the sensor";
CM_ SG_ 266 FLR2RdrDetn310To314RngRt4 "Speed towards/away from the sensor";
CM_ SG_ 266 FLR2RdrDetn310To314ScanID "Value to tie status, detection data and object data frames together";
CM_ SG_ 266 FLR2RdrDetn310To314SNR0 "Signal to Noise Ratio";
CM_ SG_ 266 FLR2RdrDetn310To314SNR1 "Signal to Noise Ration";
CM_ SG_ 266 FLR2RdrDetn310To314SNR2 "Signal to Noise Ration";
CM_ SG_ 266 FLR2RdrDetn310To314SNR3 "Signal to Noise Ration";
CM_ SG_ 266 FLR2RdrDetn310To314SNR4 "Signal to Noise Ration";
CM_ SG_ 268 FLR2RdrDetn315To319AziAng0 "Azimuth Angle";
CM_ SG_ 268 FLR2RdrDetn315To319AziAng1 "Azimuth Angle";
CM_ SG_ 268 FLR2RdrDetn315To319AziAng2 "Azimuth Angle";
CM_ SG_ 268 FLR2RdrDetn315To319AziAng3 "Azimuth Angle";
CM_ SG_ 268 FLR2RdrDetn315To319AziAng4 "Azimuth Angle";
CM_ SG_ 268 FLR2RdrDetn315To319DynPrpty0 "Moving/Stationary";
CM_ SG_ 268 FLR2RdrDetn315To319DynPrpty1 "Moving/Stationary";
CM_ SG_ 268 FLR2RdrDetn315To319DynPrpty2 "Moving/Stationary";
CM_ SG_ 268 FLR2RdrDetn315To319DynPrpty3 "Moving/Stationary";
CM_ SG_ 268 FLR2RdrDetn315To319DynPrpty4 "Moving/Stationary";
CM_ SG_ 268 FLR2RdrDetn315To319EleAng0 "Elevation angle";
CM_ SG_ 268 FLR2RdrDetn315To319EleAng1 "Elevation angle";
CM_ SG_ 268 FLR2RdrDetn315To319EleAng2 "Elevation angle";
CM_ SG_ 268 FLR2RdrDetn315To319EleAng3 "Elevation angle";
CM_ SG_ 268 FLR2RdrDetn315To319EleAng4 "Elevation angle";
CM_ SG_ 268 FLR2RdrDetn315To319Mode0 "What chirp mode the detection is from";
CM_ SG_ 268 FLR2RdrDetn315To319Mode1 "What chirp mode the detection is from";
CM_ SG_ 268 FLR2RdrDetn315To319Mode2 "What chirp mode the detection is from";
CM_ SG_ 268 FLR2RdrDetn315To319Mode3 "What chirp mode the detection is from";
CM_ SG_ 268 FLR2RdrDetn315To319Mode4 "What chirp mode the detection is from";
CM_ SG_ 268 FLR2RdrDetn315To319Quality0 "Quality";
CM_ SG_ 268 FLR2RdrDetn315To319Quality1 "Quality";
CM_ SG_ 268 FLR2RdrDetn315To319Quality2 "Quality";
CM_ SG_ 268 FLR2RdrDetn315To319Quality3 "Quality";
CM_ SG_ 268 FLR2RdrDetn315To319Quality4 "Quality";
CM_ SG_ 268 FLR2RdrDetn315To319Range0 "Range from sensor to object";
CM_ SG_ 268 FLR2RdrDetn315To319Range1 "Range from sensor to object";
CM_ SG_ 268 FLR2RdrDetn315To319Range2 "Range from sensor to object";
CM_ SG_ 268 FLR2RdrDetn315To319Range3 "Range from sensor to object";
CM_ SG_ 268 FLR2RdrDetn315To319Range4 "Range from sensor to object";
CM_ SG_ 268 FLR2RdrDetn315To319RCS0 "RCS";
CM_ SG_ 268 FLR2RdrDetn315To319RCS1 "RCS";
CM_ SG_ 268 FLR2RdrDetn315To319RCS2 "RCS";
CM_ SG_ 268 FLR2RdrDetn315To319RCS3 "RCS";
CM_ SG_ 268 FLR2RdrDetn315To319RCS4 "RCS";
CM_ SG_ 268 FLR2RdrDetn315To319RngRt0 "Speed towards/away from the sensor";
CM_ SG_ 268 FLR2RdrDetn315To319RngRt1 "Speed towards/away from the sensor";
CM_ SG_ 268 FLR2RdrDetn315To319RngRt2 "Speed towards/away from the sensor";
CM_ SG_ 268 FLR2RdrDetn315To319RngRt3 "Speed towards/away from the sensor";
CM_ SG_ 268 FLR2RdrDetn315To319RngRt4 "Speed towards/away from the sensor";
CM_ SG_ 268 FLR2RdrDetn315To319ScanID "Value to tie status, detection data and object data frames together";
CM_ SG_ 268 FLR2RdrDetn315To319SNR0 "Signal to Noise Ratio";
CM_ SG_ 268 FLR2RdrDetn315To319SNR1 "Signal to Noise Ration";
CM_ SG_ 268 FLR2RdrDetn315To319SNR2 "Signal to Noise Ration";
CM_ SG_ 268 FLR2RdrDetn315To319SNR3 "Signal to Noise Ration";
CM_ SG_ 268 FLR2RdrDetn315To319SNR4 "Signal to Noise Ration";
CM_ SG_ 270 FLR2RdrDetn320To324AziAng0 "Azimuth Angle";
CM_ SG_ 270 FLR2RdrDetn320To324AziAng1 "Azimuth Angle";
CM_ SG_ 270 FLR2RdrDetn320To324AziAng2 "Azimuth Angle";
CM_ SG_ 270 FLR2RdrDetn320To324AziAng3 "Azimuth Angle";
CM_ SG_ 270 FLR2RdrDetn320To324AziAng4 "Azimuth Angle";
CM_ SG_ 270 FLR2RdrDetn320To324DynPrpty0 "Moving/Stationary";
CM_ SG_ 270 FLR2RdrDetn320To324DynPrpty1 "Moving/Stationary";
CM_ SG_ 270 FLR2RdrDetn320To324DynPrpty2 "Moving/Stationary";
CM_ SG_ 270 FLR2RdrDetn320To324DynPrpty3 "Moving/Stationary";
CM_ SG_ 270 FLR2RdrDetn320To324DynPrpty4 "Moving/Stationary";
CM_ SG_ 270 FLR2RdrDetn320To324EleAng0 "Elevation angle";
CM_ SG_ 270 FLR2RdrDetn320To324EleAng1 "Elevation angle";
CM_ SG_ 270 FLR2RdrDetn320To324EleAng2 "Elevation angle";
CM_ SG_ 270 FLR2RdrDetn320To324EleAng3 "Elevation angle";
CM_ SG_ 270 FLR2RdrDetn320To324EleAng4 "Elevation angle";
CM_ SG_ 270 FLR2RdrDetn320To324Mode0 "What chirp mode the detection is from";
CM_ SG_ 270 FLR2RdrDetn320To324Mode1 "What chirp mode the detection is from";
CM_ SG_ 270 FLR2RdrDetn320To324Mode2 "What chirp mode the detection is from";
CM_ SG_ 270 FLR2RdrDetn320To324Mode3 "What chirp mode the detection is from";
CM_ SG_ 270 FLR2RdrDetn320To324Mode4 "What chirp mode the detection is from";
CM_ SG_ 270 FLR2RdrDetn320To324Quality0 "Quality";
CM_ SG_ 270 FLR2RdrDetn320To324Quality1 "Quality";
CM_ SG_ 270 FLR2RdrDetn320To324Quality2 "Quality";
CM_ SG_ 270 FLR2RdrDetn320To324Quality3 "Quality";
CM_ SG_ 270 FLR2RdrDetn320To324Quality4 "Quality";
CM_ SG_ 270 FLR2RdrDetn320To324Range0 "Range from sensor to object";
CM_ SG_ 270 FLR2RdrDetn320To324Range1 "Range from sensor to object";
CM_ SG_ 270 FLR2RdrDetn320To324Range2 "Range from sensor to object";
CM_ SG_ 270 FLR2RdrDetn320To324Range3 "Range from sensor to object";
CM_ SG_ 270 FLR2RdrDetn320To324Range4 "Range from sensor to object";
CM_ SG_ 270 FLR2RdrDetn320To324RCS0 "RCS";
CM_ SG_ 270 FLR2RdrDetn320To324RCS1 "RCS";
CM_ SG_ 270 FLR2RdrDetn320To324RCS2 "RCS";
CM_ SG_ 270 FLR2RdrDetn320To324RCS3 "RCS";
CM_ SG_ 270 FLR2RdrDetn320To324RCS4 "RCS";
CM_ SG_ 270 FLR2RdrDetn320To324RngRt0 "Speed towards/away from the sensor";
CM_ SG_ 270 FLR2RdrDetn320To324RngRt1 "Speed towards/away from the sensor";
CM_ SG_ 270 FLR2RdrDetn320To324RngRt2 "Speed towards/away from the sensor";
CM_ SG_ 270 FLR2RdrDetn320To324RngRt3 "Speed towards/away from the sensor";
CM_ SG_ 270 FLR2RdrDetn320To324RngRt4 "Speed towards/away from the sensor";
CM_ SG_ 270 FLR2RdrDetn320To324ScanID "Value to tie status, detection data and object data frames together";
CM_ SG_ 270 FLR2RdrDetn320To324SNR0 "Signal to Noise Ratio";
CM_ SG_ 270 FLR2RdrDetn320To324SNR1 "Signal to Noise Ration";
CM_ SG_ 270 FLR2RdrDetn320To324SNR2 "Signal to Noise Ration";
CM_ SG_ 270 FLR2RdrDetn320To324SNR3 "Signal to Noise Ration";
CM_ SG_ 270 FLR2RdrDetn320To324SNR4 "Signal to Noise Ration";
CM_ SG_ 272 FLR2RdrDetn325To329AziAng0 "Azimuth Angle";
CM_ SG_ 272 FLR2RdrDetn325To329AziAng1 "Azimuth Angle";
CM_ SG_ 272 FLR2RdrDetn325To329AziAng2 "Azimuth Angle";
CM_ SG_ 272 FLR2RdrDetn325To329AziAng3 "Azimuth Angle";
CM_ SG_ 272 FLR2RdrDetn325To329AziAng4 "Azimuth Angle";
CM_ SG_ 272 FLR2RdrDetn325To329DynPrpty0 "Moving/Stationary";
CM_ SG_ 272 FLR2RdrDetn325To329DynPrpty1 "Moving/Stationary";
CM_ SG_ 272 FLR2RdrDetn325To329DynPrpty2 "Moving/Stationary";
CM_ SG_ 272 FLR2RdrDetn325To329DynPrpty3 "Moving/Stationary";
CM_ SG_ 272 FLR2RdrDetn325To329DynPrpty4 "Moving/Stationary";
CM_ SG_ 272 FLR2RdrDetn325To329EleAng0 "Elevation angle";
CM_ SG_ 272 FLR2RdrDetn325To329EleAng1 "Elevation angle";
CM_ SG_ 272 FLR2RdrDetn325To329EleAng2 "Elevation angle";
CM_ SG_ 272 FLR2RdrDetn325To329EleAng3 "Elevation angle";
CM_ SG_ 272 FLR2RdrDetn325To329EleAng4 "Elevation angle";
CM_ SG_ 272 FLR2RdrDetn325To329Mode0 "What chirp mode the detection is from";
CM_ SG_ 272 FLR2RdrDetn325To329Mode1 "What chirp mode the detection is from";
CM_ SG_ 272 FLR2RdrDetn325To329Mode2 "What chirp mode the detection is from";
CM_ SG_ 272 FLR2RdrDetn325To329Mode3 "What chirp mode the detection is from";
CM_ SG_ 272 FLR2RdrDetn325To329Mode4 "What chirp mode the detection is from";
CM_ SG_ 272 FLR2RdrDetn325To329Quality0 "Quality";
CM_ SG_ 272 FLR2RdrDetn325To329Quality1 "Quality";
CM_ SG_ 272 FLR2RdrDetn325To329Quality2 "Quality";
CM_ SG_ 272 FLR2RdrDetn325To329Quality3 "Quality";
CM_ SG_ 272 FLR2RdrDetn325To329Quality4 "Quality";
CM_ SG_ 272 FLR2RdrDetn325To329Range0 "Range from sensor to object";
CM_ SG_ 272 FLR2RdrDetn325To329Range1 "Range from sensor to object";
CM_ SG_ 272 FLR2RdrDetn325To329Range2 "Range from sensor to object";
CM_ SG_ 272 FLR2RdrDetn325To329Range3 "Range from sensor to object";
CM_ SG_ 272 FLR2RdrDetn325To329Range4 "Range from sensor to object";
CM_ SG_ 272 FLR2RdrDetn325To329RCS0 "RCS";
CM_ SG_ 272 FLR2RdrDetn325To329RCS1 "RCS";
CM_ SG_ 272 FLR2RdrDetn325To329RCS2 "RCS";
CM_ SG_ 272 FLR2RdrDetn325To329RCS3 "RCS";
CM_ SG_ 272 FLR2RdrDetn325To329RCS4 "RCS";
CM_ SG_ 272 FLR2RdrDetn325To329RngRt0 "Speed towards/away from the sensor";
CM_ SG_ 272 FLR2RdrDetn325To329RngRt1 "Speed towards/away from the sensor";
CM_ SG_ 272 FLR2RdrDetn325To329RngRt2 "Speed towards/away from the sensor";
CM_ SG_ 272 FLR2RdrDetn325To329RngRt3 "Speed towards/away from the sensor";
CM_ SG_ 272 FLR2RdrDetn325To329RngRt4 "Speed towards/away from the sensor";
CM_ SG_ 272 FLR2RdrDetn325To329ScanID "Value to tie status, detection data and object data frames together";
CM_ SG_ 272 FLR2RdrDetn325To329SNR0 "Signal to Noise Ratio";
CM_ SG_ 272 FLR2RdrDetn325To329SNR1 "Signal to Noise Ration";
CM_ SG_ 272 FLR2RdrDetn325To329SNR2 "Signal to Noise Ration";
CM_ SG_ 272 FLR2RdrDetn325To329SNR3 "Signal to Noise Ration";
CM_ SG_ 272 FLR2RdrDetn325To329SNR4 "Signal to Noise Ration";
CM_ SG_ 274 FLR2RdrDetn330To334AziAng0 "Azimuth Angle";
CM_ SG_ 274 FLR2RdrDetn330To334AziAng1 "Azimuth Angle";
CM_ SG_ 274 FLR2RdrDetn330To334AziAng2 "Azimuth Angle";
CM_ SG_ 274 FLR2RdrDetn330To334AziAng3 "Azimuth Angle";
CM_ SG_ 274 FLR2RdrDetn330To334AziAng4 "Azimuth Angle";
CM_ SG_ 274 FLR2RdrDetn330To334DynPrpty0 "Moving/Stationary";
CM_ SG_ 274 FLR2RdrDetn330To334DynPrpty1 "Moving/Stationary";
CM_ SG_ 274 FLR2RdrDetn330To334DynPrpty2 "Moving/Stationary";
CM_ SG_ 274 FLR2RdrDetn330To334DynPrpty3 "Moving/Stationary";
CM_ SG_ 274 FLR2RdrDetn330To334DynPrpty4 "Moving/Stationary";
CM_ SG_ 274 FLR2RdrDetn330To334EleAng0 "Elevation angle";
CM_ SG_ 274 FLR2RdrDetn330To334EleAng1 "Elevation angle";
CM_ SG_ 274 FLR2RdrDetn330To334EleAng2 "Elevation angle";
CM_ SG_ 274 FLR2RdrDetn330To334EleAng3 "Elevation angle";
CM_ SG_ 274 FLR2RdrDetn330To334EleAng4 "Elevation angle";
CM_ SG_ 274 FLR2RdrDetn330To334Mode0 "What chirp mode the detection is from";
CM_ SG_ 274 FLR2RdrDetn330To334Mode1 "What chirp mode the detection is from";
CM_ SG_ 274 FLR2RdrDetn330To334Mode2 "What chirp mode the detection is from";
CM_ SG_ 274 FLR2RdrDetn330To334Mode3 "What chirp mode the detection is from";
CM_ SG_ 274 FLR2RdrDetn330To334Mode4 "What chirp mode the detection is from";
CM_ SG_ 274 FLR2RdrDetn330To334Quality0 "Quality";
CM_ SG_ 274 FLR2RdrDetn330To334Quality1 "Quality";
CM_ SG_ 274 FLR2RdrDetn330To334Quality2 "Quality";
CM_ SG_ 274 FLR2RdrDetn330To334Quality3 "Quality";
CM_ SG_ 274 FLR2RdrDetn330To334Quality4 "Quality";
CM_ SG_ 274 FLR2RdrDetn330To334Range0 "Range from sensor to object";
CM_ SG_ 274 FLR2RdrDetn330To334Range1 "Range from sensor to object";
CM_ SG_ 274 FLR2RdrDetn330To334Range2 "Range from sensor to object";
CM_ SG_ 274 FLR2RdrDetn330To334Range3 "Range from sensor to object";
CM_ SG_ 274 FLR2RdrDetn330To334Range4 "Range from sensor to object";
CM_ SG_ 274 FLR2RdrDetn330To334RCS0 "RCS";
CM_ SG_ 274 FLR2RdrDetn330To334RCS1 "RCS";
CM_ SG_ 274 FLR2RdrDetn330To334RCS2 "RCS";
CM_ SG_ 274 FLR2RdrDetn330To334RCS3 "RCS";
CM_ SG_ 274 FLR2RdrDetn330To334RCS4 "RCS";
CM_ SG_ 274 FLR2RdrDetn330To334RngRt0 "Speed towards/away from the sensor";
CM_ SG_ 274 FLR2RdrDetn330To334RngRt1 "Speed towards/away from the sensor";
CM_ SG_ 274 FLR2RdrDetn330To334RngRt2 "Speed towards/away from the sensor";
CM_ SG_ 274 FLR2RdrDetn330To334RngRt3 "Speed towards/away from the sensor";
CM_ SG_ 274 FLR2RdrDetn330To334RngRt4 "Speed towards/away from the sensor";
CM_ SG_ 274 FLR2RdrDetn330To334ScanID "Value to tie status, detection data and object data frames together";
CM_ SG_ 274 FLR2RdrDetn330To334SNR0 "Signal to Noise Ratio";
CM_ SG_ 274 FLR2RdrDetn330To334SNR1 "Signal to Noise Ration";
CM_ SG_ 274 FLR2RdrDetn330To334SNR2 "Signal to Noise Ration";
CM_ SG_ 274 FLR2RdrDetn330To334SNR3 "Signal to Noise Ration";
CM_ SG_ 274 FLR2RdrDetn330To334SNR4 "Signal to Noise Ration";
CM_ SG_ 276 FLR2RdrDetn335To339AziAng0 "Azimuth Angle";
CM_ SG_ 276 FLR2RdrDetn335To339AziAng1 "Azimuth Angle";
CM_ SG_ 276 FLR2RdrDetn335To339AziAng2 "Azimuth Angle";
CM_ SG_ 276 FLR2RdrDetn335To339AziAng3 "Azimuth Angle";
CM_ SG_ 276 FLR2RdrDetn335To339AziAng4 "Azimuth Angle";
CM_ SG_ 276 FLR2RdrDetn335To339DynPrpty0 "Moving/Stationary";
CM_ SG_ 276 FLR2RdrDetn335To339DynPrpty1 "Moving/Stationary";
CM_ SG_ 276 FLR2RdrDetn335To339DynPrpty2 "Moving/Stationary";
CM_ SG_ 276 FLR2RdrDetn335To339DynPrpty3 "Moving/Stationary";
CM_ SG_ 276 FLR2RdrDetn335To339DynPrpty4 "Moving/Stationary";
CM_ SG_ 276 FLR2RdrDetn335To339EleAng0 "Elevation angle";
CM_ SG_ 276 FLR2RdrDetn335To339EleAng1 "Elevation angle";
CM_ SG_ 276 FLR2RdrDetn335To339EleAng2 "Elevation angle";
CM_ SG_ 276 FLR2RdrDetn335To339EleAng3 "Elevation angle";
CM_ SG_ 276 FLR2RdrDetn335To339EleAng4 "Elevation angle";
CM_ SG_ 276 FLR2RdrDetn335To339Mode0 "What chirp mode the detection is from";
CM_ SG_ 276 FLR2RdrDetn335To339Mode1 "What chirp mode the detection is from";
CM_ SG_ 276 FLR2RdrDetn335To339Mode2 "What chirp mode the detection is from";
CM_ SG_ 276 FLR2RdrDetn335To339Mode3 "What chirp mode the detection is from";
CM_ SG_ 276 FLR2RdrDetn335To339Mode4 "What chirp mode the detection is from";
CM_ SG_ 276 FLR2RdrDetn335To339Quality0 "Quality";
CM_ SG_ 276 FLR2RdrDetn335To339Quality1 "Quality";
CM_ SG_ 276 FLR2RdrDetn335To339Quality2 "Quality";
CM_ SG_ 276 FLR2RdrDetn335To339Quality3 "Quality";
CM_ SG_ 276 FLR2RdrDetn335To339Quality4 "Quality";
CM_ SG_ 276 FLR2RdrDetn335To339Range0 "Range from sensor to object";
CM_ SG_ 276 FLR2RdrDetn335To339Range1 "Range from sensor to object";
CM_ SG_ 276 FLR2RdrDetn335To339Range2 "Range from sensor to object";
CM_ SG_ 276 FLR2RdrDetn335To339Range3 "Range from sensor to object";
CM_ SG_ 276 FLR2RdrDetn335To339Range4 "Range from sensor to object";
CM_ SG_ 276 FLR2RdrDetn335To339RCS0 "RCS";
CM_ SG_ 276 FLR2RdrDetn335To339RCS1 "RCS";
CM_ SG_ 276 FLR2RdrDetn335To339RCS2 "RCS";
CM_ SG_ 276 FLR2RdrDetn335To339RCS3 "RCS";
CM_ SG_ 276 FLR2RdrDetn335To339RCS4 "RCS";
CM_ SG_ 276 FLR2RdrDetn335To339RngRt0 "Speed towards/away from the sensor";
CM_ SG_ 276 FLR2RdrDetn335To339RngRt1 "Speed towards/away from the sensor";
CM_ SG_ 276 FLR2RdrDetn335To339RngRt2 "Speed towards/away from the sensor";
CM_ SG_ 276 FLR2RdrDetn335To339RngRt3 "Speed towards/away from the sensor";
CM_ SG_ 276 FLR2RdrDetn335To339RngRt4 "Speed towards/away from the sensor";
CM_ SG_ 276 FLR2RdrDetn335To339ScanID "Value to tie status, detection data and object data frames together";
CM_ SG_ 276 FLR2RdrDetn335To339SNR0 "Signal to Noise Ratio";
CM_ SG_ 276 FLR2RdrDetn335To339SNR1 "Signal to Noise Ration";
CM_ SG_ 276 FLR2RdrDetn335To339SNR2 "Signal to Noise Ration";
CM_ SG_ 276 FLR2RdrDetn335To339SNR3 "Signal to Noise Ration";
CM_ SG_ 276 FLR2RdrDetn335To339SNR4 "Signal to Noise Ration";
BA_DEF_ BO_ "CANFD_BRS" ENUM "0","1";
BA_DEF_ BO_ "GenMsgCycleTime" INT 0 65536; // [ms]
BA_DEF_ BO_ "GenMsgDelayTime" INT 0 65536; // [ms]
BA_DEF_ BO_ "GenMsgSendType" ENUM "cyclic", "spontaneous", "not-used", "not-used", "not-used", "cyclicAndSpontaneous", "not-used", "cyclicIfActive", "NoMsgSendType"; // [us]
BA_DEF_ BO_ "GenMsgStartDelayTime" INT 0 65536; // [ms]
BA_DEF_ BO_ "VFrameFormat" ENUM "StandardCAN","ExtendedCAN","reserved","J1939PG","reserved","reserved","reserved","reserved","reserved","reserved","reserved","reserved","reserved","reserved","StandardCAN_FD","ExtendedCAN_FD";
BA_DEF_ SG_ "GenSigSendType" ENUM "Cyclic","OnWrite","OnWriteWithRepetition","OnChange","OnChangeWithRepetition","IfActive","IfActiveWithRepetition","NoSigSendType";
BA_DEF_ SG_ "GenSigStartValue" HEX 0 80000000;
BA_DEF_ BO_ "GenMsgILSupport" ENUM "No","Yes";
BA_DEF_ BO_ "NmAsrMessage" ENUM "No","Yes";
BA_DEF_ SG_ "GenSigFuncType" ENUM "NoFunction","n/a","n/a","n/a","n/a","n/a","n/a","n/a","n/a","n/a","n/a","n/a","n/a","n/a","n/a","CHK","CNTR","n/a","n/a","n/a","CNTR_AR_01","CRC_AR_01_BOTH","CRC_AR_01_ALT","CRC_AR_01_LOW","CRC_AR_01_NIBBLE","CNTR_AR_04","CRC_AR_04A","CNTR_AR_05","CRC_AR_05";
BA_DEF_ SG_ "GenSigDataID" STRING;
BA_DEF_DEF_ "CANFD_BRS" "1";
BA_DEF_DEF_ "GenSigStartValue" 0;
BA_DEF_DEF_ "VFrameFormat" "J1939PG";
BA_DEF_DEF_ "GenSigSendType" "NoSigSendType";
BA_DEF_DEF_ "GenMsgCycleTime" 0;
BA_DEF_DEF_ "GenMsgDelayTime" 0;
BA_DEF_DEF_ "GenMsgStartDelayTime" 0;
BA_DEF_DEF_ "GenMsgSendType" "NoMsgSendType";
BA_DEF_DEF_ "GenMsgILSupport" "Yes";
BA_DEF_DEF_ "NmAsrMessage" "No";
BA_DEF_DEF_ "GenSigFuncType" "NoFunction";
BA_DEF_DEF_ "GenSigDataID" "";
// Frame: FlrFlr1canFr55
BA_ "GenMsgDelayTime" BO_ 250 40.000;
BA_ "GenMsgSendType" BO_ 250 1;
BA_ "VFrameFormat" BO_ 250 14;
// Frame: FlrFlr1canFr56
BA_ "GenMsgDelayTime" BO_ 252 40.000;
BA_ "GenMsgSendType" BO_ 252 1;
BA_ "VFrameFormat" BO_ 252 14;
// Frame: FlrFlr1canFr57
BA_ "GenMsgDelayTime" BO_ 254 40.000;
BA_ "GenMsgSendType" BO_ 254 1;
BA_ "VFrameFormat" BO_ 254 14;
// Frame: FlrFlr1canFr58
BA_ "GenMsgDelayTime" BO_ 256 40.000;
BA_ "GenMsgSendType" BO_ 256 1;
BA_ "VFrameFormat" BO_ 256 14;
// Frame: FlrFlr1canFr59
BA_ "GenMsgDelayTime" BO_ 258 40.000;
BA_ "GenMsgSendType" BO_ 258 1;
BA_ "VFrameFormat" BO_ 258 14;
// Frame: FlrFlr1canFr60
BA_ "GenMsgDelayTime" BO_ 260 40.000;
BA_ "GenMsgSendType" BO_ 260 1;
BA_ "VFrameFormat" BO_ 260 14;
// Frame: FlrFlr1canFr61
BA_ "GenMsgDelayTime" BO_ 262 40.000;
BA_ "GenMsgSendType" BO_ 262 1;
BA_ "VFrameFormat" BO_ 262 14;
// Frame: FlrFlr1canFr62
BA_ "GenMsgDelayTime" BO_ 264 40.000;
BA_ "GenMsgSendType" BO_ 264 1;
BA_ "VFrameFormat" BO_ 264 14;
// Frame: FlrFlr1canFr63
BA_ "GenMsgDelayTime" BO_ 266 40.000;
BA_ "GenMsgSendType" BO_ 266 1;
BA_ "VFrameFormat" BO_ 266 14;
// Frame: FlrFlr1canFr64
BA_ "GenMsgDelayTime" BO_ 268 40.000;
BA_ "GenMsgSendType" BO_ 268 1;
BA_ "VFrameFormat" BO_ 268 14;
// Frame: FlrFlr1canFr65
BA_ "GenMsgDelayTime" BO_ 270 40.000;
BA_ "GenMsgSendType" BO_ 270 1;
BA_ "VFrameFormat" BO_ 270 14;
// Frame: FlrFlr1canFr66
BA_ "GenMsgDelayTime" BO_ 272 40.000;
BA_ "GenMsgSendType" BO_ 272 1;
BA_ "VFrameFormat" BO_ 272 14;
// Frame: FlrFlr1canFr67
BA_ "GenMsgDelayTime" BO_ 274 40.000;
BA_ "GenMsgSendType" BO_ 274 1;
BA_ "VFrameFormat" BO_ 274 14;
// Frame: FlrFlr1canFr68
BA_ "GenMsgDelayTime" BO_ 276 40.000;
BA_ "GenMsgSendType" BO_ 276 1;
BA_ "VFrameFormat" BO_ 276 14;
BA_ "GenSigSendType" SG_ 250 FLR2RdrDetn270To274AziAng0 1;
BA_ "GenSigSendType" SG_ 250 FLR2RdrDetn270To274AziAng1 1;
BA_ "GenSigSendType" SG_ 250 FLR2RdrDetn270To274AziAng2 1;
BA_ "GenSigSendType" SG_ 250 FLR2RdrDetn270To274AziAng3 1;
BA_ "GenSigSendType" SG_ 250 FLR2RdrDetn270To274AziAng4 1;
BA_ "GenSigDataID" SG_ 250 FLR2RdrDetn270To274CRC "0xAEF";
BA_ "GenSigFuncType" SG_ 250 FLR2RdrDetn270To274CRC 28;
BA_ "GenSigSendType" SG_ 250 FLR2RdrDetn270To274CRC 1;
BA_ "GenSigFuncType" SG_ 250 FLR2RdrDetn270To274Counter 27;
BA_ "GenSigSendType" SG_ 250 FLR2RdrDetn270To274Counter 1;
BA_ "GenSigSendType" SG_ 250 FLR2RdrDetn270To274DynPrpty0 1;
BA_ "GenSigSendType" SG_ 250 FLR2RdrDetn270To274DynPrpty1 1;
BA_ "GenSigSendType" SG_ 250 FLR2RdrDetn270To274DynPrpty2 1;
BA_ "GenSigSendType" SG_ 250 FLR2RdrDetn270To274DynPrpty3 1;
BA_ "GenSigSendType" SG_ 250 FLR2RdrDetn270To274DynPrpty4 1;
BA_ "GenSigSendType" SG_ 250 FLR2RdrDetn270To274EleAng0 1;
BA_ "GenSigSendType" SG_ 250 FLR2RdrDetn270To274EleAng1 1;
BA_ "GenSigSendType" SG_ 250 FLR2RdrDetn270To274EleAng2 1;
BA_ "GenSigSendType" SG_ 250 FLR2RdrDetn270To274EleAng3 1;
BA_ "GenSigSendType" SG_ 250 FLR2RdrDetn270To274EleAng4 1;
BA_ "GenSigSendType" SG_ 250 FLR2RdrDetn270To274Mode0 1;
BA_ "GenSigSendType" SG_ 250 FLR2RdrDetn270To274Mode1 1;
BA_ "GenSigSendType" SG_ 250 FLR2RdrDetn270To274Mode2 1;
BA_ "GenSigSendType" SG_ 250 FLR2RdrDetn270To274Mode3 1;
BA_ "GenSigSendType" SG_ 250 FLR2RdrDetn270To274Mode4 1;
BA_ "GenSigSendType" SG_ 250 FLR2RdrDetn270To274Quality0 1;
BA_ "GenSigSendType" SG_ 250 FLR2RdrDetn270To274Quality1 1;
BA_ "GenSigSendType" SG_ 250 FLR2RdrDetn270To274Quality2 1;
BA_ "GenSigSendType" SG_ 250 FLR2RdrDetn270To274Quality3 1;
BA_ "GenSigSendType" SG_ 250 FLR2RdrDetn270To274Quality4 1;
BA_ "GenSigSendType" SG_ 250 FLR2RdrDetn270To274RCS0 1;
BA_ "GenSigStartValue" SG_ 250 FLR2RdrDetn270To274RCS0 500;
BA_ "GenSigSendType" SG_ 250 FLR2RdrDetn270To274RCS1 1;
BA_ "GenSigStartValue" SG_ 250 FLR2RdrDetn270To274RCS1 500;
BA_ "GenSigSendType" SG_ 250 FLR2RdrDetn270To274RCS2 1;
BA_ "GenSigStartValue" SG_ 250 FLR2RdrDetn270To274RCS2 500;
BA_ "GenSigSendType" SG_ 250 FLR2RdrDetn270To274RCS3 1;
BA_ "GenSigStartValue" SG_ 250 FLR2RdrDetn270To274RCS3 500;
BA_ "GenSigSendType" SG_ 250 FLR2RdrDetn270To274RCS4 1;
BA_ "GenSigStartValue" SG_ 250 FLR2RdrDetn270To274RCS4 500;
BA_ "GenSigSendType" SG_ 250 FLR2RdrDetn270To274Range0 1;
BA_ "GenSigSendType" SG_ 250 FLR2RdrDetn270To274Range1 1;
BA_ "GenSigSendType" SG_ 250 FLR2RdrDetn270To274Range2 1;
BA_ "GenSigSendType" SG_ 250 FLR2RdrDetn270To274Range3 1;
BA_ "GenSigSendType" SG_ 250 FLR2RdrDetn270To274Range4 1;
BA_ "GenSigSendType" SG_ 250 FLR2RdrDetn270To274RngRt0 1;
BA_ "GenSigStartValue" SG_ 250 FLR2RdrDetn270To274RngRt0 1111;
BA_ "GenSigSendType" SG_ 250 FLR2RdrDetn270To274RngRt1 1;
BA_ "GenSigStartValue" SG_ 250 FLR2RdrDetn270To274RngRt1 1111;
BA_ "GenSigSendType" SG_ 250 FLR2RdrDetn270To274RngRt2 1;
BA_ "GenSigStartValue" SG_ 250 FLR2RdrDetn270To274RngRt2 1111;
BA_ "GenSigSendType" SG_ 250 FLR2RdrDetn270To274RngRt3 1;
BA_ "GenSigStartValue" SG_ 250 FLR2RdrDetn270To274RngRt3 1111;
BA_ "GenSigSendType" SG_ 250 FLR2RdrDetn270To274RngRt4 1;
BA_ "GenSigStartValue" SG_ 250 FLR2RdrDetn270To274RngRt4 1111;
BA_ "GenSigSendType" SG_ 250 FLR2RdrDetn270To274SNR0 1;
BA_ "GenSigSendType" SG_ 250 FLR2RdrDetn270To274SNR1 1;
BA_ "GenSigSendType" SG_ 250 FLR2RdrDetn270To274SNR2 1;
BA_ "GenSigSendType" SG_ 250 FLR2RdrDetn270To274SNR3 1;
BA_ "GenSigSendType" SG_ 250 FLR2RdrDetn270To274SNR4 1;
BA_ "GenSigSendType" SG_ 250 FLR2RdrDetn270To274ScanID 1;
BA_ "GenSigSendType" SG_ 252 FLR2RdrDetn275To279AziAng0 1;
BA_ "GenSigSendType" SG_ 252 FLR2RdrDetn275To279AziAng1 1;
BA_ "GenSigSendType" SG_ 252 FLR2RdrDetn275To279AziAng2 1;
BA_ "GenSigSendType" SG_ 252 FLR2RdrDetn275To279AziAng3 1;
BA_ "GenSigSendType" SG_ 252 FLR2RdrDetn275To279AziAng4 1;
BA_ "GenSigDataID" SG_ 252 FLR2RdrDetn275To279CRC "0xAF0";
BA_ "GenSigFuncType" SG_ 252 FLR2RdrDetn275To279CRC 28;
BA_ "GenSigSendType" SG_ 252 FLR2RdrDetn275To279CRC 1;
BA_ "GenSigFuncType" SG_ 252 FLR2RdrDetn275To279Counter 27;
BA_ "GenSigSendType" SG_ 252 FLR2RdrDetn275To279Counter 1;
BA_ "GenSigSendType" SG_ 252 FLR2RdrDetn275To279DynPrpty0 1;
BA_ "GenSigSendType" SG_ 252 FLR2RdrDetn275To279DynPrpty1 1;
BA_ "GenSigSendType" SG_ 252 FLR2RdrDetn275To279DynPrpty2 1;
BA_ "GenSigSendType" SG_ 252 FLR2RdrDetn275To279DynPrpty3 1;
BA_ "GenSigSendType" SG_ 252 FLR2RdrDetn275To279DynPrpty4 1;
BA_ "GenSigSendType" SG_ 252 FLR2RdrDetn275To279EleAng0 1;
BA_ "GenSigSendType" SG_ 252 FLR2RdrDetn275To279EleAng1 1;
BA_ "GenSigSendType" SG_ 252 FLR2RdrDetn275To279EleAng2 1;
BA_ "GenSigSendType" SG_ 252 FLR2RdrDetn275To279EleAng3 1;
BA_ "GenSigSendType" SG_ 252 FLR2RdrDetn275To279EleAng4 1;
BA_ "GenSigSendType" SG_ 252 FLR2RdrDetn275To279Mode0 1;
BA_ "GenSigSendType" SG_ 252 FLR2RdrDetn275To279Mode1 1;
BA_ "GenSigSendType" SG_ 252 FLR2RdrDetn275To279Mode2 1;
BA_ "GenSigSendType" SG_ 252 FLR2RdrDetn275To279Mode3 1;
BA_ "GenSigSendType" SG_ 252 FLR2RdrDetn275To279Mode4 1;
BA_ "GenSigSendType" SG_ 252 FLR2RdrDetn275To279Quality0 1;
BA_ "GenSigSendType" SG_ 252 FLR2RdrDetn275To279Quality1 1;
BA_ "GenSigSendType" SG_ 252 FLR2RdrDetn275To279Quality2 1;
BA_ "GenSigSendType" SG_ 252 FLR2RdrDetn275To279Quality3 1;
BA_ "GenSigSendType" SG_ 252 FLR2RdrDetn275To279Quality4 1;
BA_ "GenSigSendType" SG_ 252 FLR2RdrDetn275To279RCS0 1;
BA_ "GenSigStartValue" SG_ 252 FLR2RdrDetn275To279RCS0 500;
BA_ "GenSigSendType" SG_ 252 FLR2RdrDetn275To279RCS1 1;
BA_ "GenSigStartValue" SG_ 252 FLR2RdrDetn275To279RCS1 500;
BA_ "GenSigSendType" SG_ 252 FLR2RdrDetn275To279RCS2 1;
BA_ "GenSigStartValue" SG_ 252 FLR2RdrDetn275To279RCS2 500;
BA_ "GenSigSendType" SG_ 252 FLR2RdrDetn275To279RCS3 1;
BA_ "GenSigStartValue" SG_ 252 FLR2RdrDetn275To279RCS3 500;
BA_ "GenSigSendType" SG_ 252 FLR2RdrDetn275To279RCS4 1;
BA_ "GenSigStartValue" SG_ 252 FLR2RdrDetn275To279RCS4 500;
BA_ "GenSigSendType" SG_ 252 FLR2RdrDetn275To279Range0 1;
BA_ "GenSigSendType" SG_ 252 FLR2RdrDetn275To279Range1 1;
BA_ "GenSigSendType" SG_ 252 FLR2RdrDetn275To279Range2 1;
BA_ "GenSigSendType" SG_ 252 FLR2RdrDetn275To279Range3 1;
BA_ "GenSigSendType" SG_ 252 FLR2RdrDetn275To279Range4 1;
BA_ "GenSigSendType" SG_ 252 FLR2RdrDetn275To279RngRt0 1;
BA_ "GenSigStartValue" SG_ 252 FLR2RdrDetn275To279RngRt0 1111;
BA_ "GenSigSendType" SG_ 252 FLR2RdrDetn275To279RngRt1 1;
BA_ "GenSigStartValue" SG_ 252 FLR2RdrDetn275To279RngRt1 1111;
BA_ "GenSigSendType" SG_ 252 FLR2RdrDetn275To279RngRt2 1;
BA_ "GenSigStartValue" SG_ 252 FLR2RdrDetn275To279RngRt2 1111;
BA_ "GenSigSendType" SG_ 252 FLR2RdrDetn275To279RngRt3 1;
BA_ "GenSigStartValue" SG_ 252 FLR2RdrDetn275To279RngRt3 1111;
BA_ "GenSigSendType" SG_ 252 FLR2RdrDetn275To279RngRt4 1;
BA_ "GenSigStartValue" SG_ 252 FLR2RdrDetn275To279RngRt4 1111;
BA_ "GenSigSendType" SG_ 252 FLR2RdrDetn275To279SNR0 1;
BA_ "GenSigSendType" SG_ 252 FLR2RdrDetn275To279SNR1 1;
BA_ "GenSigSendType" SG_ 252 FLR2RdrDetn275To279SNR2 1;
BA_ "GenSigSendType" SG_ 252 FLR2RdrDetn275To279SNR3 1;
BA_ "GenSigSendType" SG_ 252 FLR2RdrDetn275To279SNR4 1;
BA_ "GenSigSendType" SG_ 252 FLR2RdrDetn275To279ScanID 1;
BA_ "GenSigSendType" SG_ 254 FLR2RdrDetn280To284AziAng0 1;
BA_ "GenSigSendType" SG_ 254 FLR2RdrDetn280To284AziAng1 1;
BA_ "GenSigSendType" SG_ 254 FLR2RdrDetn280To284AziAng2 1;
BA_ "GenSigSendType" SG_ 254 FLR2RdrDetn280To284AziAng3 1;
BA_ "GenSigSendType" SG_ 254 FLR2RdrDetn280To284AziAng4 1;
BA_ "GenSigDataID" SG_ 254 FLR2RdrDetn280To284CRC "0xAF1";
BA_ "GenSigFuncType" SG_ 254 FLR2RdrDetn280To284CRC 28;
BA_ "GenSigSendType" SG_ 254 FLR2RdrDetn280To284CRC 1;
BA_ "GenSigFuncType" SG_ 254 FLR2RdrDetn280To284Counter 27;
BA_ "GenSigSendType" SG_ 254 FLR2RdrDetn280To284Counter 1;
BA_ "GenSigSendType" SG_ 254 FLR2RdrDetn280To284DynPrpty0 1;
BA_ "GenSigSendType" SG_ 254 FLR2RdrDetn280To284DynPrpty1 1;
BA_ "GenSigSendType" SG_ 254 FLR2RdrDetn280To284DynPrpty2 1;
BA_ "GenSigSendType" SG_ 254 FLR2RdrDetn280To284DynPrpty3 1;
BA_ "GenSigSendType" SG_ 254 FLR2RdrDetn280To284DynPrpty4 1;
BA_ "GenSigSendType" SG_ 254 FLR2RdrDetn280To284EleAng0 1;
BA_ "GenSigSendType" SG_ 254 FLR2RdrDetn280To284EleAng1 1;
BA_ "GenSigSendType" SG_ 254 FLR2RdrDetn280To284EleAng2 1;
BA_ "GenSigSendType" SG_ 254 FLR2RdrDetn280To284EleAng3 1;
BA_ "GenSigSendType" SG_ 254 FLR2RdrDetn280To284EleAng4 1;
BA_ "GenSigSendType" SG_ 254 FLR2RdrDetn280To284Mode0 1;
BA_ "GenSigSendType" SG_ 254 FLR2RdrDetn280To284Mode1 1;
BA_ "GenSigSendType" SG_ 254 FLR2RdrDetn280To284Mode2 1;
BA_ "GenSigSendType" SG_ 254 FLR2RdrDetn280To284Mode3 1;
BA_ "GenSigSendType" SG_ 254 FLR2RdrDetn280To284Mode4 1;
BA_ "GenSigSendType" SG_ 254 FLR2RdrDetn280To284Quality0 1;
BA_ "GenSigSendType" SG_ 254 FLR2RdrDetn280To284Quality1 1;
BA_ "GenSigSendType" SG_ 254 FLR2RdrDetn280To284Quality2 1;
BA_ "GenSigSendType" SG_ 254 FLR2RdrDetn280To284Quality3 1;
BA_ "GenSigSendType" SG_ 254 FLR2RdrDetn280To284Quality4 1;
BA_ "GenSigSendType" SG_ 254 FLR2RdrDetn280To284RCS0 1;
BA_ "GenSigStartValue" SG_ 254 FLR2RdrDetn280To284RCS0 500;
BA_ "GenSigSendType" SG_ 254 FLR2RdrDetn280To284RCS1 1;
BA_ "GenSigStartValue" SG_ 254 FLR2RdrDetn280To284RCS1 500;
BA_ "GenSigSendType" SG_ 254 FLR2RdrDetn280To284RCS2 1;
BA_ "GenSigStartValue" SG_ 254 FLR2RdrDetn280To284RCS2 500;
BA_ "GenSigSendType" SG_ 254 FLR2RdrDetn280To284RCS3 1;
BA_ "GenSigStartValue" SG_ 254 FLR2RdrDetn280To284RCS3 500;
BA_ "GenSigSendType" SG_ 254 FLR2RdrDetn280To284RCS4 1;
BA_ "GenSigStartValue" SG_ 254 FLR2RdrDetn280To284RCS4 500;
BA_ "GenSigSendType" SG_ 254 FLR2RdrDetn280To284Range0 1;
BA_ "GenSigSendType" SG_ 254 FLR2RdrDetn280To284Range1 1;
BA_ "GenSigSendType" SG_ 254 FLR2RdrDetn280To284Range2 1;
BA_ "GenSigSendType" SG_ 254 FLR2RdrDetn280To284Range3 1;
BA_ "GenSigSendType" SG_ 254 FLR2RdrDetn280To284Range4 1;
BA_ "GenSigSendType" SG_ 254 FLR2RdrDetn280To284RngRt0 1;
BA_ "GenSigStartValue" SG_ 254 FLR2RdrDetn280To284RngRt0 1111;
BA_ "GenSigSendType" SG_ 254 FLR2RdrDetn280To284RngRt1 1;
BA_ "GenSigStartValue" SG_ 254 FLR2RdrDetn280To284RngRt1 1111;
BA_ "GenSigSendType" SG_ 254 FLR2RdrDetn280To284RngRt2 1;
BA_ "GenSigStartValue" SG_ 254 FLR2RdrDetn280To284RngRt2 1111;
BA_ "GenSigSendType" SG_ 254 FLR2RdrDetn280To284RngRt3 1;
BA_ "GenSigStartValue" SG_ 254 FLR2RdrDetn280To284RngRt3 1111;
BA_ "GenSigSendType" SG_ 254 FLR2RdrDetn280To284RngRt4 1;
BA_ "GenSigStartValue" SG_ 254 FLR2RdrDetn280To284RngRt4 1111;
BA_ "GenSigSendType" SG_ 254 FLR2RdrDetn280To284SNR0 1;
BA_ "GenSigSendType" SG_ 254 FLR2RdrDetn280To284SNR1 1;
BA_ "GenSigSendType" SG_ 254 FLR2RdrDetn280To284SNR2 1;
BA_ "GenSigSendType" SG_ 254 FLR2RdrDetn280To284SNR3 1;
BA_ "GenSigSendType" SG_ 254 FLR2RdrDetn280To284SNR4 1;
BA_ "GenSigSendType" SG_ 254 FLR2RdrDetn280To284ScanID 1;
BA_ "GenSigSendType" SG_ 256 FLR2RdrDetn285To289AziAng0 1;
BA_ "GenSigSendType" SG_ 256 FLR2RdrDetn285To289AziAng1 1;
BA_ "GenSigSendType" SG_ 256 FLR2RdrDetn285To289AziAng2 1;
BA_ "GenSigSendType" SG_ 256 FLR2RdrDetn285To289AziAng3 1;
BA_ "GenSigSendType" SG_ 256 FLR2RdrDetn285To289AziAng4 1;
BA_ "GenSigDataID" SG_ 256 FLR2RdrDetn285To289CRC "0xAF2";
BA_ "GenSigFuncType" SG_ 256 FLR2RdrDetn285To289CRC 28;
BA_ "GenSigSendType" SG_ 256 FLR2RdrDetn285To289CRC 1;
BA_ "GenSigFuncType" SG_ 256 FLR2RdrDetn285To289Counter 27;
BA_ "GenSigSendType" SG_ 256 FLR2RdrDetn285To289Counter 1;
BA_ "GenSigSendType" SG_ 256 FLR2RdrDetn285To289DynPrpty0 1;
BA_ "GenSigSendType" SG_ 256 FLR2RdrDetn285To289DynPrpty1 1;
BA_ "GenSigSendType" SG_ 256 FLR2RdrDetn285To289DynPrpty2 1;
BA_ "GenSigSendType" SG_ 256 FLR2RdrDetn285To289DynPrpty3 1;
BA_ "GenSigSendType" SG_ 256 FLR2RdrDetn285To289DynPrpty4 1;
BA_ "GenSigSendType" SG_ 256 FLR2RdrDetn285To289EleAng0 1;
BA_ "GenSigSendType" SG_ 256 FLR2RdrDetn285To289EleAng1 1;
BA_ "GenSigSendType" SG_ 256 FLR2RdrDetn285To289EleAng2 1;
BA_ "GenSigSendType" SG_ 256 FLR2RdrDetn285To289EleAng3 1;
BA_ "GenSigSendType" SG_ 256 FLR2RdrDetn285To289EleAng4 1;
BA_ "GenSigSendType" SG_ 256 FLR2RdrDetn285To289Mode0 1;
BA_ "GenSigSendType" SG_ 256 FLR2RdrDetn285To289Mode1 1;
BA_ "GenSigSendType" SG_ 256 FLR2RdrDetn285To289Mode2 1;
BA_ "GenSigSendType" SG_ 256 FLR2RdrDetn285To289Mode3 1;
BA_ "GenSigSendType" SG_ 256 FLR2RdrDetn285To289Mode4 1;
BA_ "GenSigSendType" SG_ 256 FLR2RdrDetn285To289Quality0 1;
BA_ "GenSigSendType" SG_ 256 FLR2RdrDetn285To289Quality1 1;
BA_ "GenSigSendType" SG_ 256 FLR2RdrDetn285To289Quality2 1;
BA_ "GenSigSendType" SG_ 256 FLR2RdrDetn285To289Quality3 1;
BA_ "GenSigSendType" SG_ 256 FLR2RdrDetn285To289Quality4 1;
BA_ "GenSigSendType" SG_ 256 FLR2RdrDetn285To289RCS0 1;
BA_ "GenSigStartValue" SG_ 256 FLR2RdrDetn285To289RCS0 500;
BA_ "GenSigSendType" SG_ 256 FLR2RdrDetn285To289RCS1 1;
BA_ "GenSigStartValue" SG_ 256 FLR2RdrDetn285To289RCS1 500;
BA_ "GenSigSendType" SG_ 256 FLR2RdrDetn285To289RCS2 1;
BA_ "GenSigStartValue" SG_ 256 FLR2RdrDetn285To289RCS2 500;
BA_ "GenSigSendType" SG_ 256 FLR2RdrDetn285To289RCS3 1;
BA_ "GenSigStartValue" SG_ 256 FLR2RdrDetn285To289RCS3 500;
BA_ "GenSigSendType" SG_ 256 FLR2RdrDetn285To289RCS4 1;
BA_ "GenSigStartValue" SG_ 256 FLR2RdrDetn285To289RCS4 500;
BA_ "GenSigSendType" SG_ 256 FLR2RdrDetn285To289Range0 1;
BA_ "GenSigSendType" SG_ 256 FLR2RdrDetn285To289Range1 1;
BA_ "GenSigSendType" SG_ 256 FLR2RdrDetn285To289Range2 1;
BA_ "GenSigSendType" SG_ 256 FLR2RdrDetn285To289Range3 1;
BA_ "GenSigSendType" SG_ 256 FLR2RdrDetn285To289Range4 1;
BA_ "GenSigSendType" SG_ 256 FLR2RdrDetn285To289RngRt0 1;
BA_ "GenSigStartValue" SG_ 256 FLR2RdrDetn285To289RngRt0 1111;
BA_ "GenSigSendType" SG_ 256 FLR2RdrDetn285To289RngRt1 1;
BA_ "GenSigStartValue" SG_ 256 FLR2RdrDetn285To289RngRt1 1111;
BA_ "GenSigSendType" SG_ 256 FLR2RdrDetn285To289RngRt2 1;
BA_ "GenSigStartValue" SG_ 256 FLR2RdrDetn285To289RngRt2 1111;
BA_ "GenSigSendType" SG_ 256 FLR2RdrDetn285To289RngRt3 1;
BA_ "GenSigStartValue" SG_ 256 FLR2RdrDetn285To289RngRt3 1111;
BA_ "GenSigSendType" SG_ 256 FLR2RdrDetn285To289RngRt4 1;
BA_ "GenSigStartValue" SG_ 256 FLR2RdrDetn285To289RngRt4 1111;
BA_ "GenSigSendType" SG_ 256 FLR2RdrDetn285To289SNR0 1;
BA_ "GenSigSendType" SG_ 256 FLR2RdrDetn285To289SNR1 1;
BA_ "GenSigSendType" SG_ 256 FLR2RdrDetn285To289SNR2 1;
BA_ "GenSigSendType" SG_ 256 FLR2RdrDetn285To289SNR3 1;
BA_ "GenSigSendType" SG_ 256 FLR2RdrDetn285To289SNR4 1;
BA_ "GenSigSendType" SG_ 256 FLR2RdrDetn285To289ScanID 1;
BA_ "GenSigSendType" SG_ 258 FLR2RdrDetn290To294AziAng0 1;
BA_ "GenSigSendType" SG_ 258 FLR2RdrDetn290To294AziAng1 1;
BA_ "GenSigSendType" SG_ 258 FLR2RdrDetn290To294AziAng2 1;
BA_ "GenSigSendType" SG_ 258 FLR2RdrDetn290To294AziAng3 1;
BA_ "GenSigSendType" SG_ 258 FLR2RdrDetn290To294AziAng4 1;
BA_ "GenSigDataID" SG_ 258 FLR2RdrDetn290To294CRC "0xAF3";
BA_ "GenSigFuncType" SG_ 258 FLR2RdrDetn290To294CRC 28;
BA_ "GenSigSendType" SG_ 258 FLR2RdrDetn290To294CRC 1;
BA_ "GenSigFuncType" SG_ 258 FLR2RdrDetn290To294Counter 27;
BA_ "GenSigSendType" SG_ 258 FLR2RdrDetn290To294Counter 1;
BA_ "GenSigSendType" SG_ 258 FLR2RdrDetn290To294DynPrpty0 1;
BA_ "GenSigSendType" SG_ 258 FLR2RdrDetn290To294DynPrpty1 1;
BA_ "GenSigSendType" SG_ 258 FLR2RdrDetn290To294DynPrpty2 1;
BA_ "GenSigSendType" SG_ 258 FLR2RdrDetn290To294DynPrpty3 1;
BA_ "GenSigSendType" SG_ 258 FLR2RdrDetn290To294DynPrpty4 1;
BA_ "GenSigSendType" SG_ 258 FLR2RdrDetn290To294EleAng0 1;
BA_ "GenSigSendType" SG_ 258 FLR2RdrDetn290To294EleAng1 1;
BA_ "GenSigSendType" SG_ 258 FLR2RdrDetn290To294EleAng2 1;
BA_ "GenSigSendType" SG_ 258 FLR2RdrDetn290To294EleAng3 1;
BA_ "GenSigSendType" SG_ 258 FLR2RdrDetn290To294EleAng4 1;
BA_ "GenSigSendType" SG_ 258 FLR2RdrDetn290To294Mode0 1;
BA_ "GenSigSendType" SG_ 258 FLR2RdrDetn290To294Mode1 1;
BA_ "GenSigSendType" SG_ 258 FLR2RdrDetn290To294Mode2 1;
BA_ "GenSigSendType" SG_ 258 FLR2RdrDetn290To294Mode3 1;
BA_ "GenSigSendType" SG_ 258 FLR2RdrDetn290To294Mode4 1;
BA_ "GenSigSendType" SG_ 258 FLR2RdrDetn290To294Quality0 1;
BA_ "GenSigSendType" SG_ 258 FLR2RdrDetn290To294Quality1 1;
BA_ "GenSigSendType" SG_ 258 FLR2RdrDetn290To294Quality2 1;
BA_ "GenSigSendType" SG_ 258 FLR2RdrDetn290To294Quality3 1;
BA_ "GenSigSendType" SG_ 258 FLR2RdrDetn290To294Quality4 1;
BA_ "GenSigSendType" SG_ 258 FLR2RdrDetn290To294RCS0 1;
BA_ "GenSigStartValue" SG_ 258 FLR2RdrDetn290To294RCS0 500;
BA_ "GenSigSendType" SG_ 258 FLR2RdrDetn290To294RCS1 1;
BA_ "GenSigStartValue" SG_ 258 FLR2RdrDetn290To294RCS1 500;
BA_ "GenSigSendType" SG_ 258 FLR2RdrDetn290To294RCS2 1;
BA_ "GenSigStartValue" SG_ 258 FLR2RdrDetn290To294RCS2 500;
BA_ "GenSigSendType" SG_ 258 FLR2RdrDetn290To294RCS3 1;
BA_ "GenSigStartValue" SG_ 258 FLR2RdrDetn290To294RCS3 500;
BA_ "GenSigSendType" SG_ 258 FLR2RdrDetn290To294RCS4 1;
BA_ "GenSigStartValue" SG_ 258 FLR2RdrDetn290To294RCS4 500;
BA_ "GenSigSendType" SG_ 258 FLR2RdrDetn290To294Range0 1;
BA_ "GenSigSendType" SG_ 258 FLR2RdrDetn290To294Range1 1;
BA_ "GenSigSendType" SG_ 258 FLR2RdrDetn290To294Range2 1;
BA_ "GenSigSendType" SG_ 258 FLR2RdrDetn290To294Range3 1;
BA_ "GenSigSendType" SG_ 258 FLR2RdrDetn290To294Range4 1;
BA_ "GenSigSendType" SG_ 258 FLR2RdrDetn290To294RngRt0 1;
BA_ "GenSigStartValue" SG_ 258 FLR2RdrDetn290To294RngRt0 1111;
BA_ "GenSigSendType" SG_ 258 FLR2RdrDetn290To294RngRt1 1;
BA_ "GenSigStartValue" SG_ 258 FLR2RdrDetn290To294RngRt1 1111;
BA_ "GenSigSendType" SG_ 258 FLR2RdrDetn290To294RngRt2 1;
BA_ "GenSigStartValue" SG_ 258 FLR2RdrDetn290To294RngRt2 1111;
BA_ "GenSigSendType" SG_ 258 FLR2RdrDetn290To294RngRt3 1;
BA_ "GenSigStartValue" SG_ 258 FLR2RdrDetn290To294RngRt3 1111;
BA_ "GenSigSendType" SG_ 258 FLR2RdrDetn290To294RngRt4 1;
BA_ "GenSigStartValue" SG_ 258 FLR2RdrDetn290To294RngRt4 1111;
BA_ "GenSigSendType" SG_ 258 FLR2RdrDetn290To294SNR0 1;
BA_ "GenSigSendType" SG_ 258 FLR2RdrDetn290To294SNR1 1;
BA_ "GenSigSendType" SG_ 258 FLR2RdrDetn290To294SNR2 1;
BA_ "GenSigSendType" SG_ 258 FLR2RdrDetn290To294SNR3 1;
BA_ "GenSigSendType" SG_ 258 FLR2RdrDetn290To294SNR4 1;
BA_ "GenSigSendType" SG_ 258 FLR2RdrDetn290To294ScanID 1;
BA_ "GenSigSendType" SG_ 260 FLR2RdrDetn295To299AziAng0 1;
BA_ "GenSigSendType" SG_ 260 FLR2RdrDetn295To299AziAng1 1;
BA_ "GenSigSendType" SG_ 260 FLR2RdrDetn295To299AziAng2 1;
BA_ "GenSigSendType" SG_ 260 FLR2RdrDetn295To299AziAng3 1;
BA_ "GenSigSendType" SG_ 260 FLR2RdrDetn295To299AziAng4 1;
BA_ "GenSigDataID" SG_ 260 FLR2RdrDetn295To299CRC "0xAF4";
BA_ "GenSigFuncType" SG_ 260 FLR2RdrDetn295To299CRC 28;
BA_ "GenSigSendType" SG_ 260 FLR2RdrDetn295To299CRC 1;
BA_ "GenSigFuncType" SG_ 260 FLR2RdrDetn295To299Counter 27;
BA_ "GenSigSendType" SG_ 260 FLR2RdrDetn295To299Counter 1;
BA_ "GenSigSendType" SG_ 260 FLR2RdrDetn295To299DynPrpty0 1;
BA_ "GenSigSendType" SG_ 260 FLR2RdrDetn295To299DynPrpty1 1;
BA_ "GenSigSendType" SG_ 260 FLR2RdrDetn295To299DynPrpty2 1;
BA_ "GenSigSendType" SG_ 260 FLR2RdrDetn295To299DynPrpty3 1;
BA_ "GenSigSendType" SG_ 260 FLR2RdrDetn295To299DynPrpty4 1;
BA_ "GenSigSendType" SG_ 260 FLR2RdrDetn295To299EleAng0 1;
BA_ "GenSigSendType" SG_ 260 FLR2RdrDetn295To299EleAng1 1;
BA_ "GenSigSendType" SG_ 260 FLR2RdrDetn295To299EleAng2 1;
BA_ "GenSigSendType" SG_ 260 FLR2RdrDetn295To299EleAng3 1;
BA_ "GenSigSendType" SG_ 260 FLR2RdrDetn295To299EleAng4 1;
BA_ "GenSigSendType" SG_ 260 FLR2RdrDetn295To299Mode0 1;
BA_ "GenSigSendType" SG_ 260 FLR2RdrDetn295To299Mode1 1;
BA_ "GenSigSendType" SG_ 260 FLR2RdrDetn295To299Mode2 1;
BA_ "GenSigSendType" SG_ 260 FLR2RdrDetn295To299Mode3 1;
BA_ "GenSigSendType" SG_ 260 FLR2RdrDetn295To299Mode4 1;
BA_ "GenSigSendType" SG_ 260 FLR2RdrDetn295To299Quality0 1;
BA_ "GenSigSendType" SG_ 260 FLR2RdrDetn295To299Quality1 1;
BA_ "GenSigSendType" SG_ 260 FLR2RdrDetn295To299Quality2 1;
BA_ "GenSigSendType" SG_ 260 FLR2RdrDetn295To299Quality3 1;
BA_ "GenSigSendType" SG_ 260 FLR2RdrDetn295To299Quality4 1;
BA_ "GenSigSendType" SG_ 260 FLR2RdrDetn295To299RCS0 1;
BA_ "GenSigStartValue" SG_ 260 FLR2RdrDetn295To299RCS0 500;
BA_ "GenSigSendType" SG_ 260 FLR2RdrDetn295To299RCS1 1;
BA_ "GenSigStartValue" SG_ 260 FLR2RdrDetn295To299RCS1 500;
BA_ "GenSigSendType" SG_ 260 FLR2RdrDetn295To299RCS2 1;
BA_ "GenSigStartValue" SG_ 260 FLR2RdrDetn295To299RCS2 500;
BA_ "GenSigSendType" SG_ 260 FLR2RdrDetn295To299RCS3 1;
BA_ "GenSigStartValue" SG_ 260 FLR2RdrDetn295To299RCS3 500;
BA_ "GenSigSendType" SG_ 260 FLR2RdrDetn295To299RCS4 1;
BA_ "GenSigStartValue" SG_ 260 FLR2RdrDetn295To299RCS4 500;
BA_ "GenSigSendType" SG_ 260 FLR2RdrDetn295To299Range0 1;
BA_ "GenSigSendType" SG_ 260 FLR2RdrDetn295To299Range1 1;
BA_ "GenSigSendType" SG_ 260 FLR2RdrDetn295To299Range2 1;
BA_ "GenSigSendType" SG_ 260 FLR2RdrDetn295To299Range3 1;
BA_ "GenSigSendType" SG_ 260 FLR2RdrDetn295To299Range4 1;
BA_ "GenSigSendType" SG_ 260 FLR2RdrDetn295To299RngRt0 1;
BA_ "GenSigStartValue" SG_ 260 FLR2RdrDetn295To299RngRt0 1111;
BA_ "GenSigSendType" SG_ 260 FLR2RdrDetn295To299RngRt1 1;
BA_ "GenSigStartValue" SG_ 260 FLR2RdrDetn295To299RngRt1 1111;
BA_ "GenSigSendType" SG_ 260 FLR2RdrDetn295To299RngRt2 1;
BA_ "GenSigStartValue" SG_ 260 FLR2RdrDetn295To299RngRt2 1111;
BA_ "GenSigSendType" SG_ 260 FLR2RdrDetn295To299RngRt3 1;
BA_ "GenSigStartValue" SG_ 260 FLR2RdrDetn295To299RngRt3 1111;
BA_ "GenSigSendType" SG_ 260 FLR2RdrDetn295To299RngRt4 1;
BA_ "GenSigStartValue" SG_ 260 FLR2RdrDetn295To299RngRt4 1111;
BA_ "GenSigSendType" SG_ 260 FLR2RdrDetn295To299SNR0 1;
BA_ "GenSigSendType" SG_ 260 FLR2RdrDetn295To299SNR1 1;
BA_ "GenSigSendType" SG_ 260 FLR2RdrDetn295To299SNR2 1;
BA_ "GenSigSendType" SG_ 260 FLR2RdrDetn295To299SNR3 1;
BA_ "GenSigSendType" SG_ 260 FLR2RdrDetn295To299SNR4 1;
BA_ "GenSigSendType" SG_ 260 FLR2RdrDetn295To299ScanID 1;
BA_ "GenSigSendType" SG_ 262 FLR2RdrDetn300To304AziAng0 1;
BA_ "GenSigSendType" SG_ 262 FLR2RdrDetn300To304AziAng1 1;
BA_ "GenSigSendType" SG_ 262 FLR2RdrDetn300To304AziAng2 1;
BA_ "GenSigSendType" SG_ 262 FLR2RdrDetn300To304AziAng3 1;
BA_ "GenSigSendType" SG_ 262 FLR2RdrDetn300To304AziAng4 1;
BA_ "GenSigDataID" SG_ 262 FLR2RdrDetn300To304CRC "0xAF5";
BA_ "GenSigFuncType" SG_ 262 FLR2RdrDetn300To304CRC 28;
BA_ "GenSigSendType" SG_ 262 FLR2RdrDetn300To304CRC 1;
BA_ "GenSigFuncType" SG_ 262 FLR2RdrDetn300To304Counter 27;
BA_ "GenSigSendType" SG_ 262 FLR2RdrDetn300To304Counter 1;
BA_ "GenSigSendType" SG_ 262 FLR2RdrDetn300To304DynPrpty0 1;
BA_ "GenSigSendType" SG_ 262 FLR2RdrDetn300To304DynPrpty1 1;
BA_ "GenSigSendType" SG_ 262 FLR2RdrDetn300To304DynPrpty2 1;
BA_ "GenSigSendType" SG_ 262 FLR2RdrDetn300To304DynPrpty3 1;
BA_ "GenSigSendType" SG_ 262 FLR2RdrDetn300To304DynPrpty4 1;
BA_ "GenSigSendType" SG_ 262 FLR2RdrDetn300To304EleAng0 1;
BA_ "GenSigSendType" SG_ 262 FLR2RdrDetn300To304EleAng1 1;
BA_ "GenSigSendType" SG_ 262 FLR2RdrDetn300To304EleAng2 1;
BA_ "GenSigSendType" SG_ 262 FLR2RdrDetn300To304EleAng3 1;
BA_ "GenSigSendType" SG_ 262 FLR2RdrDetn300To304EleAng4 1;
BA_ "GenSigSendType" SG_ 262 FLR2RdrDetn300To304Mode0 1;
BA_ "GenSigSendType" SG_ 262 FLR2RdrDetn300To304Mode1 1;
BA_ "GenSigSendType" SG_ 262 FLR2RdrDetn300To304Mode2 1;
BA_ "GenSigSendType" SG_ 262 FLR2RdrDetn300To304Mode3 1;
BA_ "GenSigSendType" SG_ 262 FLR2RdrDetn300To304Mode4 1;
BA_ "GenSigSendType" SG_ 262 FLR2RdrDetn300To304Quality0 1;
BA_ "GenSigSendType" SG_ 262 FLR2RdrDetn300To304Quality1 1;
BA_ "GenSigSendType" SG_ 262 FLR2RdrDetn300To304Quality2 1;
BA_ "GenSigSendType" SG_ 262 FLR2RdrDetn300To304Quality3 1;
BA_ "GenSigSendType" SG_ 262 FLR2RdrDetn300To304Quality4 1;
BA_ "GenSigSendType" SG_ 262 FLR2RdrDetn300To304RCS0 1;
BA_ "GenSigStartValue" SG_ 262 FLR2RdrDetn300To304RCS0 500;
BA_ "GenSigSendType" SG_ 262 FLR2RdrDetn300To304RCS1 1;
BA_ "GenSigStartValue" SG_ 262 FLR2RdrDetn300To304RCS1 500;
BA_ "GenSigSendType" SG_ 262 FLR2RdrDetn300To304RCS2 1;
BA_ "GenSigStartValue" SG_ 262 FLR2RdrDetn300To304RCS2 500;
BA_ "GenSigSendType" SG_ 262 FLR2RdrDetn300To304RCS3 1;
BA_ "GenSigStartValue" SG_ 262 FLR2RdrDetn300To304RCS3 500;
BA_ "GenSigSendType" SG_ 262 FLR2RdrDetn300To304RCS4 1;
BA_ "GenSigStartValue" SG_ 262 FLR2RdrDetn300To304RCS4 500;
BA_ "GenSigSendType" SG_ 262 FLR2RdrDetn300To304Range0 1;
BA_ "GenSigSendType" SG_ 262 FLR2RdrDetn300To304Range1 1;
BA_ "GenSigSendType" SG_ 262 FLR2RdrDetn300To304Range2 1;
BA_ "GenSigSendType" SG_ 262 FLR2RdrDetn300To304Range3 1;
BA_ "GenSigSendType" SG_ 262 FLR2RdrDetn300To304Range4 1;
BA_ "GenSigSendType" SG_ 262 FLR2RdrDetn300To304RngRt0 1;
BA_ "GenSigStartValue" SG_ 262 FLR2RdrDetn300To304RngRt0 1111;
BA_ "GenSigSendType" SG_ 262 FLR2RdrDetn300To304RngRt1 1;
BA_ "GenSigStartValue" SG_ 262 FLR2RdrDetn300To304RngRt1 1111;
BA_ "GenSigSendType" SG_ 262 FLR2RdrDetn300To304RngRt2 1;
BA_ "GenSigStartValue" SG_ 262 FLR2RdrDetn300To304RngRt2 1111;
BA_ "GenSigSendType" SG_ 262 FLR2RdrDetn300To304RngRt3 1;
BA_ "GenSigStartValue" SG_ 262 FLR2RdrDetn300To304RngRt3 1111;
BA_ "GenSigSendType" SG_ 262 FLR2RdrDetn300To304RngRt4 1;
BA_ "GenSigStartValue" SG_ 262 FLR2RdrDetn300To304RngRt4 1111;
BA_ "GenSigSendType" SG_ 262 FLR2RdrDetn300To304SNR0 1;
BA_ "GenSigSendType" SG_ 262 FLR2RdrDetn300To304SNR1 1;
BA_ "GenSigSendType" SG_ 262 FLR2RdrDetn300To304SNR2 1;
BA_ "GenSigSendType" SG_ 262 FLR2RdrDetn300To304SNR3 1;
BA_ "GenSigSendType" SG_ 262 FLR2RdrDetn300To304SNR4 1;
BA_ "GenSigSendType" SG_ 262 FLR2RdrDetn300To304ScanID 1;
BA_ "GenSigSendType" SG_ 264 FLR2RdrDetn305To309AziAng0 1;
BA_ "GenSigSendType" SG_ 264 FLR2RdrDetn305To309AziAng1 1;
BA_ "GenSigSendType" SG_ 264 FLR2RdrDetn305To309AziAng2 1;
BA_ "GenSigSendType" SG_ 264 FLR2RdrDetn305To309AziAng3 1;
BA_ "GenSigSendType" SG_ 264 FLR2RdrDetn305To309AziAng4 1;
BA_ "GenSigDataID" SG_ 264 FLR2RdrDetn305To309CRC "0xAF6";
BA_ "GenSigFuncType" SG_ 264 FLR2RdrDetn305To309CRC 28;
BA_ "GenSigSendType" SG_ 264 FLR2RdrDetn305To309CRC 1;
BA_ "GenSigFuncType" SG_ 264 FLR2RdrDetn305To309Counter 27;
BA_ "GenSigSendType" SG_ 264 FLR2RdrDetn305To309Counter 1;
BA_ "GenSigSendType" SG_ 264 FLR2RdrDetn305To309DynPrpty0 1;
BA_ "GenSigSendType" SG_ 264 FLR2RdrDetn305To309DynPrpty1 1;
BA_ "GenSigSendType" SG_ 264 FLR2RdrDetn305To309DynPrpty2 1;
BA_ "GenSigSendType" SG_ 264 FLR2RdrDetn305To309DynPrpty3 1;
BA_ "GenSigSendType" SG_ 264 FLR2RdrDetn305To309DynPrpty4 1;
BA_ "GenSigSendType" SG_ 264 FLR2RdrDetn305To309EleAng0 1;
BA_ "GenSigSendType" SG_ 264 FLR2RdrDetn305To309EleAng1 1;
BA_ "GenSigSendType" SG_ 264 FLR2RdrDetn305To309EleAng2 1;
BA_ "GenSigSendType" SG_ 264 FLR2RdrDetn305To309EleAng3 1;
BA_ "GenSigSendType" SG_ 264 FLR2RdrDetn305To309EleAng4 1;
BA_ "GenSigSendType" SG_ 264 FLR2RdrDetn305To309Mode0 1;
BA_ "GenSigSendType" SG_ 264 FLR2RdrDetn305To309Mode1 1;
BA_ "GenSigSendType" SG_ 264 FLR2RdrDetn305To309Mode2 1;
BA_ "GenSigSendType" SG_ 264 FLR2RdrDetn305To309Mode3 1;
BA_ "GenSigSendType" SG_ 264 FLR2RdrDetn305To309Mode4 1;
BA_ "GenSigSendType" SG_ 264 FLR2RdrDetn305To309Quality0 1;
BA_ "GenSigSendType" SG_ 264 FLR2RdrDetn305To309Quality1 1;
BA_ "GenSigSendType" SG_ 264 FLR2RdrDetn305To309Quality2 1;
BA_ "GenSigSendType" SG_ 264 FLR2RdrDetn305To309Quality3 1;
BA_ "GenSigSendType" SG_ 264 FLR2RdrDetn305To309Quality4 1;
BA_ "GenSigSendType" SG_ 264 FLR2RdrDetn305To309RCS0 1;
BA_ "GenSigStartValue" SG_ 264 FLR2RdrDetn305To309RCS0 500;
BA_ "GenSigSendType" SG_ 264 FLR2RdrDetn305To309RCS1 1;
BA_ "GenSigStartValue" SG_ 264 FLR2RdrDetn305To309RCS1 500;
BA_ "GenSigSendType" SG_ 264 FLR2RdrDetn305To309RCS2 1;
BA_ "GenSigStartValue" SG_ 264 FLR2RdrDetn305To309RCS2 500;
BA_ "GenSigSendType" SG_ 264 FLR2RdrDetn305To309RCS3 1;
BA_ "GenSigStartValue" SG_ 264 FLR2RdrDetn305To309RCS3 500;
BA_ "GenSigSendType" SG_ 264 FLR2RdrDetn305To309RCS4 1;
BA_ "GenSigStartValue" SG_ 264 FLR2RdrDetn305To309RCS4 500;
BA_ "GenSigSendType" SG_ 264 FLR2RdrDetn305To309Range0 1;
BA_ "GenSigSendType" SG_ 264 FLR2RdrDetn305To309Range1 1;
BA_ "GenSigSendType" SG_ 264 FLR2RdrDetn305To309Range2 1;
BA_ "GenSigSendType" SG_ 264 FLR2RdrDetn305To309Range3 1;
BA_ "GenSigSendType" SG_ 264 FLR2RdrDetn305To309Range4 1;
BA_ "GenSigSendType" SG_ 264 FLR2RdrDetn305To309RngRt0 1;
BA_ "GenSigStartValue" SG_ 264 FLR2RdrDetn305To309RngRt0 1111;
BA_ "GenSigSendType" SG_ 264 FLR2RdrDetn305To309RngRt1 1;
BA_ "GenSigStartValue" SG_ 264 FLR2RdrDetn305To309RngRt1 1111;
BA_ "GenSigSendType" SG_ 264 FLR2RdrDetn305To309RngRt2 1;
BA_ "GenSigStartValue" SG_ 264 FLR2RdrDetn305To309RngRt2 1111;
BA_ "GenSigSendType" SG_ 264 FLR2RdrDetn305To309RngRt3 1;
BA_ "GenSigStartValue" SG_ 264 FLR2RdrDetn305To309RngRt3 1111;
BA_ "GenSigSendType" SG_ 264 FLR2RdrDetn305To309RngRt4 1;
BA_ "GenSigStartValue" SG_ 264 FLR2RdrDetn305To309RngRt4 1111;
BA_ "GenSigSendType" SG_ 264 FLR2RdrDetn305To309SNR0 1;
BA_ "GenSigSendType" SG_ 264 FLR2RdrDetn305To309SNR1 1;
BA_ "GenSigSendType" SG_ 264 FLR2RdrDetn305To309SNR2 1;
BA_ "GenSigSendType" SG_ 264 FLR2RdrDetn305To309SNR3 1;
BA_ "GenSigSendType" SG_ 264 FLR2RdrDetn305To309SNR4 1;
BA_ "GenSigSendType" SG_ 264 FLR2RdrDetn305To309ScanID 1;
BA_ "GenSigSendType" SG_ 266 FLR2RdrDetn310To314AziAng0 1;
BA_ "GenSigSendType" SG_ 266 FLR2RdrDetn310To314AziAng1 1;
BA_ "GenSigSendType" SG_ 266 FLR2RdrDetn310To314AziAng2 1;
BA_ "GenSigSendType" SG_ 266 FLR2RdrDetn310To314AziAng3 1;
BA_ "GenSigSendType" SG_ 266 FLR2RdrDetn310To314AziAng4 1;
BA_ "GenSigDataID" SG_ 266 FLR2RdrDetn310To314CRC "0xAF7";
BA_ "GenSigFuncType" SG_ 266 FLR2RdrDetn310To314CRC 28;
BA_ "GenSigSendType" SG_ 266 FLR2RdrDetn310To314CRC 1;
BA_ "GenSigFuncType" SG_ 266 FLR2RdrDetn310To314Counter 27;
BA_ "GenSigSendType" SG_ 266 FLR2RdrDetn310To314Counter 1;
BA_ "GenSigSendType" SG_ 266 FLR2RdrDetn310To314DynPrpty0 1;
BA_ "GenSigSendType" SG_ 266 FLR2RdrDetn310To314DynPrpty1 1;
BA_ "GenSigSendType" SG_ 266 FLR2RdrDetn310To314DynPrpty2 1;
BA_ "GenSigSendType" SG_ 266 FLR2RdrDetn310To314DynPrpty3 1;
BA_ "GenSigSendType" SG_ 266 FLR2RdrDetn310To314DynPrpty4 1;
BA_ "GenSigSendType" SG_ 266 FLR2RdrDetn310To314EleAng0 1;
BA_ "GenSigSendType" SG_ 266 FLR2RdrDetn310To314EleAng1 1;
BA_ "GenSigSendType" SG_ 266 FLR2RdrDetn310To314EleAng2 1;
BA_ "GenSigSendType" SG_ 266 FLR2RdrDetn310To314EleAng3 1;
BA_ "GenSigSendType" SG_ 266 FLR2RdrDetn310To314EleAng4 1;
BA_ "GenSigSendType" SG_ 266 FLR2RdrDetn310To314Mode0 1;
BA_ "GenSigSendType" SG_ 266 FLR2RdrDetn310To314Mode1 1;
BA_ "GenSigSendType" SG_ 266 FLR2RdrDetn310To314Mode2 1;
BA_ "GenSigSendType" SG_ 266 FLR2RdrDetn310To314Mode3 1;
BA_ "GenSigSendType" SG_ 266 FLR2RdrDetn310To314Mode4 1;
BA_ "GenSigSendType" SG_ 266 FLR2RdrDetn310To314Quality0 1;
BA_ "GenSigSendType" SG_ 266 FLR2RdrDetn310To314Quality1 1;
BA_ "GenSigSendType" SG_ 266 FLR2RdrDetn310To314Quality2 1;
BA_ "GenSigSendType" SG_ 266 FLR2RdrDetn310To314Quality3 1;
BA_ "GenSigSendType" SG_ 266 FLR2RdrDetn310To314Quality4 1;
BA_ "GenSigSendType" SG_ 266 FLR2RdrDetn310To314RCS0 1;
BA_ "GenSigStartValue" SG_ 266 FLR2RdrDetn310To314RCS0 500;
BA_ "GenSigSendType" SG_ 266 FLR2RdrDetn310To314RCS1 1;
BA_ "GenSigStartValue" SG_ 266 FLR2RdrDetn310To314RCS1 500;
BA_ "GenSigSendType" SG_ 266 FLR2RdrDetn310To314RCS2 1;
BA_ "GenSigStartValue" SG_ 266 FLR2RdrDetn310To314RCS2 500;
BA_ "GenSigSendType" SG_ 266 FLR2RdrDetn310To314RCS3 1;
BA_ "GenSigStartValue" SG_ 266 FLR2RdrDetn310To314RCS3 500;
BA_ "GenSigSendType" SG_ 266 FLR2RdrDetn310To314RCS4 1;
BA_ "GenSigStartValue" SG_ 266 FLR2RdrDetn310To314RCS4 500;
BA_ "GenSigSendType" SG_ 266 FLR2RdrDetn310To314Range0 1;
BA_ "GenSigSendType" SG_ 266 FLR2RdrDetn310To314Range1 1;
BA_ "GenSigSendType" SG_ 266 FLR2RdrDetn310To314Range2 1;
BA_ "GenSigSendType" SG_ 266 FLR2RdrDetn310To314Range3 1;
BA_ "GenSigSendType" SG_ 266 FLR2RdrDetn310To314Range4 1;
BA_ "GenSigSendType" SG_ 266 FLR2RdrDetn310To314RngRt0 1;
BA_ "GenSigStartValue" SG_ 266 FLR2RdrDetn310To314RngRt0 1111;
BA_ "GenSigSendType" SG_ 266 FLR2RdrDetn310To314RngRt1 1;
BA_ "GenSigStartValue" SG_ 266 FLR2RdrDetn310To314RngRt1 1111;
BA_ "GenSigSendType" SG_ 266 FLR2RdrDetn310To314RngRt2 1;
BA_ "GenSigStartValue" SG_ 266 FLR2RdrDetn310To314RngRt2 1111;
BA_ "GenSigSendType" SG_ 266 FLR2RdrDetn310To314RngRt3 1;
BA_ "GenSigStartValue" SG_ 266 FLR2RdrDetn310To314RngRt3 1111;
BA_ "GenSigSendType" SG_ 266 FLR2RdrDetn310To314RngRt4 1;
BA_ "GenSigStartValue" SG_ 266 FLR2RdrDetn310To314RngRt4 1111;
BA_ "GenSigSendType" SG_ 266 FLR2RdrDetn310To314SNR0 1;
BA_ "GenSigSendType" SG_ 266 FLR2RdrDetn310To314SNR1 1;
BA_ "GenSigSendType" SG_ 266 FLR2RdrDetn310To314SNR2 1;
BA_ "GenSigSendType" SG_ 266 FLR2RdrDetn310To314SNR3 1;
BA_ "GenSigSendType" SG_ 266 FLR2RdrDetn310To314SNR4 1;
BA_ "GenSigSendType" SG_ 266 FLR2RdrDetn310To314ScanID 1;
BA_ "GenSigSendType" SG_ 268 FLR2RdrDetn315To319AziAng0 1;
BA_ "GenSigSendType" SG_ 268 FLR2RdrDetn315To319AziAng1 1;
BA_ "GenSigSendType" SG_ 268 FLR2RdrDetn315To319AziAng2 1;
BA_ "GenSigSendType" SG_ 268 FLR2RdrDetn315To319AziAng3 1;
BA_ "GenSigSendType" SG_ 268 FLR2RdrDetn315To319AziAng4 1;
BA_ "GenSigDataID" SG_ 268 FLR2RdrDetn315To319CRC "0xAF8";
BA_ "GenSigFuncType" SG_ 268 FLR2RdrDetn315To319CRC 28;
BA_ "GenSigSendType" SG_ 268 FLR2RdrDetn315To319CRC 1;
BA_ "GenSigFuncType" SG_ 268 FLR2RdrDetn315To319Counter 27;
BA_ "GenSigSendType" SG_ 268 FLR2RdrDetn315To319Counter 1;
BA_ "GenSigSendType" SG_ 268 FLR2RdrDetn315To319DynPrpty0 1;
BA_ "GenSigSendType" SG_ 268 FLR2RdrDetn315To319DynPrpty1 1;
BA_ "GenSigSendType" SG_ 268 FLR2RdrDetn315To319DynPrpty2 1;
BA_ "GenSigSendType" SG_ 268 FLR2RdrDetn315To319DynPrpty3 1;
BA_ "GenSigSendType" SG_ 268 FLR2RdrDetn315To319DynPrpty4 1;
BA_ "GenSigSendType" SG_ 268 FLR2RdrDetn315To319EleAng0 1;
BA_ "GenSigSendType" SG_ 268 FLR2RdrDetn315To319EleAng1 1;
BA_ "GenSigSendType" SG_ 268 FLR2RdrDetn315To319EleAng2 1;
BA_ "GenSigSendType" SG_ 268 FLR2RdrDetn315To319EleAng3 1;
BA_ "GenSigSendType" SG_ 268 FLR2RdrDetn315To319EleAng4 1;
BA_ "GenSigSendType" SG_ 268 FLR2RdrDetn315To319Mode0 1;
BA_ "GenSigSendType" SG_ 268 FLR2RdrDetn315To319Mode1 1;
BA_ "GenSigSendType" SG_ 268 FLR2RdrDetn315To319Mode2 1;
BA_ "GenSigSendType" SG_ 268 FLR2RdrDetn315To319Mode3 1;
BA_ "GenSigSendType" SG_ 268 FLR2RdrDetn315To319Mode4 1;
BA_ "GenSigSendType" SG_ 268 FLR2RdrDetn315To319Quality0 1;
BA_ "GenSigSendType" SG_ 268 FLR2RdrDetn315To319Quality1 1;
BA_ "GenSigSendType" SG_ 268 FLR2RdrDetn315To319Quality2 1;
BA_ "GenSigSendType" SG_ 268 FLR2RdrDetn315To319Quality3 1;
BA_ "GenSigSendType" SG_ 268 FLR2RdrDetn315To319Quality4 1;
BA_ "GenSigSendType" SG_ 268 FLR2RdrDetn315To319RCS0 1;
BA_ "GenSigStartValue" SG_ 268 FLR2RdrDetn315To319RCS0 500;
BA_ "GenSigSendType" SG_ 268 FLR2RdrDetn315To319RCS1 1;
BA_ "GenSigStartValue" SG_ 268 FLR2RdrDetn315To319RCS1 500;
BA_ "GenSigSendType" SG_ 268 FLR2RdrDetn315To319RCS2 1;
BA_ "GenSigStartValue" SG_ 268 FLR2RdrDetn315To319RCS2 500;
BA_ "GenSigSendType" SG_ 268 FLR2RdrDetn315To319RCS3 1;
BA_ "GenSigStartValue" SG_ 268 FLR2RdrDetn315To319RCS3 500;
BA_ "GenSigSendType" SG_ 268 FLR2RdrDetn315To319RCS4 1;
BA_ "GenSigStartValue" SG_ 268 FLR2RdrDetn315To319RCS4 500;
BA_ "GenSigSendType" SG_ 268 FLR2RdrDetn315To319Range0 1;
BA_ "GenSigSendType" SG_ 268 FLR2RdrDetn315To319Range1 1;
BA_ "GenSigSendType" SG_ 268 FLR2RdrDetn315To319Range2 1;
BA_ "GenSigSendType" SG_ 268 FLR2RdrDetn315To319Range3 1;
BA_ "GenSigSendType" SG_ 268 FLR2RdrDetn315To319Range4 1;
BA_ "GenSigSendType" SG_ 268 FLR2RdrDetn315To319RngRt0 1;
BA_ "GenSigStartValue" SG_ 268 FLR2RdrDetn315To319RngRt0 1111;
BA_ "GenSigSendType" SG_ 268 FLR2RdrDetn315To319RngRt1 1;
BA_ "GenSigStartValue" SG_ 268 FLR2RdrDetn315To319RngRt1 1111;
BA_ "GenSigSendType" SG_ 268 FLR2RdrDetn315To319RngRt2 1;
BA_ "GenSigStartValue" SG_ 268 FLR2RdrDetn315To319RngRt2 1111;
BA_ "GenSigSendType" SG_ 268 FLR2RdrDetn315To319RngRt3 1;
BA_ "GenSigStartValue" SG_ 268 FLR2RdrDetn315To319RngRt3 1111;
BA_ "GenSigSendType" SG_ 268 FLR2RdrDetn315To319RngRt4 1;
BA_ "GenSigStartValue" SG_ 268 FLR2RdrDetn315To319RngRt4 1111;
BA_ "GenSigSendType" SG_ 268 FLR2RdrDetn315To319SNR0 1;
BA_ "GenSigSendType" SG_ 268 FLR2RdrDetn315To319SNR1 1;
BA_ "GenSigSendType" SG_ 268 FLR2RdrDetn315To319SNR2 1;
BA_ "GenSigSendType" SG_ 268 FLR2RdrDetn315To319SNR3 1;
BA_ "GenSigSendType" SG_ 268 FLR2RdrDetn315To319SNR4 1;
BA_ "GenSigSendType" SG_ 268 FLR2RdrDetn315To319ScanID 1;
BA_ "GenSigSendType" SG_ 270 FLR2RdrDetn320To324AziAng0 1;
BA_ "GenSigSendType" SG_ 270 FLR2RdrDetn320To324AziAng1 1;
BA_ "GenSigSendType" SG_ 270 FLR2RdrDetn320To324AziAng2 1;
BA_ "GenSigSendType" SG_ 270 FLR2RdrDetn320To324AziAng3 1;
BA_ "GenSigSendType" SG_ 270 FLR2RdrDetn320To324AziAng4 1;
BA_ "GenSigDataID" SG_ 270 FLR2RdrDetn320To324CRC "0xAF9";
BA_ "GenSigFuncType" SG_ 270 FLR2RdrDetn320To324CRC 28;
BA_ "GenSigSendType" SG_ 270 FLR2RdrDetn320To324CRC 1;
BA_ "GenSigFuncType" SG_ 270 FLR2RdrDetn320To324Counter 27;
BA_ "GenSigSendType" SG_ 270 FLR2RdrDetn320To324Counter 1;
BA_ "GenSigSendType" SG_ 270 FLR2RdrDetn320To324DynPrpty0 1;
BA_ "GenSigSendType" SG_ 270 FLR2RdrDetn320To324DynPrpty1 1;
BA_ "GenSigSendType" SG_ 270 FLR2RdrDetn320To324DynPrpty2 1;
BA_ "GenSigSendType" SG_ 270 FLR2RdrDetn320To324DynPrpty3 1;
BA_ "GenSigSendType" SG_ 270 FLR2RdrDetn320To324DynPrpty4 1;
BA_ "GenSigSendType" SG_ 270 FLR2RdrDetn320To324EleAng0 1;
BA_ "GenSigSendType" SG_ 270 FLR2RdrDetn320To324EleAng1 1;
BA_ "GenSigSendType" SG_ 270 FLR2RdrDetn320To324EleAng2 1;
BA_ "GenSigSendType" SG_ 270 FLR2RdrDetn320To324EleAng3 1;
BA_ "GenSigSendType" SG_ 270 FLR2RdrDetn320To324EleAng4 1;
BA_ "GenSigSendType" SG_ 270 FLR2RdrDetn320To324Mode0 1;
BA_ "GenSigSendType" SG_ 270 FLR2RdrDetn320To324Mode1 1;
BA_ "GenSigSendType" SG_ 270 FLR2RdrDetn320To324Mode2 1;
BA_ "GenSigSendType" SG_ 270 FLR2RdrDetn320To324Mode3 1;
BA_ "GenSigSendType" SG_ 270 FLR2RdrDetn320To324Mode4 1;
BA_ "GenSigSendType" SG_ 270 FLR2RdrDetn320To324Quality0 1;
BA_ "GenSigSendType" SG_ 270 FLR2RdrDetn320To324Quality1 1;
BA_ "GenSigSendType" SG_ 270 FLR2RdrDetn320To324Quality2 1;
BA_ "GenSigSendType" SG_ 270 FLR2RdrDetn320To324Quality3 1;
BA_ "GenSigSendType" SG_ 270 FLR2RdrDetn320To324Quality4 1;
BA_ "GenSigSendType" SG_ 270 FLR2RdrDetn320To324RCS0 1;
BA_ "GenSigStartValue" SG_ 270 FLR2RdrDetn320To324RCS0 500;
BA_ "GenSigSendType" SG_ 270 FLR2RdrDetn320To324RCS1 1;
BA_ "GenSigStartValue" SG_ 270 FLR2RdrDetn320To324RCS1 500;
BA_ "GenSigSendType" SG_ 270 FLR2RdrDetn320To324RCS2 1;
BA_ "GenSigStartValue" SG_ 270 FLR2RdrDetn320To324RCS2 500;
BA_ "GenSigSendType" SG_ 270 FLR2RdrDetn320To324RCS3 1;
BA_ "GenSigStartValue" SG_ 270 FLR2RdrDetn320To324RCS3 500;
BA_ "GenSigSendType" SG_ 270 FLR2RdrDetn320To324RCS4 1;
BA_ "GenSigStartValue" SG_ 270 FLR2RdrDetn320To324RCS4 500;
BA_ "GenSigSendType" SG_ 270 FLR2RdrDetn320To324Range0 1;
BA_ "GenSigSendType" SG_ 270 FLR2RdrDetn320To324Range1 1;
BA_ "GenSigSendType" SG_ 270 FLR2RdrDetn320To324Range2 1;
BA_ "GenSigSendType" SG_ 270 FLR2RdrDetn320To324Range3 1;
BA_ "GenSigSendType" SG_ 270 FLR2RdrDetn320To324Range4 1;
BA_ "GenSigSendType" SG_ 270 FLR2RdrDetn320To324RngRt0 1;
BA_ "GenSigStartValue" SG_ 270 FLR2RdrDetn320To324RngRt0 1111;
BA_ "GenSigSendType" SG_ 270 FLR2RdrDetn320To324RngRt1 1;
BA_ "GenSigStartValue" SG_ 270 FLR2RdrDetn320To324RngRt1 1111;
BA_ "GenSigSendType" SG_ 270 FLR2RdrDetn320To324RngRt2 1;
BA_ "GenSigStartValue" SG_ 270 FLR2RdrDetn320To324RngRt2 1111;
BA_ "GenSigSendType" SG_ 270 FLR2RdrDetn320To324RngRt3 1;
BA_ "GenSigStartValue" SG_ 270 FLR2RdrDetn320To324RngRt3 1111;
BA_ "GenSigSendType" SG_ 270 FLR2RdrDetn320To324RngRt4 1;
BA_ "GenSigStartValue" SG_ 270 FLR2RdrDetn320To324RngRt4 1111;
BA_ "GenSigSendType" SG_ 270 FLR2RdrDetn320To324SNR0 1;
BA_ "GenSigSendType" SG_ 270 FLR2RdrDetn320To324SNR1 1;
BA_ "GenSigSendType" SG_ 270 FLR2RdrDetn320To324SNR2 1;
BA_ "GenSigSendType" SG_ 270 FLR2RdrDetn320To324SNR3 1;
BA_ "GenSigSendType" SG_ 270 FLR2RdrDetn320To324SNR4 1;
BA_ "GenSigSendType" SG_ 270 FLR2RdrDetn320To324ScanID 1;
BA_ "GenSigSendType" SG_ 272 FLR2RdrDetn325To329AziAng0 1;
BA_ "GenSigSendType" SG_ 272 FLR2RdrDetn325To329AziAng1 1;
BA_ "GenSigSendType" SG_ 272 FLR2RdrDetn325To329AziAng2 1;
BA_ "GenSigSendType" SG_ 272 FLR2RdrDetn325To329AziAng3 1;
BA_ "GenSigSendType" SG_ 272 FLR2RdrDetn325To329AziAng4 1;
BA_ "GenSigDataID" SG_ 272 FLR2RdrDetn325To329CRC "0xAFA";
BA_ "GenSigFuncType" SG_ 272 FLR2RdrDetn325To329CRC 28;
BA_ "GenSigSendType" SG_ 272 FLR2RdrDetn325To329CRC 1;
BA_ "GenSigFuncType" SG_ 272 FLR2RdrDetn325To329Counter 27;
BA_ "GenSigSendType" SG_ 272 FLR2RdrDetn325To329Counter 1;
BA_ "GenSigSendType" SG_ 272 FLR2RdrDetn325To329DynPrpty0 1;
BA_ "GenSigSendType" SG_ 272 FLR2RdrDetn325To329DynPrpty1 1;
BA_ "GenSigSendType" SG_ 272 FLR2RdrDetn325To329DynPrpty2 1;
BA_ "GenSigSendType" SG_ 272 FLR2RdrDetn325To329DynPrpty3 1;
BA_ "GenSigSendType" SG_ 272 FLR2RdrDetn325To329DynPrpty4 1;
BA_ "GenSigSendType" SG_ 272 FLR2RdrDetn325To329EleAng0 1;
BA_ "GenSigSendType" SG_ 272 FLR2RdrDetn325To329EleAng1 1;
BA_ "GenSigSendType" SG_ 272 FLR2RdrDetn325To329EleAng2 1;
BA_ "GenSigSendType" SG_ 272 FLR2RdrDetn325To329EleAng3 1;
BA_ "GenSigSendType" SG_ 272 FLR2RdrDetn325To329EleAng4 1;
BA_ "GenSigSendType" SG_ 272 FLR2RdrDetn325To329Mode0 1;
BA_ "GenSigSendType" SG_ 272 FLR2RdrDetn325To329Mode1 1;
BA_ "GenSigSendType" SG_ 272 FLR2RdrDetn325To329Mode2 1;
BA_ "GenSigSendType" SG_ 272 FLR2RdrDetn325To329Mode3 1;
BA_ "GenSigSendType" SG_ 272 FLR2RdrDetn325To329Mode4 1;
BA_ "GenSigSendType" SG_ 272 FLR2RdrDetn325To329Quality0 1;
BA_ "GenSigSendType" SG_ 272 FLR2RdrDetn325To329Quality1 1;
BA_ "GenSigSendType" SG_ 272 FLR2RdrDetn325To329Quality2 1;
BA_ "GenSigSendType" SG_ 272 FLR2RdrDetn325To329Quality3 1;
BA_ "GenSigSendType" SG_ 272 FLR2RdrDetn325To329Quality4 1;
BA_ "GenSigSendType" SG_ 272 FLR2RdrDetn325To329RCS0 1;
BA_ "GenSigStartValue" SG_ 272 FLR2RdrDetn325To329RCS0 500;
BA_ "GenSigSendType" SG_ 272 FLR2RdrDetn325To329RCS1 1;
BA_ "GenSigStartValue" SG_ 272 FLR2RdrDetn325To329RCS1 500;
BA_ "GenSigSendType" SG_ 272 FLR2RdrDetn325To329RCS2 1;
BA_ "GenSigStartValue" SG_ 272 FLR2RdrDetn325To329RCS2 500;
BA_ "GenSigSendType" SG_ 272 FLR2RdrDetn325To329RCS3 1;
BA_ "GenSigStartValue" SG_ 272 FLR2RdrDetn325To329RCS3 500;
BA_ "GenSigSendType" SG_ 272 FLR2RdrDetn325To329RCS4 1;
BA_ "GenSigStartValue" SG_ 272 FLR2RdrDetn325To329RCS4 500;
BA_ "GenSigSendType" SG_ 272 FLR2RdrDetn325To329Range0 1;
BA_ "GenSigSendType" SG_ 272 FLR2RdrDetn325To329Range1 1;
BA_ "GenSigSendType" SG_ 272 FLR2RdrDetn325To329Range2 1;
BA_ "GenSigSendType" SG_ 272 FLR2RdrDetn325To329Range3 1;
BA_ "GenSigSendType" SG_ 272 FLR2RdrDetn325To329Range4 1;
BA_ "GenSigSendType" SG_ 272 FLR2RdrDetn325To329RngRt0 1;
BA_ "GenSigStartValue" SG_ 272 FLR2RdrDetn325To329RngRt0 1111;
BA_ "GenSigSendType" SG_ 272 FLR2RdrDetn325To329RngRt1 1;
BA_ "GenSigStartValue" SG_ 272 FLR2RdrDetn325To329RngRt1 1111;
BA_ "GenSigSendType" SG_ 272 FLR2RdrDetn325To329RngRt2 1;
BA_ "GenSigStartValue" SG_ 272 FLR2RdrDetn325To329RngRt2 1111;
BA_ "GenSigSendType" SG_ 272 FLR2RdrDetn325To329RngRt3 1;
BA_ "GenSigStartValue" SG_ 272 FLR2RdrDetn325To329RngRt3 1111;
BA_ "GenSigSendType" SG_ 272 FLR2RdrDetn325To329RngRt4 1;
BA_ "GenSigStartValue" SG_ 272 FLR2RdrDetn325To329RngRt4 1111;
BA_ "GenSigSendType" SG_ 272 FLR2RdrDetn325To329SNR0 1;
BA_ "GenSigSendType" SG_ 272 FLR2RdrDetn325To329SNR1 1;
BA_ "GenSigSendType" SG_ 272 FLR2RdrDetn325To329SNR2 1;
BA_ "GenSigSendType" SG_ 272 FLR2RdrDetn325To329SNR3 1;
BA_ "GenSigSendType" SG_ 272 FLR2RdrDetn325To329SNR4 1;
BA_ "GenSigSendType" SG_ 272 FLR2RdrDetn325To329ScanID 1;
BA_ "GenSigSendType" SG_ 274 FLR2RdrDetn330To334AziAng0 1;
BA_ "GenSigSendType" SG_ 274 FLR2RdrDetn330To334AziAng1 1;
BA_ "GenSigSendType" SG_ 274 FLR2RdrDetn330To334AziAng2 1;
BA_ "GenSigSendType" SG_ 274 FLR2RdrDetn330To334AziAng3 1;
BA_ "GenSigSendType" SG_ 274 FLR2RdrDetn330To334AziAng4 1;
BA_ "GenSigDataID" SG_ 274 FLR2RdrDetn330To334CRC "0xAFB";
BA_ "GenSigFuncType" SG_ 274 FLR2RdrDetn330To334CRC 28;
BA_ "GenSigSendType" SG_ 274 FLR2RdrDetn330To334CRC 1;
BA_ "GenSigFuncType" SG_ 274 FLR2RdrDetn330To334Counter 27;
BA_ "GenSigSendType" SG_ 274 FLR2RdrDetn330To334Counter 1;
BA_ "GenSigSendType" SG_ 274 FLR2RdrDetn330To334DynPrpty0 1;
BA_ "GenSigSendType" SG_ 274 FLR2RdrDetn330To334DynPrpty1 1;
BA_ "GenSigSendType" SG_ 274 FLR2RdrDetn330To334DynPrpty2 1;
BA_ "GenSigSendType" SG_ 274 FLR2RdrDetn330To334DynPrpty3 1;
BA_ "GenSigSendType" SG_ 274 FLR2RdrDetn330To334DynPrpty4 1;
BA_ "GenSigSendType" SG_ 274 FLR2RdrDetn330To334EleAng0 1;
BA_ "GenSigSendType" SG_ 274 FLR2RdrDetn330To334EleAng1 1;
BA_ "GenSigSendType" SG_ 274 FLR2RdrDetn330To334EleAng2 1;
BA_ "GenSigSendType" SG_ 274 FLR2RdrDetn330To334EleAng3 1;
BA_ "GenSigSendType" SG_ 274 FLR2RdrDetn330To334EleAng4 1;
BA_ "GenSigSendType" SG_ 274 FLR2RdrDetn330To334Mode0 1;
BA_ "GenSigSendType" SG_ 274 FLR2RdrDetn330To334Mode1 1;
BA_ "GenSigSendType" SG_ 274 FLR2RdrDetn330To334Mode2 1;
BA_ "GenSigSendType" SG_ 274 FLR2RdrDetn330To334Mode3 1;
BA_ "GenSigSendType" SG_ 274 FLR2RdrDetn330To334Mode4 1;
BA_ "GenSigSendType" SG_ 274 FLR2RdrDetn330To334Quality0 1;
BA_ "GenSigSendType" SG_ 274 FLR2RdrDetn330To334Quality1 1;
BA_ "GenSigSendType" SG_ 274 FLR2RdrDetn330To334Quality2 1;
BA_ "GenSigSendType" SG_ 274 FLR2RdrDetn330To334Quality3 1;
BA_ "GenSigSendType" SG_ 274 FLR2RdrDetn330To334Quality4 1;
BA_ "GenSigSendType" SG_ 274 FLR2RdrDetn330To334RCS0 1;
BA_ "GenSigStartValue" SG_ 274 FLR2RdrDetn330To334RCS0 500;
BA_ "GenSigSendType" SG_ 274 FLR2RdrDetn330To334RCS1 1;
BA_ "GenSigStartValue" SG_ 274 FLR2RdrDetn330To334RCS1 500;
BA_ "GenSigSendType" SG_ 274 FLR2RdrDetn330To334RCS2 1;
BA_ "GenSigStartValue" SG_ 274 FLR2RdrDetn330To334RCS2 500;
BA_ "GenSigSendType" SG_ 274 FLR2RdrDetn330To334RCS3 1;
BA_ "GenSigStartValue" SG_ 274 FLR2RdrDetn330To334RCS3 500;
BA_ "GenSigSendType" SG_ 274 FLR2RdrDetn330To334RCS4 1;
BA_ "GenSigStartValue" SG_ 274 FLR2RdrDetn330To334RCS4 500;
BA_ "GenSigSendType" SG_ 274 FLR2RdrDetn330To334Range0 1;
BA_ "GenSigSendType" SG_ 274 FLR2RdrDetn330To334Range1 1;
BA_ "GenSigSendType" SG_ 274 FLR2RdrDetn330To334Range2 1;
BA_ "GenSigSendType" SG_ 274 FLR2RdrDetn330To334Range3 1;
BA_ "GenSigSendType" SG_ 274 FLR2RdrDetn330To334Range4 1;
BA_ "GenSigSendType" SG_ 274 FLR2RdrDetn330To334RngRt0 1;
BA_ "GenSigStartValue" SG_ 274 FLR2RdrDetn330To334RngRt0 1111;
BA_ "GenSigSendType" SG_ 274 FLR2RdrDetn330To334RngRt1 1;
BA_ "GenSigStartValue" SG_ 274 FLR2RdrDetn330To334RngRt1 1111;
BA_ "GenSigSendType" SG_ 274 FLR2RdrDetn330To334RngRt2 1;
BA_ "GenSigStartValue" SG_ 274 FLR2RdrDetn330To334RngRt2 1111;
BA_ "GenSigSendType" SG_ 274 FLR2RdrDetn330To334RngRt3 1;
BA_ "GenSigStartValue" SG_ 274 FLR2RdrDetn330To334RngRt3 1111;
BA_ "GenSigSendType" SG_ 274 FLR2RdrDetn330To334RngRt4 1;
BA_ "GenSigStartValue" SG_ 274 FLR2RdrDetn330To334RngRt4 1111;
BA_ "GenSigSendType" SG_ 274 FLR2RdrDetn330To334SNR0 1;
BA_ "GenSigSendType" SG_ 274 FLR2RdrDetn330To334SNR1 1;
BA_ "GenSigSendType" SG_ 274 FLR2RdrDetn330To334SNR2 1;
BA_ "GenSigSendType" SG_ 274 FLR2RdrDetn330To334SNR3 1;
BA_ "GenSigSendType" SG_ 274 FLR2RdrDetn330To334SNR4 1;
BA_ "GenSigSendType" SG_ 274 FLR2RdrDetn330To334ScanID 1;
BA_ "GenSigSendType" SG_ 276 FLR2RdrDetn335To339AziAng0 1;
BA_ "GenSigSendType" SG_ 276 FLR2RdrDetn335To339AziAng1 1;
BA_ "GenSigSendType" SG_ 276 FLR2RdrDetn335To339AziAng2 1;
BA_ "GenSigSendType" SG_ 276 FLR2RdrDetn335To339AziAng3 1;
BA_ "GenSigSendType" SG_ 276 FLR2RdrDetn335To339AziAng4 1;
BA_ "GenSigDataID" SG_ 276 FLR2RdrDetn335To339CRC "0xAFC";
BA_ "GenSigFuncType" SG_ 276 FLR2RdrDetn335To339CRC 28;
BA_ "GenSigSendType" SG_ 276 FLR2RdrDetn335To339CRC 1;
BA_ "GenSigFuncType" SG_ 276 FLR2RdrDetn335To339Counter 27;
BA_ "GenSigSendType" SG_ 276 FLR2RdrDetn335To339Counter 1;
BA_ "GenSigSendType" SG_ 276 FLR2RdrDetn335To339DynPrpty0 1;
BA_ "GenSigSendType" SG_ 276 FLR2RdrDetn335To339DynPrpty1 1;
BA_ "GenSigSendType" SG_ 276 FLR2RdrDetn335To339DynPrpty2 1;
BA_ "GenSigSendType" SG_ 276 FLR2RdrDetn335To339DynPrpty3 1;
BA_ "GenSigSendType" SG_ 276 FLR2RdrDetn335To339DynPrpty4 1;
BA_ "GenSigSendType" SG_ 276 FLR2RdrDetn335To339EleAng0 1;
BA_ "GenSigSendType" SG_ 276 FLR2RdrDetn335To339EleAng1 1;
BA_ "GenSigSendType" SG_ 276 FLR2RdrDetn335To339EleAng2 1;
BA_ "GenSigSendType" SG_ 276 FLR2RdrDetn335To339EleAng3 1;
BA_ "GenSigSendType" SG_ 276 FLR2RdrDetn335To339EleAng4 1;
BA_ "GenSigSendType" SG_ 276 FLR2RdrDetn335To339Mode0 1;
BA_ "GenSigSendType" SG_ 276 FLR2RdrDetn335To339Mode1 1;
BA_ "GenSigSendType" SG_ 276 FLR2RdrDetn335To339Mode2 1;
BA_ "GenSigSendType" SG_ 276 FLR2RdrDetn335To339Mode3 1;
BA_ "GenSigSendType" SG_ 276 FLR2RdrDetn335To339Mode4 1;
BA_ "GenSigSendType" SG_ 276 FLR2RdrDetn335To339Quality0 1;
BA_ "GenSigSendType" SG_ 276 FLR2RdrDetn335To339Quality1 1;
BA_ "GenSigSendType" SG_ 276 FLR2RdrDetn335To339Quality2 1;
BA_ "GenSigSendType" SG_ 276 FLR2RdrDetn335To339Quality3 1;
BA_ "GenSigSendType" SG_ 276 FLR2RdrDetn335To339Quality4 1;
BA_ "GenSigSendType" SG_ 276 FLR2RdrDetn335To339RCS0 1;
BA_ "GenSigStartValue" SG_ 276 FLR2RdrDetn335To339RCS0 500;
BA_ "GenSigSendType" SG_ 276 FLR2RdrDetn335To339RCS1 1;
BA_ "GenSigStartValue" SG_ 276 FLR2RdrDetn335To339RCS1 500;
BA_ "GenSigSendType" SG_ 276 FLR2RdrDetn335To339RCS2 1;
BA_ "GenSigStartValue" SG_ 276 FLR2RdrDetn335To339RCS2 500;
BA_ "GenSigSendType" SG_ 276 FLR2RdrDetn335To339RCS3 1;
BA_ "GenSigStartValue" SG_ 276 FLR2RdrDetn335To339RCS3 500;
BA_ "GenSigSendType" SG_ 276 FLR2RdrDetn335To339RCS4 1;
BA_ "GenSigStartValue" SG_ 276 FLR2RdrDetn335To339RCS4 500;
BA_ "GenSigSendType" SG_ 276 FLR2RdrDetn335To339Range0 1;
BA_ "GenSigSendType" SG_ 276 FLR2RdrDetn335To339Range1 1;
BA_ "GenSigSendType" SG_ 276 FLR2RdrDetn335To339Range2 1;
BA_ "GenSigSendType" SG_ 276 FLR2RdrDetn335To339Range3 1;
BA_ "GenSigSendType" SG_ 276 FLR2RdrDetn335To339Range4 1;
BA_ "GenSigSendType" SG_ 276 FLR2RdrDetn335To339RngRt0 1;
BA_ "GenSigStartValue" SG_ 276 FLR2RdrDetn335To339RngRt0 1111;
BA_ "GenSigSendType" SG_ 276 FLR2RdrDetn335To339RngRt1 1;
BA_ "GenSigStartValue" SG_ 276 FLR2RdrDetn335To339RngRt1 1111;
BA_ "GenSigSendType" SG_ 276 FLR2RdrDetn335To339RngRt2 1;
BA_ "GenSigStartValue" SG_ 276 FLR2RdrDetn335To339RngRt2 1111;
BA_ "GenSigSendType" SG_ 276 FLR2RdrDetn335To339RngRt3 1;
BA_ "GenSigStartValue" SG_ 276 FLR2RdrDetn335To339RngRt3 1111;
BA_ "GenSigSendType" SG_ 276 FLR2RdrDetn335To339RngRt4 1;
BA_ "GenSigStartValue" SG_ 276 FLR2RdrDetn335To339RngRt4 1111;
BA_ "GenSigSendType" SG_ 276 FLR2RdrDetn335To339SNR0 1;
BA_ "GenSigSendType" SG_ 276 FLR2RdrDetn335To339SNR1 1;
BA_ "GenSigSendType" SG_ 276 FLR2RdrDetn335To339SNR2 1;
BA_ "GenSigSendType" SG_ 276 FLR2RdrDetn335To339SNR3 1;
BA_ "GenSigSendType" SG_ 276 FLR2RdrDetn335To339SNR4 1;
BA_ "GenSigSendType" SG_ 276 FLR2RdrDetn335To339ScanID 1;
VAL_ 250 FLR2RdrDetn270To274Mode0 0 "FLR2RadrDetnMode_RngNearReslMod" 1 "FLR2RadrDetnMode_RngMidReslMod" 2 "FLR2RadrDetnMode_RngLongReslMod" 3 "FLR2RadrDetnMode_DetectionUnpopulated";
VAL_ 250 FLR2RdrDetn270To274Mode1 0 "FLR2RadrDetnMode_RngNearReslMod" 1 "FLR2RadrDetnMode_RngMidReslMod" 2 "FLR2RadrDetnMode_RngLongReslMod" 3 "FLR2RadrDetnMode_DetectionUnpopulated";
VAL_ 250 FLR2RdrDetn270To274Mode2 0 "FLR2RadrDetnMode_RngNearReslMod" 1 "FLR2RadrDetnMode_RngMidReslMod" 2 "FLR2RadrDetnMode_RngLongReslMod" 3 "FLR2RadrDetnMode_DetectionUnpopulated";
VAL_ 250 FLR2RdrDetn270To274Mode3 0 "FLR2RadrDetnMode_RngNearReslMod" 1 "FLR2RadrDetnMode_RngMidReslMod" 2 "FLR2RadrDetnMode_RngLongReslMod" 3 "FLR2RadrDetnMode_DetectionUnpopulated";
VAL_ 250 FLR2RdrDetn270To274Mode4 0 "FLR2RadrDetnMode_RngNearReslMod" 1 "FLR2RadrDetnMode_RngMidReslMod" 2 "FLR2RadrDetnMode_RngLongReslMod" 3 "FLR2RadrDetnMode_DetectionUnpopulated";
VAL_ 250 FLR2RdrDetn270To274Quality0 0 "Quality_Low" 1 "Quality_Medium" 2 "Quality_High" 3 "Quality_DetectionUnpopulated";
VAL_ 250 FLR2RdrDetn270To274Quality1 0 "Quality_Low" 1 "Quality_Medium" 2 "Quality_High" 3 "Quality_DetectionUnpopulated";
VAL_ 250 FLR2RdrDetn270To274Quality2 0 "Quality_Low" 1 "Quality_Medium" 2 "Quality_High" 3 "Quality_DetectionUnpopulated";
VAL_ 250 FLR2RdrDetn270To274Quality3 0 "Quality_Low" 1 "Quality_Medium" 2 "Quality_High" 3 "Quality_DetectionUnpopulated";
VAL_ 250 FLR2RdrDetn270To274Quality4 0 "Quality_Low" 1 "Quality_Medium" 2 "Quality_High" 3 "Quality_DetectionUnpopulated";
VAL_ 252 FLR2RdrDetn275To279Mode0 0 "FLR2RadrDetnMode_RngNearReslMod" 1 "FLR2RadrDetnMode_RngMidReslMod" 2 "FLR2RadrDetnMode_RngLongReslMod" 3 "FLR2RadrDetnMode_DetectionUnpopulated";
VAL_ 252 FLR2RdrDetn275To279Mode1 0 "FLR2RadrDetnMode_RngNearReslMod" 1 "FLR2RadrDetnMode_RngMidReslMod" 2 "FLR2RadrDetnMode_RngLongReslMod" 3 "FLR2RadrDetnMode_DetectionUnpopulated";
VAL_ 252 FLR2RdrDetn275To279Mode2 0 "FLR2RadrDetnMode_RngNearReslMod" 1 "FLR2RadrDetnMode_RngMidReslMod" 2 "FLR2RadrDetnMode_RngLongReslMod" 3 "FLR2RadrDetnMode_DetectionUnpopulated";
VAL_ 252 FLR2RdrDetn275To279Mode3 0 "FLR2RadrDetnMode_RngNearReslMod" 1 "FLR2RadrDetnMode_RngMidReslMod" 2 "FLR2RadrDetnMode_RngLongReslMod" 3 "FLR2RadrDetnMode_DetectionUnpopulated";
VAL_ 252 FLR2RdrDetn275To279Mode4 0 "FLR2RadrDetnMode_RngNearReslMod" 1 "FLR2RadrDetnMode_RngMidReslMod" 2 "FLR2RadrDetnMode_RngLongReslMod" 3 "FLR2RadrDetnMode_DetectionUnpopulated";
VAL_ 252 FLR2RdrDetn275To279Quality0 0 "Quality_Low" 1 "Quality_Medium" 2 "Quality_High" 3 "Quality_DetectionUnpopulated";
VAL_ 252 FLR2RdrDetn275To279Quality1 0 "Quality_Low" 1 "Quality_Medium" 2 "Quality_High" 3 "Quality_DetectionUnpopulated";
VAL_ 252 FLR2RdrDetn275To279Quality2 0 "Quality_Low" 1 "Quality_Medium" 2 "Quality_High" 3 "Quality_DetectionUnpopulated";
VAL_ 252 FLR2RdrDetn275To279Quality3 0 "Quality_Low" 1 "Quality_Medium" 2 "Quality_High" 3 "Quality_DetectionUnpopulated";
VAL_ 252 FLR2RdrDetn275To279Quality4 0 "Quality_Low" 1 "Quality_Medium" 2 "Quality_High" 3 "Quality_DetectionUnpopulated";
VAL_ 254 FLR2RdrDetn280To284Mode0 0 "FLR2RadrDetnMode_RngNearReslMod" 1 "FLR2RadrDetnMode_RngMidReslMod" 2 "FLR2RadrDetnMode_RngLongReslMod" 3 "FLR2RadrDetnMode_DetectionUnpopulated";
VAL_ 254 FLR2RdrDetn280To284Mode1 0 "FLR2RadrDetnMode_RngNearReslMod" 1 "FLR2RadrDetnMode_RngMidReslMod" 2 "FLR2RadrDetnMode_RngLongReslMod" 3 "FLR2RadrDetnMode_DetectionUnpopulated";
VAL_ 254 FLR2RdrDetn280To284Mode2 0 "FLR2RadrDetnMode_RngNearReslMod" 1 "FLR2RadrDetnMode_RngMidReslMod" 2 "FLR2RadrDetnMode_RngLongReslMod" 3 "FLR2RadrDetnMode_DetectionUnpopulated";
VAL_ 254 FLR2RdrDetn280To284Mode3 0 "FLR2RadrDetnMode_RngNearReslMod" 1 "FLR2RadrDetnMode_RngMidReslMod" 2 "FLR2RadrDetnMode_RngLongReslMod" 3 "FLR2RadrDetnMode_DetectionUnpopulated";
VAL_ 254 FLR2RdrDetn280To284Mode4 0 "FLR2RadrDetnMode_RngNearReslMod" 1 "FLR2RadrDetnMode_RngMidReslMod" 2 "FLR2RadrDetnMode_RngLongReslMod" 3 "FLR2RadrDetnMode_DetectionUnpopulated";
VAL_ 254 FLR2RdrDetn280To284Quality0 0 "Quality_Low" 1 "Quality_Medium" 2 "Quality_High" 3 "Quality_DetectionUnpopulated";
VAL_ 254 FLR2RdrDetn280To284Quality1 0 "Quality_Low" 1 "Quality_Medium" 2 "Quality_High" 3 "Quality_DetectionUnpopulated";
VAL_ 254 FLR2RdrDetn280To284Quality2 0 "Quality_Low" 1 "Quality_Medium" 2 "Quality_High" 3 "Quality_DetectionUnpopulated";
VAL_ 254 FLR2RdrDetn280To284Quality3 0 "Quality_Low" 1 "Quality_Medium" 2 "Quality_High" 3 "Quality_DetectionUnpopulated";
VAL_ 254 FLR2RdrDetn280To284Quality4 0 "Quality_Low" 1 "Quality_Medium" 2 "Quality_High" 3 "Quality_DetectionUnpopulated";
VAL_ 256 FLR2RdrDetn285To289Mode0 0 "FLR2RadrDetnMode_RngNearReslMod" 1 "FLR2RadrDetnMode_RngMidReslMod" 2 "FLR2RadrDetnMode_RngLongReslMod" 3 "FLR2RadrDetnMode_DetectionUnpopulated";
VAL_ 256 FLR2RdrDetn285To289Mode1 0 "FLR2RadrDetnMode_RngNearReslMod" 1 "FLR2RadrDetnMode_RngMidReslMod" 2 "FLR2RadrDetnMode_RngLongReslMod" 3 "FLR2RadrDetnMode_DetectionUnpopulated";
VAL_ 256 FLR2RdrDetn285To289Mode2 0 "FLR2RadrDetnMode_RngNearReslMod" 1 "FLR2RadrDetnMode_RngMidReslMod" 2 "FLR2RadrDetnMode_RngLongReslMod" 3 "FLR2RadrDetnMode_DetectionUnpopulated";
VAL_ 256 FLR2RdrDetn285To289Mode3 0 "FLR2RadrDetnMode_RngNearReslMod" 1 "FLR2RadrDetnMode_RngMidReslMod" 2 "FLR2RadrDetnMode_RngLongReslMod" 3 "FLR2RadrDetnMode_DetectionUnpopulated";
VAL_ 256 FLR2RdrDetn285To289Mode4 0 "FLR2RadrDetnMode_RngNearReslMod" 1 "FLR2RadrDetnMode_RngMidReslMod" 2 "FLR2RadrDetnMode_RngLongReslMod" 3 "FLR2RadrDetnMode_DetectionUnpopulated";
VAL_ 256 FLR2RdrDetn285To289Quality0 0 "Quality_Low" 1 "Quality_Medium" 2 "Quality_High" 3 "Quality_DetectionUnpopulated";
VAL_ 256 FLR2RdrDetn285To289Quality1 0 "Quality_Low" 1 "Quality_Medium" 2 "Quality_High" 3 "Quality_DetectionUnpopulated";
VAL_ 256 FLR2RdrDetn285To289Quality2 0 "Quality_Low" 1 "Quality_Medium" 2 "Quality_High" 3 "Quality_DetectionUnpopulated";
VAL_ 256 FLR2RdrDetn285To289Quality3 0 "Quality_Low" 1 "Quality_Medium" 2 "Quality_High" 3 "Quality_DetectionUnpopulated";
VAL_ 256 FLR2RdrDetn285To289Quality4 0 "Quality_Low" 1 "Quality_Medium" 2 "Quality_High" 3 "Quality_DetectionUnpopulated";
VAL_ 258 FLR2RdrDetn290To294Mode0 0 "FLR2RadrDetnMode_RngNearReslMod" 1 "FLR2RadrDetnMode_RngMidReslMod" 2 "FLR2RadrDetnMode_RngLongReslMod" 3 "FLR2RadrDetnMode_DetectionUnpopulated";
VAL_ 258 FLR2RdrDetn290To294Mode1 0 "FLR2RadrDetnMode_RngNearReslMod" 1 "FLR2RadrDetnMode_RngMidReslMod" 2 "FLR2RadrDetnMode_RngLongReslMod" 3 "FLR2RadrDetnMode_DetectionUnpopulated";
VAL_ 258 FLR2RdrDetn290To294Mode2 0 "FLR2RadrDetnMode_RngNearReslMod" 1 "FLR2RadrDetnMode_RngMidReslMod" 2 "FLR2RadrDetnMode_RngLongReslMod" 3 "FLR2RadrDetnMode_DetectionUnpopulated";
VAL_ 258 FLR2RdrDetn290To294Mode3 0 "FLR2RadrDetnMode_RngNearReslMod" 1 "FLR2RadrDetnMode_RngMidReslMod" 2 "FLR2RadrDetnMode_RngLongReslMod" 3 "FLR2RadrDetnMode_DetectionUnpopulated";
VAL_ 258 FLR2RdrDetn290To294Mode4 0 "FLR2RadrDetnMode_RngNearReslMod" 1 "FLR2RadrDetnMode_RngMidReslMod" 2 "FLR2RadrDetnMode_RngLongReslMod" 3 "FLR2RadrDetnMode_DetectionUnpopulated";
VAL_ 258 FLR2RdrDetn290To294Quality0 0 "Quality_Low" 1 "Quality_Medium" 2 "Quality_High" 3 "Quality_DetectionUnpopulated";
VAL_ 258 FLR2RdrDetn290To294Quality1 0 "Quality_Low" 1 "Quality_Medium" 2 "Quality_High" 3 "Quality_DetectionUnpopulated";
VAL_ 258 FLR2RdrDetn290To294Quality2 0 "Quality_Low" 1 "Quality_Medium" 2 "Quality_High" 3 "Quality_DetectionUnpopulated";
VAL_ 258 FLR2RdrDetn290To294Quality3 0 "Quality_Low" 1 "Quality_Medium" 2 "Quality_High" 3 "Quality_DetectionUnpopulated";
VAL_ 258 FLR2RdrDetn290To294Quality4 0 "Quality_Low" 1 "Quality_Medium" 2 "Quality_High" 3 "Quality_DetectionUnpopulated";
VAL_ 260 FLR2RdrDetn295To299Mode0 0 "FLR2RadrDetnMode_RngNearReslMod" 1 "FLR2RadrDetnMode_RngMidReslMod" 2 "FLR2RadrDetnMode_RngLongReslMod" 3 "FLR2RadrDetnMode_DetectionUnpopulated";
VAL_ 260 FLR2RdrDetn295To299Mode1 0 "FLR2RadrDetnMode_RngNearReslMod" 1 "FLR2RadrDetnMode_RngMidReslMod" 2 "FLR2RadrDetnMode_RngLongReslMod" 3 "FLR2RadrDetnMode_DetectionUnpopulated";
VAL_ 260 FLR2RdrDetn295To299Mode2 0 "FLR2RadrDetnMode_RngNearReslMod" 1 "FLR2RadrDetnMode_RngMidReslMod" 2 "FLR2RadrDetnMode_RngLongReslMod" 3 "FLR2RadrDetnMode_DetectionUnpopulated";
VAL_ 260 FLR2RdrDetn295To299Mode3 0 "FLR2RadrDetnMode_RngNearReslMod" 1 "FLR2RadrDetnMode_RngMidReslMod" 2 "FLR2RadrDetnMode_RngLongReslMod" 3 "FLR2RadrDetnMode_DetectionUnpopulated";
VAL_ 260 FLR2RdrDetn295To299Mode4 0 "FLR2RadrDetnMode_RngNearReslMod" 1 "FLR2RadrDetnMode_RngMidReslMod" 2 "FLR2RadrDetnMode_RngLongReslMod" 3 "FLR2RadrDetnMode_DetectionUnpopulated";
VAL_ 260 FLR2RdrDetn295To299Quality0 0 "Quality_Low" 1 "Quality_Medium" 2 "Quality_High" 3 "Quality_DetectionUnpopulated";
VAL_ 260 FLR2RdrDetn295To299Quality1 0 "Quality_Low" 1 "Quality_Medium" 2 "Quality_High" 3 "Quality_DetectionUnpopulated";
VAL_ 260 FLR2RdrDetn295To299Quality2 0 "Quality_Low" 1 "Quality_Medium" 2 "Quality_High" 3 "Quality_DetectionUnpopulated";
VAL_ 260 FLR2RdrDetn295To299Quality3 0 "Quality_Low" 1 "Quality_Medium" 2 "Quality_High" 3 "Quality_DetectionUnpopulated";
VAL_ 260 FLR2RdrDetn295To299Quality4 0 "Quality_Low" 1 "Quality_Medium" 2 "Quality_High" 3 "Quality_DetectionUnpopulated";
VAL_ 262 FLR2RdrDetn300To304Mode0 0 "FLR2RadrDetnMode_RngNearReslMod" 1 "FLR2RadrDetnMode_RngMidReslMod" 2 "FLR2RadrDetnMode_RngLongReslMod" 3 "FLR2RadrDetnMode_DetectionUnpopulated";
VAL_ 262 FLR2RdrDetn300To304Mode1 0 "FLR2RadrDetnMode_RngNearReslMod" 1 "FLR2RadrDetnMode_RngMidReslMod" 2 "FLR2RadrDetnMode_RngLongReslMod" 3 "FLR2RadrDetnMode_DetectionUnpopulated";
VAL_ 262 FLR2RdrDetn300To304Mode2 0 "FLR2RadrDetnMode_RngNearReslMod" 1 "FLR2RadrDetnMode_RngMidReslMod" 2 "FLR2RadrDetnMode_RngLongReslMod" 3 "FLR2RadrDetnMode_DetectionUnpopulated";
VAL_ 262 FLR2RdrDetn300To304Mode3 0 "FLR2RadrDetnMode_RngNearReslMod" 1 "FLR2RadrDetnMode_RngMidReslMod" 2 "FLR2RadrDetnMode_RngLongReslMod" 3 "FLR2RadrDetnMode_DetectionUnpopulated";
VAL_ 262 FLR2RdrDetn300To304Mode4 0 "FLR2RadrDetnMode_RngNearReslMod" 1 "FLR2RadrDetnMode_RngMidReslMod" 2 "FLR2RadrDetnMode_RngLongReslMod" 3 "FLR2RadrDetnMode_DetectionUnpopulated";
VAL_ 262 FLR2RdrDetn300To304Quality0 0 "Quality_Low" 1 "Quality_Medium" 2 "Quality_High" 3 "Quality_DetectionUnpopulated";
VAL_ 262 FLR2RdrDetn300To304Quality1 0 "Quality_Low" 1 "Quality_Medium" 2 "Quality_High" 3 "Quality_DetectionUnpopulated";
VAL_ 262 FLR2RdrDetn300To304Quality2 0 "Quality_Low" 1 "Quality_Medium" 2 "Quality_High" 3 "Quality_DetectionUnpopulated";
VAL_ 262 FLR2RdrDetn300To304Quality3 0 "Quality_Low" 1 "Quality_Medium" 2 "Quality_High" 3 "Quality_DetectionUnpopulated";
VAL_ 262 FLR2RdrDetn300To304Quality4 0 "Quality_Low" 1 "Quality_Medium" 2 "Quality_High" 3 "Quality_DetectionUnpopulated";
VAL_ 264 FLR2RdrDetn305To309Mode0 0 "FLR2RadrDetnMode_RngNearReslMod" 1 "FLR2RadrDetnMode_RngMidReslMod" 2 "FLR2RadrDetnMode_RngLongReslMod" 3 "FLR2RadrDetnMode_DetectionUnpopulated";
VAL_ 264 FLR2RdrDetn305To309Mode1 0 "FLR2RadrDetnMode_RngNearReslMod" 1 "FLR2RadrDetnMode_RngMidReslMod" 2 "FLR2RadrDetnMode_RngLongReslMod" 3 "FLR2RadrDetnMode_DetectionUnpopulated";
VAL_ 264 FLR2RdrDetn305To309Mode2 0 "FLR2RadrDetnMode_RngNearReslMod" 1 "FLR2RadrDetnMode_RngMidReslMod" 2 "FLR2RadrDetnMode_RngLongReslMod" 3 "FLR2RadrDetnMode_DetectionUnpopulated";
VAL_ 264 FLR2RdrDetn305To309Mode3 0 "FLR2RadrDetnMode_RngNearReslMod" 1 "FLR2RadrDetnMode_RngMidReslMod" 2 "FLR2RadrDetnMode_RngLongReslMod" 3 "FLR2RadrDetnMode_DetectionUnpopulated";
VAL_ 264 FLR2RdrDetn305To309Mode4 0 "FLR2RadrDetnMode_RngNearReslMod" 1 "FLR2RadrDetnMode_RngMidReslMod" 2 "FLR2RadrDetnMode_RngLongReslMod" 3 "FLR2RadrDetnMode_DetectionUnpopulated";
VAL_ 264 FLR2RdrDetn305To309Quality0 0 "Quality_Low" 1 "Quality_Medium" 2 "Quality_High" 3 "Quality_DetectionUnpopulated";
VAL_ 264 FLR2RdrDetn305To309Quality1 0 "Quality_Low" 1 "Quality_Medium" 2 "Quality_High" 3 "Quality_DetectionUnpopulated";
VAL_ 264 FLR2RdrDetn305To309Quality2 0 "Quality_Low" 1 "Quality_Medium" 2 "Quality_High" 3 "Quality_DetectionUnpopulated";
VAL_ 264 FLR2RdrDetn305To309Quality3 0 "Quality_Low" 1 "Quality_Medium" 2 "Quality_High" 3 "Quality_DetectionUnpopulated";
VAL_ 264 FLR2RdrDetn305To309Quality4 0 "Quality_Low" 1 "Quality_Medium" 2 "Quality_High" 3 "Quality_DetectionUnpopulated";
VAL_ 266 FLR2RdrDetn310To314Mode0 0 "FLR2RadrDetnMode_RngNearReslMod" 1 "FLR2RadrDetnMode_RngMidReslMod" 2 "FLR2RadrDetnMode_RngLongReslMod" 3 "FLR2RadrDetnMode_DetectionUnpopulated";
VAL_ 266 FLR2RdrDetn310To314Mode1 0 "FLR2RadrDetnMode_RngNearReslMod" 1 "FLR2RadrDetnMode_RngMidReslMod" 2 "FLR2RadrDetnMode_RngLongReslMod" 3 "FLR2RadrDetnMode_DetectionUnpopulated";
VAL_ 266 FLR2RdrDetn310To314Mode2 0 "FLR2RadrDetnMode_RngNearReslMod" 1 "FLR2RadrDetnMode_RngMidReslMod" 2 "FLR2RadrDetnMode_RngLongReslMod" 3 "FLR2RadrDetnMode_DetectionUnpopulated";
VAL_ 266 FLR2RdrDetn310To314Mode3 0 "FLR2RadrDetnMode_RngNearReslMod" 1 "FLR2RadrDetnMode_RngMidReslMod" 2 "FLR2RadrDetnMode_RngLongReslMod" 3 "FLR2RadrDetnMode_DetectionUnpopulated";
VAL_ 266 FLR2RdrDetn310To314Mode4 0 "FLR2RadrDetnMode_RngNearReslMod" 1 "FLR2RadrDetnMode_RngMidReslMod" 2 "FLR2RadrDetnMode_RngLongReslMod" 3 "FLR2RadrDetnMode_DetectionUnpopulated";
VAL_ 266 FLR2RdrDetn310To314Quality0 0 "Quality_Low" 1 "Quality_Medium" 2 "Quality_High" 3 "Quality_DetectionUnpopulated";
VAL_ 266 FLR2RdrDetn310To314Quality1 0 "Quality_Low" 1 "Quality_Medium" 2 "Quality_High" 3 "Quality_DetectionUnpopulated";
VAL_ 266 FLR2RdrDetn310To314Quality2 0 "Quality_Low" 1 "Quality_Medium" 2 "Quality_High" 3 "Quality_DetectionUnpopulated";
VAL_ 266 FLR2RdrDetn310To314Quality3 0 "Quality_Low" 1 "Quality_Medium" 2 "Quality_High" 3 "Quality_DetectionUnpopulated";
VAL_ 266 FLR2RdrDetn310To314Quality4 0 "Quality_Low" 1 "Quality_Medium" 2 "Quality_High" 3 "Quality_DetectionUnpopulated";
VAL_ 268 FLR2RdrDetn315To319Mode0 0 "FLR2RadrDetnMode_RngNearReslMod" 1 "FLR2RadrDetnMode_RngMidReslMod" 2 "FLR2RadrDetnMode_RngLongReslMod" 3 "FLR2RadrDetnMode_DetectionUnpopulated";
VAL_ 268 FLR2RdrDetn315To319Mode1 0 "FLR2RadrDetnMode_RngNearReslMod" 1 "FLR2RadrDetnMode_RngMidReslMod" 2 "FLR2RadrDetnMode_RngLongReslMod" 3 "FLR2RadrDetnMode_DetectionUnpopulated";
VAL_ 268 FLR2RdrDetn315To319Mode2 0 "FLR2RadrDetnMode_RngNearReslMod" 1 "FLR2RadrDetnMode_RngMidReslMod" 2 "FLR2RadrDetnMode_RngLongReslMod" 3 "FLR2RadrDetnMode_DetectionUnpopulated";
VAL_ 268 FLR2RdrDetn315To319Mode3 0 "FLR2RadrDetnMode_RngNearReslMod" 1 "FLR2RadrDetnMode_RngMidReslMod" 2 "FLR2RadrDetnMode_RngLongReslMod" 3 "FLR2RadrDetnMode_DetectionUnpopulated";
VAL_ 268 FLR2RdrDetn315To319Mode4 0 "FLR2RadrDetnMode_RngNearReslMod" 1 "FLR2RadrDetnMode_RngMidReslMod" 2 "FLR2RadrDetnMode_RngLongReslMod" 3 "FLR2RadrDetnMode_DetectionUnpopulated";
VAL_ 268 FLR2RdrDetn315To319Quality0 0 "Quality_Low" 1 "Quality_Medium" 2 "Quality_High" 3 "Quality_DetectionUnpopulated";
VAL_ 268 FLR2RdrDetn315To319Quality1 0 "Quality_Low" 1 "Quality_Medium" 2 "Quality_High" 3 "Quality_DetectionUnpopulated";
VAL_ 268 FLR2RdrDetn315To319Quality2 0 "Quality_Low" 1 "Quality_Medium" 2 "Quality_High" 3 "Quality_DetectionUnpopulated";
VAL_ 268 FLR2RdrDetn315To319Quality3 0 "Quality_Low" 1 "Quality_Medium" 2 "Quality_High" 3 "Quality_DetectionUnpopulated";
VAL_ 268 FLR2RdrDetn315To319Quality4 0 "Quality_Low" 1 "Quality_Medium" 2 "Quality_High" 3 "Quality_DetectionUnpopulated";
VAL_ 270 FLR2RdrDetn320To324Mode0 0 "FLR2RadrDetnMode_RngNearReslMod" 1 "FLR2RadrDetnMode_RngMidReslMod" 2 "FLR2RadrDetnMode_RngLongReslMod" 3 "FLR2RadrDetnMode_DetectionUnpopulated";
VAL_ 270 FLR2RdrDetn320To324Mode1 0 "FLR2RadrDetnMode_RngNearReslMod" 1 "FLR2RadrDetnMode_RngMidReslMod" 2 "FLR2RadrDetnMode_RngLongReslMod" 3 "FLR2RadrDetnMode_DetectionUnpopulated";
VAL_ 270 FLR2RdrDetn320To324Mode2 0 "FLR2RadrDetnMode_RngNearReslMod" 1 "FLR2RadrDetnMode_RngMidReslMod" 2 "FLR2RadrDetnMode_RngLongReslMod" 3 "FLR2RadrDetnMode_DetectionUnpopulated";
VAL_ 270 FLR2RdrDetn320To324Mode3 0 "FLR2RadrDetnMode_RngNearReslMod" 1 "FLR2RadrDetnMode_RngMidReslMod" 2 "FLR2RadrDetnMode_RngLongReslMod" 3 "FLR2RadrDetnMode_DetectionUnpopulated";
VAL_ 270 FLR2RdrDetn320To324Mode4 0 "FLR2RadrDetnMode_RngNearReslMod" 1 "FLR2RadrDetnMode_RngMidReslMod" 2 "FLR2RadrDetnMode_RngLongReslMod" 3 "FLR2RadrDetnMode_DetectionUnpopulated";
VAL_ 270 FLR2RdrDetn320To324Quality0 0 "Quality_Low" 1 "Quality_Medium" 2 "Quality_High" 3 "Quality_DetectionUnpopulated";
VAL_ 270 FLR2RdrDetn320To324Quality1 0 "Quality_Low" 1 "Quality_Medium" 2 "Quality_High" 3 "Quality_DetectionUnpopulated";
VAL_ 270 FLR2RdrDetn320To324Quality2 0 "Quality_Low" 1 "Quality_Medium" 2 "Quality_High" 3 "Quality_DetectionUnpopulated";
VAL_ 270 FLR2RdrDetn320To324Quality3 0 "Quality_Low" 1 "Quality_Medium" 2 "Quality_High" 3 "Quality_DetectionUnpopulated";
VAL_ 270 FLR2RdrDetn320To324Quality4 0 "Quality_Low" 1 "Quality_Medium" 2 "Quality_High" 3 "Quality_DetectionUnpopulated";
VAL_ 272 FLR2RdrDetn325To329Mode0 0 "FLR2RadrDetnMode_RngNearReslMod" 1 "FLR2RadrDetnMode_RngMidReslMod" 2 "FLR2RadrDetnMode_RngLongReslMod" 3 "FLR2RadrDetnMode_DetectionUnpopulated";
VAL_ 272 FLR2RdrDetn325To329Mode1 0 "FLR2RadrDetnMode_RngNearReslMod" 1 "FLR2RadrDetnMode_RngMidReslMod" 2 "FLR2RadrDetnMode_RngLongReslMod" 3 "FLR2RadrDetnMode_DetectionUnpopulated";
VAL_ 272 FLR2RdrDetn325To329Mode2 0 "FLR2RadrDetnMode_RngNearReslMod" 1 "FLR2RadrDetnMode_RngMidReslMod" 2 "FLR2RadrDetnMode_RngLongReslMod" 3 "FLR2RadrDetnMode_DetectionUnpopulated";
VAL_ 272 FLR2RdrDetn325To329Mode3 0 "FLR2RadrDetnMode_RngNearReslMod" 1 "FLR2RadrDetnMode_RngMidReslMod" 2 "FLR2RadrDetnMode_RngLongReslMod" 3 "FLR2RadrDetnMode_DetectionUnpopulated";
VAL_ 272 FLR2RdrDetn325To329Mode4 0 "FLR2RadrDetnMode_RngNearReslMod" 1 "FLR2RadrDetnMode_RngMidReslMod" 2 "FLR2RadrDetnMode_RngLongReslMod" 3 "FLR2RadrDetnMode_DetectionUnpopulated";
VAL_ 272 FLR2RdrDetn325To329Quality0 0 "Quality_Low" 1 "Quality_Medium" 2 "Quality_High" 3 "Quality_DetectionUnpopulated";
VAL_ 272 FLR2RdrDetn325To329Quality1 0 "Quality_Low" 1 "Quality_Medium" 2 "Quality_High" 3 "Quality_DetectionUnpopulated";
VAL_ 272 FLR2RdrDetn325To329Quality2 0 "Quality_Low" 1 "Quality_Medium" 2 "Quality_High" 3 "Quality_DetectionUnpopulated";
VAL_ 272 FLR2RdrDetn325To329Quality3 0 "Quality_Low" 1 "Quality_Medium" 2 "Quality_High" 3 "Quality_DetectionUnpopulated";
VAL_ 272 FLR2RdrDetn325To329Quality4 0 "Quality_Low" 1 "Quality_Medium" 2 "Quality_High" 3 "Quality_DetectionUnpopulated";
VAL_ 274 FLR2RdrDetn330To334Mode0 0 "FLR2RadrDetnMode_RngNearReslMod" 1 "FLR2RadrDetnMode_RngMidReslMod" 2 "FLR2RadrDetnMode_RngLongReslMod" 3 "FLR2RadrDetnMode_DetectionUnpopulated";
VAL_ 274 FLR2RdrDetn330To334Mode1 0 "FLR2RadrDetnMode_RngNearReslMod" 1 "FLR2RadrDetnMode_RngMidReslMod" 2 "FLR2RadrDetnMode_RngLongReslMod" 3 "FLR2RadrDetnMode_DetectionUnpopulated";
VAL_ 274 FLR2RdrDetn330To334Mode2 0 "FLR2RadrDetnMode_RngNearReslMod" 1 "FLR2RadrDetnMode_RngMidReslMod" 2 "FLR2RadrDetnMode_RngLongReslMod" 3 "FLR2RadrDetnMode_DetectionUnpopulated";
VAL_ 274 FLR2RdrDetn330To334Mode3 0 "FLR2RadrDetnMode_RngNearReslMod" 1 "FLR2RadrDetnMode_RngMidReslMod" 2 "FLR2RadrDetnMode_RngLongReslMod" 3 "FLR2RadrDetnMode_DetectionUnpopulated";
VAL_ 274 FLR2RdrDetn330To334Mode4 0 "FLR2RadrDetnMode_RngNearReslMod" 1 "FLR2RadrDetnMode_RngMidReslMod" 2 "FLR2RadrDetnMode_RngLongReslMod" 3 "FLR2RadrDetnMode_DetectionUnpopulated";
VAL_ 274 FLR2RdrDetn330To334Quality0 0 "Quality_Low" 1 "Quality_Medium" 2 "Quality_High" 3 "Quality_DetectionUnpopulated";
VAL_ 274 FLR2RdrDetn330To334Quality1 0 "Quality_Low" 1 "Quality_Medium" 2 "Quality_High" 3 "Quality_DetectionUnpopulated";
VAL_ 274 FLR2RdrDetn330To334Quality2 0 "Quality_Low" 1 "Quality_Medium" 2 "Quality_High" 3 "Quality_DetectionUnpopulated";
VAL_ 274 FLR2RdrDetn330To334Quality3 0 "Quality_Low" 1 "Quality_Medium" 2 "Quality_High" 3 "Quality_DetectionUnpopulated";
VAL_ 274 FLR2RdrDetn330To334Quality4 0 "Quality_Low" 1 "Quality_Medium" 2 "Quality_High" 3 "Quality_DetectionUnpopulated";
VAL_ 276 FLR2RdrDetn335To339Mode0 0 "FLR2RadrDetnMode_RngNearReslMod" 1 "FLR2RadrDetnMode_RngMidReslMod" 2 "FLR2RadrDetnMode_RngLongReslMod" 3 "FLR2RadrDetnMode_DetectionUnpopulated";
VAL_ 276 FLR2RdrDetn335To339Mode1 0 "FLR2RadrDetnMode_RngNearReslMod" 1 "FLR2RadrDetnMode_RngMidReslMod" 2 "FLR2RadrDetnMode_RngLongReslMod" 3 "FLR2RadrDetnMode_DetectionUnpopulated";
VAL_ 276 FLR2RdrDetn335To339Mode2 0 "FLR2RadrDetnMode_RngNearReslMod" 1 "FLR2RadrDetnMode_RngMidReslMod" 2 "FLR2RadrDetnMode_RngLongReslMod" 3 "FLR2RadrDetnMode_DetectionUnpopulated";
VAL_ 276 FLR2RdrDetn335To339Mode3 0 "FLR2RadrDetnMode_RngNearReslMod" 1 "FLR2RadrDetnMode_RngMidReslMod" 2 "FLR2RadrDetnMode_RngLongReslMod" 3 "FLR2RadrDetnMode_DetectionUnpopulated";
VAL_ 276 FLR2RdrDetn335To339Mode4 0 "FLR2RadrDetnMode_RngNearReslMod" 1 "FLR2RadrDetnMode_RngMidReslMod" 2 "FLR2RadrDetnMode_RngLongReslMod" 3 "FLR2RadrDetnMode_DetectionUnpopulated";
VAL_ 276 FLR2RdrDetn335To339Quality0 0 "Quality_Low" 1 "Quality_Medium" 2 "Quality_High" 3 "Quality_DetectionUnpopulated";
VAL_ 276 FLR2RdrDetn335To339Quality1 0 "Quality_Low" 1 "Quality_Medium" 2 "Quality_High" 3 "Quality_DetectionUnpopulated";
VAL_ 276 FLR2RdrDetn335To339Quality2 0 "Quality_Low" 1 "Quality_Medium" 2 "Quality_High" 3 "Quality_DetectionUnpopulated";
VAL_ 276 FLR2RdrDetn335To339Quality3 0 "Quality_Low" 1 "Quality_Medium" 2 "Quality_High" 3 "Quality_DetectionUnpopulated";
VAL_ 276 FLR2RdrDetn335To339Quality4 0 "Quality_Low" 1 "Quality_Medium" 2 "Quality_High" 3 "Quality_DetectionUnpopulated";
SIG_GROUP_ 250 FLR2RdrDetn270To274 1 : FLR2RdrDetn270To274AziAng0 FLR2RdrDetn270To274AziAng1 FLR2RdrDetn270To274AziAng2 FLR2RdrDetn270To274AziAng3 FLR2RdrDetn270To274AziAng4 FLR2RdrDetn270To274Counter FLR2RdrDetn270To274CRC FLR2RdrDetn270To274DynPrpty0 FLR2RdrDetn270To274DynPrpty1 FLR2RdrDetn270To274DynPrpty2 FLR2RdrDetn270To274DynPrpty3 FLR2RdrDetn270To274DynPrpty4 FLR2RdrDetn270To274EleAng0 FLR2RdrDetn270To274EleAng1 FLR2RdrDetn270To274EleAng2 FLR2RdrDetn270To274EleAng3 FLR2RdrDetn270To274EleAng4 FLR2RdrDetn270To274Mode0 FLR2RdrDetn270To274Mode1 FLR2RdrDetn270To274Mode2 FLR2RdrDetn270To274Mode3 FLR2RdrDetn270To274Mode4 FLR2RdrDetn270To274Quality0 FLR2RdrDetn270To274Quality1 FLR2RdrDetn270To274Quality2 FLR2RdrDetn270To274Quality3 FLR2RdrDetn270To274Quality4 FLR2RdrDetn270To274Range0 FLR2RdrDetn270To274Range1 FLR2RdrDetn270To274Range2 FLR2RdrDetn270To274Range3 FLR2RdrDetn270To274Range4 FLR2RdrDetn270To274RCS0 FLR2RdrDetn270To274RCS1 FLR2RdrDetn270To274RCS2 FLR2RdrDetn270To274RCS3 FLR2RdrDetn270To274RCS4 FLR2RdrDetn270To274RngRt0 FLR2RdrDetn270To274RngRt1 FLR2RdrDetn270To274RngRt2 FLR2RdrDetn270To274RngRt3 FLR2RdrDetn270To274RngRt4 FLR2RdrDetn270To274ScanID FLR2RdrDetn270To274SNR0 FLR2RdrDetn270To274SNR1 FLR2RdrDetn270To274SNR2 FLR2RdrDetn270To274SNR3 FLR2RdrDetn270To274SNR4;
SIG_GROUP_ 252 FLR2RdrDetn275To279 1 : FLR2RdrDetn275To279AziAng0 FLR2RdrDetn275To279AziAng1 FLR2RdrDetn275To279AziAng2 FLR2RdrDetn275To279AziAng3 FLR2RdrDetn275To279AziAng4 FLR2RdrDetn275To279Counter FLR2RdrDetn275To279CRC FLR2RdrDetn275To279DynPrpty0 FLR2RdrDetn275To279DynPrpty1 FLR2RdrDetn275To279DynPrpty2 FLR2RdrDetn275To279DynPrpty3 FLR2RdrDetn275To279DynPrpty4 FLR2RdrDetn275To279EleAng0 FLR2RdrDetn275To279EleAng1 FLR2RdrDetn275To279EleAng2 FLR2RdrDetn275To279EleAng3 FLR2RdrDetn275To279EleAng4 FLR2RdrDetn275To279Mode0 FLR2RdrDetn275To279Mode1 FLR2RdrDetn275To279Mode2 FLR2RdrDetn275To279Mode3 FLR2RdrDetn275To279Mode4 FLR2RdrDetn275To279Quality0 FLR2RdrDetn275To279Quality1 FLR2RdrDetn275To279Quality2 FLR2RdrDetn275To279Quality3 FLR2RdrDetn275To279Quality4 FLR2RdrDetn275To279Range0 FLR2RdrDetn275To279Range1 FLR2RdrDetn275To279Range2 FLR2RdrDetn275To279Range3 FLR2RdrDetn275To279Range4 FLR2RdrDetn275To279RCS0 FLR2RdrDetn275To279RCS1 FLR2RdrDetn275To279RCS2 FLR2RdrDetn275To279RCS3 FLR2RdrDetn275To279RCS4 FLR2RdrDetn275To279RngRt0 FLR2RdrDetn275To279RngRt1 FLR2RdrDetn275To279RngRt2 FLR2RdrDetn275To279RngRt3 FLR2RdrDetn275To279RngRt4 FLR2RdrDetn275To279ScanID FLR2RdrDetn275To279SNR0 FLR2RdrDetn275To279SNR1 FLR2RdrDetn275To279SNR2 FLR2RdrDetn275To279SNR3 FLR2RdrDetn275To279SNR4;
SIG_GROUP_ 254 FLR2RdrDetn280To284 1 : FLR2RdrDetn280To284AziAng0 FLR2RdrDetn280To284AziAng1 FLR2RdrDetn280To284AziAng2 FLR2RdrDetn280To284AziAng3 FLR2RdrDetn280To284AziAng4 FLR2RdrDetn280To284Counter FLR2RdrDetn280To284CRC FLR2RdrDetn280To284DynPrpty0 FLR2RdrDetn280To284DynPrpty1 FLR2RdrDetn280To284DynPrpty2 FLR2RdrDetn280To284DynPrpty3 FLR2RdrDetn280To284DynPrpty4 FLR2RdrDetn280To284EleAng0 FLR2RdrDetn280To284EleAng1 FLR2RdrDetn280To284EleAng2 FLR2RdrDetn280To284EleAng3 FLR2RdrDetn280To284EleAng4 FLR2RdrDetn280To284Mode0 FLR2RdrDetn280To284Mode1 FLR2RdrDetn280To284Mode2 FLR2RdrDetn280To284Mode3 FLR2RdrDetn280To284Mode4 FLR2RdrDetn280To284Quality0 FLR2RdrDetn280To284Quality1 FLR2RdrDetn280To284Quality2 FLR2RdrDetn280To284Quality3 FLR2RdrDetn280To284Quality4 FLR2RdrDetn280To284Range0 FLR2RdrDetn280To284Range1 FLR2RdrDetn280To284Range2 FLR2RdrDetn280To284Range3 FLR2RdrDetn280To284Range4 FLR2RdrDetn280To284RCS0 FLR2RdrDetn280To284RCS1 FLR2RdrDetn280To284RCS2 FLR2RdrDetn280To284RCS3 FLR2RdrDetn280To284RCS4 FLR2RdrDetn280To284RngRt0 FLR2RdrDetn280To284RngRt1 FLR2RdrDetn280To284RngRt2 FLR2RdrDetn280To284RngRt3 FLR2RdrDetn280To284RngRt4 FLR2RdrDetn280To284ScanID FLR2RdrDetn280To284SNR0 FLR2RdrDetn280To284SNR1 FLR2RdrDetn280To284SNR2 FLR2RdrDetn280To284SNR3 FLR2RdrDetn280To284SNR4;
SIG_GROUP_ 256 FLR2RdrDetn285To289 1 : FLR2RdrDetn285To289AziAng0 FLR2RdrDetn285To289AziAng1 FLR2RdrDetn285To289AziAng2 FLR2RdrDetn285To289AziAng3 FLR2RdrDetn285To289AziAng4 FLR2RdrDetn285To289Counter FLR2RdrDetn285To289CRC FLR2RdrDetn285To289DynPrpty0 FLR2RdrDetn285To289DynPrpty1 FLR2RdrDetn285To289DynPrpty2 FLR2RdrDetn285To289DynPrpty3 FLR2RdrDetn285To289DynPrpty4 FLR2RdrDetn285To289EleAng0 FLR2RdrDetn285To289EleAng1 FLR2RdrDetn285To289EleAng2 FLR2RdrDetn285To289EleAng3 FLR2RdrDetn285To289EleAng4 FLR2RdrDetn285To289Mode0 FLR2RdrDetn285To289Mode1 FLR2RdrDetn285To289Mode2 FLR2RdrDetn285To289Mode3 FLR2RdrDetn285To289Mode4 FLR2RdrDetn285To289Quality0 FLR2RdrDetn285To289Quality1 FLR2RdrDetn285To289Quality2 FLR2RdrDetn285To289Quality3 FLR2RdrDetn285To289Quality4 FLR2RdrDetn285To289Range0 FLR2RdrDetn285To289Range1 FLR2RdrDetn285To289Range2 FLR2RdrDetn285To289Range3 FLR2RdrDetn285To289Range4 FLR2RdrDetn285To289RCS0 FLR2RdrDetn285To289RCS1 FLR2RdrDetn285To289RCS2 FLR2RdrDetn285To289RCS3 FLR2RdrDetn285To289RCS4 FLR2RdrDetn285To289RngRt0 FLR2RdrDetn285To289RngRt1 FLR2RdrDetn285To289RngRt2 FLR2RdrDetn285To289RngRt3 FLR2RdrDetn285To289RngRt4 FLR2RdrDetn285To289ScanID FLR2RdrDetn285To289SNR0 FLR2RdrDetn285To289SNR1 FLR2RdrDetn285To289SNR2 FLR2RdrDetn285To289SNR3 FLR2RdrDetn285To289SNR4;
SIG_GROUP_ 258 FLR2RdrDetn290To294 1 : FLR2RdrDetn290To294AziAng0 FLR2RdrDetn290To294AziAng1 FLR2RdrDetn290To294AziAng2 FLR2RdrDetn290To294AziAng3 FLR2RdrDetn290To294AziAng4 FLR2RdrDetn290To294Counter FLR2RdrDetn290To294CRC FLR2RdrDetn290To294DynPrpty0 FLR2RdrDetn290To294DynPrpty1 FLR2RdrDetn290To294DynPrpty2 FLR2RdrDetn290To294DynPrpty3 FLR2RdrDetn290To294DynPrpty4 FLR2RdrDetn290To294EleAng0 FLR2RdrDetn290To294EleAng1 FLR2RdrDetn290To294EleAng2 FLR2RdrDetn290To294EleAng3 FLR2RdrDetn290To294EleAng4 FLR2RdrDetn290To294Mode0 FLR2RdrDetn290To294Mode1 FLR2RdrDetn290To294Mode2 FLR2RdrDetn290To294Mode3 FLR2RdrDetn290To294Mode4 FLR2RdrDetn290To294Quality0 FLR2RdrDetn290To294Quality1 FLR2RdrDetn290To294Quality2 FLR2RdrDetn290To294Quality3 FLR2RdrDetn290To294Quality4 FLR2RdrDetn290To294Range0 FLR2RdrDetn290To294Range1 FLR2RdrDetn290To294Range2 FLR2RdrDetn290To294Range3 FLR2RdrDetn290To294Range4 FLR2RdrDetn290To294RCS0 FLR2RdrDetn290To294RCS1 FLR2RdrDetn290To294RCS2 FLR2RdrDetn290To294RCS3 FLR2RdrDetn290To294RCS4 FLR2RdrDetn290To294RngRt0 FLR2RdrDetn290To294RngRt1 FLR2RdrDetn290To294RngRt2 FLR2RdrDetn290To294RngRt3 FLR2RdrDetn290To294RngRt4 FLR2RdrDetn290To294ScanID FLR2RdrDetn290To294SNR0 FLR2RdrDetn290To294SNR1 FLR2RdrDetn290To294SNR2 FLR2RdrDetn290To294SNR3 FLR2RdrDetn290To294SNR4;
SIG_GROUP_ 260 FLR2RdrDetn295To299 1 : FLR2RdrDetn295To299AziAng0 FLR2RdrDetn295To299AziAng1 FLR2RdrDetn295To299AziAng2 FLR2RdrDetn295To299AziAng3 FLR2RdrDetn295To299AziAng4 FLR2RdrDetn295To299Counter FLR2RdrDetn295To299CRC FLR2RdrDetn295To299DynPrpty0 FLR2RdrDetn295To299DynPrpty1 FLR2RdrDetn295To299DynPrpty2 FLR2RdrDetn295To299DynPrpty3 FLR2RdrDetn295To299DynPrpty4 FLR2RdrDetn295To299EleAng0 FLR2RdrDetn295To299EleAng1 FLR2RdrDetn295To299EleAng2 FLR2RdrDetn295To299EleAng3 FLR2RdrDetn295To299EleAng4 FLR2RdrDetn295To299Mode0 FLR2RdrDetn295To299Mode1 FLR2RdrDetn295To299Mode2 FLR2RdrDetn295To299Mode3 FLR2RdrDetn295To299Mode4 FLR2RdrDetn295To299Quality0 FLR2RdrDetn295To299Quality1 FLR2RdrDetn295To299Quality2 FLR2RdrDetn295To299Quality3 FLR2RdrDetn295To299Quality4 FLR2RdrDetn295To299Range0 FLR2RdrDetn295To299Range1 FLR2RdrDetn295To299Range2 FLR2RdrDetn295To299Range3 FLR2RdrDetn295To299Range4 FLR2RdrDetn295To299RCS0 FLR2RdrDetn295To299RCS1 FLR2RdrDetn295To299RCS2 FLR2RdrDetn295To299RCS3 FLR2RdrDetn295To299RCS4 FLR2RdrDetn295To299RngRt0 FLR2RdrDetn295To299RngRt1 FLR2RdrDetn295To299RngRt2 FLR2RdrDetn295To299RngRt3 FLR2RdrDetn295To299RngRt4 FLR2RdrDetn295To299ScanID FLR2RdrDetn295To299SNR0 FLR2RdrDetn295To299SNR1 FLR2RdrDetn295To299SNR2 FLR2RdrDetn295To299SNR3 FLR2RdrDetn295To299SNR4;
SIG_GROUP_ 262 FLR2RdrDetn300To304 1 : FLR2RdrDetn300To304AziAng0 FLR2RdrDetn300To304AziAng1 FLR2RdrDetn300To304AziAng2 FLR2RdrDetn300To304AziAng3 FLR2RdrDetn300To304AziAng4 FLR2RdrDetn300To304Counter FLR2RdrDetn300To304CRC FLR2RdrDetn300To304DynPrpty0 FLR2RdrDetn300To304DynPrpty1 FLR2RdrDetn300To304DynPrpty2 FLR2RdrDetn300To304DynPrpty3 FLR2RdrDetn300To304DynPrpty4 FLR2RdrDetn300To304EleAng0 FLR2RdrDetn300To304EleAng1 FLR2RdrDetn300To304EleAng2 FLR2RdrDetn300To304EleAng3 FLR2RdrDetn300To304EleAng4 FLR2RdrDetn300To304Mode0 FLR2RdrDetn300To304Mode1 FLR2RdrDetn300To304Mode2 FLR2RdrDetn300To304Mode3 FLR2RdrDetn300To304Mode4 FLR2RdrDetn300To304Quality0 FLR2RdrDetn300To304Quality1 FLR2RdrDetn300To304Quality2 FLR2RdrDetn300To304Quality3 FLR2RdrDetn300To304Quality4 FLR2RdrDetn300To304Range0 FLR2RdrDetn300To304Range1 FLR2RdrDetn300To304Range2 FLR2RdrDetn300To304Range3 FLR2RdrDetn300To304Range4 FLR2RdrDetn300To304RCS0 FLR2RdrDetn300To304RCS1 FLR2RdrDetn300To304RCS2 FLR2RdrDetn300To304RCS3 FLR2RdrDetn300To304RCS4 FLR2RdrDetn300To304RngRt0 FLR2RdrDetn300To304RngRt1 FLR2RdrDetn300To304RngRt2 FLR2RdrDetn300To304RngRt3 FLR2RdrDetn300To304RngRt4 FLR2RdrDetn300To304ScanID FLR2RdrDetn300To304SNR0 FLR2RdrDetn300To304SNR1 FLR2RdrDetn300To304SNR2 FLR2RdrDetn300To304SNR3 FLR2RdrDetn300To304SNR4;
SIG_GROUP_ 264 FLR2RdrDetn305To309 1 : FLR2RdrDetn305To309AziAng0 FLR2RdrDetn305To309AziAng1 FLR2RdrDetn305To309AziAng2 FLR2RdrDetn305To309AziAng3 FLR2RdrDetn305To309AziAng4 FLR2RdrDetn305To309Counter FLR2RdrDetn305To309CRC FLR2RdrDetn305To309DynPrpty0 FLR2RdrDetn305To309DynPrpty1 FLR2RdrDetn305To309DynPrpty2 FLR2RdrDetn305To309DynPrpty3 FLR2RdrDetn305To309DynPrpty4 FLR2RdrDetn305To309EleAng0 FLR2RdrDetn305To309EleAng1 FLR2RdrDetn305To309EleAng2 FLR2RdrDetn305To309EleAng3 FLR2RdrDetn305To309EleAng4 FLR2RdrDetn305To309Mode0 FLR2RdrDetn305To309Mode1 FLR2RdrDetn305To309Mode2 FLR2RdrDetn305To309Mode3 FLR2RdrDetn305To309Mode4 FLR2RdrDetn305To309Quality0 FLR2RdrDetn305To309Quality1 FLR2RdrDetn305To309Quality2 FLR2RdrDetn305To309Quality3 FLR2RdrDetn305To309Quality4 FLR2RdrDetn305To309Range0 FLR2RdrDetn305To309Range1 FLR2RdrDetn305To309Range2 FLR2RdrDetn305To309Range3 FLR2RdrDetn305To309Range4 FLR2RdrDetn305To309RCS0 FLR2RdrDetn305To309RCS1 FLR2RdrDetn305To309RCS2 FLR2RdrDetn305To309RCS3 FLR2RdrDetn305To309RCS4 FLR2RdrDetn305To309RngRt0 FLR2RdrDetn305To309RngRt1 FLR2RdrDetn305To309RngRt2 FLR2RdrDetn305To309RngRt3 FLR2RdrDetn305To309RngRt4 FLR2RdrDetn305To309ScanID FLR2RdrDetn305To309SNR0 FLR2RdrDetn305To309SNR1 FLR2RdrDetn305To309SNR2 FLR2RdrDetn305To309SNR3 FLR2RdrDetn305To309SNR4;
SIG_GROUP_ 266 FLR2RdrDetn310To314 1 : FLR2RdrDetn310To314AziAng0 FLR2RdrDetn310To314AziAng1 FLR2RdrDetn310To314AziAng2 FLR2RdrDetn310To314AziAng3 FLR2RdrDetn310To314AziAng4 FLR2RdrDetn310To314Counter FLR2RdrDetn310To314CRC FLR2RdrDetn310To314DynPrpty0 FLR2RdrDetn310To314DynPrpty1 FLR2RdrDetn310To314DynPrpty2 FLR2RdrDetn310To314DynPrpty3 FLR2RdrDetn310To314DynPrpty4 FLR2RdrDetn310To314EleAng0 FLR2RdrDetn310To314EleAng1 FLR2RdrDetn310To314EleAng2 FLR2RdrDetn310To314EleAng3 FLR2RdrDetn310To314EleAng4 FLR2RdrDetn310To314Mode0 FLR2RdrDetn310To314Mode1 FLR2RdrDetn310To314Mode2 FLR2RdrDetn310To314Mode3 FLR2RdrDetn310To314Mode4 FLR2RdrDetn310To314Quality0 FLR2RdrDetn310To314Quality1 FLR2RdrDetn310To314Quality2 FLR2RdrDetn310To314Quality3 FLR2RdrDetn310To314Quality4 FLR2RdrDetn310To314Range0 FLR2RdrDetn310To314Range1 FLR2RdrDetn310To314Range2 FLR2RdrDetn310To314Range3 FLR2RdrDetn310To314Range4 FLR2RdrDetn310To314RCS0 FLR2RdrDetn310To314RCS1 FLR2RdrDetn310To314RCS2 FLR2RdrDetn310To314RCS3 FLR2RdrDetn310To314RCS4 FLR2RdrDetn310To314RngRt0 FLR2RdrDetn310To314RngRt1 FLR2RdrDetn310To314RngRt2 FLR2RdrDetn310To314RngRt3 FLR2RdrDetn310To314RngRt4 FLR2RdrDetn310To314ScanID FLR2RdrDetn310To314SNR0 FLR2RdrDetn310To314SNR1 FLR2RdrDetn310To314SNR2 FLR2RdrDetn310To314SNR3 FLR2RdrDetn310To314SNR4;
SIG_GROUP_ 268 FLR2RdrDetn315To319 1 : FLR2RdrDetn315To319AziAng0 FLR2RdrDetn315To319AziAng1 FLR2RdrDetn315To319AziAng2 FLR2RdrDetn315To319AziAng3 FLR2RdrDetn315To319AziAng4 FLR2RdrDetn315To319Counter FLR2RdrDetn315To319CRC FLR2RdrDetn315To319DynPrpty0 FLR2RdrDetn315To319DynPrpty1 FLR2RdrDetn315To319DynPrpty2 FLR2RdrDetn315To319DynPrpty3 FLR2RdrDetn315To319DynPrpty4 FLR2RdrDetn315To319EleAng0 FLR2RdrDetn315To319EleAng1 FLR2RdrDetn315To319EleAng2 FLR2RdrDetn315To319EleAng3 FLR2RdrDetn315To319EleAng4 FLR2RdrDetn315To319Mode0 FLR2RdrDetn315To319Mode1 FLR2RdrDetn315To319Mode2 FLR2RdrDetn315To319Mode3 FLR2RdrDetn315To319Mode4 FLR2RdrDetn315To319Quality0 FLR2RdrDetn315To319Quality1 FLR2RdrDetn315To319Quality2 FLR2RdrDetn315To319Quality3 FLR2RdrDetn315To319Quality4 FLR2RdrDetn315To319Range0 FLR2RdrDetn315To319Range1 FLR2RdrDetn315To319Range2 FLR2RdrDetn315To319Range3 FLR2RdrDetn315To319Range4 FLR2RdrDetn315To319RCS0 FLR2RdrDetn315To319RCS1 FLR2RdrDetn315To319RCS2 FLR2RdrDetn315To319RCS3 FLR2RdrDetn315To319RCS4 FLR2RdrDetn315To319RngRt0 FLR2RdrDetn315To319RngRt1 FLR2RdrDetn315To319RngRt2 FLR2RdrDetn315To319RngRt3 FLR2RdrDetn315To319RngRt4 FLR2RdrDetn315To319ScanID FLR2RdrDetn315To319SNR0 FLR2RdrDetn315To319SNR1 FLR2RdrDetn315To319SNR2 FLR2RdrDetn315To319SNR3 FLR2RdrDetn315To319SNR4;
SIG_GROUP_ 270 FLR2RdrDetn320To324 1 : FLR2RdrDetn320To324AziAng0 FLR2RdrDetn320To324AziAng1 FLR2RdrDetn320To324AziAng2 FLR2RdrDetn320To324AziAng3 FLR2RdrDetn320To324AziAng4 FLR2RdrDetn320To324Counter FLR2RdrDetn320To324CRC FLR2RdrDetn320To324DynPrpty0 FLR2RdrDetn320To324DynPrpty1 FLR2RdrDetn320To324DynPrpty2 FLR2RdrDetn320To324DynPrpty3 FLR2RdrDetn320To324DynPrpty4 FLR2RdrDetn320To324EleAng0 FLR2RdrDetn320To324EleAng1 FLR2RdrDetn320To324EleAng2 FLR2RdrDetn320To324EleAng3 FLR2RdrDetn320To324EleAng4 FLR2RdrDetn320To324Mode0 FLR2RdrDetn320To324Mode1 FLR2RdrDetn320To324Mode2 FLR2RdrDetn320To324Mode3 FLR2RdrDetn320To324Mode4 FLR2RdrDetn320To324Quality0 FLR2RdrDetn320To324Quality1 FLR2RdrDetn320To324Quality2 FLR2RdrDetn320To324Quality3 FLR2RdrDetn320To324Quality4 FLR2RdrDetn320To324Range0 FLR2RdrDetn320To324Range1 FLR2RdrDetn320To324Range2 FLR2RdrDetn320To324Range3 FLR2RdrDetn320To324Range4 FLR2RdrDetn320To324RCS0 FLR2RdrDetn320To324RCS1 FLR2RdrDetn320To324RCS2 FLR2RdrDetn320To324RCS3 FLR2RdrDetn320To324RCS4 FLR2RdrDetn320To324RngRt0 FLR2RdrDetn320To324RngRt1 FLR2RdrDetn320To324RngRt2 FLR2RdrDetn320To324RngRt3 FLR2RdrDetn320To324RngRt4 FLR2RdrDetn320To324ScanID FLR2RdrDetn320To324SNR0 FLR2RdrDetn320To324SNR1 FLR2RdrDetn320To324SNR2 FLR2RdrDetn320To324SNR3 FLR2RdrDetn320To324SNR4;
SIG_GROUP_ 272 FLR2RdrDetn325To329 1 : FLR2RdrDetn325To329AziAng0 FLR2RdrDetn325To329AziAng1 FLR2RdrDetn325To329AziAng2 FLR2RdrDetn325To329AziAng3 FLR2RdrDetn325To329AziAng4 FLR2RdrDetn325To329Counter FLR2RdrDetn325To329CRC FLR2RdrDetn325To329DynPrpty0 FLR2RdrDetn325To329DynPrpty1 FLR2RdrDetn325To329DynPrpty2 FLR2RdrDetn325To329DynPrpty3 FLR2RdrDetn325To329DynPrpty4 FLR2RdrDetn325To329EleAng0 FLR2RdrDetn325To329EleAng1 FLR2RdrDetn325To329EleAng2 FLR2RdrDetn325To329EleAng3 FLR2RdrDetn325To329EleAng4 FLR2RdrDetn325To329Mode0 FLR2RdrDetn325To329Mode1 FLR2RdrDetn325To329Mode2 FLR2RdrDetn325To329Mode3 FLR2RdrDetn325To329Mode4 FLR2RdrDetn325To329Quality0 FLR2RdrDetn325To329Quality1 FLR2RdrDetn325To329Quality2 FLR2RdrDetn325To329Quality3 FLR2RdrDetn325To329Quality4 FLR2RdrDetn325To329Range0 FLR2RdrDetn325To329Range1 FLR2RdrDetn325To329Range2 FLR2RdrDetn325To329Range3 FLR2RdrDetn325To329Range4 FLR2RdrDetn325To329RCS0 FLR2RdrDetn325To329RCS1 FLR2RdrDetn325To329RCS2 FLR2RdrDetn325To329RCS3 FLR2RdrDetn325To329RCS4 FLR2RdrDetn325To329RngRt0 FLR2RdrDetn325To329RngRt1 FLR2RdrDetn325To329RngRt2 FLR2RdrDetn325To329RngRt3 FLR2RdrDetn325To329RngRt4 FLR2RdrDetn325To329ScanID FLR2RdrDetn325To329SNR0 FLR2RdrDetn325To329SNR1 FLR2RdrDetn325To329SNR2 FLR2RdrDetn325To329SNR3 FLR2RdrDetn325To329SNR4;
SIG_GROUP_ 274 FLR2RdrDetn330To334 1 : FLR2RdrDetn330To334AziAng0 FLR2RdrDetn330To334AziAng1 FLR2RdrDetn330To334AziAng2 FLR2RdrDetn330To334AziAng3 FLR2RdrDetn330To334AziAng4 FLR2RdrDetn330To334Counter FLR2RdrDetn330To334CRC FLR2RdrDetn330To334DynPrpty0 FLR2RdrDetn330To334DynPrpty1 FLR2RdrDetn330To334DynPrpty2 FLR2RdrDetn330To334DynPrpty3 FLR2RdrDetn330To334DynPrpty4 FLR2RdrDetn330To334EleAng0 FLR2RdrDetn330To334EleAng1 FLR2RdrDetn330To334EleAng2 FLR2RdrDetn330To334EleAng3 FLR2RdrDetn330To334EleAng4 FLR2RdrDetn330To334Mode0 FLR2RdrDetn330To334Mode1 FLR2RdrDetn330To334Mode2 FLR2RdrDetn330To334Mode3 FLR2RdrDetn330To334Mode4 FLR2RdrDetn330To334Quality0 FLR2RdrDetn330To334Quality1 FLR2RdrDetn330To334Quality2 FLR2RdrDetn330To334Quality3 FLR2RdrDetn330To334Quality4 FLR2RdrDetn330To334Range0 FLR2RdrDetn330To334Range1 FLR2RdrDetn330To334Range2 FLR2RdrDetn330To334Range3 FLR2RdrDetn330To334Range4 FLR2RdrDetn330To334RCS0 FLR2RdrDetn330To334RCS1 FLR2RdrDetn330To334RCS2 FLR2RdrDetn330To334RCS3 FLR2RdrDetn330To334RCS4 FLR2RdrDetn330To334RngRt0 FLR2RdrDetn330To334RngRt1 FLR2RdrDetn330To334RngRt2 FLR2RdrDetn330To334RngRt3 FLR2RdrDetn330To334RngRt4 FLR2RdrDetn330To334ScanID FLR2RdrDetn330To334SNR0 FLR2RdrDetn330To334SNR1 FLR2RdrDetn330To334SNR2 FLR2RdrDetn330To334SNR3 FLR2RdrDetn330To334SNR4;
SIG_GROUP_ 276 FLR2RdrDetn335To339 1 : FLR2RdrDetn335To339AziAng0 FLR2RdrDetn335To339AziAng1 FLR2RdrDetn335To339AziAng2 FLR2RdrDetn335To339AziAng3 FLR2RdrDetn335To339AziAng4 FLR2RdrDetn335To339Counter FLR2RdrDetn335To339CRC FLR2RdrDetn335To339DynPrpty0 FLR2RdrDetn335To339DynPrpty1 FLR2RdrDetn335To339DynPrpty2 FLR2RdrDetn335To339DynPrpty3 FLR2RdrDetn335To339DynPrpty4 FLR2RdrDetn335To339EleAng0 FLR2RdrDetn335To339EleAng1 FLR2RdrDetn335To339EleAng2 FLR2RdrDetn335To339EleAng3 FLR2RdrDetn335To339EleAng4 FLR2RdrDetn335To339Mode0 FLR2RdrDetn335To339Mode1 FLR2RdrDetn335To339Mode2 FLR2RdrDetn335To339Mode3 FLR2RdrDetn335To339Mode4 FLR2RdrDetn335To339Quality0 FLR2RdrDetn335To339Quality1 FLR2RdrDetn335To339Quality2 FLR2RdrDetn335To339Quality3 FLR2RdrDetn335To339Quality4 FLR2RdrDetn335To339Range0 FLR2RdrDetn335To339Range1 FLR2RdrDetn335To339Range2 FLR2RdrDetn335To339Range3 FLR2RdrDetn335To339Range4 FLR2RdrDetn335To339RCS0 FLR2RdrDetn335To339RCS1 FLR2RdrDetn335To339RCS2 FLR2RdrDetn335To339RCS3 FLR2RdrDetn335To339RCS4 FLR2RdrDetn335To339RngRt0 FLR2RdrDetn335To339RngRt1 FLR2RdrDetn335To339RngRt2 FLR2RdrDetn335To339RngRt3 FLR2RdrDetn335To339RngRt4 FLR2RdrDetn335To339ScanID FLR2RdrDetn335To339SNR0 FLR2RdrDetn335To339SNR1 FLR2RdrDetn335To339SNR2 FLR2RdrDetn335To339SNR3 FLR2RdrDetn335To339SNR4;
