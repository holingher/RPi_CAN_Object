// *************************************************************************** *
// *                                                                           *
// * Description:         CANDB File                                           *
// * Generated at:        2023-01-05 13:51                                     *
// * System:              FLRsystem_MAIN_26                                    *
// * Network:             FLR1CAN                                              *
// *                                                                           *
// *************************************************************************** *
VERSION "FLR1CAN"

NS_ :

BS_ :

BU_ :  FLR FLRdpHPA FLRdpHPB

BO_ 211 FlrFlr1canFr41 : 64 FLR
 SG_ FLR2RdrDetn200To204_UB : 359|1@0+ (1,0) [0|1] "" FLRdpHPA,FLRdpHPB
 SG_ FLR2RdrDetn200To204AziAng0 : 32|9@1+ (0.0035,-0.87266) [-0.87266|0.91584] "rad" FLRdpHPA,FLRdpHPB
 SG_ FLR2RdrDetn200To204AziAng1 : 96|9@1+ (0.0035,-0.87266) [-0.87266|0.91584] "rad" FLRdpHPA,FLRdpHPB
 SG_ FLR2RdrDetn200To204AziAng2 : 160|9@1+ (0.0035,-0.87266) [-0.87266|0.91584] "rad" FLRdpHPA,FLRdpHPB
 SG_ FLR2RdrDetn200To204AziAng3 : 224|9@1+ (0.0035,-0.87266) [-0.87266|0.91584] "rad" FLRdpHPA,FLRdpHPB
 SG_ FLR2RdrDetn200To204AziAng4 : 288|9@1+ (0.0035,-0.87266) [-0.87266|0.91584] "rad" FLRdpHPA,FLRdpHPB
 SG_ FLR2RdrDetn200To204Counter : 16|8@1+ (1.0,0.0) [0.0|255.0] "Unitless" FLRdpHPA,FLRdpHPB
 SG_ FLR2RdrDetn200To204CRC : 0|16@1+ (1.0,0.0) [0.0|65535.0] "Unitless" FLRdpHPA,FLRdpHPB
 SG_ FLR2RdrDetn200To204DynPrpty0 : 93|1@1+ (1.0,0.0) [0.0|1.0] "Unitless" FLRdpHPA,FLRdpHPB
 SG_ FLR2RdrDetn200To204DynPrpty1 : 157|1@1+ (1.0,0.0) [0.0|1.0] "Unitless" FLRdpHPA,FLRdpHPB
 SG_ FLR2RdrDetn200To204DynPrpty2 : 221|1@1+ (1.0,0.0) [0.0|1.0] "Unitless" FLRdpHPA,FLRdpHPB
 SG_ FLR2RdrDetn200To204DynPrpty3 : 285|1@1+ (1.0,0.0) [0.0|1.0] "Unitless" FLRdpHPA,FLRdpHPB
 SG_ FLR2RdrDetn200To204DynPrpty4 : 349|1@1+ (1.0,0.0) [0.0|1.0] "Unitless" FLRdpHPA,FLRdpHPB
 SG_ FLR2RdrDetn200To204EleAng0 : 64|8@1+ (0.002,0.0) [0.0|0.5] "rad" FLRdpHPA,FLRdpHPB
 SG_ FLR2RdrDetn200To204EleAng1 : 128|8@1+ (0.002,0.0) [0.0|0.5] "rad" FLRdpHPA,FLRdpHPB
 SG_ FLR2RdrDetn200To204EleAng2 : 192|8@1+ (0.002,0.0) [0.0|0.5] "rad" FLRdpHPA,FLRdpHPB
 SG_ FLR2RdrDetn200To204EleAng3 : 256|8@1+ (0.002,0.0) [0.0|0.5] "rad" FLRdpHPA,FLRdpHPB
 SG_ FLR2RdrDetn200To204EleAng4 : 320|8@1+ (0.002,0.0) [0.0|0.5] "rad" FLRdpHPA,FLRdpHPB
 SG_ FLR2RdrDetn200To204Mode0 : 60|2@1+ (1,0) [0|3] "" FLRdpHPA,FLRdpHPB
 SG_ FLR2RdrDetn200To204Mode1 : 124|2@1+ (1,0) [0|3] "" FLRdpHPA,FLRdpHPB
 SG_ FLR2RdrDetn200To204Mode2 : 188|2@1+ (1,0) [0|3] "" FLRdpHPA,FLRdpHPB
 SG_ FLR2RdrDetn200To204Mode3 : 252|2@1+ (1,0) [0|3] "" FLRdpHPA,FLRdpHPB
 SG_ FLR2RdrDetn200To204Mode4 : 316|2@1+ (1,0) [0|3] "" FLRdpHPA,FLRdpHPB
 SG_ FLR2RdrDetn200To204Quality0 : 62|2@1+ (1,0) [0|3] "" FLRdpHPA,FLRdpHPB
 SG_ FLR2RdrDetn200To204Quality1 : 126|2@1+ (1,0) [0|3] "" FLRdpHPA,FLRdpHPB
 SG_ FLR2RdrDetn200To204Quality2 : 190|2@1+ (1,0) [0|3] "" FLRdpHPA,FLRdpHPB
 SG_ FLR2RdrDetn200To204Quality3 : 254|2@1+ (1,0) [0|3] "" FLRdpHPA,FLRdpHPB
 SG_ FLR2RdrDetn200To204Quality4 : 318|2@1+ (1,0) [0|3] "" FLRdpHPA,FLRdpHPB
 SG_ FLR2RdrDetn200To204Range0 : 48|12@1+ (0.1,0.4) [0.4|300.0] "m" FLRdpHPA,FLRdpHPB
 SG_ FLR2RdrDetn200To204Range1 : 112|12@1+ (0.1,0.4) [0.4|300.0] "m" FLRdpHPA,FLRdpHPB
 SG_ FLR2RdrDetn200To204Range2 : 176|12@1+ (0.1,0.4) [0.4|300.0] "m" FLRdpHPA,FLRdpHPB
 SG_ FLR2RdrDetn200To204Range3 : 240|12@1+ (0.1,0.4) [0.4|300.0] "m" FLRdpHPA,FLRdpHPB
 SG_ FLR2RdrDetn200To204Range4 : 304|12@1+ (0.1,0.4) [0.4|300.0] "m" FLRdpHPA,FLRdpHPB
 SG_ FLR2RdrDetn200To204RCS0 : 83|10@1+ (0.2,-100.0) [-100.0|70.0] "dBsm" FLRdpHPA,FLRdpHPB
 SG_ FLR2RdrDetn200To204RCS1 : 147|10@1+ (0.2,-100.0) [-100.0|70.0] "dBsm" FLRdpHPA,FLRdpHPB
 SG_ FLR2RdrDetn200To204RCS2 : 211|10@1+ (0.2,-100.0) [-100.0|70.0] "dBsm" FLRdpHPA,FLRdpHPB
 SG_ FLR2RdrDetn200To204RCS3 : 275|10@1+ (0.2,-100.0) [-100.0|70.0] "dBsm" FLRdpHPA,FLRdpHPB
 SG_ FLR2RdrDetn200To204RCS4 : 339|10@1+ (0.2,-100.0) [-100.0|70.0] "dBsm" FLRdpHPA,FLRdpHPB
 SG_ FLR2RdrDetn200To204RngRt0 : 72|11@1+ (0.1,-111.11) [-111.11|55.59000000000002] "m/s" FLRdpHPA,FLRdpHPB
 SG_ FLR2RdrDetn200To204RngRt1 : 136|11@1+ (0.1,-111.11) [-111.11|55.59000000000002] "m/s" FLRdpHPA,FLRdpHPB
 SG_ FLR2RdrDetn200To204RngRt2 : 200|11@1+ (0.1,-111.11) [-111.11|55.59000000000002] "m/s" FLRdpHPA,FLRdpHPB
 SG_ FLR2RdrDetn200To204RngRt3 : 264|11@1+ (0.1,-111.11) [-111.11|55.59000000000002] "m/s" FLRdpHPA,FLRdpHPB
 SG_ FLR2RdrDetn200To204RngRt4 : 328|11@1+ (0.1,-111.11) [-111.11|55.59000000000002] "m/s" FLRdpHPA,FLRdpHPB
 SG_ FLR2RdrDetn200To204ScanID : 24|8@1+ (1.0,0.0) [0.0|255.0] "Unitless" FLRdpHPA,FLRdpHPB
 SG_ FLR2RdrDetn200To204SNR0 : 41|7@1+ (0.5,0.0) [0.0|63.5] "dB" FLRdpHPA,FLRdpHPB
 SG_ FLR2RdrDetn200To204SNR1 : 105|7@1+ (0.5,0.0) [0.0|63.5] "dB" FLRdpHPA,FLRdpHPB
 SG_ FLR2RdrDetn200To204SNR2 : 169|7@1+ (0.5,0.0) [0.0|63.5] "dB" FLRdpHPA,FLRdpHPB
 SG_ FLR2RdrDetn200To204SNR3 : 233|7@1+ (0.5,0.0) [0.0|63.5] "dB" FLRdpHPA,FLRdpHPB
 SG_ FLR2RdrDetn200To204SNR4 : 297|7@1+ (0.5,0.0) [0.0|63.5] "dB" FLRdpHPA,FLRdpHPB

BO_ 214 FlrFlr1canFr42 : 64 FLR
 SG_ FLR2RdrDetn205To209_UB : 359|1@0+ (1,0) [0|1] "" FLRdpHPA,FLRdpHPB
 SG_ FLR2RdrDetn205To209AziAng0 : 32|9@1+ (0.0035,-0.87266) [-0.87266|0.91584] "rad" FLRdpHPA,FLRdpHPB
 SG_ FLR2RdrDetn205To209AziAng1 : 96|9@1+ (0.0035,-0.87266) [-0.87266|0.91584] "rad" FLRdpHPA,FLRdpHPB
 SG_ FLR2RdrDetn205To209AziAng2 : 160|9@1+ (0.0035,-0.87266) [-0.87266|0.91584] "rad" FLRdpHPA,FLRdpHPB
 SG_ FLR2RdrDetn205To209AziAng3 : 224|9@1+ (0.0035,-0.87266) [-0.87266|0.91584] "rad" FLRdpHPA,FLRdpHPB
 SG_ FLR2RdrDetn205To209AziAng4 : 288|9@1+ (0.0035,-0.87266) [-0.87266|0.91584] "rad" FLRdpHPA,FLRdpHPB
 SG_ FLR2RdrDetn205To209Counter : 16|8@1+ (1.0,0.0) [0.0|255.0] "Unitless" FLRdpHPA,FLRdpHPB
 SG_ FLR2RdrDetn205To209CRC : 0|16@1+ (1.0,0.0) [0.0|65535.0] "Unitless" FLRdpHPA,FLRdpHPB
 SG_ FLR2RdrDetn205To209DynPrpty0 : 93|1@1+ (1.0,0.0) [0.0|1.0] "Unitless" FLRdpHPA,FLRdpHPB
 SG_ FLR2RdrDetn205To209DynPrpty1 : 157|1@1+ (1.0,0.0) [0.0|1.0] "Unitless" FLRdpHPA,FLRdpHPB
 SG_ FLR2RdrDetn205To209DynPrpty2 : 221|1@1+ (1.0,0.0) [0.0|1.0] "Unitless" FLRdpHPA,FLRdpHPB
 SG_ FLR2RdrDetn205To209DynPrpty3 : 285|1@1+ (1.0,0.0) [0.0|1.0] "Unitless" FLRdpHPA,FLRdpHPB
 SG_ FLR2RdrDetn205To209DynPrpty4 : 349|1@1+ (1.0,0.0) [0.0|1.0] "Unitless" FLRdpHPA,FLRdpHPB
 SG_ FLR2RdrDetn205To209EleAng0 : 64|8@1+ (0.002,0.0) [0.0|0.5] "rad" FLRdpHPA,FLRdpHPB
 SG_ FLR2RdrDetn205To209EleAng1 : 128|8@1+ (0.002,0.0) [0.0|0.5] "rad" FLRdpHPA,FLRdpHPB
 SG_ FLR2RdrDetn205To209EleAng2 : 192|8@1+ (0.002,0.0) [0.0|0.5] "rad" FLRdpHPA,FLRdpHPB
 SG_ FLR2RdrDetn205To209EleAng3 : 256|8@1+ (0.002,0.0) [0.0|0.5] "rad" FLRdpHPA,FLRdpHPB
 SG_ FLR2RdrDetn205To209EleAng4 : 320|8@1+ (0.002,0.0) [0.0|0.5] "rad" FLRdpHPA,FLRdpHPB
 SG_ FLR2RdrDetn205To209Mode0 : 60|2@1+ (1,0) [0|3] "" FLRdpHPA,FLRdpHPB
 SG_ FLR2RdrDetn205To209Mode1 : 124|2@1+ (1,0) [0|3] "" FLRdpHPA,FLRdpHPB
 SG_ FLR2RdrDetn205To209Mode2 : 188|2@1+ (1,0) [0|3] "" FLRdpHPA,FLRdpHPB
 SG_ FLR2RdrDetn205To209Mode3 : 252|2@1+ (1,0) [0|3] "" FLRdpHPA,FLRdpHPB
 SG_ FLR2RdrDetn205To209Mode4 : 316|2@1+ (1,0) [0|3] "" FLRdpHPA,FLRdpHPB
 SG_ FLR2RdrDetn205To209Quality0 : 62|2@1+ (1,0) [0|3] "" FLRdpHPA,FLRdpHPB
 SG_ FLR2RdrDetn205To209Quality1 : 126|2@1+ (1,0) [0|3] "" FLRdpHPA,FLRdpHPB
 SG_ FLR2RdrDetn205To209Quality2 : 190|2@1+ (1,0) [0|3] "" FLRdpHPA,FLRdpHPB
 SG_ FLR2RdrDetn205To209Quality3 : 254|2@1+ (1,0) [0|3] "" FLRdpHPA,FLRdpHPB
 SG_ FLR2RdrDetn205To209Quality4 : 318|2@1+ (1,0) [0|3] "" FLRdpHPA,FLRdpHPB
 SG_ FLR2RdrDetn205To209Range0 : 48|12@1+ (0.1,0.4) [0.4|300.0] "m" FLRdpHPA,FLRdpHPB
 SG_ FLR2RdrDetn205To209Range1 : 112|12@1+ (0.1,0.4) [0.4|300.0] "m" FLRdpHPA,FLRdpHPB
 SG_ FLR2RdrDetn205To209Range2 : 176|12@1+ (0.1,0.4) [0.4|300.0] "m" FLRdpHPA,FLRdpHPB
 SG_ FLR2RdrDetn205To209Range3 : 240|12@1+ (0.1,0.4) [0.4|300.0] "m" FLRdpHPA,FLRdpHPB
 SG_ FLR2RdrDetn205To209Range4 : 304|12@1+ (0.1,0.4) [0.4|300.0] "m" FLRdpHPA,FLRdpHPB
 SG_ FLR2RdrDetn205To209RCS0 : 83|10@1+ (0.2,-100.0) [-100.0|70.0] "dBsm" FLRdpHPA,FLRdpHPB
 SG_ FLR2RdrDetn205To209RCS1 : 147|10@1+ (0.2,-100.0) [-100.0|70.0] "dBsm" FLRdpHPA,FLRdpHPB
 SG_ FLR2RdrDetn205To209RCS2 : 211|10@1+ (0.2,-100.0) [-100.0|70.0] "dBsm" FLRdpHPA,FLRdpHPB
 SG_ FLR2RdrDetn205To209RCS3 : 275|10@1+ (0.2,-100.0) [-100.0|70.0] "dBsm" FLRdpHPA,FLRdpHPB
 SG_ FLR2RdrDetn205To209RCS4 : 339|10@1+ (0.2,-100.0) [-100.0|70.0] "dBsm" FLRdpHPA,FLRdpHPB
 SG_ FLR2RdrDetn205To209RngRt0 : 72|11@1+ (0.1,-111.11) [-111.11|55.59000000000002] "m/s" FLRdpHPA,FLRdpHPB
 SG_ FLR2RdrDetn205To209RngRt1 : 136|11@1+ (0.1,-111.11) [-111.11|55.59000000000002] "m/s" FLRdpHPA,FLRdpHPB
 SG_ FLR2RdrDetn205To209RngRt2 : 200|11@1+ (0.1,-111.11) [-111.11|55.59000000000002] "m/s" FLRdpHPA,FLRdpHPB
 SG_ FLR2RdrDetn205To209RngRt3 : 264|11@1+ (0.1,-111.11) [-111.11|55.59000000000002] "m/s" FLRdpHPA,FLRdpHPB
 SG_ FLR2RdrDetn205To209RngRt4 : 328|11@1+ (0.1,-111.11) [-111.11|55.59000000000002] "m/s" FLRdpHPA,FLRdpHPB
 SG_ FLR2RdrDetn205To209ScanID : 24|8@1+ (1.0,0.0) [0.0|255.0] "Unitless" FLRdpHPA,FLRdpHPB
 SG_ FLR2RdrDetn205To209SNR0 : 41|7@1+ (0.5,0.0) [0.0|63.5] "dB" FLRdpHPA,FLRdpHPB
 SG_ FLR2RdrDetn205To209SNR1 : 105|7@1+ (0.5,0.0) [0.0|63.5] "dB" FLRdpHPA,FLRdpHPB
 SG_ FLR2RdrDetn205To209SNR2 : 169|7@1+ (0.5,0.0) [0.0|63.5] "dB" FLRdpHPA,FLRdpHPB
 SG_ FLR2RdrDetn205To209SNR3 : 233|7@1+ (0.5,0.0) [0.0|63.5] "dB" FLRdpHPA,FLRdpHPB
 SG_ FLR2RdrDetn205To209SNR4 : 297|7@1+ (0.5,0.0) [0.0|63.5] "dB" FLRdpHPA,FLRdpHPB

BO_ 217 FlrFlr1canFr43 : 64 FLR
 SG_ FLR2RdrDetn210To214_UB : 359|1@0+ (1,0) [0|1] "" FLRdpHPA,FLRdpHPB
 SG_ FLR2RdrDetn210To214AziAng0 : 32|9@1+ (0.0035,-0.87266) [-0.87266|0.91584] "rad" FLRdpHPA,FLRdpHPB
 SG_ FLR2RdrDetn210To214AziAng1 : 96|9@1+ (0.0035,-0.87266) [-0.87266|0.91584] "rad" FLRdpHPA,FLRdpHPB
 SG_ FLR2RdrDetn210To214AziAng2 : 160|9@1+ (0.0035,-0.87266) [-0.87266|0.91584] "rad" FLRdpHPA,FLRdpHPB
 SG_ FLR2RdrDetn210To214AziAng3 : 224|9@1+ (0.0035,-0.87266) [-0.87266|0.91584] "rad" FLRdpHPA,FLRdpHPB
 SG_ FLR2RdrDetn210To214AziAng4 : 288|9@1+ (0.0035,-0.87266) [-0.87266|0.91584] "rad" FLRdpHPA,FLRdpHPB
 SG_ FLR2RdrDetn210To214Counter : 16|8@1+ (1.0,0.0) [0.0|255.0] "Unitless" FLRdpHPA,FLRdpHPB
 SG_ FLR2RdrDetn210To214CRC : 0|16@1+ (1.0,0.0) [0.0|65535.0] "Unitless" FLRdpHPA,FLRdpHPB
 SG_ FLR2RdrDetn210To214DynPrpty0 : 93|1@1+ (1.0,0.0) [0.0|1.0] "Unitless" FLRdpHPA,FLRdpHPB
 SG_ FLR2RdrDetn210To214DynPrpty1 : 157|1@1+ (1.0,0.0) [0.0|1.0] "Unitless" FLRdpHPA,FLRdpHPB
 SG_ FLR2RdrDetn210To214DynPrpty2 : 221|1@1+ (1.0,0.0) [0.0|1.0] "Unitless" FLRdpHPA,FLRdpHPB
 SG_ FLR2RdrDetn210To214DynPrpty3 : 285|1@1+ (1.0,0.0) [0.0|1.0] "Unitless" FLRdpHPA,FLRdpHPB
 SG_ FLR2RdrDetn210To214DynPrpty4 : 349|1@1+ (1.0,0.0) [0.0|1.0] "Unitless" FLRdpHPA,FLRdpHPB
 SG_ FLR2RdrDetn210To214EleAng0 : 64|8@1+ (0.002,0.0) [0.0|0.5] "rad" FLRdpHPA,FLRdpHPB
 SG_ FLR2RdrDetn210To214EleAng1 : 128|8@1+ (0.002,0.0) [0.0|0.5] "rad" FLRdpHPA,FLRdpHPB
 SG_ FLR2RdrDetn210To214EleAng2 : 192|8@1+ (0.002,0.0) [0.0|0.5] "rad" FLRdpHPA,FLRdpHPB
 SG_ FLR2RdrDetn210To214EleAng3 : 256|8@1+ (0.002,0.0) [0.0|0.5] "rad" FLRdpHPA,FLRdpHPB
 SG_ FLR2RdrDetn210To214EleAng4 : 320|8@1+ (0.002,0.0) [0.0|0.5] "rad" FLRdpHPA,FLRdpHPB
 SG_ FLR2RdrDetn210To214Mode0 : 60|2@1+ (1,0) [0|3] "" FLRdpHPA,FLRdpHPB
 SG_ FLR2RdrDetn210To214Mode1 : 124|2@1+ (1,0) [0|3] "" FLRdpHPA,FLRdpHPB
 SG_ FLR2RdrDetn210To214Mode2 : 188|2@1+ (1,0) [0|3] "" FLRdpHPA,FLRdpHPB
 SG_ FLR2RdrDetn210To214Mode3 : 252|2@1+ (1,0) [0|3] "" FLRdpHPA,FLRdpHPB
 SG_ FLR2RdrDetn210To214Mode4 : 316|2@1+ (1,0) [0|3] "" FLRdpHPA,FLRdpHPB
 SG_ FLR2RdrDetn210To214Quality0 : 62|2@1+ (1,0) [0|3] "" FLRdpHPA,FLRdpHPB
 SG_ FLR2RdrDetn210To214Quality1 : 126|2@1+ (1,0) [0|3] "" FLRdpHPA,FLRdpHPB
 SG_ FLR2RdrDetn210To214Quality2 : 190|2@1+ (1,0) [0|3] "" FLRdpHPA,FLRdpHPB
 SG_ FLR2RdrDetn210To214Quality3 : 254|2@1+ (1,0) [0|3] "" FLRdpHPA,FLRdpHPB
 SG_ FLR2RdrDetn210To214Quality4 : 318|2@1+ (1,0) [0|3] "" FLRdpHPA,FLRdpHPB
 SG_ FLR2RdrDetn210To214Range0 : 48|12@1+ (0.1,0.4) [0.4|300.0] "m" FLRdpHPA,FLRdpHPB
 SG_ FLR2RdrDetn210To214Range1 : 112|12@1+ (0.1,0.4) [0.4|300.0] "m" FLRdpHPA,FLRdpHPB
 SG_ FLR2RdrDetn210To214Range2 : 176|12@1+ (0.1,0.4) [0.4|300.0] "m" FLRdpHPA,FLRdpHPB
 SG_ FLR2RdrDetn210To214Range3 : 240|12@1+ (0.1,0.4) [0.4|300.0] "m" FLRdpHPA,FLRdpHPB
 SG_ FLR2RdrDetn210To214Range4 : 304|12@1+ (0.1,0.4) [0.4|300.0] "m" FLRdpHPA,FLRdpHPB
 SG_ FLR2RdrDetn210To214RCS0 : 83|10@1+ (0.2,-100.0) [-100.0|70.0] "dBsm" FLRdpHPA,FLRdpHPB
 SG_ FLR2RdrDetn210To214RCS1 : 147|10@1+ (0.2,-100.0) [-100.0|70.0] "dBsm" FLRdpHPA,FLRdpHPB
 SG_ FLR2RdrDetn210To214RCS2 : 211|10@1+ (0.2,-100.0) [-100.0|70.0] "dBsm" FLRdpHPA,FLRdpHPB
 SG_ FLR2RdrDetn210To214RCS3 : 275|10@1+ (0.2,-100.0) [-100.0|70.0] "dBsm" FLRdpHPA,FLRdpHPB
 SG_ FLR2RdrDetn210To214RCS4 : 339|10@1+ (0.2,-100.0) [-100.0|70.0] "dBsm" FLRdpHPA,FLRdpHPB
 SG_ FLR2RdrDetn210To214RngRt0 : 72|11@1+ (0.1,-111.11) [-111.11|55.59000000000002] "m/s" FLRdpHPA,FLRdpHPB
 SG_ FLR2RdrDetn210To214RngRt1 : 136|11@1+ (0.1,-111.11) [-111.11|55.59000000000002] "m/s" FLRdpHPA,FLRdpHPB
 SG_ FLR2RdrDetn210To214RngRt2 : 200|11@1+ (0.1,-111.11) [-111.11|55.59000000000002] "m/s" FLRdpHPA,FLRdpHPB
 SG_ FLR2RdrDetn210To214RngRt3 : 264|11@1+ (0.1,-111.11) [-111.11|55.59000000000002] "m/s" FLRdpHPA,FLRdpHPB
 SG_ FLR2RdrDetn210To214RngRt4 : 328|11@1+ (0.1,-111.11) [-111.11|55.59000000000002] "m/s" FLRdpHPA,FLRdpHPB
 SG_ FLR2RdrDetn210To214ScanID : 24|8@1+ (1.0,0.0) [0.0|255.0] "Unitless" FLRdpHPA,FLRdpHPB
 SG_ FLR2RdrDetn210To214SNR0 : 41|7@1+ (0.5,0.0) [0.0|63.5] "dB" FLRdpHPA,FLRdpHPB
 SG_ FLR2RdrDetn210To214SNR1 : 105|7@1+ (0.5,0.0) [0.0|63.5] "dB" FLRdpHPA,FLRdpHPB
 SG_ FLR2RdrDetn210To214SNR2 : 169|7@1+ (0.5,0.0) [0.0|63.5] "dB" FLRdpHPA,FLRdpHPB
 SG_ FLR2RdrDetn210To214SNR3 : 233|7@1+ (0.5,0.0) [0.0|63.5] "dB" FLRdpHPA,FLRdpHPB
 SG_ FLR2RdrDetn210To214SNR4 : 297|7@1+ (0.5,0.0) [0.0|63.5] "dB" FLRdpHPA,FLRdpHPB

BO_ 220 FlrFlr1canFr44 : 64 FLR
 SG_ FLR2RdrDetn215To219_UB : 359|1@0+ (1,0) [0|1] "" FLRdpHPA,FLRdpHPB
 SG_ FLR2RdrDetn215To219AziAng0 : 32|9@1+ (0.0035,-0.87266) [-0.87266|0.91584] "rad" FLRdpHPA,FLRdpHPB
 SG_ FLR2RdrDetn215To219AziAng1 : 96|9@1+ (0.0035,-0.87266) [-0.87266|0.91584] "rad" FLRdpHPA,FLRdpHPB
 SG_ FLR2RdrDetn215To219AziAng2 : 160|9@1+ (0.0035,-0.87266) [-0.87266|0.91584] "rad" FLRdpHPA,FLRdpHPB
 SG_ FLR2RdrDetn215To219AziAng3 : 224|9@1+ (0.0035,-0.87266) [-0.87266|0.91584] "rad" FLRdpHPA,FLRdpHPB
 SG_ FLR2RdrDetn215To219AziAng4 : 288|9@1+ (0.0035,-0.87266) [-0.87266|0.91584] "rad" FLRdpHPA,FLRdpHPB
 SG_ FLR2RdrDetn215To219Counter : 16|8@1+ (1.0,0.0) [0.0|255.0] "Unitless" FLRdpHPA,FLRdpHPB
 SG_ FLR2RdrDetn215To219CRC : 0|16@1+ (1.0,0.0) [0.0|65535.0] "Unitless" FLRdpHPA,FLRdpHPB
 SG_ FLR2RdrDetn215To219DynPrpty0 : 93|1@1+ (1.0,0.0) [0.0|1.0] "Unitless" FLRdpHPA,FLRdpHPB
 SG_ FLR2RdrDetn215To219DynPrpty1 : 157|1@1+ (1.0,0.0) [0.0|1.0] "Unitless" FLRdpHPA,FLRdpHPB
 SG_ FLR2RdrDetn215To219DynPrpty2 : 221|1@1+ (1.0,0.0) [0.0|1.0] "Unitless" FLRdpHPA,FLRdpHPB
 SG_ FLR2RdrDetn215To219DynPrpty3 : 285|1@1+ (1.0,0.0) [0.0|1.0] "Unitless" FLRdpHPA,FLRdpHPB
 SG_ FLR2RdrDetn215To219DynPrpty4 : 349|1@1+ (1.0,0.0) [0.0|1.0] "Unitless" FLRdpHPA,FLRdpHPB
 SG_ FLR2RdrDetn215To219EleAng0 : 64|8@1+ (0.002,0.0) [0.0|0.5] "rad" FLRdpHPA,FLRdpHPB
 SG_ FLR2RdrDetn215To219EleAng1 : 128|8@1+ (0.002,0.0) [0.0|0.5] "rad" FLRdpHPA,FLRdpHPB
 SG_ FLR2RdrDetn215To219EleAng2 : 192|8@1+ (0.002,0.0) [0.0|0.5] "rad" FLRdpHPA,FLRdpHPB
 SG_ FLR2RdrDetn215To219EleAng3 : 256|8@1+ (0.002,0.0) [0.0|0.5] "rad" FLRdpHPA,FLRdpHPB
 SG_ FLR2RdrDetn215To219EleAng4 : 320|8@1+ (0.002,0.0) [0.0|0.5] "rad" FLRdpHPA,FLRdpHPB
 SG_ FLR2RdrDetn215To219Mode0 : 60|2@1+ (1,0) [0|3] "" FLRdpHPA,FLRdpHPB
 SG_ FLR2RdrDetn215To219Mode1 : 124|2@1+ (1,0) [0|3] "" FLRdpHPA,FLRdpHPB
 SG_ FLR2RdrDetn215To219Mode2 : 188|2@1+ (1,0) [0|3] "" FLRdpHPA,FLRdpHPB
 SG_ FLR2RdrDetn215To219Mode3 : 252|2@1+ (1,0) [0|3] "" FLRdpHPA,FLRdpHPB
 SG_ FLR2RdrDetn215To219Mode4 : 316|2@1+ (1,0) [0|3] "" FLRdpHPA,FLRdpHPB
 SG_ FLR2RdrDetn215To219Quality0 : 62|2@1+ (1,0) [0|3] "" FLRdpHPA,FLRdpHPB
 SG_ FLR2RdrDetn215To219Quality1 : 126|2@1+ (1,0) [0|3] "" FLRdpHPA,FLRdpHPB
 SG_ FLR2RdrDetn215To219Quality2 : 190|2@1+ (1,0) [0|3] "" FLRdpHPA,FLRdpHPB
 SG_ FLR2RdrDetn215To219Quality3 : 254|2@1+ (1,0) [0|3] "" FLRdpHPA,FLRdpHPB
 SG_ FLR2RdrDetn215To219Quality4 : 318|2@1+ (1,0) [0|3] "" FLRdpHPA,FLRdpHPB
 SG_ FLR2RdrDetn215To219Range0 : 48|12@1+ (0.1,0.4) [0.4|300.0] "m" FLRdpHPA,FLRdpHPB
 SG_ FLR2RdrDetn215To219Range1 : 112|12@1+ (0.1,0.4) [0.4|300.0] "m" FLRdpHPA,FLRdpHPB
 SG_ FLR2RdrDetn215To219Range2 : 176|12@1+ (0.1,0.4) [0.4|300.0] "m" FLRdpHPA,FLRdpHPB
 SG_ FLR2RdrDetn215To219Range3 : 240|12@1+ (0.1,0.4) [0.4|300.0] "m" FLRdpHPA,FLRdpHPB
 SG_ FLR2RdrDetn215To219Range4 : 304|12@1+ (0.1,0.4) [0.4|300.0] "m" FLRdpHPA,FLRdpHPB
 SG_ FLR2RdrDetn215To219RCS0 : 83|10@1+ (0.2,-100.0) [-100.0|70.0] "dBsm" FLRdpHPA,FLRdpHPB
 SG_ FLR2RdrDetn215To219RCS1 : 147|10@1+ (0.2,-100.0) [-100.0|70.0] "dBsm" FLRdpHPA,FLRdpHPB
 SG_ FLR2RdrDetn215To219RCS2 : 211|10@1+ (0.2,-100.0) [-100.0|70.0] "dBsm" FLRdpHPA,FLRdpHPB
 SG_ FLR2RdrDetn215To219RCS3 : 275|10@1+ (0.2,-100.0) [-100.0|70.0] "dBsm" FLRdpHPA,FLRdpHPB
 SG_ FLR2RdrDetn215To219RCS4 : 339|10@1+ (0.2,-100.0) [-100.0|70.0] "dBsm" FLRdpHPA,FLRdpHPB
 SG_ FLR2RdrDetn215To219RngRt0 : 72|11@1+ (0.1,-111.11) [-111.11|55.59000000000002] "m/s" FLRdpHPA,FLRdpHPB
 SG_ FLR2RdrDetn215To219RngRt1 : 136|11@1+ (0.1,-111.11) [-111.11|55.59000000000002] "m/s" FLRdpHPA,FLRdpHPB
 SG_ FLR2RdrDetn215To219RngRt2 : 200|11@1+ (0.1,-111.11) [-111.11|55.59000000000002] "m/s" FLRdpHPA,FLRdpHPB
 SG_ FLR2RdrDetn215To219RngRt3 : 264|11@1+ (0.1,-111.11) [-111.11|55.59000000000002] "m/s" FLRdpHPA,FLRdpHPB
 SG_ FLR2RdrDetn215To219RngRt4 : 328|11@1+ (0.1,-111.11) [-111.11|55.59000000000002] "m/s" FLRdpHPA,FLRdpHPB
 SG_ FLR2RdrDetn215To219ScanID : 24|8@1+ (1.0,0.0) [0.0|255.0] "Unitless" FLRdpHPA,FLRdpHPB
 SG_ FLR2RdrDetn215To219SNR0 : 41|7@1+ (0.5,0.0) [0.0|63.5] "dB" FLRdpHPA,FLRdpHPB
 SG_ FLR2RdrDetn215To219SNR1 : 105|7@1+ (0.5,0.0) [0.0|63.5] "dB" FLRdpHPA,FLRdpHPB
 SG_ FLR2RdrDetn215To219SNR2 : 169|7@1+ (0.5,0.0) [0.0|63.5] "dB" FLRdpHPA,FLRdpHPB
 SG_ FLR2RdrDetn215To219SNR3 : 233|7@1+ (0.5,0.0) [0.0|63.5] "dB" FLRdpHPA,FLRdpHPB
 SG_ FLR2RdrDetn215To219SNR4 : 297|7@1+ (0.5,0.0) [0.0|63.5] "dB" FLRdpHPA,FLRdpHPB

BO_ 224 FlrFlr1canFr45 : 64 FLR
 SG_ FLR2RdrDetn220To224_UB : 359|1@0+ (1,0) [0|1] "" FLRdpHPA,FLRdpHPB
 SG_ FLR2RdrDetn220To224AziAng0 : 32|9@1+ (0.0035,-0.87266) [-0.87266|0.91584] "rad" FLRdpHPA,FLRdpHPB
 SG_ FLR2RdrDetn220To224AziAng1 : 96|9@1+ (0.0035,-0.87266) [-0.87266|0.91584] "rad" FLRdpHPA,FLRdpHPB
 SG_ FLR2RdrDetn220To224AziAng2 : 160|9@1+ (0.0035,-0.87266) [-0.87266|0.91584] "rad" FLRdpHPA,FLRdpHPB
 SG_ FLR2RdrDetn220To224AziAng3 : 224|9@1+ (0.0035,-0.87266) [-0.87266|0.91584] "rad" FLRdpHPA,FLRdpHPB
 SG_ FLR2RdrDetn220To224AziAng4 : 288|9@1+ (0.0035,-0.87266) [-0.87266|0.91584] "rad" FLRdpHPA,FLRdpHPB
 SG_ FLR2RdrDetn220To224Counter : 16|8@1+ (1.0,0.0) [0.0|255.0] "Unitless" FLRdpHPA,FLRdpHPB
 SG_ FLR2RdrDetn220To224CRC : 0|16@1+ (1.0,0.0) [0.0|65535.0] "Unitless" FLRdpHPA,FLRdpHPB
 SG_ FLR2RdrDetn220To224DynPrpty0 : 93|1@1+ (1.0,0.0) [0.0|1.0] "Unitless" FLRdpHPA,FLRdpHPB
 SG_ FLR2RdrDetn220To224DynPrpty1 : 157|1@1+ (1.0,0.0) [0.0|1.0] "Unitless" FLRdpHPA,FLRdpHPB
 SG_ FLR2RdrDetn220To224DynPrpty2 : 221|1@1+ (1.0,0.0) [0.0|1.0] "Unitless" FLRdpHPA,FLRdpHPB
 SG_ FLR2RdrDetn220To224DynPrpty3 : 285|1@1+ (1.0,0.0) [0.0|1.0] "Unitless" FLRdpHPA,FLRdpHPB
 SG_ FLR2RdrDetn220To224DynPrpty4 : 349|1@1+ (1.0,0.0) [0.0|1.0] "Unitless" FLRdpHPA,FLRdpHPB
 SG_ FLR2RdrDetn220To224EleAng0 : 64|8@1+ (0.002,0.0) [0.0|0.5] "rad" FLRdpHPA,FLRdpHPB
 SG_ FLR2RdrDetn220To224EleAng1 : 128|8@1+ (0.002,0.0) [0.0|0.5] "rad" FLRdpHPA,FLRdpHPB
 SG_ FLR2RdrDetn220To224EleAng2 : 192|8@1+ (0.002,0.0) [0.0|0.5] "rad" FLRdpHPA,FLRdpHPB
 SG_ FLR2RdrDetn220To224EleAng3 : 256|8@1+ (0.002,0.0) [0.0|0.5] "rad" FLRdpHPA,FLRdpHPB
 SG_ FLR2RdrDetn220To224EleAng4 : 320|8@1+ (0.002,0.0) [0.0|0.5] "rad" FLRdpHPA,FLRdpHPB
 SG_ FLR2RdrDetn220To224Mode0 : 60|2@1+ (1,0) [0|3] "" FLRdpHPA,FLRdpHPB
 SG_ FLR2RdrDetn220To224Mode1 : 124|2@1+ (1,0) [0|3] "" FLRdpHPA,FLRdpHPB
 SG_ FLR2RdrDetn220To224Mode2 : 188|2@1+ (1,0) [0|3] "" FLRdpHPA,FLRdpHPB
 SG_ FLR2RdrDetn220To224Mode3 : 252|2@1+ (1,0) [0|3] "" FLRdpHPA,FLRdpHPB
 SG_ FLR2RdrDetn220To224Mode4 : 316|2@1+ (1,0) [0|3] "" FLRdpHPA,FLRdpHPB
 SG_ FLR2RdrDetn220To224Quality0 : 62|2@1+ (1,0) [0|3] "" FLRdpHPA,FLRdpHPB
 SG_ FLR2RdrDetn220To224Quality1 : 126|2@1+ (1,0) [0|3] "" FLRdpHPA,FLRdpHPB
 SG_ FLR2RdrDetn220To224Quality2 : 190|2@1+ (1,0) [0|3] "" FLRdpHPA,FLRdpHPB
 SG_ FLR2RdrDetn220To224Quality3 : 254|2@1+ (1,0) [0|3] "" FLRdpHPA,FLRdpHPB
 SG_ FLR2RdrDetn220To224Quality4 : 318|2@1+ (1,0) [0|3] "" FLRdpHPA,FLRdpHPB
 SG_ FLR2RdrDetn220To224Range0 : 48|12@1+ (0.1,0.4) [0.4|300.0] "m" FLRdpHPA,FLRdpHPB
 SG_ FLR2RdrDetn220To224Range1 : 112|12@1+ (0.1,0.4) [0.4|300.0] "m" FLRdpHPA,FLRdpHPB
 SG_ FLR2RdrDetn220To224Range2 : 176|12@1+ (0.1,0.4) [0.4|300.0] "m" FLRdpHPA,FLRdpHPB
 SG_ FLR2RdrDetn220To224Range3 : 240|12@1+ (0.1,0.4) [0.4|300.0] "m" FLRdpHPA,FLRdpHPB
 SG_ FLR2RdrDetn220To224Range4 : 304|12@1+ (0.1,0.4) [0.4|300.0] "m" FLRdpHPA,FLRdpHPB
 SG_ FLR2RdrDetn220To224RCS0 : 83|10@1+ (0.2,-100.0) [-100.0|70.0] "dBsm" FLRdpHPA,FLRdpHPB
 SG_ FLR2RdrDetn220To224RCS1 : 147|10@1+ (0.2,-100.0) [-100.0|70.0] "dBsm" FLRdpHPA,FLRdpHPB
 SG_ FLR2RdrDetn220To224RCS2 : 211|10@1+ (0.2,-100.0) [-100.0|70.0] "dBsm" FLRdpHPA,FLRdpHPB
 SG_ FLR2RdrDetn220To224RCS3 : 275|10@1+ (0.2,-100.0) [-100.0|70.0] "dBsm" FLRdpHPA,FLRdpHPB
 SG_ FLR2RdrDetn220To224RCS4 : 339|10@1+ (0.2,-100.0) [-100.0|70.0] "dBsm" FLRdpHPA,FLRdpHPB
 SG_ FLR2RdrDetn220To224RngRt0 : 72|11@1+ (0.1,-111.11) [-111.11|55.59000000000002] "m/s" FLRdpHPA,FLRdpHPB
 SG_ FLR2RdrDetn220To224RngRt1 : 136|11@1+ (0.1,-111.11) [-111.11|55.59000000000002] "m/s" FLRdpHPA,FLRdpHPB
 SG_ FLR2RdrDetn220To224RngRt2 : 200|11@1+ (0.1,-111.11) [-111.11|55.59000000000002] "m/s" FLRdpHPA,FLRdpHPB
 SG_ FLR2RdrDetn220To224RngRt3 : 264|11@1+ (0.1,-111.11) [-111.11|55.59000000000002] "m/s" FLRdpHPA,FLRdpHPB
 SG_ FLR2RdrDetn220To224RngRt4 : 328|11@1+ (0.1,-111.11) [-111.11|55.59000000000002] "m/s" FLRdpHPA,FLRdpHPB
 SG_ FLR2RdrDetn220To224ScanID : 24|8@1+ (1.0,0.0) [0.0|255.0] "Unitless" FLRdpHPA,FLRdpHPB
 SG_ FLR2RdrDetn220To224SNR0 : 41|7@1+ (0.5,0.0) [0.0|63.5] "dB" FLRdpHPA,FLRdpHPB
 SG_ FLR2RdrDetn220To224SNR1 : 105|7@1+ (0.5,0.0) [0.0|63.5] "dB" FLRdpHPA,FLRdpHPB
 SG_ FLR2RdrDetn220To224SNR2 : 169|7@1+ (0.5,0.0) [0.0|63.5] "dB" FLRdpHPA,FLRdpHPB
 SG_ FLR2RdrDetn220To224SNR3 : 233|7@1+ (0.5,0.0) [0.0|63.5] "dB" FLRdpHPA,FLRdpHPB
 SG_ FLR2RdrDetn220To224SNR4 : 297|7@1+ (0.5,0.0) [0.0|63.5] "dB" FLRdpHPA,FLRdpHPB

BO_ 227 FlrFlr1canFr46 : 64 FLR
 SG_ FLR2RdrDetn225To229_UB : 359|1@0+ (1,0) [0|1] "" FLRdpHPA,FLRdpHPB
 SG_ FLR2RdrDetn225To229AziAng0 : 32|9@1+ (0.0035,-0.87266) [-0.87266|0.91584] "rad" FLRdpHPA,FLRdpHPB
 SG_ FLR2RdrDetn225To229AziAng1 : 96|9@1+ (0.0035,-0.87266) [-0.87266|0.91584] "rad" FLRdpHPA,FLRdpHPB
 SG_ FLR2RdrDetn225To229AziAng2 : 160|9@1+ (0.0035,-0.87266) [-0.87266|0.91584] "rad" FLRdpHPA,FLRdpHPB
 SG_ FLR2RdrDetn225To229AziAng3 : 224|9@1+ (0.0035,-0.87266) [-0.87266|0.91584] "rad" FLRdpHPA,FLRdpHPB
 SG_ FLR2RdrDetn225To229AziAng4 : 288|9@1+ (0.0035,-0.87266) [-0.87266|0.91584] "rad" FLRdpHPA,FLRdpHPB
 SG_ FLR2RdrDetn225To229Counter : 16|8@1+ (1.0,0.0) [0.0|255.0] "Unitless" FLRdpHPA,FLRdpHPB
 SG_ FLR2RdrDetn225To229CRC : 0|16@1+ (1.0,0.0) [0.0|65535.0] "Unitless" FLRdpHPA,FLRdpHPB
 SG_ FLR2RdrDetn225To229DynPrpty0 : 93|1@1+ (1.0,0.0) [0.0|1.0] "Unitless" FLRdpHPA,FLRdpHPB
 SG_ FLR2RdrDetn225To229DynPrpty1 : 157|1@1+ (1.0,0.0) [0.0|1.0] "Unitless" FLRdpHPA,FLRdpHPB
 SG_ FLR2RdrDetn225To229DynPrpty2 : 221|1@1+ (1.0,0.0) [0.0|1.0] "Unitless" FLRdpHPA,FLRdpHPB
 SG_ FLR2RdrDetn225To229DynPrpty3 : 285|1@1+ (1.0,0.0) [0.0|1.0] "Unitless" FLRdpHPA,FLRdpHPB
 SG_ FLR2RdrDetn225To229DynPrpty4 : 349|1@1+ (1.0,0.0) [0.0|1.0] "Unitless" FLRdpHPA,FLRdpHPB
 SG_ FLR2RdrDetn225To229EleAng0 : 64|8@1+ (0.002,0.0) [0.0|0.5] "rad" FLRdpHPA,FLRdpHPB
 SG_ FLR2RdrDetn225To229EleAng1 : 128|8@1+ (0.002,0.0) [0.0|0.5] "rad" FLRdpHPA,FLRdpHPB
 SG_ FLR2RdrDetn225To229EleAng2 : 192|8@1+ (0.002,0.0) [0.0|0.5] "rad" FLRdpHPA,FLRdpHPB
 SG_ FLR2RdrDetn225To229EleAng3 : 256|8@1+ (0.002,0.0) [0.0|0.5] "rad" FLRdpHPA,FLRdpHPB
 SG_ FLR2RdrDetn225To229EleAng4 : 320|8@1+ (0.002,0.0) [0.0|0.5] "rad" FLRdpHPA,FLRdpHPB
 SG_ FLR2RdrDetn225To229Mode0 : 60|2@1+ (1,0) [0|3] "" FLRdpHPA,FLRdpHPB
 SG_ FLR2RdrDetn225To229Mode1 : 124|2@1+ (1,0) [0|3] "" FLRdpHPA,FLRdpHPB
 SG_ FLR2RdrDetn225To229Mode2 : 188|2@1+ (1,0) [0|3] "" FLRdpHPA,FLRdpHPB
 SG_ FLR2RdrDetn225To229Mode3 : 252|2@1+ (1,0) [0|3] "" FLRdpHPA,FLRdpHPB
 SG_ FLR2RdrDetn225To229Mode4 : 316|2@1+ (1,0) [0|3] "" FLRdpHPA,FLRdpHPB
 SG_ FLR2RdrDetn225To229Quality0 : 62|2@1+ (1,0) [0|3] "" FLRdpHPA,FLRdpHPB
 SG_ FLR2RdrDetn225To229Quality1 : 126|2@1+ (1,0) [0|3] "" FLRdpHPA,FLRdpHPB
 SG_ FLR2RdrDetn225To229Quality2 : 190|2@1+ (1,0) [0|3] "" FLRdpHPA,FLRdpHPB
 SG_ FLR2RdrDetn225To229Quality3 : 254|2@1+ (1,0) [0|3] "" FLRdpHPA,FLRdpHPB
 SG_ FLR2RdrDetn225To229Quality4 : 318|2@1+ (1,0) [0|3] "" FLRdpHPA,FLRdpHPB
 SG_ FLR2RdrDetn225To229Range0 : 48|12@1+ (0.1,0.4) [0.4|300.0] "m" FLRdpHPA,FLRdpHPB
 SG_ FLR2RdrDetn225To229Range1 : 112|12@1+ (0.1,0.4) [0.4|300.0] "m" FLRdpHPA,FLRdpHPB
 SG_ FLR2RdrDetn225To229Range2 : 176|12@1+ (0.1,0.4) [0.4|300.0] "m" FLRdpHPA,FLRdpHPB
 SG_ FLR2RdrDetn225To229Range3 : 240|12@1+ (0.1,0.4) [0.4|300.0] "m" FLRdpHPA,FLRdpHPB
 SG_ FLR2RdrDetn225To229Range4 : 304|12@1+ (0.1,0.4) [0.4|300.0] "m" FLRdpHPA,FLRdpHPB
 SG_ FLR2RdrDetn225To229RCS0 : 83|10@1+ (0.2,-100.0) [-100.0|70.0] "dBsm" FLRdpHPA,FLRdpHPB
 SG_ FLR2RdrDetn225To229RCS1 : 147|10@1+ (0.2,-100.0) [-100.0|70.0] "dBsm" FLRdpHPA,FLRdpHPB
 SG_ FLR2RdrDetn225To229RCS2 : 211|10@1+ (0.2,-100.0) [-100.0|70.0] "dBsm" FLRdpHPA,FLRdpHPB
 SG_ FLR2RdrDetn225To229RCS3 : 275|10@1+ (0.2,-100.0) [-100.0|70.0] "dBsm" FLRdpHPA,FLRdpHPB
 SG_ FLR2RdrDetn225To229RCS4 : 339|10@1+ (0.2,-100.0) [-100.0|70.0] "dBsm" FLRdpHPA,FLRdpHPB
 SG_ FLR2RdrDetn225To229RngRt0 : 72|11@1+ (0.1,-111.11) [-111.11|55.59000000000002] "m/s" FLRdpHPA,FLRdpHPB
 SG_ FLR2RdrDetn225To229RngRt1 : 136|11@1+ (0.1,-111.11) [-111.11|55.59000000000002] "m/s" FLRdpHPA,FLRdpHPB
 SG_ FLR2RdrDetn225To229RngRt2 : 200|11@1+ (0.1,-111.11) [-111.11|55.59000000000002] "m/s" FLRdpHPA,FLRdpHPB
 SG_ FLR2RdrDetn225To229RngRt3 : 264|11@1+ (0.1,-111.11) [-111.11|55.59000000000002] "m/s" FLRdpHPA,FLRdpHPB
 SG_ FLR2RdrDetn225To229RngRt4 : 328|11@1+ (0.1,-111.11) [-111.11|55.59000000000002] "m/s" FLRdpHPA,FLRdpHPB
 SG_ FLR2RdrDetn225To229ScanID : 24|8@1+ (1.0,0.0) [0.0|255.0] "Unitless" FLRdpHPA,FLRdpHPB
 SG_ FLR2RdrDetn225To229SNR0 : 41|7@1+ (0.5,0.0) [0.0|63.5] "dB" FLRdpHPA,FLRdpHPB
 SG_ FLR2RdrDetn225To229SNR1 : 105|7@1+ (0.5,0.0) [0.0|63.5] "dB" FLRdpHPA,FLRdpHPB
 SG_ FLR2RdrDetn225To229SNR2 : 169|7@1+ (0.5,0.0) [0.0|63.5] "dB" FLRdpHPA,FLRdpHPB
 SG_ FLR2RdrDetn225To229SNR3 : 233|7@1+ (0.5,0.0) [0.0|63.5] "dB" FLRdpHPA,FLRdpHPB
 SG_ FLR2RdrDetn225To229SNR4 : 297|7@1+ (0.5,0.0) [0.0|63.5] "dB" FLRdpHPA,FLRdpHPB

BO_ 230 FlrFlr1canFr47 : 64 FLR
 SG_ FLR2RdrDetn230To234_UB : 359|1@0+ (1,0) [0|1] "" FLRdpHPA,FLRdpHPB
 SG_ FLR2RdrDetn230To234AziAng0 : 32|9@1+ (0.0035,-0.87266) [-0.87266|0.91584] "rad" FLRdpHPA,FLRdpHPB
 SG_ FLR2RdrDetn230To234AziAng1 : 96|9@1+ (0.0035,-0.87266) [-0.87266|0.91584] "rad" FLRdpHPA,FLRdpHPB
 SG_ FLR2RdrDetn230To234AziAng2 : 160|9@1+ (0.0035,-0.87266) [-0.87266|0.91584] "rad" FLRdpHPA,FLRdpHPB
 SG_ FLR2RdrDetn230To234AziAng3 : 224|9@1+ (0.0035,-0.87266) [-0.87266|0.91584] "rad" FLRdpHPA,FLRdpHPB
 SG_ FLR2RdrDetn230To234AziAng4 : 288|9@1+ (0.0035,-0.87266) [-0.87266|0.91584] "rad" FLRdpHPA,FLRdpHPB
 SG_ FLR2RdrDetn230To234Counter : 16|8@1+ (1.0,0.0) [0.0|255.0] "Unitless" FLRdpHPA,FLRdpHPB
 SG_ FLR2RdrDetn230To234CRC : 0|16@1+ (1.0,0.0) [0.0|65535.0] "Unitless" FLRdpHPA,FLRdpHPB
 SG_ FLR2RdrDetn230To234DynPrpty0 : 93|1@1+ (1.0,0.0) [0.0|1.0] "Unitless" FLRdpHPA,FLRdpHPB
 SG_ FLR2RdrDetn230To234DynPrpty1 : 157|1@1+ (1.0,0.0) [0.0|1.0] "Unitless" FLRdpHPA,FLRdpHPB
 SG_ FLR2RdrDetn230To234DynPrpty2 : 221|1@1+ (1.0,0.0) [0.0|1.0] "Unitless" FLRdpHPA,FLRdpHPB
 SG_ FLR2RdrDetn230To234DynPrpty3 : 285|1@1+ (1.0,0.0) [0.0|1.0] "Unitless" FLRdpHPA,FLRdpHPB
 SG_ FLR2RdrDetn230To234DynPrpty4 : 349|1@1+ (1.0,0.0) [0.0|1.0] "Unitless" FLRdpHPA,FLRdpHPB
 SG_ FLR2RdrDetn230To234EleAng0 : 64|8@1+ (0.002,0.0) [0.0|0.5] "rad" FLRdpHPA,FLRdpHPB
 SG_ FLR2RdrDetn230To234EleAng1 : 128|8@1+ (0.002,0.0) [0.0|0.5] "rad" FLRdpHPA,FLRdpHPB
 SG_ FLR2RdrDetn230To234EleAng2 : 192|8@1+ (0.002,0.0) [0.0|0.5] "rad" FLRdpHPA,FLRdpHPB
 SG_ FLR2RdrDetn230To234EleAng3 : 256|8@1+ (0.002,0.0) [0.0|0.5] "rad" FLRdpHPA,FLRdpHPB
 SG_ FLR2RdrDetn230To234EleAng4 : 320|8@1+ (0.002,0.0) [0.0|0.5] "rad" FLRdpHPA,FLRdpHPB
 SG_ FLR2RdrDetn230To234Mode0 : 60|2@1+ (1,0) [0|3] "" FLRdpHPA,FLRdpHPB
 SG_ FLR2RdrDetn230To234Mode1 : 124|2@1+ (1,0) [0|3] "" FLRdpHPA,FLRdpHPB
 SG_ FLR2RdrDetn230To234Mode2 : 188|2@1+ (1,0) [0|3] "" FLRdpHPA,FLRdpHPB
 SG_ FLR2RdrDetn230To234Mode3 : 252|2@1+ (1,0) [0|3] "" FLRdpHPA,FLRdpHPB
 SG_ FLR2RdrDetn230To234Mode4 : 316|2@1+ (1,0) [0|3] "" FLRdpHPA,FLRdpHPB
 SG_ FLR2RdrDetn230To234Quality0 : 62|2@1+ (1,0) [0|3] "" FLRdpHPA,FLRdpHPB
 SG_ FLR2RdrDetn230To234Quality1 : 126|2@1+ (1,0) [0|3] "" FLRdpHPA,FLRdpHPB
 SG_ FLR2RdrDetn230To234Quality2 : 190|2@1+ (1,0) [0|3] "" FLRdpHPA,FLRdpHPB
 SG_ FLR2RdrDetn230To234Quality3 : 254|2@1+ (1,0) [0|3] "" FLRdpHPA,FLRdpHPB
 SG_ FLR2RdrDetn230To234Quality4 : 318|2@1+ (1,0) [0|3] "" FLRdpHPA,FLRdpHPB
 SG_ FLR2RdrDetn230To234Range0 : 48|12@1+ (0.1,0.4) [0.4|300.0] "m" FLRdpHPA,FLRdpHPB
 SG_ FLR2RdrDetn230To234Range1 : 112|12@1+ (0.1,0.4) [0.4|300.0] "m" FLRdpHPA,FLRdpHPB
 SG_ FLR2RdrDetn230To234Range2 : 176|12@1+ (0.1,0.4) [0.4|300.0] "m" FLRdpHPA,FLRdpHPB
 SG_ FLR2RdrDetn230To234Range3 : 240|12@1+ (0.1,0.4) [0.4|300.0] "m" FLRdpHPA,FLRdpHPB
 SG_ FLR2RdrDetn230To234Range4 : 304|12@1+ (0.1,0.4) [0.4|300.0] "m" FLRdpHPA,FLRdpHPB
 SG_ FLR2RdrDetn230To234RCS0 : 83|10@1+ (0.2,-100.0) [-100.0|70.0] "dBsm" FLRdpHPA,FLRdpHPB
 SG_ FLR2RdrDetn230To234RCS1 : 147|10@1+ (0.2,-100.0) [-100.0|70.0] "dBsm" FLRdpHPA,FLRdpHPB
 SG_ FLR2RdrDetn230To234RCS2 : 211|10@1+ (0.2,-100.0) [-100.0|70.0] "dBsm" FLRdpHPA,FLRdpHPB
 SG_ FLR2RdrDetn230To234RCS3 : 275|10@1+ (0.2,-100.0) [-100.0|70.0] "dBsm" FLRdpHPA,FLRdpHPB
 SG_ FLR2RdrDetn230To234RCS4 : 339|10@1+ (0.2,-100.0) [-100.0|70.0] "dBsm" FLRdpHPA,FLRdpHPB
 SG_ FLR2RdrDetn230To234RngRt0 : 72|11@1+ (0.1,-111.11) [-111.11|55.59000000000002] "m/s" FLRdpHPA,FLRdpHPB
 SG_ FLR2RdrDetn230To234RngRt1 : 136|11@1+ (0.1,-111.11) [-111.11|55.59000000000002] "m/s" FLRdpHPA,FLRdpHPB
 SG_ FLR2RdrDetn230To234RngRt2 : 200|11@1+ (0.1,-111.11) [-111.11|55.59000000000002] "m/s" FLRdpHPA,FLRdpHPB
 SG_ FLR2RdrDetn230To234RngRt3 : 264|11@1+ (0.1,-111.11) [-111.11|55.59000000000002] "m/s" FLRdpHPA,FLRdpHPB
 SG_ FLR2RdrDetn230To234RngRt4 : 328|11@1+ (0.1,-111.11) [-111.11|55.59000000000002] "m/s" FLRdpHPA,FLRdpHPB
 SG_ FLR2RdrDetn230To234ScanID : 24|8@1+ (1.0,0.0) [0.0|255.0] "Unitless" FLRdpHPA,FLRdpHPB
 SG_ FLR2RdrDetn230To234SNR0 : 41|7@1+ (0.5,0.0) [0.0|63.5] "dB" FLRdpHPA,FLRdpHPB
 SG_ FLR2RdrDetn230To234SNR1 : 105|7@1+ (0.5,0.0) [0.0|63.5] "dB" FLRdpHPA,FLRdpHPB
 SG_ FLR2RdrDetn230To234SNR2 : 169|7@1+ (0.5,0.0) [0.0|63.5] "dB" FLRdpHPA,FLRdpHPB
 SG_ FLR2RdrDetn230To234SNR3 : 233|7@1+ (0.5,0.0) [0.0|63.5] "dB" FLRdpHPA,FLRdpHPB
 SG_ FLR2RdrDetn230To234SNR4 : 297|7@1+ (0.5,0.0) [0.0|63.5] "dB" FLRdpHPA,FLRdpHPB

BO_ 233 FlrFlr1canFr48 : 64 FLR
 SG_ FLR2RdrDetn235To239_UB : 359|1@0+ (1,0) [0|1] "" FLRdpHPA,FLRdpHPB
 SG_ FLR2RdrDetn235To239AziAng0 : 32|9@1+ (0.0035,-0.87266) [-0.87266|0.91584] "rad" FLRdpHPA,FLRdpHPB
 SG_ FLR2RdrDetn235To239AziAng1 : 96|9@1+ (0.0035,-0.87266) [-0.87266|0.91584] "rad" FLRdpHPA,FLRdpHPB
 SG_ FLR2RdrDetn235To239AziAng2 : 160|9@1+ (0.0035,-0.87266) [-0.87266|0.91584] "rad" FLRdpHPA,FLRdpHPB
 SG_ FLR2RdrDetn235To239AziAng3 : 224|9@1+ (0.0035,-0.87266) [-0.87266|0.91584] "rad" FLRdpHPA,FLRdpHPB
 SG_ FLR2RdrDetn235To239AziAng4 : 288|9@1+ (0.0035,-0.87266) [-0.87266|0.91584] "rad" FLRdpHPA,FLRdpHPB
 SG_ FLR2RdrDetn235To239Counter : 16|8@1+ (1.0,0.0) [0.0|255.0] "Unitless" FLRdpHPA,FLRdpHPB
 SG_ FLR2RdrDetn235To239CRC : 0|16@1+ (1.0,0.0) [0.0|65535.0] "Unitless" FLRdpHPA,FLRdpHPB
 SG_ FLR2RdrDetn235To239DynPrpty0 : 93|1@1+ (1.0,0.0) [0.0|1.0] "Unitless" FLRdpHPA,FLRdpHPB
 SG_ FLR2RdrDetn235To239DynPrpty1 : 157|1@1+ (1.0,0.0) [0.0|1.0] "Unitless" FLRdpHPA,FLRdpHPB
 SG_ FLR2RdrDetn235To239DynPrpty2 : 221|1@1+ (1.0,0.0) [0.0|1.0] "Unitless" FLRdpHPA,FLRdpHPB
 SG_ FLR2RdrDetn235To239DynPrpty3 : 285|1@1+ (1.0,0.0) [0.0|1.0] "Unitless" FLRdpHPA,FLRdpHPB
 SG_ FLR2RdrDetn235To239DynPrpty4 : 349|1@1+ (1.0,0.0) [0.0|1.0] "Unitless" FLRdpHPA,FLRdpHPB
 SG_ FLR2RdrDetn235To239EleAng0 : 64|8@1+ (0.002,0.0) [0.0|0.5] "rad" FLRdpHPA,FLRdpHPB
 SG_ FLR2RdrDetn235To239EleAng1 : 128|8@1+ (0.002,0.0) [0.0|0.5] "rad" FLRdpHPA,FLRdpHPB
 SG_ FLR2RdrDetn235To239EleAng2 : 192|8@1+ (0.002,0.0) [0.0|0.5] "rad" FLRdpHPA,FLRdpHPB
 SG_ FLR2RdrDetn235To239EleAng3 : 256|8@1+ (0.002,0.0) [0.0|0.5] "rad" FLRdpHPA,FLRdpHPB
 SG_ FLR2RdrDetn235To239EleAng4 : 320|8@1+ (0.002,0.0) [0.0|0.5] "rad" FLRdpHPA,FLRdpHPB
 SG_ FLR2RdrDetn235To239Mode0 : 60|2@1+ (1,0) [0|3] "" FLRdpHPA,FLRdpHPB
 SG_ FLR2RdrDetn235To239Mode1 : 124|2@1+ (1,0) [0|3] "" FLRdpHPA,FLRdpHPB
 SG_ FLR2RdrDetn235To239Mode2 : 188|2@1+ (1,0) [0|3] "" FLRdpHPA,FLRdpHPB
 SG_ FLR2RdrDetn235To239Mode3 : 252|2@1+ (1,0) [0|3] "" FLRdpHPA,FLRdpHPB
 SG_ FLR2RdrDetn235To239Mode4 : 316|2@1+ (1,0) [0|3] "" FLRdpHPA,FLRdpHPB
 SG_ FLR2RdrDetn235To239Quality0 : 62|2@1+ (1,0) [0|3] "" FLRdpHPA,FLRdpHPB
 SG_ FLR2RdrDetn235To239Quality1 : 126|2@1+ (1,0) [0|3] "" FLRdpHPA,FLRdpHPB
 SG_ FLR2RdrDetn235To239Quality2 : 190|2@1+ (1,0) [0|3] "" FLRdpHPA,FLRdpHPB
 SG_ FLR2RdrDetn235To239Quality3 : 254|2@1+ (1,0) [0|3] "" FLRdpHPA,FLRdpHPB
 SG_ FLR2RdrDetn235To239Quality4 : 318|2@1+ (1,0) [0|3] "" FLRdpHPA,FLRdpHPB
 SG_ FLR2RdrDetn235To239Range0 : 48|12@1+ (0.1,0.4) [0.4|300.0] "m" FLRdpHPA,FLRdpHPB
 SG_ FLR2RdrDetn235To239Range1 : 112|12@1+ (0.1,0.4) [0.4|300.0] "m" FLRdpHPA,FLRdpHPB
 SG_ FLR2RdrDetn235To239Range2 : 176|12@1+ (0.1,0.4) [0.4|300.0] "m" FLRdpHPA,FLRdpHPB
 SG_ FLR2RdrDetn235To239Range3 : 240|12@1+ (0.1,0.4) [0.4|300.0] "m" FLRdpHPA,FLRdpHPB
 SG_ FLR2RdrDetn235To239Range4 : 304|12@1+ (0.1,0.4) [0.4|300.0] "m" FLRdpHPA,FLRdpHPB
 SG_ FLR2RdrDetn235To239RCS0 : 83|10@1+ (0.2,-100.0) [-100.0|70.0] "dBsm" FLRdpHPA,FLRdpHPB
 SG_ FLR2RdrDetn235To239RCS1 : 147|10@1+ (0.2,-100.0) [-100.0|70.0] "dBsm" FLRdpHPA,FLRdpHPB
 SG_ FLR2RdrDetn235To239RCS2 : 211|10@1+ (0.2,-100.0) [-100.0|70.0] "dBsm" FLRdpHPA,FLRdpHPB
 SG_ FLR2RdrDetn235To239RCS3 : 275|10@1+ (0.2,-100.0) [-100.0|70.0] "dBsm" FLRdpHPA,FLRdpHPB
 SG_ FLR2RdrDetn235To239RCS4 : 339|10@1+ (0.2,-100.0) [-100.0|70.0] "dBsm" FLRdpHPA,FLRdpHPB
 SG_ FLR2RdrDetn235To239RngRt0 : 72|11@1+ (0.1,-111.11) [-111.11|55.59000000000002] "m/s" FLRdpHPA,FLRdpHPB
 SG_ FLR2RdrDetn235To239RngRt1 : 136|11@1+ (0.1,-111.11) [-111.11|55.59000000000002] "m/s" FLRdpHPA,FLRdpHPB
 SG_ FLR2RdrDetn235To239RngRt2 : 200|11@1+ (0.1,-111.11) [-111.11|55.59000000000002] "m/s" FLRdpHPA,FLRdpHPB
 SG_ FLR2RdrDetn235To239RngRt3 : 264|11@1+ (0.1,-111.11) [-111.11|55.59000000000002] "m/s" FLRdpHPA,FLRdpHPB
 SG_ FLR2RdrDetn235To239RngRt4 : 328|11@1+ (0.1,-111.11) [-111.11|55.59000000000002] "m/s" FLRdpHPA,FLRdpHPB
 SG_ FLR2RdrDetn235To239ScanID : 24|8@1+ (1.0,0.0) [0.0|255.0] "Unitless" FLRdpHPA,FLRdpHPB
 SG_ FLR2RdrDetn235To239SNR0 : 41|7@1+ (0.5,0.0) [0.0|63.5] "dB" FLRdpHPA,FLRdpHPB
 SG_ FLR2RdrDetn235To239SNR1 : 105|7@1+ (0.5,0.0) [0.0|63.5] "dB" FLRdpHPA,FLRdpHPB
 SG_ FLR2RdrDetn235To239SNR2 : 169|7@1+ (0.5,0.0) [0.0|63.5] "dB" FLRdpHPA,FLRdpHPB
 SG_ FLR2RdrDetn235To239SNR3 : 233|7@1+ (0.5,0.0) [0.0|63.5] "dB" FLRdpHPA,FLRdpHPB
 SG_ FLR2RdrDetn235To239SNR4 : 297|7@1+ (0.5,0.0) [0.0|63.5] "dB" FLRdpHPA,FLRdpHPB

BO_ 236 FlrFlr1canFr49 : 64 FLR
 SG_ FLR2RdrDetn240To244_UB : 359|1@0+ (1,0) [0|1] "" FLRdpHPA,FLRdpHPB
 SG_ FLR2RdrDetn240To244AziAng0 : 32|9@1+ (0.0035,-0.87266) [-0.87266|0.91584] "rad" FLRdpHPA,FLRdpHPB
 SG_ FLR2RdrDetn240To244AziAng1 : 96|9@1+ (0.0035,-0.87266) [-0.87266|0.91584] "rad" FLRdpHPA,FLRdpHPB
 SG_ FLR2RdrDetn240To244AziAng2 : 160|9@1+ (0.0035,-0.87266) [-0.87266|0.91584] "rad" FLRdpHPA,FLRdpHPB
 SG_ FLR2RdrDetn240To244AziAng3 : 224|9@1+ (0.0035,-0.87266) [-0.87266|0.91584] "rad" FLRdpHPA,FLRdpHPB
 SG_ FLR2RdrDetn240To244AziAng4 : 288|9@1+ (0.0035,-0.87266) [-0.87266|0.91584] "rad" FLRdpHPA,FLRdpHPB
 SG_ FLR2RdrDetn240To244Counter : 16|8@1+ (1.0,0.0) [0.0|255.0] "Unitless" FLRdpHPA,FLRdpHPB
 SG_ FLR2RdrDetn240To244CRC : 0|16@1+ (1.0,0.0) [0.0|65535.0] "Unitless" FLRdpHPA,FLRdpHPB
 SG_ FLR2RdrDetn240To244DynPrpty0 : 93|1@1+ (1.0,0.0) [0.0|1.0] "Unitless" FLRdpHPA,FLRdpHPB
 SG_ FLR2RdrDetn240To244DynPrpty1 : 157|1@1+ (1.0,0.0) [0.0|1.0] "Unitless" FLRdpHPA,FLRdpHPB
 SG_ FLR2RdrDetn240To244DynPrpty2 : 221|1@1+ (1.0,0.0) [0.0|1.0] "Unitless" FLRdpHPA,FLRdpHPB
 SG_ FLR2RdrDetn240To244DynPrpty3 : 285|1@1+ (1.0,0.0) [0.0|1.0] "Unitless" FLRdpHPA,FLRdpHPB
 SG_ FLR2RdrDetn240To244DynPrpty4 : 349|1@1+ (1.0,0.0) [0.0|1.0] "Unitless" FLRdpHPA,FLRdpHPB
 SG_ FLR2RdrDetn240To244EleAng0 : 64|8@1+ (0.002,0.0) [0.0|0.5] "rad" FLRdpHPA,FLRdpHPB
 SG_ FLR2RdrDetn240To244EleAng1 : 128|8@1+ (0.002,0.0) [0.0|0.5] "rad" FLRdpHPA,FLRdpHPB
 SG_ FLR2RdrDetn240To244EleAng2 : 192|8@1+ (0.002,0.0) [0.0|0.5] "rad" FLRdpHPA,FLRdpHPB
 SG_ FLR2RdrDetn240To244EleAng3 : 256|8@1+ (0.002,0.0) [0.0|0.5] "rad" FLRdpHPA,FLRdpHPB
 SG_ FLR2RdrDetn240To244EleAng4 : 320|8@1+ (0.002,0.0) [0.0|0.5] "rad" FLRdpHPA,FLRdpHPB
 SG_ FLR2RdrDetn240To244Mode0 : 60|2@1+ (1,0) [0|3] "" FLRdpHPA,FLRdpHPB
 SG_ FLR2RdrDetn240To244Mode1 : 124|2@1+ (1,0) [0|3] "" FLRdpHPA,FLRdpHPB
 SG_ FLR2RdrDetn240To244Mode2 : 188|2@1+ (1,0) [0|3] "" FLRdpHPA,FLRdpHPB
 SG_ FLR2RdrDetn240To244Mode3 : 252|2@1+ (1,0) [0|3] "" FLRdpHPA,FLRdpHPB
 SG_ FLR2RdrDetn240To244Mode4 : 316|2@1+ (1,0) [0|3] "" FLRdpHPA,FLRdpHPB
 SG_ FLR2RdrDetn240To244Quality0 : 62|2@1+ (1,0) [0|3] "" FLRdpHPA,FLRdpHPB
 SG_ FLR2RdrDetn240To244Quality1 : 126|2@1+ (1,0) [0|3] "" FLRdpHPA,FLRdpHPB
 SG_ FLR2RdrDetn240To244Quality2 : 190|2@1+ (1,0) [0|3] "" FLRdpHPA,FLRdpHPB
 SG_ FLR2RdrDetn240To244Quality3 : 254|2@1+ (1,0) [0|3] "" FLRdpHPA,FLRdpHPB
 SG_ FLR2RdrDetn240To244Quality4 : 318|2@1+ (1,0) [0|3] "" FLRdpHPA,FLRdpHPB
 SG_ FLR2RdrDetn240To244Range0 : 48|12@1+ (0.1,0.4) [0.4|300.0] "m" FLRdpHPA,FLRdpHPB
 SG_ FLR2RdrDetn240To244Range1 : 112|12@1+ (0.1,0.4) [0.4|300.0] "m" FLRdpHPA,FLRdpHPB
 SG_ FLR2RdrDetn240To244Range2 : 176|12@1+ (0.1,0.4) [0.4|300.0] "m" FLRdpHPA,FLRdpHPB
 SG_ FLR2RdrDetn240To244Range3 : 240|12@1+ (0.1,0.4) [0.4|300.0] "m" FLRdpHPA,FLRdpHPB
 SG_ FLR2RdrDetn240To244Range4 : 304|12@1+ (0.1,0.4) [0.4|300.0] "m" FLRdpHPA,FLRdpHPB
 SG_ FLR2RdrDetn240To244RCS0 : 83|10@1+ (0.2,-100.0) [-100.0|70.0] "dBsm" FLRdpHPA,FLRdpHPB
 SG_ FLR2RdrDetn240To244RCS1 : 147|10@1+ (0.2,-100.0) [-100.0|70.0] "dBsm" FLRdpHPA,FLRdpHPB
 SG_ FLR2RdrDetn240To244RCS2 : 211|10@1+ (0.2,-100.0) [-100.0|70.0] "dBsm" FLRdpHPA,FLRdpHPB
 SG_ FLR2RdrDetn240To244RCS3 : 275|10@1+ (0.2,-100.0) [-100.0|70.0] "dBsm" FLRdpHPA,FLRdpHPB
 SG_ FLR2RdrDetn240To244RCS4 : 339|10@1+ (0.2,-100.0) [-100.0|70.0] "dBsm" FLRdpHPA,FLRdpHPB
 SG_ FLR2RdrDetn240To244RngRt0 : 72|11@1+ (0.1,-111.11) [-111.11|55.59000000000002] "m/s" FLRdpHPA,FLRdpHPB
 SG_ FLR2RdrDetn240To244RngRt1 : 136|11@1+ (0.1,-111.11) [-111.11|55.59000000000002] "m/s" FLRdpHPA,FLRdpHPB
 SG_ FLR2RdrDetn240To244RngRt2 : 200|11@1+ (0.1,-111.11) [-111.11|55.59000000000002] "m/s" FLRdpHPA,FLRdpHPB
 SG_ FLR2RdrDetn240To244RngRt3 : 264|11@1+ (0.1,-111.11) [-111.11|55.59000000000002] "m/s" FLRdpHPA,FLRdpHPB
 SG_ FLR2RdrDetn240To244RngRt4 : 328|11@1+ (0.1,-111.11) [-111.11|55.59000000000002] "m/s" FLRdpHPA,FLRdpHPB
 SG_ FLR2RdrDetn240To244ScanID : 24|8@1+ (1.0,0.0) [0.0|255.0] "Unitless" FLRdpHPA,FLRdpHPB
 SG_ FLR2RdrDetn240To244SNR0 : 41|7@1+ (0.5,0.0) [0.0|63.5] "dB" FLRdpHPA,FLRdpHPB
 SG_ FLR2RdrDetn240To244SNR1 : 105|7@1+ (0.5,0.0) [0.0|63.5] "dB" FLRdpHPA,FLRdpHPB
 SG_ FLR2RdrDetn240To244SNR2 : 169|7@1+ (0.5,0.0) [0.0|63.5] "dB" FLRdpHPA,FLRdpHPB
 SG_ FLR2RdrDetn240To244SNR3 : 233|7@1+ (0.5,0.0) [0.0|63.5] "dB" FLRdpHPA,FLRdpHPB
 SG_ FLR2RdrDetn240To244SNR4 : 297|7@1+ (0.5,0.0) [0.0|63.5] "dB" FLRdpHPA,FLRdpHPB

BO_ 240 FlrFlr1canFr50 : 64 FLR
 SG_ FLR2RdrDetn245To249_UB : 359|1@0+ (1,0) [0|1] "" FLRdpHPA,FLRdpHPB
 SG_ FLR2RdrDetn245To249AziAng0 : 32|9@1+ (0.0035,-0.87266) [-0.87266|0.91584] "rad" FLRdpHPA,FLRdpHPB
 SG_ FLR2RdrDetn245To249AziAng1 : 96|9@1+ (0.0035,-0.87266) [-0.87266|0.91584] "rad" FLRdpHPA,FLRdpHPB
 SG_ FLR2RdrDetn245To249AziAng2 : 160|9@1+ (0.0035,-0.87266) [-0.87266|0.91584] "rad" FLRdpHPA,FLRdpHPB
 SG_ FLR2RdrDetn245To249AziAng3 : 224|9@1+ (0.0035,-0.87266) [-0.87266|0.91584] "rad" FLRdpHPA,FLRdpHPB
 SG_ FLR2RdrDetn245To249AziAng4 : 288|9@1+ (0.0035,-0.87266) [-0.87266|0.91584] "rad" FLRdpHPA,FLRdpHPB
 SG_ FLR2RdrDetn245To249Counter : 16|8@1+ (1.0,0.0) [0.0|255.0] "Unitless" FLRdpHPA,FLRdpHPB
 SG_ FLR2RdrDetn245To249CRC : 0|16@1+ (1.0,0.0) [0.0|65535.0] "Unitless" FLRdpHPA,FLRdpHPB
 SG_ FLR2RdrDetn245To249DynPrpty0 : 93|1@1+ (1.0,0.0) [0.0|1.0] "Unitless" FLRdpHPA,FLRdpHPB
 SG_ FLR2RdrDetn245To249DynPrpty1 : 157|1@1+ (1.0,0.0) [0.0|1.0] "Unitless" FLRdpHPA,FLRdpHPB
 SG_ FLR2RdrDetn245To249DynPrpty2 : 221|1@1+ (1.0,0.0) [0.0|1.0] "Unitless" FLRdpHPA,FLRdpHPB
 SG_ FLR2RdrDetn245To249DynPrpty3 : 285|1@1+ (1.0,0.0) [0.0|1.0] "Unitless" FLRdpHPA,FLRdpHPB
 SG_ FLR2RdrDetn245To249DynPrpty4 : 349|1@1+ (1.0,0.0) [0.0|1.0] "Unitless" FLRdpHPA,FLRdpHPB
 SG_ FLR2RdrDetn245To249EleAng0 : 64|8@1+ (0.002,0.0) [0.0|0.5] "rad" FLRdpHPA,FLRdpHPB
 SG_ FLR2RdrDetn245To249EleAng1 : 128|8@1+ (0.002,0.0) [0.0|0.5] "rad" FLRdpHPA,FLRdpHPB
 SG_ FLR2RdrDetn245To249EleAng2 : 192|8@1+ (0.002,0.0) [0.0|0.5] "rad" FLRdpHPA,FLRdpHPB
 SG_ FLR2RdrDetn245To249EleAng3 : 256|8@1+ (0.002,0.0) [0.0|0.5] "rad" FLRdpHPA,FLRdpHPB
 SG_ FLR2RdrDetn245To249EleAng4 : 320|8@1+ (0.002,0.0) [0.0|0.5] "rad" FLRdpHPA,FLRdpHPB
 SG_ FLR2RdrDetn245To249Mode0 : 60|2@1+ (1,0) [0|3] "" FLRdpHPA,FLRdpHPB
 SG_ FLR2RdrDetn245To249Mode1 : 124|2@1+ (1,0) [0|3] "" FLRdpHPA,FLRdpHPB
 SG_ FLR2RdrDetn245To249Mode2 : 188|2@1+ (1,0) [0|3] "" FLRdpHPA,FLRdpHPB
 SG_ FLR2RdrDetn245To249Mode3 : 252|2@1+ (1,0) [0|3] "" FLRdpHPA,FLRdpHPB
 SG_ FLR2RdrDetn245To249Mode4 : 316|2@1+ (1,0) [0|3] "" FLRdpHPA,FLRdpHPB
 SG_ FLR2RdrDetn245To249Quality0 : 62|2@1+ (1,0) [0|3] "" FLRdpHPA,FLRdpHPB
 SG_ FLR2RdrDetn245To249Quality1 : 126|2@1+ (1,0) [0|3] "" FLRdpHPA,FLRdpHPB
 SG_ FLR2RdrDetn245To249Quality2 : 190|2@1+ (1,0) [0|3] "" FLRdpHPA,FLRdpHPB
 SG_ FLR2RdrDetn245To249Quality3 : 254|2@1+ (1,0) [0|3] "" FLRdpHPA,FLRdpHPB
 SG_ FLR2RdrDetn245To249Quality4 : 318|2@1+ (1,0) [0|3] "" FLRdpHPA,FLRdpHPB
 SG_ FLR2RdrDetn245To249Range0 : 48|12@1+ (0.1,0.4) [0.4|300.0] "m" FLRdpHPA,FLRdpHPB
 SG_ FLR2RdrDetn245To249Range1 : 112|12@1+ (0.1,0.4) [0.4|300.0] "m" FLRdpHPA,FLRdpHPB
 SG_ FLR2RdrDetn245To249Range2 : 176|12@1+ (0.1,0.4) [0.4|300.0] "m" FLRdpHPA,FLRdpHPB
 SG_ FLR2RdrDetn245To249Range3 : 240|12@1+ (0.1,0.4) [0.4|300.0] "m" FLRdpHPA,FLRdpHPB
 SG_ FLR2RdrDetn245To249Range4 : 304|12@1+ (0.1,0.4) [0.4|300.0] "m" FLRdpHPA,FLRdpHPB
 SG_ FLR2RdrDetn245To249RCS0 : 83|10@1+ (0.2,-100.0) [-100.0|70.0] "dBsm" FLRdpHPA,FLRdpHPB
 SG_ FLR2RdrDetn245To249RCS1 : 147|10@1+ (0.2,-100.0) [-100.0|70.0] "dBsm" FLRdpHPA,FLRdpHPB
 SG_ FLR2RdrDetn245To249RCS2 : 211|10@1+ (0.2,-100.0) [-100.0|70.0] "dBsm" FLRdpHPA,FLRdpHPB
 SG_ FLR2RdrDetn245To249RCS3 : 275|10@1+ (0.2,-100.0) [-100.0|70.0] "dBsm" FLRdpHPA,FLRdpHPB
 SG_ FLR2RdrDetn245To249RCS4 : 339|10@1+ (0.2,-100.0) [-100.0|70.0] "dBsm" FLRdpHPA,FLRdpHPB
 SG_ FLR2RdrDetn245To249RngRt0 : 72|11@1+ (0.1,-111.11) [-111.11|55.59000000000002] "m/s" FLRdpHPA,FLRdpHPB
 SG_ FLR2RdrDetn245To249RngRt1 : 136|11@1+ (0.1,-111.11) [-111.11|55.59000000000002] "m/s" FLRdpHPA,FLRdpHPB
 SG_ FLR2RdrDetn245To249RngRt2 : 200|11@1+ (0.1,-111.11) [-111.11|55.59000000000002] "m/s" FLRdpHPA,FLRdpHPB
 SG_ FLR2RdrDetn245To249RngRt3 : 264|11@1+ (0.1,-111.11) [-111.11|55.59000000000002] "m/s" FLRdpHPA,FLRdpHPB
 SG_ FLR2RdrDetn245To249RngRt4 : 328|11@1+ (0.1,-111.11) [-111.11|55.59000000000002] "m/s" FLRdpHPA,FLRdpHPB
 SG_ FLR2RdrDetn245To249ScanID : 24|8@1+ (1.0,0.0) [0.0|255.0] "Unitless" FLRdpHPA,FLRdpHPB
 SG_ FLR2RdrDetn245To249SNR0 : 41|7@1+ (0.5,0.0) [0.0|63.5] "dB" FLRdpHPA,FLRdpHPB
 SG_ FLR2RdrDetn245To249SNR1 : 105|7@1+ (0.5,0.0) [0.0|63.5] "dB" FLRdpHPA,FLRdpHPB
 SG_ FLR2RdrDetn245To249SNR2 : 169|7@1+ (0.5,0.0) [0.0|63.5] "dB" FLRdpHPA,FLRdpHPB
 SG_ FLR2RdrDetn245To249SNR3 : 233|7@1+ (0.5,0.0) [0.0|63.5] "dB" FLRdpHPA,FLRdpHPB
 SG_ FLR2RdrDetn245To249SNR4 : 297|7@1+ (0.5,0.0) [0.0|63.5] "dB" FLRdpHPA,FLRdpHPB

BO_ 242 FlrFlr1canFr51 : 64 FLR
 SG_ FLR2RdrDetn250To254_UB : 359|1@0+ (1,0) [0|1] "" FLRdpHPA,FLRdpHPB
 SG_ FLR2RdrDetn250To254AziAng0 : 32|9@1+ (0.0035,-0.87266) [-0.87266|0.91584] "rad" FLRdpHPA,FLRdpHPB
 SG_ FLR2RdrDetn250To254AziAng1 : 96|9@1+ (0.0035,-0.87266) [-0.87266|0.91584] "rad" FLRdpHPA,FLRdpHPB
 SG_ FLR2RdrDetn250To254AziAng2 : 160|9@1+ (0.0035,-0.87266) [-0.87266|0.91584] "rad" FLRdpHPA,FLRdpHPB
 SG_ FLR2RdrDetn250To254AziAng3 : 224|9@1+ (0.0035,-0.87266) [-0.87266|0.91584] "rad" FLRdpHPA,FLRdpHPB
 SG_ FLR2RdrDetn250To254AziAng4 : 288|9@1+ (0.0035,-0.87266) [-0.87266|0.91584] "rad" FLRdpHPA,FLRdpHPB
 SG_ FLR2RdrDetn250To254Counter : 16|8@1+ (1.0,0.0) [0.0|255.0] "Unitless" FLRdpHPA,FLRdpHPB
 SG_ FLR2RdrDetn250To254CRC : 0|16@1+ (1.0,0.0) [0.0|65535.0] "Unitless" FLRdpHPA,FLRdpHPB
 SG_ FLR2RdrDetn250To254DynPrpty0 : 93|1@1+ (1.0,0.0) [0.0|1.0] "Unitless" FLRdpHPA,FLRdpHPB
 SG_ FLR2RdrDetn250To254DynPrpty1 : 157|1@1+ (1.0,0.0) [0.0|1.0] "Unitless" FLRdpHPA,FLRdpHPB
 SG_ FLR2RdrDetn250To254DynPrpty2 : 221|1@1+ (1.0,0.0) [0.0|1.0] "Unitless" FLRdpHPA,FLRdpHPB
 SG_ FLR2RdrDetn250To254DynPrpty3 : 285|1@1+ (1.0,0.0) [0.0|1.0] "Unitless" FLRdpHPA,FLRdpHPB
 SG_ FLR2RdrDetn250To254DynPrpty4 : 349|1@1+ (1.0,0.0) [0.0|1.0] "Unitless" FLRdpHPA,FLRdpHPB
 SG_ FLR2RdrDetn250To254EleAng0 : 64|8@1+ (0.002,0.0) [0.0|0.5] "rad" FLRdpHPA,FLRdpHPB
 SG_ FLR2RdrDetn250To254EleAng1 : 128|8@1+ (0.002,0.0) [0.0|0.5] "rad" FLRdpHPA,FLRdpHPB
 SG_ FLR2RdrDetn250To254EleAng2 : 192|8@1+ (0.002,0.0) [0.0|0.5] "rad" FLRdpHPA,FLRdpHPB
 SG_ FLR2RdrDetn250To254EleAng3 : 256|8@1+ (0.002,0.0) [0.0|0.5] "rad" FLRdpHPA,FLRdpHPB
 SG_ FLR2RdrDetn250To254EleAng4 : 320|8@1+ (0.002,0.0) [0.0|0.5] "rad" FLRdpHPA,FLRdpHPB
 SG_ FLR2RdrDetn250To254Mode0 : 60|2@1+ (1,0) [0|3] "" FLRdpHPA,FLRdpHPB
 SG_ FLR2RdrDetn250To254Mode1 : 124|2@1+ (1,0) [0|3] "" FLRdpHPA,FLRdpHPB
 SG_ FLR2RdrDetn250To254Mode2 : 188|2@1+ (1,0) [0|3] "" FLRdpHPA,FLRdpHPB
 SG_ FLR2RdrDetn250To254Mode3 : 252|2@1+ (1,0) [0|3] "" FLRdpHPA,FLRdpHPB
 SG_ FLR2RdrDetn250To254Mode4 : 316|2@1+ (1,0) [0|3] "" FLRdpHPA,FLRdpHPB
 SG_ FLR2RdrDetn250To254Quality0 : 62|2@1+ (1,0) [0|3] "" FLRdpHPA,FLRdpHPB
 SG_ FLR2RdrDetn250To254Quality1 : 126|2@1+ (1,0) [0|3] "" FLRdpHPA,FLRdpHPB
 SG_ FLR2RdrDetn250To254Quality2 : 190|2@1+ (1,0) [0|3] "" FLRdpHPA,FLRdpHPB
 SG_ FLR2RdrDetn250To254Quality3 : 254|2@1+ (1,0) [0|3] "" FLRdpHPA,FLRdpHPB
 SG_ FLR2RdrDetn250To254Quality4 : 318|2@1+ (1,0) [0|3] "" FLRdpHPA,FLRdpHPB
 SG_ FLR2RdrDetn250To254Range0 : 48|12@1+ (0.1,0.4) [0.4|300.0] "m" FLRdpHPA,FLRdpHPB
 SG_ FLR2RdrDetn250To254Range1 : 112|12@1+ (0.1,0.4) [0.4|300.0] "m" FLRdpHPA,FLRdpHPB
 SG_ FLR2RdrDetn250To254Range2 : 176|12@1+ (0.1,0.4) [0.4|300.0] "m" FLRdpHPA,FLRdpHPB
 SG_ FLR2RdrDetn250To254Range3 : 240|12@1+ (0.1,0.4) [0.4|300.0] "m" FLRdpHPA,FLRdpHPB
 SG_ FLR2RdrDetn250To254Range4 : 304|12@1+ (0.1,0.4) [0.4|300.0] "m" FLRdpHPA,FLRdpHPB
 SG_ FLR2RdrDetn250To254RCS0 : 83|10@1+ (0.2,-100.0) [-100.0|70.0] "dBsm" FLRdpHPA,FLRdpHPB
 SG_ FLR2RdrDetn250To254RCS1 : 147|10@1+ (0.2,-100.0) [-100.0|70.0] "dBsm" FLRdpHPA,FLRdpHPB
 SG_ FLR2RdrDetn250To254RCS2 : 211|10@1+ (0.2,-100.0) [-100.0|70.0] "dBsm" FLRdpHPA,FLRdpHPB
 SG_ FLR2RdrDetn250To254RCS3 : 275|10@1+ (0.2,-100.0) [-100.0|70.0] "dBsm" FLRdpHPA,FLRdpHPB
 SG_ FLR2RdrDetn250To254RCS4 : 339|10@1+ (0.2,-100.0) [-100.0|70.0] "dBsm" FLRdpHPA,FLRdpHPB
 SG_ FLR2RdrDetn250To254RngRt0 : 72|11@1+ (0.1,-111.11) [-111.11|55.59000000000002] "m/s" FLRdpHPA,FLRdpHPB
 SG_ FLR2RdrDetn250To254RngRt1 : 136|11@1+ (0.1,-111.11) [-111.11|55.59000000000002] "m/s" FLRdpHPA,FLRdpHPB
 SG_ FLR2RdrDetn250To254RngRt2 : 200|11@1+ (0.1,-111.11) [-111.11|55.59000000000002] "m/s" FLRdpHPA,FLRdpHPB
 SG_ FLR2RdrDetn250To254RngRt3 : 264|11@1+ (0.1,-111.11) [-111.11|55.59000000000002] "m/s" FLRdpHPA,FLRdpHPB
 SG_ FLR2RdrDetn250To254RngRt4 : 328|11@1+ (0.1,-111.11) [-111.11|55.59000000000002] "m/s" FLRdpHPA,FLRdpHPB
 SG_ FLR2RdrDetn250To254ScanID : 24|8@1+ (1.0,0.0) [0.0|255.0] "Unitless" FLRdpHPA,FLRdpHPB
 SG_ FLR2RdrDetn250To254SNR0 : 41|7@1+ (0.5,0.0) [0.0|63.5] "dB" FLRdpHPA,FLRdpHPB
 SG_ FLR2RdrDetn250To254SNR1 : 105|7@1+ (0.5,0.0) [0.0|63.5] "dB" FLRdpHPA,FLRdpHPB
 SG_ FLR2RdrDetn250To254SNR2 : 169|7@1+ (0.5,0.0) [0.0|63.5] "dB" FLRdpHPA,FLRdpHPB
 SG_ FLR2RdrDetn250To254SNR3 : 233|7@1+ (0.5,0.0) [0.0|63.5] "dB" FLRdpHPA,FLRdpHPB
 SG_ FLR2RdrDetn250To254SNR4 : 297|7@1+ (0.5,0.0) [0.0|63.5] "dB" FLRdpHPA,FLRdpHPB

BO_ 244 FlrFlr1canFr52 : 64 FLR
 SG_ FLR2RdrDetn255To259_UB : 359|1@0+ (1,0) [0|1] "" FLRdpHPA,FLRdpHPB
 SG_ FLR2RdrDetn255To259AziAng0 : 32|9@1+ (0.0035,-0.87266) [-0.87266|0.91584] "rad" FLRdpHPA,FLRdpHPB
 SG_ FLR2RdrDetn255To259AziAng1 : 96|9@1+ (0.0035,-0.87266) [-0.87266|0.91584] "rad" FLRdpHPA,FLRdpHPB
 SG_ FLR2RdrDetn255To259AziAng2 : 160|9@1+ (0.0035,-0.87266) [-0.87266|0.91584] "rad" FLRdpHPA,FLRdpHPB
 SG_ FLR2RdrDetn255To259AziAng3 : 224|9@1+ (0.0035,-0.87266) [-0.87266|0.91584] "rad" FLRdpHPA,FLRdpHPB
 SG_ FLR2RdrDetn255To259AziAng4 : 288|9@1+ (0.0035,-0.87266) [-0.87266|0.91584] "rad" FLRdpHPA,FLRdpHPB
 SG_ FLR2RdrDetn255To259Counter : 16|8@1+ (1.0,0.0) [0.0|255.0] "Unitless" FLRdpHPA,FLRdpHPB
 SG_ FLR2RdrDetn255To259CRC : 0|16@1+ (1.0,0.0) [0.0|65535.0] "Unitless" FLRdpHPA,FLRdpHPB
 SG_ FLR2RdrDetn255To259DynPrpty0 : 93|1@1+ (1.0,0.0) [0.0|1.0] "Unitless" FLRdpHPA,FLRdpHPB
 SG_ FLR2RdrDetn255To259DynPrpty1 : 157|1@1+ (1.0,0.0) [0.0|1.0] "Unitless" FLRdpHPA,FLRdpHPB
 SG_ FLR2RdrDetn255To259DynPrpty2 : 221|1@1+ (1.0,0.0) [0.0|1.0] "Unitless" FLRdpHPA,FLRdpHPB
 SG_ FLR2RdrDetn255To259DynPrpty3 : 285|1@1+ (1.0,0.0) [0.0|1.0] "Unitless" FLRdpHPA,FLRdpHPB
 SG_ FLR2RdrDetn255To259DynPrpty4 : 349|1@1+ (1.0,0.0) [0.0|1.0] "Unitless" FLRdpHPA,FLRdpHPB
 SG_ FLR2RdrDetn255To259EleAng0 : 64|8@1+ (0.002,0.0) [0.0|0.5] "rad" FLRdpHPA,FLRdpHPB
 SG_ FLR2RdrDetn255To259EleAng1 : 128|8@1+ (0.002,0.0) [0.0|0.5] "rad" FLRdpHPA,FLRdpHPB
 SG_ FLR2RdrDetn255To259EleAng2 : 192|8@1+ (0.002,0.0) [0.0|0.5] "rad" FLRdpHPA,FLRdpHPB
 SG_ FLR2RdrDetn255To259EleAng3 : 256|8@1+ (0.002,0.0) [0.0|0.5] "rad" FLRdpHPA,FLRdpHPB
 SG_ FLR2RdrDetn255To259EleAng4 : 320|8@1+ (0.002,0.0) [0.0|0.5] "rad" FLRdpHPA,FLRdpHPB
 SG_ FLR2RdrDetn255To259Mode0 : 60|2@1+ (1,0) [0|3] "" FLRdpHPA,FLRdpHPB
 SG_ FLR2RdrDetn255To259Mode1 : 124|2@1+ (1,0) [0|3] "" FLRdpHPA,FLRdpHPB
 SG_ FLR2RdrDetn255To259Mode2 : 188|2@1+ (1,0) [0|3] "" FLRdpHPA,FLRdpHPB
 SG_ FLR2RdrDetn255To259Mode3 : 252|2@1+ (1,0) [0|3] "" FLRdpHPA,FLRdpHPB
 SG_ FLR2RdrDetn255To259Mode4 : 316|2@1+ (1,0) [0|3] "" FLRdpHPA,FLRdpHPB
 SG_ FLR2RdrDetn255To259Quality0 : 62|2@1+ (1,0) [0|3] "" FLRdpHPA,FLRdpHPB
 SG_ FLR2RdrDetn255To259Quality1 : 126|2@1+ (1,0) [0|3] "" FLRdpHPA,FLRdpHPB
 SG_ FLR2RdrDetn255To259Quality2 : 190|2@1+ (1,0) [0|3] "" FLRdpHPA,FLRdpHPB
 SG_ FLR2RdrDetn255To259Quality3 : 254|2@1+ (1,0) [0|3] "" FLRdpHPA,FLRdpHPB
 SG_ FLR2RdrDetn255To259Quality4 : 318|2@1+ (1,0) [0|3] "" FLRdpHPA,FLRdpHPB
 SG_ FLR2RdrDetn255To259Range0 : 48|12@1+ (0.1,0.4) [0.4|300.0] "m" FLRdpHPA,FLRdpHPB
 SG_ FLR2RdrDetn255To259Range1 : 112|12@1+ (0.1,0.4) [0.4|300.0] "m" FLRdpHPA,FLRdpHPB
 SG_ FLR2RdrDetn255To259Range2 : 176|12@1+ (0.1,0.4) [0.4|300.0] "m" FLRdpHPA,FLRdpHPB
 SG_ FLR2RdrDetn255To259Range3 : 240|12@1+ (0.1,0.4) [0.4|300.0] "m" FLRdpHPA,FLRdpHPB
 SG_ FLR2RdrDetn255To259Range4 : 304|12@1+ (0.1,0.4) [0.4|300.0] "m" FLRdpHPA,FLRdpHPB
 SG_ FLR2RdrDetn255To259RCS0 : 83|10@1+ (0.2,-100.0) [-100.0|70.0] "dBsm" FLRdpHPA,FLRdpHPB
 SG_ FLR2RdrDetn255To259RCS1 : 147|10@1+ (0.2,-100.0) [-100.0|70.0] "dBsm" FLRdpHPA,FLRdpHPB
 SG_ FLR2RdrDetn255To259RCS2 : 211|10@1+ (0.2,-100.0) [-100.0|70.0] "dBsm" FLRdpHPA,FLRdpHPB
 SG_ FLR2RdrDetn255To259RCS3 : 275|10@1+ (0.2,-100.0) [-100.0|70.0] "dBsm" FLRdpHPA,FLRdpHPB
 SG_ FLR2RdrDetn255To259RCS4 : 339|10@1+ (0.2,-100.0) [-100.0|70.0] "dBsm" FLRdpHPA,FLRdpHPB
 SG_ FLR2RdrDetn255To259RngRt0 : 72|11@1+ (0.1,-111.11) [-111.11|55.59000000000002] "m/s" FLRdpHPA,FLRdpHPB
 SG_ FLR2RdrDetn255To259RngRt1 : 136|11@1+ (0.1,-111.11) [-111.11|55.59000000000002] "m/s" FLRdpHPA,FLRdpHPB
 SG_ FLR2RdrDetn255To259RngRt2 : 200|11@1+ (0.1,-111.11) [-111.11|55.59000000000002] "m/s" FLRdpHPA,FLRdpHPB
 SG_ FLR2RdrDetn255To259RngRt3 : 264|11@1+ (0.1,-111.11) [-111.11|55.59000000000002] "m/s" FLRdpHPA,FLRdpHPB
 SG_ FLR2RdrDetn255To259RngRt4 : 328|11@1+ (0.1,-111.11) [-111.11|55.59000000000002] "m/s" FLRdpHPA,FLRdpHPB
 SG_ FLR2RdrDetn255To259ScanID : 24|8@1+ (1.0,0.0) [0.0|255.0] "Unitless" FLRdpHPA,FLRdpHPB
 SG_ FLR2RdrDetn255To259SNR0 : 41|7@1+ (0.5,0.0) [0.0|63.5] "dB" FLRdpHPA,FLRdpHPB
 SG_ FLR2RdrDetn255To259SNR1 : 105|7@1+ (0.5,0.0) [0.0|63.5] "dB" FLRdpHPA,FLRdpHPB
 SG_ FLR2RdrDetn255To259SNR2 : 169|7@1+ (0.5,0.0) [0.0|63.5] "dB" FLRdpHPA,FLRdpHPB
 SG_ FLR2RdrDetn255To259SNR3 : 233|7@1+ (0.5,0.0) [0.0|63.5] "dB" FLRdpHPA,FLRdpHPB
 SG_ FLR2RdrDetn255To259SNR4 : 297|7@1+ (0.5,0.0) [0.0|63.5] "dB" FLRdpHPA,FLRdpHPB

BO_ 246 FlrFlr1canFr53 : 64 FLR
 SG_ FLR2RdrDetn260To264_UB : 359|1@0+ (1,0) [0|1] "" FLRdpHPA,FLRdpHPB
 SG_ FLR2RdrDetn260To264AziAng0 : 32|9@1+ (0.0035,-0.87266) [-0.87266|0.91584] "rad" FLRdpHPA,FLRdpHPB
 SG_ FLR2RdrDetn260To264AziAng1 : 96|9@1+ (0.0035,-0.87266) [-0.87266|0.91584] "rad" FLRdpHPA,FLRdpHPB
 SG_ FLR2RdrDetn260To264AziAng2 : 160|9@1+ (0.0035,-0.87266) [-0.87266|0.91584] "rad" FLRdpHPA,FLRdpHPB
 SG_ FLR2RdrDetn260To264AziAng3 : 224|9@1+ (0.0035,-0.87266) [-0.87266|0.91584] "rad" FLRdpHPA,FLRdpHPB
 SG_ FLR2RdrDetn260To264AziAng4 : 288|9@1+ (0.0035,-0.87266) [-0.87266|0.91584] "rad" FLRdpHPA,FLRdpHPB
 SG_ FLR2RdrDetn260To264Counter : 16|8@1+ (1.0,0.0) [0.0|255.0] "Unitless" FLRdpHPA,FLRdpHPB
 SG_ FLR2RdrDetn260To264CRC : 0|16@1+ (1.0,0.0) [0.0|65535.0] "Unitless" FLRdpHPA,FLRdpHPB
 SG_ FLR2RdrDetn260To264DynPrpty0 : 93|1@1+ (1.0,0.0) [0.0|1.0] "Unitless" FLRdpHPA,FLRdpHPB
 SG_ FLR2RdrDetn260To264DynPrpty1 : 157|1@1+ (1.0,0.0) [0.0|1.0] "Unitless" FLRdpHPA,FLRdpHPB
 SG_ FLR2RdrDetn260To264DynPrpty2 : 221|1@1+ (1.0,0.0) [0.0|1.0] "Unitless" FLRdpHPA,FLRdpHPB
 SG_ FLR2RdrDetn260To264DynPrpty3 : 285|1@1+ (1.0,0.0) [0.0|1.0] "Unitless" FLRdpHPA,FLRdpHPB
 SG_ FLR2RdrDetn260To264DynPrpty4 : 349|1@1+ (1.0,0.0) [0.0|1.0] "Unitless" FLRdpHPA,FLRdpHPB
 SG_ FLR2RdrDetn260To264EleAng0 : 64|8@1+ (0.002,0.0) [0.0|0.5] "rad" FLRdpHPA,FLRdpHPB
 SG_ FLR2RdrDetn260To264EleAng1 : 128|8@1+ (0.002,0.0) [0.0|0.5] "rad" FLRdpHPA,FLRdpHPB
 SG_ FLR2RdrDetn260To264EleAng2 : 192|8@1+ (0.002,0.0) [0.0|0.5] "rad" FLRdpHPA,FLRdpHPB
 SG_ FLR2RdrDetn260To264EleAng3 : 256|8@1+ (0.002,0.0) [0.0|0.5] "rad" FLRdpHPA,FLRdpHPB
 SG_ FLR2RdrDetn260To264EleAng4 : 320|8@1+ (0.002,0.0) [0.0|0.5] "rad" FLRdpHPA,FLRdpHPB
 SG_ FLR2RdrDetn260To264Mode0 : 60|2@1+ (1,0) [0|3] "" FLRdpHPA,FLRdpHPB
 SG_ FLR2RdrDetn260To264Mode1 : 124|2@1+ (1,0) [0|3] "" FLRdpHPA,FLRdpHPB
 SG_ FLR2RdrDetn260To264Mode2 : 188|2@1+ (1,0) [0|3] "" FLRdpHPA,FLRdpHPB
 SG_ FLR2RdrDetn260To264Mode3 : 252|2@1+ (1,0) [0|3] "" FLRdpHPA,FLRdpHPB
 SG_ FLR2RdrDetn260To264Mode4 : 316|2@1+ (1,0) [0|3] "" FLRdpHPA,FLRdpHPB
 SG_ FLR2RdrDetn260To264Quality0 : 62|2@1+ (1,0) [0|3] "" FLRdpHPA,FLRdpHPB
 SG_ FLR2RdrDetn260To264Quality1 : 126|2@1+ (1,0) [0|3] "" FLRdpHPA,FLRdpHPB
 SG_ FLR2RdrDetn260To264Quality2 : 190|2@1+ (1,0) [0|3] "" FLRdpHPA,FLRdpHPB
 SG_ FLR2RdrDetn260To264Quality3 : 254|2@1+ (1,0) [0|3] "" FLRdpHPA,FLRdpHPB
 SG_ FLR2RdrDetn260To264Quality4 : 318|2@1+ (1,0) [0|3] "" FLRdpHPA,FLRdpHPB
 SG_ FLR2RdrDetn260To264Range0 : 48|12@1+ (0.1,0.4) [0.4|300.0] "m" FLRdpHPA,FLRdpHPB
 SG_ FLR2RdrDetn260To264Range1 : 112|12@1+ (0.1,0.4) [0.4|300.0] "m" FLRdpHPA,FLRdpHPB
 SG_ FLR2RdrDetn260To264Range2 : 176|12@1+ (0.1,0.4) [0.4|300.0] "m" FLRdpHPA,FLRdpHPB
 SG_ FLR2RdrDetn260To264Range3 : 240|12@1+ (0.1,0.4) [0.4|300.0] "m" FLRdpHPA,FLRdpHPB
 SG_ FLR2RdrDetn260To264Range4 : 304|12@1+ (0.1,0.4) [0.4|300.0] "m" FLRdpHPA,FLRdpHPB
 SG_ FLR2RdrDetn260To264RCS0 : 83|10@1+ (0.2,-100.0) [-100.0|70.0] "dBsm" FLRdpHPA,FLRdpHPB
 SG_ FLR2RdrDetn260To264RCS1 : 147|10@1+ (0.2,-100.0) [-100.0|70.0] "dBsm" FLRdpHPA,FLRdpHPB
 SG_ FLR2RdrDetn260To264RCS2 : 211|10@1+ (0.2,-100.0) [-100.0|70.0] "dBsm" FLRdpHPA,FLRdpHPB
 SG_ FLR2RdrDetn260To264RCS3 : 275|10@1+ (0.2,-100.0) [-100.0|70.0] "dBsm" FLRdpHPA,FLRdpHPB
 SG_ FLR2RdrDetn260To264RCS4 : 339|10@1+ (0.2,-100.0) [-100.0|70.0] "dBsm" FLRdpHPA,FLRdpHPB
 SG_ FLR2RdrDetn260To264RngRt0 : 72|11@1+ (0.1,-111.11) [-111.11|55.59000000000002] "m/s" FLRdpHPA,FLRdpHPB
 SG_ FLR2RdrDetn260To264RngRt1 : 136|11@1+ (0.1,-111.11) [-111.11|55.59000000000002] "m/s" FLRdpHPA,FLRdpHPB
 SG_ FLR2RdrDetn260To264RngRt2 : 200|11@1+ (0.1,-111.11) [-111.11|55.59000000000002] "m/s" FLRdpHPA,FLRdpHPB
 SG_ FLR2RdrDetn260To264RngRt3 : 264|11@1+ (0.1,-111.11) [-111.11|55.59000000000002] "m/s" FLRdpHPA,FLRdpHPB
 SG_ FLR2RdrDetn260To264RngRt4 : 328|11@1+ (0.1,-111.11) [-111.11|55.59000000000002] "m/s" FLRdpHPA,FLRdpHPB
 SG_ FLR2RdrDetn260To264ScanID : 24|8@1+ (1.0,0.0) [0.0|255.0] "Unitless" FLRdpHPA,FLRdpHPB
 SG_ FLR2RdrDetn260To264SNR0 : 41|7@1+ (0.5,0.0) [0.0|63.5] "dB" FLRdpHPA,FLRdpHPB
 SG_ FLR2RdrDetn260To264SNR1 : 105|7@1+ (0.5,0.0) [0.0|63.5] "dB" FLRdpHPA,FLRdpHPB
 SG_ FLR2RdrDetn260To264SNR2 : 169|7@1+ (0.5,0.0) [0.0|63.5] "dB" FLRdpHPA,FLRdpHPB
 SG_ FLR2RdrDetn260To264SNR3 : 233|7@1+ (0.5,0.0) [0.0|63.5] "dB" FLRdpHPA,FLRdpHPB
 SG_ FLR2RdrDetn260To264SNR4 : 297|7@1+ (0.5,0.0) [0.0|63.5] "dB" FLRdpHPA,FLRdpHPB

BO_ 248 FlrFlr1canFr54 : 64 FLR
 SG_ FLR2RdrDetn265To269_UB : 359|1@0+ (1,0) [0|1] "" FLRdpHPA,FLRdpHPB
 SG_ FLR2RdrDetn265To269AziAng0 : 32|9@1+ (0.0035,-0.87266) [-0.87266|0.91584] "rad" FLRdpHPA,FLRdpHPB
 SG_ FLR2RdrDetn265To269AziAng1 : 96|9@1+ (0.0035,-0.87266) [-0.87266|0.91584] "rad" FLRdpHPA,FLRdpHPB
 SG_ FLR2RdrDetn265To269AziAng2 : 160|9@1+ (0.0035,-0.87266) [-0.87266|0.91584] "rad" FLRdpHPA,FLRdpHPB
 SG_ FLR2RdrDetn265To269AziAng3 : 224|9@1+ (0.0035,-0.87266) [-0.87266|0.91584] "rad" FLRdpHPA,FLRdpHPB
 SG_ FLR2RdrDetn265To269AziAng4 : 288|9@1+ (0.0035,-0.87266) [-0.87266|0.91584] "rad" FLRdpHPA,FLRdpHPB
 SG_ FLR2RdrDetn265To269Counter : 16|8@1+ (1.0,0.0) [0.0|255.0] "Unitless" FLRdpHPA,FLRdpHPB
 SG_ FLR2RdrDetn265To269CRC : 0|16@1+ (1.0,0.0) [0.0|65535.0] "Unitless" FLRdpHPA,FLRdpHPB
 SG_ FLR2RdrDetn265To269DynPrpty0 : 93|1@1+ (1.0,0.0) [0.0|1.0] "Unitless" FLRdpHPA,FLRdpHPB
 SG_ FLR2RdrDetn265To269DynPrpty1 : 157|1@1+ (1.0,0.0) [0.0|1.0] "Unitless" FLRdpHPA,FLRdpHPB
 SG_ FLR2RdrDetn265To269DynPrpty2 : 221|1@1+ (1.0,0.0) [0.0|1.0] "Unitless" FLRdpHPA,FLRdpHPB
 SG_ FLR2RdrDetn265To269DynPrpty3 : 285|1@1+ (1.0,0.0) [0.0|1.0] "Unitless" FLRdpHPA,FLRdpHPB
 SG_ FLR2RdrDetn265To269DynPrpty4 : 349|1@1+ (1.0,0.0) [0.0|1.0] "Unitless" FLRdpHPA,FLRdpHPB
 SG_ FLR2RdrDetn265To269EleAng0 : 64|8@1+ (0.002,0.0) [0.0|0.5] "rad" FLRdpHPA,FLRdpHPB
 SG_ FLR2RdrDetn265To269EleAng1 : 128|8@1+ (0.002,0.0) [0.0|0.5] "rad" FLRdpHPA,FLRdpHPB
 SG_ FLR2RdrDetn265To269EleAng2 : 192|8@1+ (0.002,0.0) [0.0|0.5] "rad" FLRdpHPA,FLRdpHPB
 SG_ FLR2RdrDetn265To269EleAng3 : 256|8@1+ (0.002,0.0) [0.0|0.5] "rad" FLRdpHPA,FLRdpHPB
 SG_ FLR2RdrDetn265To269EleAng4 : 320|8@1+ (0.002,0.0) [0.0|0.5] "rad" FLRdpHPA,FLRdpHPB
 SG_ FLR2RdrDetn265To269Mode0 : 60|2@1+ (1,0) [0|3] "" FLRdpHPA,FLRdpHPB
 SG_ FLR2RdrDetn265To269Mode1 : 124|2@1+ (1,0) [0|3] "" FLRdpHPA,FLRdpHPB
 SG_ FLR2RdrDetn265To269Mode2 : 188|2@1+ (1,0) [0|3] "" FLRdpHPA,FLRdpHPB
 SG_ FLR2RdrDetn265To269Mode3 : 252|2@1+ (1,0) [0|3] "" FLRdpHPA,FLRdpHPB
 SG_ FLR2RdrDetn265To269Mode4 : 316|2@1+ (1,0) [0|3] "" FLRdpHPA,FLRdpHPB
 SG_ FLR2RdrDetn265To269Quality0 : 62|2@1+ (1,0) [0|3] "" FLRdpHPA,FLRdpHPB
 SG_ FLR2RdrDetn265To269Quality1 : 126|2@1+ (1,0) [0|3] "" FLRdpHPA,FLRdpHPB
 SG_ FLR2RdrDetn265To269Quality2 : 190|2@1+ (1,0) [0|3] "" FLRdpHPA,FLRdpHPB
 SG_ FLR2RdrDetn265To269Quality3 : 254|2@1+ (1,0) [0|3] "" FLRdpHPA,FLRdpHPB
 SG_ FLR2RdrDetn265To269Quality4 : 318|2@1+ (1,0) [0|3] "" FLRdpHPA,FLRdpHPB
 SG_ FLR2RdrDetn265To269Range0 : 48|12@1+ (0.1,0.4) [0.4|300.0] "m" FLRdpHPA,FLRdpHPB
 SG_ FLR2RdrDetn265To269Range1 : 112|12@1+ (0.1,0.4) [0.4|300.0] "m" FLRdpHPA,FLRdpHPB
 SG_ FLR2RdrDetn265To269Range2 : 176|12@1+ (0.1,0.4) [0.4|300.0] "m" FLRdpHPA,FLRdpHPB
 SG_ FLR2RdrDetn265To269Range3 : 240|12@1+ (0.1,0.4) [0.4|300.0] "m" FLRdpHPA,FLRdpHPB
 SG_ FLR2RdrDetn265To269Range4 : 304|12@1+ (0.1,0.4) [0.4|300.0] "m" FLRdpHPA,FLRdpHPB
 SG_ FLR2RdrDetn265To269RCS0 : 83|10@1+ (0.2,-100.0) [-100.0|70.0] "dBsm" FLRdpHPA,FLRdpHPB
 SG_ FLR2RdrDetn265To269RCS1 : 147|10@1+ (0.2,-100.0) [-100.0|70.0] "dBsm" FLRdpHPA,FLRdpHPB
 SG_ FLR2RdrDetn265To269RCS2 : 211|10@1+ (0.2,-100.0) [-100.0|70.0] "dBsm" FLRdpHPA,FLRdpHPB
 SG_ FLR2RdrDetn265To269RCS3 : 275|10@1+ (0.2,-100.0) [-100.0|70.0] "dBsm" FLRdpHPA,FLRdpHPB
 SG_ FLR2RdrDetn265To269RCS4 : 339|10@1+ (0.2,-100.0) [-100.0|70.0] "dBsm" FLRdpHPA,FLRdpHPB
 SG_ FLR2RdrDetn265To269RngRt0 : 72|11@1+ (0.1,-111.11) [-111.11|55.59000000000002] "m/s" FLRdpHPA,FLRdpHPB
 SG_ FLR2RdrDetn265To269RngRt1 : 136|11@1+ (0.1,-111.11) [-111.11|55.59000000000002] "m/s" FLRdpHPA,FLRdpHPB
 SG_ FLR2RdrDetn265To269RngRt2 : 200|11@1+ (0.1,-111.11) [-111.11|55.59000000000002] "m/s" FLRdpHPA,FLRdpHPB
 SG_ FLR2RdrDetn265To269RngRt3 : 264|11@1+ (0.1,-111.11) [-111.11|55.59000000000002] "m/s" FLRdpHPA,FLRdpHPB
 SG_ FLR2RdrDetn265To269RngRt4 : 328|11@1+ (0.1,-111.11) [-111.11|55.59000000000002] "m/s" FLRdpHPA,FLRdpHPB
 SG_ FLR2RdrDetn265To269ScanID : 24|8@1+ (1.0,0.0) [0.0|255.0] "Unitless" FLRdpHPA,FLRdpHPB
 SG_ FLR2RdrDetn265To269SNR0 : 41|7@1+ (0.5,0.0) [0.0|63.5] "dB" FLRdpHPA,FLRdpHPB
 SG_ FLR2RdrDetn265To269SNR1 : 105|7@1+ (0.5,0.0) [0.0|63.5] "dB" FLRdpHPA,FLRdpHPB
 SG_ FLR2RdrDetn265To269SNR2 : 169|7@1+ (0.5,0.0) [0.0|63.5] "dB" FLRdpHPA,FLRdpHPB
 SG_ FLR2RdrDetn265To269SNR3 : 233|7@1+ (0.5,0.0) [0.0|63.5] "dB" FLRdpHPA,FLRdpHPB
 SG_ FLR2RdrDetn265To269SNR4 : 297|7@1+ (0.5,0.0) [0.0|63.5] "dB" FLRdpHPA,FLRdpHPB

CM_ SG_ 211 FLR2RdrDetn200To204AziAng0 "Azimuth Angle";
CM_ SG_ 211 FLR2RdrDetn200To204AziAng1 "Azimuth Angle";
CM_ SG_ 211 FLR2RdrDetn200To204AziAng2 "Azimuth Angle";
CM_ SG_ 211 FLR2RdrDetn200To204AziAng3 "Azimuth Angle";
CM_ SG_ 211 FLR2RdrDetn200To204AziAng4 "Azimuth Angle";
CM_ SG_ 211 FLR2RdrDetn200To204DynPrpty0 "Moving/Stationary";
CM_ SG_ 211 FLR2RdrDetn200To204DynPrpty1 "Moving/Stationary";
CM_ SG_ 211 FLR2RdrDetn200To204DynPrpty2 "Moving/Stationary";
CM_ SG_ 211 FLR2RdrDetn200To204DynPrpty3 "Moving/Stationary";
CM_ SG_ 211 FLR2RdrDetn200To204DynPrpty4 "Moving/Stationary";
CM_ SG_ 211 FLR2RdrDetn200To204EleAng0 "Elevation angle";
CM_ SG_ 211 FLR2RdrDetn200To204EleAng1 "Elevation angle";
CM_ SG_ 211 FLR2RdrDetn200To204EleAng2 "Elevation angle";
CM_ SG_ 211 FLR2RdrDetn200To204EleAng3 "Elevation angle";
CM_ SG_ 211 FLR2RdrDetn200To204EleAng4 "Elevation angle";
CM_ SG_ 211 FLR2RdrDetn200To204Mode0 "What chirp mode the detection is from";
CM_ SG_ 211 FLR2RdrDetn200To204Mode1 "What chirp mode the detection is from";
CM_ SG_ 211 FLR2RdrDetn200To204Mode2 "What chirp mode the detection is from";
CM_ SG_ 211 FLR2RdrDetn200To204Mode3 "What chirp mode the detection is from";
CM_ SG_ 211 FLR2RdrDetn200To204Mode4 "What chirp mode the detection is from";
CM_ SG_ 211 FLR2RdrDetn200To204Quality0 "Quality";
CM_ SG_ 211 FLR2RdrDetn200To204Quality1 "Quality";
CM_ SG_ 211 FLR2RdrDetn200To204Quality2 "Quality";
CM_ SG_ 211 FLR2RdrDetn200To204Quality3 "Quality";
CM_ SG_ 211 FLR2RdrDetn200To204Quality4 "Quality";
CM_ SG_ 211 FLR2RdrDetn200To204Range0 "Range from sensor to object";
CM_ SG_ 211 FLR2RdrDetn200To204Range1 "Range from sensor to object";
CM_ SG_ 211 FLR2RdrDetn200To204Range2 "Range from sensor to object";
CM_ SG_ 211 FLR2RdrDetn200To204Range3 "Range from sensor to object";
CM_ SG_ 211 FLR2RdrDetn200To204Range4 "Range from sensor to object";
CM_ SG_ 211 FLR2RdrDetn200To204RCS0 "RCS";
CM_ SG_ 211 FLR2RdrDetn200To204RCS1 "RCS";
CM_ SG_ 211 FLR2RdrDetn200To204RCS2 "RCS";
CM_ SG_ 211 FLR2RdrDetn200To204RCS3 "RCS";
CM_ SG_ 211 FLR2RdrDetn200To204RCS4 "RCS";
CM_ SG_ 211 FLR2RdrDetn200To204RngRt0 "Speed towards/away from the sensor";
CM_ SG_ 211 FLR2RdrDetn200To204RngRt1 "Speed towards/away from the sensor";
CM_ SG_ 211 FLR2RdrDetn200To204RngRt2 "Speed towards/away from the sensor";
CM_ SG_ 211 FLR2RdrDetn200To204RngRt3 "Speed towards/away from the sensor";
CM_ SG_ 211 FLR2RdrDetn200To204RngRt4 "Speed towards/away from the sensor";
CM_ SG_ 211 FLR2RdrDetn200To204ScanID "Value to tie status, detection data and object data frames together";
CM_ SG_ 211 FLR2RdrDetn200To204SNR0 "Signal to Noise Ratio";
CM_ SG_ 211 FLR2RdrDetn200To204SNR1 "Signal to Noise Ration";
CM_ SG_ 211 FLR2RdrDetn200To204SNR2 "Signal to Noise Ration";
CM_ SG_ 211 FLR2RdrDetn200To204SNR3 "Signal to Noise Ration";
CM_ SG_ 211 FLR2RdrDetn200To204SNR4 "Signal to Noise Ration";
CM_ SG_ 214 FLR2RdrDetn205To209AziAng0 "Azimuth Angle";
CM_ SG_ 214 FLR2RdrDetn205To209AziAng1 "Azimuth Angle";
CM_ SG_ 214 FLR2RdrDetn205To209AziAng2 "Azimuth Angle";
CM_ SG_ 214 FLR2RdrDetn205To209AziAng3 "Azimuth Angle";
CM_ SG_ 214 FLR2RdrDetn205To209AziAng4 "Azimuth Angle";
CM_ SG_ 214 FLR2RdrDetn205To209DynPrpty0 "Moving/Stationary";
CM_ SG_ 214 FLR2RdrDetn205To209DynPrpty1 "Moving/Stationary";
CM_ SG_ 214 FLR2RdrDetn205To209DynPrpty2 "Moving/Stationary";
CM_ SG_ 214 FLR2RdrDetn205To209DynPrpty3 "Moving/Stationary";
CM_ SG_ 214 FLR2RdrDetn205To209DynPrpty4 "Moving/Stationary";
CM_ SG_ 214 FLR2RdrDetn205To209EleAng0 "Elevation angle";
CM_ SG_ 214 FLR2RdrDetn205To209EleAng1 "Elevation angle";
CM_ SG_ 214 FLR2RdrDetn205To209EleAng2 "Elevation angle";
CM_ SG_ 214 FLR2RdrDetn205To209EleAng3 "Elevation angle";
CM_ SG_ 214 FLR2RdrDetn205To209EleAng4 "Elevation angle";
CM_ SG_ 214 FLR2RdrDetn205To209Mode0 "What chirp mode the detection is from";
CM_ SG_ 214 FLR2RdrDetn205To209Mode1 "What chirp mode the detection is from";
CM_ SG_ 214 FLR2RdrDetn205To209Mode2 "What chirp mode the detection is from";
CM_ SG_ 214 FLR2RdrDetn205To209Mode3 "What chirp mode the detection is from";
CM_ SG_ 214 FLR2RdrDetn205To209Mode4 "What chirp mode the detection is from";
CM_ SG_ 214 FLR2RdrDetn205To209Quality0 "Quality";
CM_ SG_ 214 FLR2RdrDetn205To209Quality1 "Quality";
CM_ SG_ 214 FLR2RdrDetn205To209Quality2 "Quality";
CM_ SG_ 214 FLR2RdrDetn205To209Quality3 "Quality";
CM_ SG_ 214 FLR2RdrDetn205To209Quality4 "Quality";
CM_ SG_ 214 FLR2RdrDetn205To209Range0 "Range from sensor to object";
CM_ SG_ 214 FLR2RdrDetn205To209Range1 "Range from sensor to object";
CM_ SG_ 214 FLR2RdrDetn205To209Range2 "Range from sensor to object";
CM_ SG_ 214 FLR2RdrDetn205To209Range3 "Range from sensor to object";
CM_ SG_ 214 FLR2RdrDetn205To209Range4 "Range from sensor to object";
CM_ SG_ 214 FLR2RdrDetn205To209RCS0 "RCS";
CM_ SG_ 214 FLR2RdrDetn205To209RCS1 "RCS";
CM_ SG_ 214 FLR2RdrDetn205To209RCS2 "RCS";
CM_ SG_ 214 FLR2RdrDetn205To209RCS3 "RCS";
CM_ SG_ 214 FLR2RdrDetn205To209RCS4 "RCS";
CM_ SG_ 214 FLR2RdrDetn205To209RngRt0 "Speed towards/away from the sensor";
CM_ SG_ 214 FLR2RdrDetn205To209RngRt1 "Speed towards/away from the sensor";
CM_ SG_ 214 FLR2RdrDetn205To209RngRt2 "Speed towards/away from the sensor";
CM_ SG_ 214 FLR2RdrDetn205To209RngRt3 "Speed towards/away from the sensor";
CM_ SG_ 214 FLR2RdrDetn205To209RngRt4 "Speed towards/away from the sensor";
CM_ SG_ 214 FLR2RdrDetn205To209ScanID "Value to tie status, detection data and object data frames together";
CM_ SG_ 214 FLR2RdrDetn205To209SNR0 "Signal to Noise Ratio";
CM_ SG_ 214 FLR2RdrDetn205To209SNR1 "Signal to Noise Ration";
CM_ SG_ 214 FLR2RdrDetn205To209SNR2 "Signal to Noise Ration";
CM_ SG_ 214 FLR2RdrDetn205To209SNR3 "Signal to Noise Ration";
CM_ SG_ 214 FLR2RdrDetn205To209SNR4 "Signal to Noise Ration";
CM_ SG_ 217 FLR2RdrDetn210To214AziAng0 "Azimuth Angle";
CM_ SG_ 217 FLR2RdrDetn210To214AziAng1 "Azimuth Angle";
CM_ SG_ 217 FLR2RdrDetn210To214AziAng2 "Azimuth Angle";
CM_ SG_ 217 FLR2RdrDetn210To214AziAng3 "Azimuth Angle";
CM_ SG_ 217 FLR2RdrDetn210To214AziAng4 "Azimuth Angle";
CM_ SG_ 217 FLR2RdrDetn210To214DynPrpty0 "Moving/Stationary";
CM_ SG_ 217 FLR2RdrDetn210To214DynPrpty1 "Moving/Stationary";
CM_ SG_ 217 FLR2RdrDetn210To214DynPrpty2 "Moving/Stationary";
CM_ SG_ 217 FLR2RdrDetn210To214DynPrpty3 "Moving/Stationary";
CM_ SG_ 217 FLR2RdrDetn210To214DynPrpty4 "Moving/Stationary";
CM_ SG_ 217 FLR2RdrDetn210To214EleAng0 "Elevation angle";
CM_ SG_ 217 FLR2RdrDetn210To214EleAng1 "Elevation angle";
CM_ SG_ 217 FLR2RdrDetn210To214EleAng2 "Elevation angle";
CM_ SG_ 217 FLR2RdrDetn210To214EleAng3 "Elevation angle";
CM_ SG_ 217 FLR2RdrDetn210To214EleAng4 "Elevation angle";
CM_ SG_ 217 FLR2RdrDetn210To214Mode0 "What chirp mode the detection is from";
CM_ SG_ 217 FLR2RdrDetn210To214Mode1 "What chirp mode the detection is from";
CM_ SG_ 217 FLR2RdrDetn210To214Mode2 "What chirp mode the detection is from";
CM_ SG_ 217 FLR2RdrDetn210To214Mode3 "What chirp mode the detection is from";
CM_ SG_ 217 FLR2RdrDetn210To214Mode4 "What chirp mode the detection is from";
CM_ SG_ 217 FLR2RdrDetn210To214Quality0 "Quality";
CM_ SG_ 217 FLR2RdrDetn210To214Quality1 "Quality";
CM_ SG_ 217 FLR2RdrDetn210To214Quality2 "Quality";
CM_ SG_ 217 FLR2RdrDetn210To214Quality3 "Quality";
CM_ SG_ 217 FLR2RdrDetn210To214Quality4 "Quality";
CM_ SG_ 217 FLR2RdrDetn210To214Range0 "Range from sensor to object";
CM_ SG_ 217 FLR2RdrDetn210To214Range1 "Range from sensor to object";
CM_ SG_ 217 FLR2RdrDetn210To214Range2 "Range from sensor to object";
CM_ SG_ 217 FLR2RdrDetn210To214Range3 "Range from sensor to object";
CM_ SG_ 217 FLR2RdrDetn210To214Range4 "Range from sensor to object";
CM_ SG_ 217 FLR2RdrDetn210To214RCS0 "RCS";
CM_ SG_ 217 FLR2RdrDetn210To214RCS1 "RCS";
CM_ SG_ 217 FLR2RdrDetn210To214RCS2 "RCS";
CM_ SG_ 217 FLR2RdrDetn210To214RCS3 "RCS";
CM_ SG_ 217 FLR2RdrDetn210To214RCS4 "RCS";
CM_ SG_ 217 FLR2RdrDetn210To214RngRt0 "Speed towards/away from the sensor";
CM_ SG_ 217 FLR2RdrDetn210To214RngRt1 "Speed towards/away from the sensor";
CM_ SG_ 217 FLR2RdrDetn210To214RngRt2 "Speed towards/away from the sensor";
CM_ SG_ 217 FLR2RdrDetn210To214RngRt3 "Speed towards/away from the sensor";
CM_ SG_ 217 FLR2RdrDetn210To214RngRt4 "Speed towards/away from the sensor";
CM_ SG_ 217 FLR2RdrDetn210To214ScanID "Value to tie status, detection data and object data frames together";
CM_ SG_ 217 FLR2RdrDetn210To214SNR0 "Signal to Noise Ratio";
CM_ SG_ 217 FLR2RdrDetn210To214SNR1 "Signal to Noise Ration";
CM_ SG_ 217 FLR2RdrDetn210To214SNR2 "Signal to Noise Ration";
CM_ SG_ 217 FLR2RdrDetn210To214SNR3 "Signal to Noise Ration";
CM_ SG_ 217 FLR2RdrDetn210To214SNR4 "Signal to Noise Ration";
CM_ SG_ 220 FLR2RdrDetn215To219AziAng0 "Azimuth Angle";
CM_ SG_ 220 FLR2RdrDetn215To219AziAng1 "Azimuth Angle";
CM_ SG_ 220 FLR2RdrDetn215To219AziAng2 "Azimuth Angle";
CM_ SG_ 220 FLR2RdrDetn215To219AziAng3 "Azimuth Angle";
CM_ SG_ 220 FLR2RdrDetn215To219AziAng4 "Azimuth Angle";
CM_ SG_ 220 FLR2RdrDetn215To219DynPrpty0 "Moving/Stationary";
CM_ SG_ 220 FLR2RdrDetn215To219DynPrpty1 "Moving/Stationary";
CM_ SG_ 220 FLR2RdrDetn215To219DynPrpty2 "Moving/Stationary";
CM_ SG_ 220 FLR2RdrDetn215To219DynPrpty3 "Moving/Stationary";
CM_ SG_ 220 FLR2RdrDetn215To219DynPrpty4 "Moving/Stationary";
CM_ SG_ 220 FLR2RdrDetn215To219EleAng0 "Elevation angle";
CM_ SG_ 220 FLR2RdrDetn215To219EleAng1 "Elevation angle";
CM_ SG_ 220 FLR2RdrDetn215To219EleAng2 "Elevation angle";
CM_ SG_ 220 FLR2RdrDetn215To219EleAng3 "Elevation angle";
CM_ SG_ 220 FLR2RdrDetn215To219EleAng4 "Elevation angle";
CM_ SG_ 220 FLR2RdrDetn215To219Mode0 "What chirp mode the detection is from";
CM_ SG_ 220 FLR2RdrDetn215To219Mode1 "What chirp mode the detection is from";
CM_ SG_ 220 FLR2RdrDetn215To219Mode2 "What chirp mode the detection is from";
CM_ SG_ 220 FLR2RdrDetn215To219Mode3 "What chirp mode the detection is from";
CM_ SG_ 220 FLR2RdrDetn215To219Mode4 "What chirp mode the detection is from";
CM_ SG_ 220 FLR2RdrDetn215To219Quality0 "Quality";
CM_ SG_ 220 FLR2RdrDetn215To219Quality1 "Quality";
CM_ SG_ 220 FLR2RdrDetn215To219Quality2 "Quality";
CM_ SG_ 220 FLR2RdrDetn215To219Quality3 "Quality";
CM_ SG_ 220 FLR2RdrDetn215To219Quality4 "Quality";
CM_ SG_ 220 FLR2RdrDetn215To219Range0 "Range from sensor to object";
CM_ SG_ 220 FLR2RdrDetn215To219Range1 "Range from sensor to object";
CM_ SG_ 220 FLR2RdrDetn215To219Range2 "Range from sensor to object";
CM_ SG_ 220 FLR2RdrDetn215To219Range3 "Range from sensor to object";
CM_ SG_ 220 FLR2RdrDetn215To219Range4 "Range from sensor to object";
CM_ SG_ 220 FLR2RdrDetn215To219RCS0 "RCS";
CM_ SG_ 220 FLR2RdrDetn215To219RCS1 "RCS";
CM_ SG_ 220 FLR2RdrDetn215To219RCS2 "RCS";
CM_ SG_ 220 FLR2RdrDetn215To219RCS3 "RCS";
CM_ SG_ 220 FLR2RdrDetn215To219RCS4 "RCS";
CM_ SG_ 220 FLR2RdrDetn215To219RngRt0 "Speed towards/away from the sensor";
CM_ SG_ 220 FLR2RdrDetn215To219RngRt1 "Speed towards/away from the sensor";
CM_ SG_ 220 FLR2RdrDetn215To219RngRt2 "Speed towards/away from the sensor";
CM_ SG_ 220 FLR2RdrDetn215To219RngRt3 "Speed towards/away from the sensor";
CM_ SG_ 220 FLR2RdrDetn215To219RngRt4 "Speed towards/away from the sensor";
CM_ SG_ 220 FLR2RdrDetn215To219ScanID "Value to tie status, detection data and object data frames together";
CM_ SG_ 220 FLR2RdrDetn215To219SNR0 "Signal to Noise Ratio";
CM_ SG_ 220 FLR2RdrDetn215To219SNR1 "Signal to Noise Ration";
CM_ SG_ 220 FLR2RdrDetn215To219SNR2 "Signal to Noise Ration";
CM_ SG_ 220 FLR2RdrDetn215To219SNR3 "Signal to Noise Ration";
CM_ SG_ 220 FLR2RdrDetn215To219SNR4 "Signal to Noise Ration";
CM_ SG_ 224 FLR2RdrDetn220To224AziAng0 "Azimuth Angle";
CM_ SG_ 224 FLR2RdrDetn220To224AziAng1 "Azimuth Angle";
CM_ SG_ 224 FLR2RdrDetn220To224AziAng2 "Azimuth Angle";
CM_ SG_ 224 FLR2RdrDetn220To224AziAng3 "Azimuth Angle";
CM_ SG_ 224 FLR2RdrDetn220To224AziAng4 "Azimuth Angle";
CM_ SG_ 224 FLR2RdrDetn220To224DynPrpty0 "Moving/Stationary";
CM_ SG_ 224 FLR2RdrDetn220To224DynPrpty1 "Moving/Stationary";
CM_ SG_ 224 FLR2RdrDetn220To224DynPrpty2 "Moving/Stationary";
CM_ SG_ 224 FLR2RdrDetn220To224DynPrpty3 "Moving/Stationary";
CM_ SG_ 224 FLR2RdrDetn220To224DynPrpty4 "Moving/Stationary";
CM_ SG_ 224 FLR2RdrDetn220To224EleAng0 "Elevation angle";
CM_ SG_ 224 FLR2RdrDetn220To224EleAng1 "Elevation angle";
CM_ SG_ 224 FLR2RdrDetn220To224EleAng2 "Elevation angle";
CM_ SG_ 224 FLR2RdrDetn220To224EleAng3 "Elevation angle";
CM_ SG_ 224 FLR2RdrDetn220To224EleAng4 "Elevation angle";
CM_ SG_ 224 FLR2RdrDetn220To224Mode0 "What chirp mode the detection is from";
CM_ SG_ 224 FLR2RdrDetn220To224Mode1 "What chirp mode the detection is from";
CM_ SG_ 224 FLR2RdrDetn220To224Mode2 "What chirp mode the detection is from";
CM_ SG_ 224 FLR2RdrDetn220To224Mode3 "What chirp mode the detection is from";
CM_ SG_ 224 FLR2RdrDetn220To224Mode4 "What chirp mode the detection is from";
CM_ SG_ 224 FLR2RdrDetn220To224Quality0 "Quality";
CM_ SG_ 224 FLR2RdrDetn220To224Quality1 "Quality";
CM_ SG_ 224 FLR2RdrDetn220To224Quality2 "Quality";
CM_ SG_ 224 FLR2RdrDetn220To224Quality3 "Quality";
CM_ SG_ 224 FLR2RdrDetn220To224Quality4 "Quality";
CM_ SG_ 224 FLR2RdrDetn220To224Range0 "Range from sensor to object";
CM_ SG_ 224 FLR2RdrDetn220To224Range1 "Range from sensor to object";
CM_ SG_ 224 FLR2RdrDetn220To224Range2 "Range from sensor to object";
CM_ SG_ 224 FLR2RdrDetn220To224Range3 "Range from sensor to object";
CM_ SG_ 224 FLR2RdrDetn220To224Range4 "Range from sensor to object";
CM_ SG_ 224 FLR2RdrDetn220To224RCS0 "RCS";
CM_ SG_ 224 FLR2RdrDetn220To224RCS1 "RCS";
CM_ SG_ 224 FLR2RdrDetn220To224RCS2 "RCS";
CM_ SG_ 224 FLR2RdrDetn220To224RCS3 "RCS";
CM_ SG_ 224 FLR2RdrDetn220To224RCS4 "RCS";
CM_ SG_ 224 FLR2RdrDetn220To224RngRt0 "Speed towards/away from the sensor";
CM_ SG_ 224 FLR2RdrDetn220To224RngRt1 "Speed towards/away from the sensor";
CM_ SG_ 224 FLR2RdrDetn220To224RngRt2 "Speed towards/away from the sensor";
CM_ SG_ 224 FLR2RdrDetn220To224RngRt3 "Speed towards/away from the sensor";
CM_ SG_ 224 FLR2RdrDetn220To224RngRt4 "Speed towards/away from the sensor";
CM_ SG_ 224 FLR2RdrDetn220To224ScanID "Value to tie status, detection data and object data frames together";
CM_ SG_ 224 FLR2RdrDetn220To224SNR0 "Signal to Noise Ratio";
CM_ SG_ 224 FLR2RdrDetn220To224SNR1 "Signal to Noise Ration";
CM_ SG_ 224 FLR2RdrDetn220To224SNR2 "Signal to Noise Ration";
CM_ SG_ 224 FLR2RdrDetn220To224SNR3 "Signal to Noise Ration";
CM_ SG_ 224 FLR2RdrDetn220To224SNR4 "Signal to Noise Ration";
CM_ SG_ 227 FLR2RdrDetn225To229AziAng0 "Azimuth Angle";
CM_ SG_ 227 FLR2RdrDetn225To229AziAng1 "Azimuth Angle";
CM_ SG_ 227 FLR2RdrDetn225To229AziAng2 "Azimuth Angle";
CM_ SG_ 227 FLR2RdrDetn225To229AziAng3 "Azimuth Angle";
CM_ SG_ 227 FLR2RdrDetn225To229AziAng4 "Azimuth Angle";
CM_ SG_ 227 FLR2RdrDetn225To229DynPrpty0 "Moving/Stationary";
CM_ SG_ 227 FLR2RdrDetn225To229DynPrpty1 "Moving/Stationary";
CM_ SG_ 227 FLR2RdrDetn225To229DynPrpty2 "Moving/Stationary";
CM_ SG_ 227 FLR2RdrDetn225To229DynPrpty3 "Moving/Stationary";
CM_ SG_ 227 FLR2RdrDetn225To229DynPrpty4 "Moving/Stationary";
CM_ SG_ 227 FLR2RdrDetn225To229EleAng0 "Elevation angle";
CM_ SG_ 227 FLR2RdrDetn225To229EleAng1 "Elevation angle";
CM_ SG_ 227 FLR2RdrDetn225To229EleAng2 "Elevation angle";
CM_ SG_ 227 FLR2RdrDetn225To229EleAng3 "Elevation angle";
CM_ SG_ 227 FLR2RdrDetn225To229EleAng4 "Elevation angle";
CM_ SG_ 227 FLR2RdrDetn225To229Mode0 "What chirp mode the detection is from";
CM_ SG_ 227 FLR2RdrDetn225To229Mode1 "What chirp mode the detection is from";
CM_ SG_ 227 FLR2RdrDetn225To229Mode2 "What chirp mode the detection is from";
CM_ SG_ 227 FLR2RdrDetn225To229Mode3 "What chirp mode the detection is from";
CM_ SG_ 227 FLR2RdrDetn225To229Mode4 "What chirp mode the detection is from";
CM_ SG_ 227 FLR2RdrDetn225To229Quality0 "Quality";
CM_ SG_ 227 FLR2RdrDetn225To229Quality1 "Quality";
CM_ SG_ 227 FLR2RdrDetn225To229Quality2 "Quality";
CM_ SG_ 227 FLR2RdrDetn225To229Quality3 "Quality";
CM_ SG_ 227 FLR2RdrDetn225To229Quality4 "Quality";
CM_ SG_ 227 FLR2RdrDetn225To229Range0 "Range from sensor to object";
CM_ SG_ 227 FLR2RdrDetn225To229Range1 "Range from sensor to object";
CM_ SG_ 227 FLR2RdrDetn225To229Range2 "Range from sensor to object";
CM_ SG_ 227 FLR2RdrDetn225To229Range3 "Range from sensor to object";
CM_ SG_ 227 FLR2RdrDetn225To229Range4 "Range from sensor to object";
CM_ SG_ 227 FLR2RdrDetn225To229RCS0 "RCS";
CM_ SG_ 227 FLR2RdrDetn225To229RCS1 "RCS";
CM_ SG_ 227 FLR2RdrDetn225To229RCS2 "RCS";
CM_ SG_ 227 FLR2RdrDetn225To229RCS3 "RCS";
CM_ SG_ 227 FLR2RdrDetn225To229RCS4 "RCS";
CM_ SG_ 227 FLR2RdrDetn225To229RngRt0 "Speed towards/away from the sensor";
CM_ SG_ 227 FLR2RdrDetn225To229RngRt1 "Speed towards/away from the sensor";
CM_ SG_ 227 FLR2RdrDetn225To229RngRt2 "Speed towards/away from the sensor";
CM_ SG_ 227 FLR2RdrDetn225To229RngRt3 "Speed towards/away from the sensor";
CM_ SG_ 227 FLR2RdrDetn225To229RngRt4 "Speed towards/away from the sensor";
CM_ SG_ 227 FLR2RdrDetn225To229ScanID "Value to tie status, detection data and object data frames together";
CM_ SG_ 227 FLR2RdrDetn225To229SNR0 "Signal to Noise Ratio";
CM_ SG_ 227 FLR2RdrDetn225To229SNR1 "Signal to Noise Ration";
CM_ SG_ 227 FLR2RdrDetn225To229SNR2 "Signal to Noise Ration";
CM_ SG_ 227 FLR2RdrDetn225To229SNR3 "Signal to Noise Ration";
CM_ SG_ 227 FLR2RdrDetn225To229SNR4 "Signal to Noise Ration";
CM_ SG_ 230 FLR2RdrDetn230To234AziAng0 "Azimuth Angle";
CM_ SG_ 230 FLR2RdrDetn230To234AziAng1 "Azimuth Angle";
CM_ SG_ 230 FLR2RdrDetn230To234AziAng2 "Azimuth Angle";
CM_ SG_ 230 FLR2RdrDetn230To234AziAng3 "Azimuth Angle";
CM_ SG_ 230 FLR2RdrDetn230To234AziAng4 "Azimuth Angle";
CM_ SG_ 230 FLR2RdrDetn230To234DynPrpty0 "Moving/Stationary";
CM_ SG_ 230 FLR2RdrDetn230To234DynPrpty1 "Moving/Stationary";
CM_ SG_ 230 FLR2RdrDetn230To234DynPrpty2 "Moving/Stationary";
CM_ SG_ 230 FLR2RdrDetn230To234DynPrpty3 "Moving/Stationary";
CM_ SG_ 230 FLR2RdrDetn230To234DynPrpty4 "Moving/Stationary";
CM_ SG_ 230 FLR2RdrDetn230To234EleAng0 "Elevation angle";
CM_ SG_ 230 FLR2RdrDetn230To234EleAng1 "Elevation angle";
CM_ SG_ 230 FLR2RdrDetn230To234EleAng2 "Elevation angle";
CM_ SG_ 230 FLR2RdrDetn230To234EleAng3 "Elevation angle";
CM_ SG_ 230 FLR2RdrDetn230To234EleAng4 "Elevation angle";
CM_ SG_ 230 FLR2RdrDetn230To234Mode0 "What chirp mode the detection is from";
CM_ SG_ 230 FLR2RdrDetn230To234Mode1 "What chirp mode the detection is from";
CM_ SG_ 230 FLR2RdrDetn230To234Mode2 "What chirp mode the detection is from";
CM_ SG_ 230 FLR2RdrDetn230To234Mode3 "What chirp mode the detection is from";
CM_ SG_ 230 FLR2RdrDetn230To234Mode4 "What chirp mode the detection is from";
CM_ SG_ 230 FLR2RdrDetn230To234Quality0 "Quality";
CM_ SG_ 230 FLR2RdrDetn230To234Quality1 "Quality";
CM_ SG_ 230 FLR2RdrDetn230To234Quality2 "Quality";
CM_ SG_ 230 FLR2RdrDetn230To234Quality3 "Quality";
CM_ SG_ 230 FLR2RdrDetn230To234Quality4 "Quality";
CM_ SG_ 230 FLR2RdrDetn230To234Range0 "Range from sensor to object";
CM_ SG_ 230 FLR2RdrDetn230To234Range1 "Range from sensor to object";
CM_ SG_ 230 FLR2RdrDetn230To234Range2 "Range from sensor to object";
CM_ SG_ 230 FLR2RdrDetn230To234Range3 "Range from sensor to object";
CM_ SG_ 230 FLR2RdrDetn230To234Range4 "Range from sensor to object";
CM_ SG_ 230 FLR2RdrDetn230To234RCS0 "RCS";
CM_ SG_ 230 FLR2RdrDetn230To234RCS1 "RCS";
CM_ SG_ 230 FLR2RdrDetn230To234RCS2 "RCS";
CM_ SG_ 230 FLR2RdrDetn230To234RCS3 "RCS";
CM_ SG_ 230 FLR2RdrDetn230To234RCS4 "RCS";
CM_ SG_ 230 FLR2RdrDetn230To234RngRt0 "Speed towards/away from the sensor";
CM_ SG_ 230 FLR2RdrDetn230To234RngRt1 "Speed towards/away from the sensor";
CM_ SG_ 230 FLR2RdrDetn230To234RngRt2 "Speed towards/away from the sensor";
CM_ SG_ 230 FLR2RdrDetn230To234RngRt3 "Speed towards/away from the sensor";
CM_ SG_ 230 FLR2RdrDetn230To234RngRt4 "Speed towards/away from the sensor";
CM_ SG_ 230 FLR2RdrDetn230To234ScanID "Value to tie status, detection data and object data frames together";
CM_ SG_ 230 FLR2RdrDetn230To234SNR0 "Signal to Noise Ratio";
CM_ SG_ 230 FLR2RdrDetn230To234SNR1 "Signal to Noise Ration";
CM_ SG_ 230 FLR2RdrDetn230To234SNR2 "Signal to Noise Ration";
CM_ SG_ 230 FLR2RdrDetn230To234SNR3 "Signal to Noise Ration";
CM_ SG_ 230 FLR2RdrDetn230To234SNR4 "Signal to Noise Ration";
CM_ SG_ 233 FLR2RdrDetn235To239AziAng0 "Azimuth Angle";
CM_ SG_ 233 FLR2RdrDetn235To239AziAng1 "Azimuth Angle";
CM_ SG_ 233 FLR2RdrDetn235To239AziAng2 "Azimuth Angle";
CM_ SG_ 233 FLR2RdrDetn235To239AziAng3 "Azimuth Angle";
CM_ SG_ 233 FLR2RdrDetn235To239AziAng4 "Azimuth Angle";
CM_ SG_ 233 FLR2RdrDetn235To239DynPrpty0 "Moving/Stationary";
CM_ SG_ 233 FLR2RdrDetn235To239DynPrpty1 "Moving/Stationary";
CM_ SG_ 233 FLR2RdrDetn235To239DynPrpty2 "Moving/Stationary";
CM_ SG_ 233 FLR2RdrDetn235To239DynPrpty3 "Moving/Stationary";
CM_ SG_ 233 FLR2RdrDetn235To239DynPrpty4 "Moving/Stationary";
CM_ SG_ 233 FLR2RdrDetn235To239EleAng0 "Elevation angle";
CM_ SG_ 233 FLR2RdrDetn235To239EleAng1 "Elevation angle";
CM_ SG_ 233 FLR2RdrDetn235To239EleAng2 "Elevation angle";
CM_ SG_ 233 FLR2RdrDetn235To239EleAng3 "Elevation angle";
CM_ SG_ 233 FLR2RdrDetn235To239EleAng4 "Elevation angle";
CM_ SG_ 233 FLR2RdrDetn235To239Mode0 "What chirp mode the detection is from";
CM_ SG_ 233 FLR2RdrDetn235To239Mode1 "What chirp mode the detection is from";
CM_ SG_ 233 FLR2RdrDetn235To239Mode2 "What chirp mode the detection is from";
CM_ SG_ 233 FLR2RdrDetn235To239Mode3 "What chirp mode the detection is from";
CM_ SG_ 233 FLR2RdrDetn235To239Mode4 "What chirp mode the detection is from";
CM_ SG_ 233 FLR2RdrDetn235To239Quality0 "Quality";
CM_ SG_ 233 FLR2RdrDetn235To239Quality1 "Quality";
CM_ SG_ 233 FLR2RdrDetn235To239Quality2 "Quality";
CM_ SG_ 233 FLR2RdrDetn235To239Quality3 "Quality";
CM_ SG_ 233 FLR2RdrDetn235To239Quality4 "Quality";
CM_ SG_ 233 FLR2RdrDetn235To239Range0 "Range from sensor to object";
CM_ SG_ 233 FLR2RdrDetn235To239Range1 "Range from sensor to object";
CM_ SG_ 233 FLR2RdrDetn235To239Range2 "Range from sensor to object";
CM_ SG_ 233 FLR2RdrDetn235To239Range3 "Range from sensor to object";
CM_ SG_ 233 FLR2RdrDetn235To239Range4 "Range from sensor to object";
CM_ SG_ 233 FLR2RdrDetn235To239RCS0 "RCS";
CM_ SG_ 233 FLR2RdrDetn235To239RCS1 "RCS";
CM_ SG_ 233 FLR2RdrDetn235To239RCS2 "RCS";
CM_ SG_ 233 FLR2RdrDetn235To239RCS3 "RCS";
CM_ SG_ 233 FLR2RdrDetn235To239RCS4 "RCS";
CM_ SG_ 233 FLR2RdrDetn235To239RngRt0 "Speed towards/away from the sensor";
CM_ SG_ 233 FLR2RdrDetn235To239RngRt1 "Speed towards/away from the sensor";
CM_ SG_ 233 FLR2RdrDetn235To239RngRt2 "Speed towards/away from the sensor";
CM_ SG_ 233 FLR2RdrDetn235To239RngRt3 "Speed towards/away from the sensor";
CM_ SG_ 233 FLR2RdrDetn235To239RngRt4 "Speed towards/away from the sensor";
CM_ SG_ 233 FLR2RdrDetn235To239ScanID "Value to tie status, detection data and object data frames together";
CM_ SG_ 233 FLR2RdrDetn235To239SNR0 "Signal to Noise Ratio";
CM_ SG_ 233 FLR2RdrDetn235To239SNR1 "Signal to Noise Ration";
CM_ SG_ 233 FLR2RdrDetn235To239SNR2 "Signal to Noise Ration";
CM_ SG_ 233 FLR2RdrDetn235To239SNR3 "Signal to Noise Ration";
CM_ SG_ 233 FLR2RdrDetn235To239SNR4 "Signal to Noise Ration";
CM_ SG_ 236 FLR2RdrDetn240To244AziAng0 "Azimuth Angle";
CM_ SG_ 236 FLR2RdrDetn240To244AziAng1 "Azimuth Angle";
CM_ SG_ 236 FLR2RdrDetn240To244AziAng2 "Azimuth Angle";
CM_ SG_ 236 FLR2RdrDetn240To244AziAng3 "Azimuth Angle";
CM_ SG_ 236 FLR2RdrDetn240To244AziAng4 "Azimuth Angle";
CM_ SG_ 236 FLR2RdrDetn240To244DynPrpty0 "Moving/Stationary";
CM_ SG_ 236 FLR2RdrDetn240To244DynPrpty1 "Moving/Stationary";
CM_ SG_ 236 FLR2RdrDetn240To244DynPrpty2 "Moving/Stationary";
CM_ SG_ 236 FLR2RdrDetn240To244DynPrpty3 "Moving/Stationary";
CM_ SG_ 236 FLR2RdrDetn240To244DynPrpty4 "Moving/Stationary";
CM_ SG_ 236 FLR2RdrDetn240To244EleAng0 "Elevation angle";
CM_ SG_ 236 FLR2RdrDetn240To244EleAng1 "Elevation angle";
CM_ SG_ 236 FLR2RdrDetn240To244EleAng2 "Elevation angle";
CM_ SG_ 236 FLR2RdrDetn240To244EleAng3 "Elevation angle";
CM_ SG_ 236 FLR2RdrDetn240To244EleAng4 "Elevation angle";
CM_ SG_ 236 FLR2RdrDetn240To244Mode0 "What chirp mode the detection is from";
CM_ SG_ 236 FLR2RdrDetn240To244Mode1 "What chirp mode the detection is from";
CM_ SG_ 236 FLR2RdrDetn240To244Mode2 "What chirp mode the detection is from";
CM_ SG_ 236 FLR2RdrDetn240To244Mode3 "What chirp mode the detection is from";
CM_ SG_ 236 FLR2RdrDetn240To244Mode4 "What chirp mode the detection is from";
CM_ SG_ 236 FLR2RdrDetn240To244Quality0 "Quality";
CM_ SG_ 236 FLR2RdrDetn240To244Quality1 "Quality";
CM_ SG_ 236 FLR2RdrDetn240To244Quality2 "Quality";
CM_ SG_ 236 FLR2RdrDetn240To244Quality3 "Quality";
CM_ SG_ 236 FLR2RdrDetn240To244Quality4 "Quality";
CM_ SG_ 236 FLR2RdrDetn240To244Range0 "Range from sensor to object";
CM_ SG_ 236 FLR2RdrDetn240To244Range1 "Range from sensor to object";
CM_ SG_ 236 FLR2RdrDetn240To244Range2 "Range from sensor to object";
CM_ SG_ 236 FLR2RdrDetn240To244Range3 "Range from sensor to object";
CM_ SG_ 236 FLR2RdrDetn240To244Range4 "Range from sensor to object";
CM_ SG_ 236 FLR2RdrDetn240To244RCS0 "RCS";
CM_ SG_ 236 FLR2RdrDetn240To244RCS1 "RCS";
CM_ SG_ 236 FLR2RdrDetn240To244RCS2 "RCS";
CM_ SG_ 236 FLR2RdrDetn240To244RCS3 "RCS";
CM_ SG_ 236 FLR2RdrDetn240To244RCS4 "RCS";
CM_ SG_ 236 FLR2RdrDetn240To244RngRt0 "Speed towards/away from the sensor";
CM_ SG_ 236 FLR2RdrDetn240To244RngRt1 "Speed towards/away from the sensor";
CM_ SG_ 236 FLR2RdrDetn240To244RngRt2 "Speed towards/away from the sensor";
CM_ SG_ 236 FLR2RdrDetn240To244RngRt3 "Speed towards/away from the sensor";
CM_ SG_ 236 FLR2RdrDetn240To244RngRt4 "Speed towards/away from the sensor";
CM_ SG_ 236 FLR2RdrDetn240To244ScanID "Value to tie status, detection data and object data frames together";
CM_ SG_ 236 FLR2RdrDetn240To244SNR0 "Signal to Noise Ratio";
CM_ SG_ 236 FLR2RdrDetn240To244SNR1 "Signal to Noise Ration";
CM_ SG_ 236 FLR2RdrDetn240To244SNR2 "Signal to Noise Ration";
CM_ SG_ 236 FLR2RdrDetn240To244SNR3 "Signal to Noise Ration";
CM_ SG_ 236 FLR2RdrDetn240To244SNR4 "Signal to Noise Ration";
CM_ SG_ 240 FLR2RdrDetn245To249AziAng0 "Azimuth Angle";
CM_ SG_ 240 FLR2RdrDetn245To249AziAng1 "Azimuth Angle";
CM_ SG_ 240 FLR2RdrDetn245To249AziAng2 "Azimuth Angle";
CM_ SG_ 240 FLR2RdrDetn245To249AziAng3 "Azimuth Angle";
CM_ SG_ 240 FLR2RdrDetn245To249AziAng4 "Azimuth Angle";
CM_ SG_ 240 FLR2RdrDetn245To249DynPrpty0 "Moving/Stationary";
CM_ SG_ 240 FLR2RdrDetn245To249DynPrpty1 "Moving/Stationary";
CM_ SG_ 240 FLR2RdrDetn245To249DynPrpty2 "Moving/Stationary";
CM_ SG_ 240 FLR2RdrDetn245To249DynPrpty3 "Moving/Stationary";
CM_ SG_ 240 FLR2RdrDetn245To249DynPrpty4 "Moving/Stationary";
CM_ SG_ 240 FLR2RdrDetn245To249EleAng0 "Elevation angle";
CM_ SG_ 240 FLR2RdrDetn245To249EleAng1 "Elevation angle";
CM_ SG_ 240 FLR2RdrDetn245To249EleAng2 "Elevation angle";
CM_ SG_ 240 FLR2RdrDetn245To249EleAng3 "Elevation angle";
CM_ SG_ 240 FLR2RdrDetn245To249EleAng4 "Elevation angle";
CM_ SG_ 240 FLR2RdrDetn245To249Mode0 "What chirp mode the detection is from";
CM_ SG_ 240 FLR2RdrDetn245To249Mode1 "What chirp mode the detection is from";
CM_ SG_ 240 FLR2RdrDetn245To249Mode2 "What chirp mode the detection is from";
CM_ SG_ 240 FLR2RdrDetn245To249Mode3 "What chirp mode the detection is from";
CM_ SG_ 240 FLR2RdrDetn245To249Mode4 "What chirp mode the detection is from";
CM_ SG_ 240 FLR2RdrDetn245To249Quality0 "Quality";
CM_ SG_ 240 FLR2RdrDetn245To249Quality1 "Quality";
CM_ SG_ 240 FLR2RdrDetn245To249Quality2 "Quality";
CM_ SG_ 240 FLR2RdrDetn245To249Quality3 "Quality";
CM_ SG_ 240 FLR2RdrDetn245To249Quality4 "Quality";
CM_ SG_ 240 FLR2RdrDetn245To249Range0 "Range from sensor to object";
CM_ SG_ 240 FLR2RdrDetn245To249Range1 "Range from sensor to object";
CM_ SG_ 240 FLR2RdrDetn245To249Range2 "Range from sensor to object";
CM_ SG_ 240 FLR2RdrDetn245To249Range3 "Range from sensor to object";
CM_ SG_ 240 FLR2RdrDetn245To249Range4 "Range from sensor to object";
CM_ SG_ 240 FLR2RdrDetn245To249RCS0 "RCS";
CM_ SG_ 240 FLR2RdrDetn245To249RCS1 "RCS";
CM_ SG_ 240 FLR2RdrDetn245To249RCS2 "RCS";
CM_ SG_ 240 FLR2RdrDetn245To249RCS3 "RCS";
CM_ SG_ 240 FLR2RdrDetn245To249RCS4 "RCS";
CM_ SG_ 240 FLR2RdrDetn245To249RngRt0 "Speed towards/away from the sensor";
CM_ SG_ 240 FLR2RdrDetn245To249RngRt1 "Speed towards/away from the sensor";
CM_ SG_ 240 FLR2RdrDetn245To249RngRt2 "Speed towards/away from the sensor";
CM_ SG_ 240 FLR2RdrDetn245To249RngRt3 "Speed towards/away from the sensor";
CM_ SG_ 240 FLR2RdrDetn245To249RngRt4 "Speed towards/away from the sensor";
CM_ SG_ 240 FLR2RdrDetn245To249ScanID "Value to tie status, detection data and object data frames together";
CM_ SG_ 240 FLR2RdrDetn245To249SNR0 "Signal to Noise Ratio";
CM_ SG_ 240 FLR2RdrDetn245To249SNR1 "Signal to Noise Ration";
CM_ SG_ 240 FLR2RdrDetn245To249SNR2 "Signal to Noise Ration";
CM_ SG_ 240 FLR2RdrDetn245To249SNR3 "Signal to Noise Ration";
CM_ SG_ 240 FLR2RdrDetn245To249SNR4 "Signal to Noise Ration";
CM_ SG_ 242 FLR2RdrDetn250To254AziAng0 "Azimuth Angle";
CM_ SG_ 242 FLR2RdrDetn250To254AziAng1 "Azimuth Angle";
CM_ SG_ 242 FLR2RdrDetn250To254AziAng2 "Azimuth Angle";
CM_ SG_ 242 FLR2RdrDetn250To254AziAng3 "Azimuth Angle";
CM_ SG_ 242 FLR2RdrDetn250To254AziAng4 "Azimuth Angle";
CM_ SG_ 242 FLR2RdrDetn250To254DynPrpty0 "Moving/Stationary";
CM_ SG_ 242 FLR2RdrDetn250To254DynPrpty1 "Moving/Stationary";
CM_ SG_ 242 FLR2RdrDetn250To254DynPrpty2 "Moving/Stationary";
CM_ SG_ 242 FLR2RdrDetn250To254DynPrpty3 "Moving/Stationary";
CM_ SG_ 242 FLR2RdrDetn250To254DynPrpty4 "Moving/Stationary";
CM_ SG_ 242 FLR2RdrDetn250To254EleAng0 "Elevation angle";
CM_ SG_ 242 FLR2RdrDetn250To254EleAng1 "Elevation angle";
CM_ SG_ 242 FLR2RdrDetn250To254EleAng2 "Elevation angle";
CM_ SG_ 242 FLR2RdrDetn250To254EleAng3 "Elevation angle";
CM_ SG_ 242 FLR2RdrDetn250To254EleAng4 "Elevation angle";
CM_ SG_ 242 FLR2RdrDetn250To254Mode0 "What chirp mode the detection is from";
CM_ SG_ 242 FLR2RdrDetn250To254Mode1 "What chirp mode the detection is from";
CM_ SG_ 242 FLR2RdrDetn250To254Mode2 "What chirp mode the detection is from";
CM_ SG_ 242 FLR2RdrDetn250To254Mode3 "What chirp mode the detection is from";
CM_ SG_ 242 FLR2RdrDetn250To254Mode4 "What chirp mode the detection is from";
CM_ SG_ 242 FLR2RdrDetn250To254Quality0 "Quality";
CM_ SG_ 242 FLR2RdrDetn250To254Quality1 "Quality";
CM_ SG_ 242 FLR2RdrDetn250To254Quality2 "Quality";
CM_ SG_ 242 FLR2RdrDetn250To254Quality3 "Quality";
CM_ SG_ 242 FLR2RdrDetn250To254Quality4 "Quality";
CM_ SG_ 242 FLR2RdrDetn250To254Range0 "Range from sensor to object";
CM_ SG_ 242 FLR2RdrDetn250To254Range1 "Range from sensor to object";
CM_ SG_ 242 FLR2RdrDetn250To254Range2 "Range from sensor to object";
CM_ SG_ 242 FLR2RdrDetn250To254Range3 "Range from sensor to object";
CM_ SG_ 242 FLR2RdrDetn250To254Range4 "Range from sensor to object";
CM_ SG_ 242 FLR2RdrDetn250To254RCS0 "RCS";
CM_ SG_ 242 FLR2RdrDetn250To254RCS1 "RCS";
CM_ SG_ 242 FLR2RdrDetn250To254RCS2 "RCS";
CM_ SG_ 242 FLR2RdrDetn250To254RCS3 "RCS";
CM_ SG_ 242 FLR2RdrDetn250To254RCS4 "RCS";
CM_ SG_ 242 FLR2RdrDetn250To254RngRt0 "Speed towards/away from the sensor";
CM_ SG_ 242 FLR2RdrDetn250To254RngRt1 "Speed towards/away from the sensor";
CM_ SG_ 242 FLR2RdrDetn250To254RngRt2 "Speed towards/away from the sensor";
CM_ SG_ 242 FLR2RdrDetn250To254RngRt3 "Speed towards/away from the sensor";
CM_ SG_ 242 FLR2RdrDetn250To254RngRt4 "Speed towards/away from the sensor";
CM_ SG_ 242 FLR2RdrDetn250To254ScanID "Value to tie status, detection data and object data frames together";
CM_ SG_ 242 FLR2RdrDetn250To254SNR0 "Signal to Noise Ratio";
CM_ SG_ 242 FLR2RdrDetn250To254SNR1 "Signal to Noise Ration";
CM_ SG_ 242 FLR2RdrDetn250To254SNR2 "Signal to Noise Ration";
CM_ SG_ 242 FLR2RdrDetn250To254SNR3 "Signal to Noise Ration";
CM_ SG_ 242 FLR2RdrDetn250To254SNR4 "Signal to Noise Ration";
CM_ SG_ 244 FLR2RdrDetn255To259AziAng0 "Azimuth Angle";
CM_ SG_ 244 FLR2RdrDetn255To259AziAng1 "Azimuth Angle";
CM_ SG_ 244 FLR2RdrDetn255To259AziAng2 "Azimuth Angle";
CM_ SG_ 244 FLR2RdrDetn255To259AziAng3 "Azimuth Angle";
CM_ SG_ 244 FLR2RdrDetn255To259AziAng4 "Azimuth Angle";
CM_ SG_ 244 FLR2RdrDetn255To259DynPrpty0 "Moving/Stationary";
CM_ SG_ 244 FLR2RdrDetn255To259DynPrpty1 "Moving/Stationary";
CM_ SG_ 244 FLR2RdrDetn255To259DynPrpty2 "Moving/Stationary";
CM_ SG_ 244 FLR2RdrDetn255To259DynPrpty3 "Moving/Stationary";
CM_ SG_ 244 FLR2RdrDetn255To259DynPrpty4 "Moving/Stationary";
CM_ SG_ 244 FLR2RdrDetn255To259EleAng0 "Elevation angle";
CM_ SG_ 244 FLR2RdrDetn255To259EleAng1 "Elevation angle";
CM_ SG_ 244 FLR2RdrDetn255To259EleAng2 "Elevation angle";
CM_ SG_ 244 FLR2RdrDetn255To259EleAng3 "Elevation angle";
CM_ SG_ 244 FLR2RdrDetn255To259EleAng4 "Elevation angle";
CM_ SG_ 244 FLR2RdrDetn255To259Mode0 "What chirp mode the detection is from";
CM_ SG_ 244 FLR2RdrDetn255To259Mode1 "What chirp mode the detection is from";
CM_ SG_ 244 FLR2RdrDetn255To259Mode2 "What chirp mode the detection is from";
CM_ SG_ 244 FLR2RdrDetn255To259Mode3 "What chirp mode the detection is from";
CM_ SG_ 244 FLR2RdrDetn255To259Mode4 "What chirp mode the detection is from";
CM_ SG_ 244 FLR2RdrDetn255To259Quality0 "Quality";
CM_ SG_ 244 FLR2RdrDetn255To259Quality1 "Quality";
CM_ SG_ 244 FLR2RdrDetn255To259Quality2 "Quality";
CM_ SG_ 244 FLR2RdrDetn255To259Quality3 "Quality";
CM_ SG_ 244 FLR2RdrDetn255To259Quality4 "Quality";
CM_ SG_ 244 FLR2RdrDetn255To259Range0 "Range from sensor to object";
CM_ SG_ 244 FLR2RdrDetn255To259Range1 "Range from sensor to object";
CM_ SG_ 244 FLR2RdrDetn255To259Range2 "Range from sensor to object";
CM_ SG_ 244 FLR2RdrDetn255To259Range3 "Range from sensor to object";
CM_ SG_ 244 FLR2RdrDetn255To259Range4 "Range from sensor to object";
CM_ SG_ 244 FLR2RdrDetn255To259RCS0 "RCS";
CM_ SG_ 244 FLR2RdrDetn255To259RCS1 "RCS";
CM_ SG_ 244 FLR2RdrDetn255To259RCS2 "RCS";
CM_ SG_ 244 FLR2RdrDetn255To259RCS3 "RCS";
CM_ SG_ 244 FLR2RdrDetn255To259RCS4 "RCS";
CM_ SG_ 244 FLR2RdrDetn255To259RngRt0 "Speed towards/away from the sensor";
CM_ SG_ 244 FLR2RdrDetn255To259RngRt1 "Speed towards/away from the sensor";
CM_ SG_ 244 FLR2RdrDetn255To259RngRt2 "Speed towards/away from the sensor";
CM_ SG_ 244 FLR2RdrDetn255To259RngRt3 "Speed towards/away from the sensor";
CM_ SG_ 244 FLR2RdrDetn255To259RngRt4 "Speed towards/away from the sensor";
CM_ SG_ 244 FLR2RdrDetn255To259ScanID "Value to tie status, detection data and object data frames together";
CM_ SG_ 244 FLR2RdrDetn255To259SNR0 "Signal to Noise Ratio";
CM_ SG_ 244 FLR2RdrDetn255To259SNR1 "Signal to Noise Ration";
CM_ SG_ 244 FLR2RdrDetn255To259SNR2 "Signal to Noise Ration";
CM_ SG_ 244 FLR2RdrDetn255To259SNR3 "Signal to Noise Ration";
CM_ SG_ 244 FLR2RdrDetn255To259SNR4 "Signal to Noise Ration";
CM_ SG_ 246 FLR2RdrDetn260To264AziAng0 "Azimuth Angle";
CM_ SG_ 246 FLR2RdrDetn260To264AziAng1 "Azimuth Angle";
CM_ SG_ 246 FLR2RdrDetn260To264AziAng2 "Azimuth Angle";
CM_ SG_ 246 FLR2RdrDetn260To264AziAng3 "Azimuth Angle";
CM_ SG_ 246 FLR2RdrDetn260To264AziAng4 "Azimuth Angle";
CM_ SG_ 246 FLR2RdrDetn260To264DynPrpty0 "Moving/Stationary";
CM_ SG_ 246 FLR2RdrDetn260To264DynPrpty1 "Moving/Stationary";
CM_ SG_ 246 FLR2RdrDetn260To264DynPrpty2 "Moving/Stationary";
CM_ SG_ 246 FLR2RdrDetn260To264DynPrpty3 "Moving/Stationary";
CM_ SG_ 246 FLR2RdrDetn260To264DynPrpty4 "Moving/Stationary";
CM_ SG_ 246 FLR2RdrDetn260To264EleAng0 "Elevation angle";
CM_ SG_ 246 FLR2RdrDetn260To264EleAng1 "Elevation angle";
CM_ SG_ 246 FLR2RdrDetn260To264EleAng2 "Elevation angle";
CM_ SG_ 246 FLR2RdrDetn260To264EleAng3 "Elevation angle";
CM_ SG_ 246 FLR2RdrDetn260To264EleAng4 "Elevation angle";
CM_ SG_ 246 FLR2RdrDetn260To264Mode0 "What chirp mode the detection is from";
CM_ SG_ 246 FLR2RdrDetn260To264Mode1 "What chirp mode the detection is from";
CM_ SG_ 246 FLR2RdrDetn260To264Mode2 "What chirp mode the detection is from";
CM_ SG_ 246 FLR2RdrDetn260To264Mode3 "What chirp mode the detection is from";
CM_ SG_ 246 FLR2RdrDetn260To264Mode4 "What chirp mode the detection is from";
CM_ SG_ 246 FLR2RdrDetn260To264Quality0 "Quality";
CM_ SG_ 246 FLR2RdrDetn260To264Quality1 "Quality";
CM_ SG_ 246 FLR2RdrDetn260To264Quality2 "Quality";
CM_ SG_ 246 FLR2RdrDetn260To264Quality3 "Quality";
CM_ SG_ 246 FLR2RdrDetn260To264Quality4 "Quality";
CM_ SG_ 246 FLR2RdrDetn260To264Range0 "Range from sensor to object";
CM_ SG_ 246 FLR2RdrDetn260To264Range1 "Range from sensor to object";
CM_ SG_ 246 FLR2RdrDetn260To264Range2 "Range from sensor to object";
CM_ SG_ 246 FLR2RdrDetn260To264Range3 "Range from sensor to object";
CM_ SG_ 246 FLR2RdrDetn260To264Range4 "Range from sensor to object";
CM_ SG_ 246 FLR2RdrDetn260To264RCS0 "RCS";
CM_ SG_ 246 FLR2RdrDetn260To264RCS1 "RCS";
CM_ SG_ 246 FLR2RdrDetn260To264RCS2 "RCS";
CM_ SG_ 246 FLR2RdrDetn260To264RCS3 "RCS";
CM_ SG_ 246 FLR2RdrDetn260To264RCS4 "RCS";
CM_ SG_ 246 FLR2RdrDetn260To264RngRt0 "Speed towards/away from the sensor";
CM_ SG_ 246 FLR2RdrDetn260To264RngRt1 "Speed towards/away from the sensor";
CM_ SG_ 246 FLR2RdrDetn260To264RngRt2 "Speed towards/away from the sensor";
CM_ SG_ 246 FLR2RdrDetn260To264RngRt3 "Speed towards/away from the sensor";
CM_ SG_ 246 FLR2RdrDetn260To264RngRt4 "Speed towards/away from the sensor";
CM_ SG_ 246 FLR2RdrDetn260To264ScanID "Value to tie status, detection data and object data frames together";
CM_ SG_ 246 FLR2RdrDetn260To264SNR0 "Signal to Noise Ratio";
CM_ SG_ 246 FLR2RdrDetn260To264SNR1 "Signal to Noise Ration";
CM_ SG_ 246 FLR2RdrDetn260To264SNR2 "Signal to Noise Ration";
CM_ SG_ 246 FLR2RdrDetn260To264SNR3 "Signal to Noise Ration";
CM_ SG_ 246 FLR2RdrDetn260To264SNR4 "Signal to Noise Ration";
CM_ SG_ 248 FLR2RdrDetn265To269AziAng0 "Azimuth Angle";
CM_ SG_ 248 FLR2RdrDetn265To269AziAng1 "Azimuth Angle";
CM_ SG_ 248 FLR2RdrDetn265To269AziAng2 "Azimuth Angle";
CM_ SG_ 248 FLR2RdrDetn265To269AziAng3 "Azimuth Angle";
CM_ SG_ 248 FLR2RdrDetn265To269AziAng4 "Azimuth Angle";
CM_ SG_ 248 FLR2RdrDetn265To269DynPrpty0 "Moving/Stationary";
CM_ SG_ 248 FLR2RdrDetn265To269DynPrpty1 "Moving/Stationary";
CM_ SG_ 248 FLR2RdrDetn265To269DynPrpty2 "Moving/Stationary";
CM_ SG_ 248 FLR2RdrDetn265To269DynPrpty3 "Moving/Stationary";
CM_ SG_ 248 FLR2RdrDetn265To269DynPrpty4 "Moving/Stationary";
CM_ SG_ 248 FLR2RdrDetn265To269EleAng0 "Elevation angle";
CM_ SG_ 248 FLR2RdrDetn265To269EleAng1 "Elevation angle";
CM_ SG_ 248 FLR2RdrDetn265To269EleAng2 "Elevation angle";
CM_ SG_ 248 FLR2RdrDetn265To269EleAng3 "Elevation angle";
CM_ SG_ 248 FLR2RdrDetn265To269EleAng4 "Elevation angle";
CM_ SG_ 248 FLR2RdrDetn265To269Mode0 "What chirp mode the detection is from";
CM_ SG_ 248 FLR2RdrDetn265To269Mode1 "What chirp mode the detection is from";
CM_ SG_ 248 FLR2RdrDetn265To269Mode2 "What chirp mode the detection is from";
CM_ SG_ 248 FLR2RdrDetn265To269Mode3 "What chirp mode the detection is from";
CM_ SG_ 248 FLR2RdrDetn265To269Mode4 "What chirp mode the detection is from";
CM_ SG_ 248 FLR2RdrDetn265To269Quality0 "Quality";
CM_ SG_ 248 FLR2RdrDetn265To269Quality1 "Quality";
CM_ SG_ 248 FLR2RdrDetn265To269Quality2 "Quality";
CM_ SG_ 248 FLR2RdrDetn265To269Quality3 "Quality";
CM_ SG_ 248 FLR2RdrDetn265To269Quality4 "Quality";
CM_ SG_ 248 FLR2RdrDetn265To269Range0 "Range from sensor to object";
CM_ SG_ 248 FLR2RdrDetn265To269Range1 "Range from sensor to object";
CM_ SG_ 248 FLR2RdrDetn265To269Range2 "Range from sensor to object";
CM_ SG_ 248 FLR2RdrDetn265To269Range3 "Range from sensor to object";
CM_ SG_ 248 FLR2RdrDetn265To269Range4 "Range from sensor to object";
CM_ SG_ 248 FLR2RdrDetn265To269RCS0 "RCS";
CM_ SG_ 248 FLR2RdrDetn265To269RCS1 "RCS";
CM_ SG_ 248 FLR2RdrDetn265To269RCS2 "RCS";
CM_ SG_ 248 FLR2RdrDetn265To269RCS3 "RCS";
CM_ SG_ 248 FLR2RdrDetn265To269RCS4 "RCS";
CM_ SG_ 248 FLR2RdrDetn265To269RngRt0 "Speed towards/away from the sensor";
CM_ SG_ 248 FLR2RdrDetn265To269RngRt1 "Speed towards/away from the sensor";
CM_ SG_ 248 FLR2RdrDetn265To269RngRt2 "Speed towards/away from the sensor";
CM_ SG_ 248 FLR2RdrDetn265To269RngRt3 "Speed towards/away from the sensor";
CM_ SG_ 248 FLR2RdrDetn265To269RngRt4 "Speed towards/away from the sensor";
CM_ SG_ 248 FLR2RdrDetn265To269ScanID "Value to tie status, detection data and object data frames together";
CM_ SG_ 248 FLR2RdrDetn265To269SNR0 "Signal to Noise Ratio";
CM_ SG_ 248 FLR2RdrDetn265To269SNR1 "Signal to Noise Ration";
CM_ SG_ 248 FLR2RdrDetn265To269SNR2 "Signal to Noise Ration";
CM_ SG_ 248 FLR2RdrDetn265To269SNR3 "Signal to Noise Ration";
CM_ SG_ 248 FLR2RdrDetn265To269SNR4 "Signal to Noise Ration";
BA_DEF_ BO_ "CANFD_BRS" ENUM "0","1";
BA_DEF_ BO_ "GenMsgCycleTime" INT 0 65536; // [ms]
BA_DEF_ BO_ "GenMsgDelayTime" INT 0 65536; // [ms]
BA_DEF_ BO_ "GenMsgSendType" ENUM "cyclic", "spontaneous", "not-used", "not-used", "not-used", "cyclicAndSpontaneous", "not-used", "cyclicIfActive", "NoMsgSendType"; // [us]
BA_DEF_ BO_ "GenMsgStartDelayTime" INT 0 65536; // [ms]
BA_DEF_ BO_ "VFrameFormat" ENUM "StandardCAN","ExtendedCAN","reserved","J1939PG","reserved","reserved","reserved","reserved","reserved","reserved","reserved","reserved","reserved","reserved","StandardCAN_FD","ExtendedCAN_FD";
BA_DEF_ SG_ "GenSigSendType" ENUM "Cyclic","OnWrite","OnWriteWithRepetition","OnChange","OnChangeWithRepetition","IfActive","IfActiveWithRepetition","NoSigSendType";
BA_DEF_ SG_ "GenSigStartValue" HEX 0 80000000;
BA_DEF_ BO_ "GenMsgILSupport" ENUM "No","Yes";
BA_DEF_ BO_ "NmAsrMessage" ENUM "No","Yes";
BA_DEF_ SG_ "GenSigFuncType" ENUM "NoFunction","n/a","n/a","n/a","n/a","n/a","n/a","n/a","n/a","n/a","n/a","n/a","n/a","n/a","n/a","CHK","CNTR","n/a","n/a","n/a","CNTR_AR_01","CRC_AR_01_BOTH","CRC_AR_01_ALT","CRC_AR_01_LOW","CRC_AR_01_NIBBLE","CNTR_AR_04","CRC_AR_04A","CNTR_AR_05","CRC_AR_05";
BA_DEF_ SG_ "GenSigDataID" STRING;
BA_DEF_DEF_ "CANFD_BRS" "1";
BA_DEF_DEF_ "GenSigStartValue" 0;
BA_DEF_DEF_ "VFrameFormat" "J1939PG";
BA_DEF_DEF_ "GenSigSendType" "NoSigSendType";
BA_DEF_DEF_ "GenMsgCycleTime" 0;
BA_DEF_DEF_ "GenMsgDelayTime" 0;
BA_DEF_DEF_ "GenMsgStartDelayTime" 0;
BA_DEF_DEF_ "GenMsgSendType" "NoMsgSendType";
BA_DEF_DEF_ "GenMsgILSupport" "Yes";
BA_DEF_DEF_ "NmAsrMessage" "No";
BA_DEF_DEF_ "GenSigFuncType" "NoFunction";
BA_DEF_DEF_ "GenSigDataID" "";
// Frame: FlrFlr1canFr41
BA_ "GenMsgDelayTime" BO_ 211 40.000;
BA_ "GenMsgSendType" BO_ 211 1;
BA_ "VFrameFormat" BO_ 211 14;
// Frame: FlrFlr1canFr42
BA_ "GenMsgDelayTime" BO_ 214 40.000;
BA_ "GenMsgSendType" BO_ 214 1;
BA_ "VFrameFormat" BO_ 214 14;
// Frame: FlrFlr1canFr43
BA_ "GenMsgDelayTime" BO_ 217 40.000;
BA_ "GenMsgSendType" BO_ 217 1;
BA_ "VFrameFormat" BO_ 217 14;
// Frame: FlrFlr1canFr44
BA_ "GenMsgDelayTime" BO_ 220 40.000;
BA_ "GenMsgSendType" BO_ 220 1;
BA_ "VFrameFormat" BO_ 220 14;
// Frame: FlrFlr1canFr45
BA_ "GenMsgDelayTime" BO_ 224 40.000;
BA_ "GenMsgSendType" BO_ 224 1;
BA_ "VFrameFormat" BO_ 224 14;
// Frame: FlrFlr1canFr46
BA_ "GenMsgDelayTime" BO_ 227 40.000;
BA_ "GenMsgSendType" BO_ 227 1;
BA_ "VFrameFormat" BO_ 227 14;
// Frame: FlrFlr1canFr47
BA_ "GenMsgDelayTime" BO_ 230 40.000;
BA_ "GenMsgSendType" BO_ 230 1;
BA_ "VFrameFormat" BO_ 230 14;
// Frame: FlrFlr1canFr48
BA_ "GenMsgDelayTime" BO_ 233 40.000;
BA_ "GenMsgSendType" BO_ 233 1;
BA_ "VFrameFormat" BO_ 233 14;
// Frame: FlrFlr1canFr49
BA_ "GenMsgDelayTime" BO_ 236 40.000;
BA_ "GenMsgSendType" BO_ 236 1;
BA_ "VFrameFormat" BO_ 236 14;
// Frame: FlrFlr1canFr50
BA_ "GenMsgDelayTime" BO_ 240 40.000;
BA_ "GenMsgSendType" BO_ 240 1;
BA_ "VFrameFormat" BO_ 240 14;
// Frame: FlrFlr1canFr51
BA_ "GenMsgDelayTime" BO_ 242 40.000;
BA_ "GenMsgSendType" BO_ 242 1;
BA_ "VFrameFormat" BO_ 242 14;
// Frame: FlrFlr1canFr52
BA_ "GenMsgDelayTime" BO_ 244 40.000;
BA_ "GenMsgSendType" BO_ 244 1;
BA_ "VFrameFormat" BO_ 244 14;
// Frame: FlrFlr1canFr53
BA_ "GenMsgDelayTime" BO_ 246 40.000;
BA_ "GenMsgSendType" BO_ 246 1;
BA_ "VFrameFormat" BO_ 246 14;
// Frame: FlrFlr1canFr54
BA_ "GenMsgDelayTime" BO_ 248 40.000;
BA_ "GenMsgSendType" BO_ 248 1;
BA_ "VFrameFormat" BO_ 248 14;
BA_ "GenSigSendType" SG_ 211 FLR2RdrDetn200To204AziAng0 1;
BA_ "GenSigSendType" SG_ 211 FLR2RdrDetn200To204AziAng1 1;
BA_ "GenSigSendType" SG_ 211 FLR2RdrDetn200To204AziAng2 1;
BA_ "GenSigSendType" SG_ 211 FLR2RdrDetn200To204AziAng3 1;
BA_ "GenSigSendType" SG_ 211 FLR2RdrDetn200To204AziAng4 1;
BA_ "GenSigDataID" SG_ 211 FLR2RdrDetn200To204CRC "0xAE1";
BA_ "GenSigFuncType" SG_ 211 FLR2RdrDetn200To204CRC 28;
BA_ "GenSigSendType" SG_ 211 FLR2RdrDetn200To204CRC 1;
BA_ "GenSigFuncType" SG_ 211 FLR2RdrDetn200To204Counter 27;
BA_ "GenSigSendType" SG_ 211 FLR2RdrDetn200To204Counter 1;
BA_ "GenSigSendType" SG_ 211 FLR2RdrDetn200To204DynPrpty0 1;
BA_ "GenSigSendType" SG_ 211 FLR2RdrDetn200To204DynPrpty1 1;
BA_ "GenSigSendType" SG_ 211 FLR2RdrDetn200To204DynPrpty2 1;
BA_ "GenSigSendType" SG_ 211 FLR2RdrDetn200To204DynPrpty3 1;
BA_ "GenSigSendType" SG_ 211 FLR2RdrDetn200To204DynPrpty4 1;
BA_ "GenSigSendType" SG_ 211 FLR2RdrDetn200To204EleAng0 1;
BA_ "GenSigSendType" SG_ 211 FLR2RdrDetn200To204EleAng1 1;
BA_ "GenSigSendType" SG_ 211 FLR2RdrDetn200To204EleAng2 1;
BA_ "GenSigSendType" SG_ 211 FLR2RdrDetn200To204EleAng3 1;
BA_ "GenSigSendType" SG_ 211 FLR2RdrDetn200To204EleAng4 1;
BA_ "GenSigSendType" SG_ 211 FLR2RdrDetn200To204Mode0 1;
BA_ "GenSigSendType" SG_ 211 FLR2RdrDetn200To204Mode1 1;
BA_ "GenSigSendType" SG_ 211 FLR2RdrDetn200To204Mode2 1;
BA_ "GenSigSendType" SG_ 211 FLR2RdrDetn200To204Mode3 1;
BA_ "GenSigSendType" SG_ 211 FLR2RdrDetn200To204Mode4 1;
BA_ "GenSigSendType" SG_ 211 FLR2RdrDetn200To204Quality0 1;
BA_ "GenSigSendType" SG_ 211 FLR2RdrDetn200To204Quality1 1;
BA_ "GenSigSendType" SG_ 211 FLR2RdrDetn200To204Quality2 1;
BA_ "GenSigSendType" SG_ 211 FLR2RdrDetn200To204Quality3 1;
BA_ "GenSigSendType" SG_ 211 FLR2RdrDetn200To204Quality4 1;
BA_ "GenSigSendType" SG_ 211 FLR2RdrDetn200To204RCS0 1;
BA_ "GenSigStartValue" SG_ 211 FLR2RdrDetn200To204RCS0 500;
BA_ "GenSigSendType" SG_ 211 FLR2RdrDetn200To204RCS1 1;
BA_ "GenSigStartValue" SG_ 211 FLR2RdrDetn200To204RCS1 500;
BA_ "GenSigSendType" SG_ 211 FLR2RdrDetn200To204RCS2 1;
BA_ "GenSigStartValue" SG_ 211 FLR2RdrDetn200To204RCS2 500;
BA_ "GenSigSendType" SG_ 211 FLR2RdrDetn200To204RCS3 1;
BA_ "GenSigStartValue" SG_ 211 FLR2RdrDetn200To204RCS3 500;
BA_ "GenSigSendType" SG_ 211 FLR2RdrDetn200To204RCS4 1;
BA_ "GenSigStartValue" SG_ 211 FLR2RdrDetn200To204RCS4 500;
BA_ "GenSigSendType" SG_ 211 FLR2RdrDetn200To204Range0 1;
BA_ "GenSigSendType" SG_ 211 FLR2RdrDetn200To204Range1 1;
BA_ "GenSigSendType" SG_ 211 FLR2RdrDetn200To204Range2 1;
BA_ "GenSigSendType" SG_ 211 FLR2RdrDetn200To204Range3 1;
BA_ "GenSigSendType" SG_ 211 FLR2RdrDetn200To204Range4 1;
BA_ "GenSigSendType" SG_ 211 FLR2RdrDetn200To204RngRt0 1;
BA_ "GenSigStartValue" SG_ 211 FLR2RdrDetn200To204RngRt0 1111;
BA_ "GenSigSendType" SG_ 211 FLR2RdrDetn200To204RngRt1 1;
BA_ "GenSigStartValue" SG_ 211 FLR2RdrDetn200To204RngRt1 1111;
BA_ "GenSigSendType" SG_ 211 FLR2RdrDetn200To204RngRt2 1;
BA_ "GenSigStartValue" SG_ 211 FLR2RdrDetn200To204RngRt2 1111;
BA_ "GenSigSendType" SG_ 211 FLR2RdrDetn200To204RngRt3 1;
BA_ "GenSigStartValue" SG_ 211 FLR2RdrDetn200To204RngRt3 1111;
BA_ "GenSigSendType" SG_ 211 FLR2RdrDetn200To204RngRt4 1;
BA_ "GenSigStartValue" SG_ 211 FLR2RdrDetn200To204RngRt4 1111;
BA_ "GenSigSendType" SG_ 211 FLR2RdrDetn200To204SNR0 1;
BA_ "GenSigSendType" SG_ 211 FLR2RdrDetn200To204SNR1 1;
BA_ "GenSigSendType" SG_ 211 FLR2RdrDetn200To204SNR2 1;
BA_ "GenSigSendType" SG_ 211 FLR2RdrDetn200To204SNR3 1;
BA_ "GenSigSendType" SG_ 211 FLR2RdrDetn200To204SNR4 1;
BA_ "GenSigSendType" SG_ 211 FLR2RdrDetn200To204ScanID 1;
BA_ "GenSigSendType" SG_ 214 FLR2RdrDetn205To209AziAng0 1;
BA_ "GenSigSendType" SG_ 214 FLR2RdrDetn205To209AziAng1 1;
BA_ "GenSigSendType" SG_ 214 FLR2RdrDetn205To209AziAng2 1;
BA_ "GenSigSendType" SG_ 214 FLR2RdrDetn205To209AziAng3 1;
BA_ "GenSigSendType" SG_ 214 FLR2RdrDetn205To209AziAng4 1;
BA_ "GenSigDataID" SG_ 214 FLR2RdrDetn205To209CRC "0xAE2";
BA_ "GenSigFuncType" SG_ 214 FLR2RdrDetn205To209CRC 28;
BA_ "GenSigSendType" SG_ 214 FLR2RdrDetn205To209CRC 1;
BA_ "GenSigFuncType" SG_ 214 FLR2RdrDetn205To209Counter 27;
BA_ "GenSigSendType" SG_ 214 FLR2RdrDetn205To209Counter 1;
BA_ "GenSigSendType" SG_ 214 FLR2RdrDetn205To209DynPrpty0 1;
BA_ "GenSigSendType" SG_ 214 FLR2RdrDetn205To209DynPrpty1 1;
BA_ "GenSigSendType" SG_ 214 FLR2RdrDetn205To209DynPrpty2 1;
BA_ "GenSigSendType" SG_ 214 FLR2RdrDetn205To209DynPrpty3 1;
BA_ "GenSigSendType" SG_ 214 FLR2RdrDetn205To209DynPrpty4 1;
BA_ "GenSigSendType" SG_ 214 FLR2RdrDetn205To209EleAng0 1;
BA_ "GenSigSendType" SG_ 214 FLR2RdrDetn205To209EleAng1 1;
BA_ "GenSigSendType" SG_ 214 FLR2RdrDetn205To209EleAng2 1;
BA_ "GenSigSendType" SG_ 214 FLR2RdrDetn205To209EleAng3 1;
BA_ "GenSigSendType" SG_ 214 FLR2RdrDetn205To209EleAng4 1;
BA_ "GenSigSendType" SG_ 214 FLR2RdrDetn205To209Mode0 1;
BA_ "GenSigSendType" SG_ 214 FLR2RdrDetn205To209Mode1 1;
BA_ "GenSigSendType" SG_ 214 FLR2RdrDetn205To209Mode2 1;
BA_ "GenSigSendType" SG_ 214 FLR2RdrDetn205To209Mode3 1;
BA_ "GenSigSendType" SG_ 214 FLR2RdrDetn205To209Mode4 1;
BA_ "GenSigSendType" SG_ 214 FLR2RdrDetn205To209Quality0 1;
BA_ "GenSigSendType" SG_ 214 FLR2RdrDetn205To209Quality1 1;
BA_ "GenSigSendType" SG_ 214 FLR2RdrDetn205To209Quality2 1;
BA_ "GenSigSendType" SG_ 214 FLR2RdrDetn205To209Quality3 1;
BA_ "GenSigSendType" SG_ 214 FLR2RdrDetn205To209Quality4 1;
BA_ "GenSigSendType" SG_ 214 FLR2RdrDetn205To209RCS0 1;
BA_ "GenSigStartValue" SG_ 214 FLR2RdrDetn205To209RCS0 500;
BA_ "GenSigSendType" SG_ 214 FLR2RdrDetn205To209RCS1 1;
BA_ "GenSigStartValue" SG_ 214 FLR2RdrDetn205To209RCS1 500;
BA_ "GenSigSendType" SG_ 214 FLR2RdrDetn205To209RCS2 1;
BA_ "GenSigStartValue" SG_ 214 FLR2RdrDetn205To209RCS2 500;
BA_ "GenSigSendType" SG_ 214 FLR2RdrDetn205To209RCS3 1;
BA_ "GenSigStartValue" SG_ 214 FLR2RdrDetn205To209RCS3 500;
BA_ "GenSigSendType" SG_ 214 FLR2RdrDetn205To209RCS4 1;
BA_ "GenSigStartValue" SG_ 214 FLR2RdrDetn205To209RCS4 500;
BA_ "GenSigSendType" SG_ 214 FLR2RdrDetn205To209Range0 1;
BA_ "GenSigSendType" SG_ 214 FLR2RdrDetn205To209Range1 1;
BA_ "GenSigSendType" SG_ 214 FLR2RdrDetn205To209Range2 1;
BA_ "GenSigSendType" SG_ 214 FLR2RdrDetn205To209Range3 1;
BA_ "GenSigSendType" SG_ 214 FLR2RdrDetn205To209Range4 1;
BA_ "GenSigSendType" SG_ 214 FLR2RdrDetn205To209RngRt0 1;
BA_ "GenSigStartValue" SG_ 214 FLR2RdrDetn205To209RngRt0 1111;
BA_ "GenSigSendType" SG_ 214 FLR2RdrDetn205To209RngRt1 1;
BA_ "GenSigStartValue" SG_ 214 FLR2RdrDetn205To209RngRt1 1111;
BA_ "GenSigSendType" SG_ 214 FLR2RdrDetn205To209RngRt2 1;
BA_ "GenSigStartValue" SG_ 214 FLR2RdrDetn205To209RngRt2 1111;
BA_ "GenSigSendType" SG_ 214 FLR2RdrDetn205To209RngRt3 1;
BA_ "GenSigStartValue" SG_ 214 FLR2RdrDetn205To209RngRt3 1111;
BA_ "GenSigSendType" SG_ 214 FLR2RdrDetn205To209RngRt4 1;
BA_ "GenSigStartValue" SG_ 214 FLR2RdrDetn205To209RngRt4 1111;
BA_ "GenSigSendType" SG_ 214 FLR2RdrDetn205To209SNR0 1;
BA_ "GenSigSendType" SG_ 214 FLR2RdrDetn205To209SNR1 1;
BA_ "GenSigSendType" SG_ 214 FLR2RdrDetn205To209SNR2 1;
BA_ "GenSigSendType" SG_ 214 FLR2RdrDetn205To209SNR3 1;
BA_ "GenSigSendType" SG_ 214 FLR2RdrDetn205To209SNR4 1;
BA_ "GenSigSendType" SG_ 214 FLR2RdrDetn205To209ScanID 1;
BA_ "GenSigSendType" SG_ 217 FLR2RdrDetn210To214AziAng0 1;
BA_ "GenSigSendType" SG_ 217 FLR2RdrDetn210To214AziAng1 1;
BA_ "GenSigSendType" SG_ 217 FLR2RdrDetn210To214AziAng2 1;
BA_ "GenSigSendType" SG_ 217 FLR2RdrDetn210To214AziAng3 1;
BA_ "GenSigSendType" SG_ 217 FLR2RdrDetn210To214AziAng4 1;
BA_ "GenSigDataID" SG_ 217 FLR2RdrDetn210To214CRC "0xAE3";
BA_ "GenSigFuncType" SG_ 217 FLR2RdrDetn210To214CRC 28;
BA_ "GenSigSendType" SG_ 217 FLR2RdrDetn210To214CRC 1;
BA_ "GenSigFuncType" SG_ 217 FLR2RdrDetn210To214Counter 27;
BA_ "GenSigSendType" SG_ 217 FLR2RdrDetn210To214Counter 1;
BA_ "GenSigSendType" SG_ 217 FLR2RdrDetn210To214DynPrpty0 1;
BA_ "GenSigSendType" SG_ 217 FLR2RdrDetn210To214DynPrpty1 1;
BA_ "GenSigSendType" SG_ 217 FLR2RdrDetn210To214DynPrpty2 1;
BA_ "GenSigSendType" SG_ 217 FLR2RdrDetn210To214DynPrpty3 1;
BA_ "GenSigSendType" SG_ 217 FLR2RdrDetn210To214DynPrpty4 1;
BA_ "GenSigSendType" SG_ 217 FLR2RdrDetn210To214EleAng0 1;
BA_ "GenSigSendType" SG_ 217 FLR2RdrDetn210To214EleAng1 1;
BA_ "GenSigSendType" SG_ 217 FLR2RdrDetn210To214EleAng2 1;
BA_ "GenSigSendType" SG_ 217 FLR2RdrDetn210To214EleAng3 1;
BA_ "GenSigSendType" SG_ 217 FLR2RdrDetn210To214EleAng4 1;
BA_ "GenSigSendType" SG_ 217 FLR2RdrDetn210To214Mode0 1;
BA_ "GenSigSendType" SG_ 217 FLR2RdrDetn210To214Mode1 1;
BA_ "GenSigSendType" SG_ 217 FLR2RdrDetn210To214Mode2 1;
BA_ "GenSigSendType" SG_ 217 FLR2RdrDetn210To214Mode3 1;
BA_ "GenSigSendType" SG_ 217 FLR2RdrDetn210To214Mode4 1;
BA_ "GenSigSendType" SG_ 217 FLR2RdrDetn210To214Quality0 1;
BA_ "GenSigSendType" SG_ 217 FLR2RdrDetn210To214Quality1 1;
BA_ "GenSigSendType" SG_ 217 FLR2RdrDetn210To214Quality2 1;
BA_ "GenSigSendType" SG_ 217 FLR2RdrDetn210To214Quality3 1;
BA_ "GenSigSendType" SG_ 217 FLR2RdrDetn210To214Quality4 1;
BA_ "GenSigSendType" SG_ 217 FLR2RdrDetn210To214RCS0 1;
BA_ "GenSigStartValue" SG_ 217 FLR2RdrDetn210To214RCS0 500;
BA_ "GenSigSendType" SG_ 217 FLR2RdrDetn210To214RCS1 1;
BA_ "GenSigStartValue" SG_ 217 FLR2RdrDetn210To214RCS1 500;
BA_ "GenSigSendType" SG_ 217 FLR2RdrDetn210To214RCS2 1;
BA_ "GenSigStartValue" SG_ 217 FLR2RdrDetn210To214RCS2 500;
BA_ "GenSigSendType" SG_ 217 FLR2RdrDetn210To214RCS3 1;
BA_ "GenSigStartValue" SG_ 217 FLR2RdrDetn210To214RCS3 500;
BA_ "GenSigSendType" SG_ 217 FLR2RdrDetn210To214RCS4 1;
BA_ "GenSigStartValue" SG_ 217 FLR2RdrDetn210To214RCS4 500;
BA_ "GenSigSendType" SG_ 217 FLR2RdrDetn210To214Range0 1;
BA_ "GenSigSendType" SG_ 217 FLR2RdrDetn210To214Range1 1;
BA_ "GenSigSendType" SG_ 217 FLR2RdrDetn210To214Range2 1;
BA_ "GenSigSendType" SG_ 217 FLR2RdrDetn210To214Range3 1;
BA_ "GenSigSendType" SG_ 217 FLR2RdrDetn210To214Range4 1;
BA_ "GenSigSendType" SG_ 217 FLR2RdrDetn210To214RngRt0 1;
BA_ "GenSigStartValue" SG_ 217 FLR2RdrDetn210To214RngRt0 1111;
BA_ "GenSigSendType" SG_ 217 FLR2RdrDetn210To214RngRt1 1;
BA_ "GenSigStartValue" SG_ 217 FLR2RdrDetn210To214RngRt1 1111;
BA_ "GenSigSendType" SG_ 217 FLR2RdrDetn210To214RngRt2 1;
BA_ "GenSigStartValue" SG_ 217 FLR2RdrDetn210To214RngRt2 1111;
BA_ "GenSigSendType" SG_ 217 FLR2RdrDetn210To214RngRt3 1;
BA_ "GenSigStartValue" SG_ 217 FLR2RdrDetn210To214RngRt3 1111;
BA_ "GenSigSendType" SG_ 217 FLR2RdrDetn210To214RngRt4 1;
BA_ "GenSigStartValue" SG_ 217 FLR2RdrDetn210To214RngRt4 1111;
BA_ "GenSigSendType" SG_ 217 FLR2RdrDetn210To214SNR0 1;
BA_ "GenSigSendType" SG_ 217 FLR2RdrDetn210To214SNR1 1;
BA_ "GenSigSendType" SG_ 217 FLR2RdrDetn210To214SNR2 1;
BA_ "GenSigSendType" SG_ 217 FLR2RdrDetn210To214SNR3 1;
BA_ "GenSigSendType" SG_ 217 FLR2RdrDetn210To214SNR4 1;
BA_ "GenSigSendType" SG_ 217 FLR2RdrDetn210To214ScanID 1;
BA_ "GenSigSendType" SG_ 220 FLR2RdrDetn215To219AziAng0 1;
BA_ "GenSigSendType" SG_ 220 FLR2RdrDetn215To219AziAng1 1;
BA_ "GenSigSendType" SG_ 220 FLR2RdrDetn215To219AziAng2 1;
BA_ "GenSigSendType" SG_ 220 FLR2RdrDetn215To219AziAng3 1;
BA_ "GenSigSendType" SG_ 220 FLR2RdrDetn215To219AziAng4 1;
BA_ "GenSigDataID" SG_ 220 FLR2RdrDetn215To219CRC "0xAE4";
BA_ "GenSigFuncType" SG_ 220 FLR2RdrDetn215To219CRC 28;
BA_ "GenSigSendType" SG_ 220 FLR2RdrDetn215To219CRC 1;
BA_ "GenSigFuncType" SG_ 220 FLR2RdrDetn215To219Counter 27;
BA_ "GenSigSendType" SG_ 220 FLR2RdrDetn215To219Counter 1;
BA_ "GenSigSendType" SG_ 220 FLR2RdrDetn215To219DynPrpty0 1;
BA_ "GenSigSendType" SG_ 220 FLR2RdrDetn215To219DynPrpty1 1;
BA_ "GenSigSendType" SG_ 220 FLR2RdrDetn215To219DynPrpty2 1;
BA_ "GenSigSendType" SG_ 220 FLR2RdrDetn215To219DynPrpty3 1;
BA_ "GenSigSendType" SG_ 220 FLR2RdrDetn215To219DynPrpty4 1;
BA_ "GenSigSendType" SG_ 220 FLR2RdrDetn215To219EleAng0 1;
BA_ "GenSigSendType" SG_ 220 FLR2RdrDetn215To219EleAng1 1;
BA_ "GenSigSendType" SG_ 220 FLR2RdrDetn215To219EleAng2 1;
BA_ "GenSigSendType" SG_ 220 FLR2RdrDetn215To219EleAng3 1;
BA_ "GenSigSendType" SG_ 220 FLR2RdrDetn215To219EleAng4 1;
BA_ "GenSigSendType" SG_ 220 FLR2RdrDetn215To219Mode0 1;
BA_ "GenSigSendType" SG_ 220 FLR2RdrDetn215To219Mode1 1;
BA_ "GenSigSendType" SG_ 220 FLR2RdrDetn215To219Mode2 1;
BA_ "GenSigSendType" SG_ 220 FLR2RdrDetn215To219Mode3 1;
BA_ "GenSigSendType" SG_ 220 FLR2RdrDetn215To219Mode4 1;
BA_ "GenSigSendType" SG_ 220 FLR2RdrDetn215To219Quality0 1;
BA_ "GenSigSendType" SG_ 220 FLR2RdrDetn215To219Quality1 1;
BA_ "GenSigSendType" SG_ 220 FLR2RdrDetn215To219Quality2 1;
BA_ "GenSigSendType" SG_ 220 FLR2RdrDetn215To219Quality3 1;
BA_ "GenSigSendType" SG_ 220 FLR2RdrDetn215To219Quality4 1;
BA_ "GenSigSendType" SG_ 220 FLR2RdrDetn215To219RCS0 1;
BA_ "GenSigStartValue" SG_ 220 FLR2RdrDetn215To219RCS0 500;
BA_ "GenSigSendType" SG_ 220 FLR2RdrDetn215To219RCS1 1;
BA_ "GenSigStartValue" SG_ 220 FLR2RdrDetn215To219RCS1 500;
BA_ "GenSigSendType" SG_ 220 FLR2RdrDetn215To219RCS2 1;
BA_ "GenSigStartValue" SG_ 220 FLR2RdrDetn215To219RCS2 500;
BA_ "GenSigSendType" SG_ 220 FLR2RdrDetn215To219RCS3 1;
BA_ "GenSigStartValue" SG_ 220 FLR2RdrDetn215To219RCS3 500;
BA_ "GenSigSendType" SG_ 220 FLR2RdrDetn215To219RCS4 1;
BA_ "GenSigStartValue" SG_ 220 FLR2RdrDetn215To219RCS4 500;
BA_ "GenSigSendType" SG_ 220 FLR2RdrDetn215To219Range0 1;
BA_ "GenSigSendType" SG_ 220 FLR2RdrDetn215To219Range1 1;
BA_ "GenSigSendType" SG_ 220 FLR2RdrDetn215To219Range2 1;
BA_ "GenSigSendType" SG_ 220 FLR2RdrDetn215To219Range3 1;
BA_ "GenSigSendType" SG_ 220 FLR2RdrDetn215To219Range4 1;
BA_ "GenSigSendType" SG_ 220 FLR2RdrDetn215To219RngRt0 1;
BA_ "GenSigStartValue" SG_ 220 FLR2RdrDetn215To219RngRt0 1111;
BA_ "GenSigSendType" SG_ 220 FLR2RdrDetn215To219RngRt1 1;
BA_ "GenSigStartValue" SG_ 220 FLR2RdrDetn215To219RngRt1 1111;
BA_ "GenSigSendType" SG_ 220 FLR2RdrDetn215To219RngRt2 1;
BA_ "GenSigStartValue" SG_ 220 FLR2RdrDetn215To219RngRt2 1111;
BA_ "GenSigSendType" SG_ 220 FLR2RdrDetn215To219RngRt3 1;
BA_ "GenSigStartValue" SG_ 220 FLR2RdrDetn215To219RngRt3 1111;
BA_ "GenSigSendType" SG_ 220 FLR2RdrDetn215To219RngRt4 1;
BA_ "GenSigStartValue" SG_ 220 FLR2RdrDetn215To219RngRt4 1111;
BA_ "GenSigSendType" SG_ 220 FLR2RdrDetn215To219SNR0 1;
BA_ "GenSigSendType" SG_ 220 FLR2RdrDetn215To219SNR1 1;
BA_ "GenSigSendType" SG_ 220 FLR2RdrDetn215To219SNR2 1;
BA_ "GenSigSendType" SG_ 220 FLR2RdrDetn215To219SNR3 1;
BA_ "GenSigSendType" SG_ 220 FLR2RdrDetn215To219SNR4 1;
BA_ "GenSigSendType" SG_ 220 FLR2RdrDetn215To219ScanID 1;
BA_ "GenSigSendType" SG_ 224 FLR2RdrDetn220To224AziAng0 1;
BA_ "GenSigSendType" SG_ 224 FLR2RdrDetn220To224AziAng1 1;
BA_ "GenSigSendType" SG_ 224 FLR2RdrDetn220To224AziAng2 1;
BA_ "GenSigSendType" SG_ 224 FLR2RdrDetn220To224AziAng3 1;
BA_ "GenSigSendType" SG_ 224 FLR2RdrDetn220To224AziAng4 1;
BA_ "GenSigDataID" SG_ 224 FLR2RdrDetn220To224CRC "0xAE5";
BA_ "GenSigFuncType" SG_ 224 FLR2RdrDetn220To224CRC 28;
BA_ "GenSigSendType" SG_ 224 FLR2RdrDetn220To224CRC 1;
BA_ "GenSigFuncType" SG_ 224 FLR2RdrDetn220To224Counter 27;
BA_ "GenSigSendType" SG_ 224 FLR2RdrDetn220To224Counter 1;
BA_ "GenSigSendType" SG_ 224 FLR2RdrDetn220To224DynPrpty0 1;
BA_ "GenSigSendType" SG_ 224 FLR2RdrDetn220To224DynPrpty1 1;
BA_ "GenSigSendType" SG_ 224 FLR2RdrDetn220To224DynPrpty2 1;
BA_ "GenSigSendType" SG_ 224 FLR2RdrDetn220To224DynPrpty3 1;
BA_ "GenSigSendType" SG_ 224 FLR2RdrDetn220To224DynPrpty4 1;
BA_ "GenSigSendType" SG_ 224 FLR2RdrDetn220To224EleAng0 1;
BA_ "GenSigSendType" SG_ 224 FLR2RdrDetn220To224EleAng1 1;
BA_ "GenSigSendType" SG_ 224 FLR2RdrDetn220To224EleAng2 1;
BA_ "GenSigSendType" SG_ 224 FLR2RdrDetn220To224EleAng3 1;
BA_ "GenSigSendType" SG_ 224 FLR2RdrDetn220To224EleAng4 1;
BA_ "GenSigSendType" SG_ 224 FLR2RdrDetn220To224Mode0 1;
BA_ "GenSigSendType" SG_ 224 FLR2RdrDetn220To224Mode1 1;
BA_ "GenSigSendType" SG_ 224 FLR2RdrDetn220To224Mode2 1;
BA_ "GenSigSendType" SG_ 224 FLR2RdrDetn220To224Mode3 1;
BA_ "GenSigSendType" SG_ 224 FLR2RdrDetn220To224Mode4 1;
BA_ "GenSigSendType" SG_ 224 FLR2RdrDetn220To224Quality0 1;
BA_ "GenSigSendType" SG_ 224 FLR2RdrDetn220To224Quality1 1;
BA_ "GenSigSendType" SG_ 224 FLR2RdrDetn220To224Quality2 1;
BA_ "GenSigSendType" SG_ 224 FLR2RdrDetn220To224Quality3 1;
BA_ "GenSigSendType" SG_ 224 FLR2RdrDetn220To224Quality4 1;
BA_ "GenSigSendType" SG_ 224 FLR2RdrDetn220To224RCS0 1;
BA_ "GenSigStartValue" SG_ 224 FLR2RdrDetn220To224RCS0 500;
BA_ "GenSigSendType" SG_ 224 FLR2RdrDetn220To224RCS1 1;
BA_ "GenSigStartValue" SG_ 224 FLR2RdrDetn220To224RCS1 500;
BA_ "GenSigSendType" SG_ 224 FLR2RdrDetn220To224RCS2 1;
BA_ "GenSigStartValue" SG_ 224 FLR2RdrDetn220To224RCS2 500;
BA_ "GenSigSendType" SG_ 224 FLR2RdrDetn220To224RCS3 1;
BA_ "GenSigStartValue" SG_ 224 FLR2RdrDetn220To224RCS3 500;
BA_ "GenSigSendType" SG_ 224 FLR2RdrDetn220To224RCS4 1;
BA_ "GenSigStartValue" SG_ 224 FLR2RdrDetn220To224RCS4 500;
BA_ "GenSigSendType" SG_ 224 FLR2RdrDetn220To224Range0 1;
BA_ "GenSigSendType" SG_ 224 FLR2RdrDetn220To224Range1 1;
BA_ "GenSigSendType" SG_ 224 FLR2RdrDetn220To224Range2 1;
BA_ "GenSigSendType" SG_ 224 FLR2RdrDetn220To224Range3 1;
BA_ "GenSigSendType" SG_ 224 FLR2RdrDetn220To224Range4 1;
BA_ "GenSigSendType" SG_ 224 FLR2RdrDetn220To224RngRt0 1;
BA_ "GenSigStartValue" SG_ 224 FLR2RdrDetn220To224RngRt0 1111;
BA_ "GenSigSendType" SG_ 224 FLR2RdrDetn220To224RngRt1 1;
BA_ "GenSigStartValue" SG_ 224 FLR2RdrDetn220To224RngRt1 1111;
BA_ "GenSigSendType" SG_ 224 FLR2RdrDetn220To224RngRt2 1;
BA_ "GenSigStartValue" SG_ 224 FLR2RdrDetn220To224RngRt2 1111;
BA_ "GenSigSendType" SG_ 224 FLR2RdrDetn220To224RngRt3 1;
BA_ "GenSigStartValue" SG_ 224 FLR2RdrDetn220To224RngRt3 1111;
BA_ "GenSigSendType" SG_ 224 FLR2RdrDetn220To224RngRt4 1;
BA_ "GenSigStartValue" SG_ 224 FLR2RdrDetn220To224RngRt4 1111;
BA_ "GenSigSendType" SG_ 224 FLR2RdrDetn220To224SNR0 1;
BA_ "GenSigSendType" SG_ 224 FLR2RdrDetn220To224SNR1 1;
BA_ "GenSigSendType" SG_ 224 FLR2RdrDetn220To224SNR2 1;
BA_ "GenSigSendType" SG_ 224 FLR2RdrDetn220To224SNR3 1;
BA_ "GenSigSendType" SG_ 224 FLR2RdrDetn220To224SNR4 1;
BA_ "GenSigSendType" SG_ 224 FLR2RdrDetn220To224ScanID 1;
BA_ "GenSigSendType" SG_ 227 FLR2RdrDetn225To229AziAng0 1;
BA_ "GenSigSendType" SG_ 227 FLR2RdrDetn225To229AziAng1 1;
BA_ "GenSigSendType" SG_ 227 FLR2RdrDetn225To229AziAng2 1;
BA_ "GenSigSendType" SG_ 227 FLR2RdrDetn225To229AziAng3 1;
BA_ "GenSigSendType" SG_ 227 FLR2RdrDetn225To229AziAng4 1;
BA_ "GenSigDataID" SG_ 227 FLR2RdrDetn225To229CRC "0xAE6";
BA_ "GenSigFuncType" SG_ 227 FLR2RdrDetn225To229CRC 28;
BA_ "GenSigSendType" SG_ 227 FLR2RdrDetn225To229CRC 1;
BA_ "GenSigFuncType" SG_ 227 FLR2RdrDetn225To229Counter 27;
BA_ "GenSigSendType" SG_ 227 FLR2RdrDetn225To229Counter 1;
BA_ "GenSigSendType" SG_ 227 FLR2RdrDetn225To229DynPrpty0 1;
BA_ "GenSigSendType" SG_ 227 FLR2RdrDetn225To229DynPrpty1 1;
BA_ "GenSigSendType" SG_ 227 FLR2RdrDetn225To229DynPrpty2 1;
BA_ "GenSigSendType" SG_ 227 FLR2RdrDetn225To229DynPrpty3 1;
BA_ "GenSigSendType" SG_ 227 FLR2RdrDetn225To229DynPrpty4 1;
BA_ "GenSigSendType" SG_ 227 FLR2RdrDetn225To229EleAng0 1;
BA_ "GenSigSendType" SG_ 227 FLR2RdrDetn225To229EleAng1 1;
BA_ "GenSigSendType" SG_ 227 FLR2RdrDetn225To229EleAng2 1;
BA_ "GenSigSendType" SG_ 227 FLR2RdrDetn225To229EleAng3 1;
BA_ "GenSigSendType" SG_ 227 FLR2RdrDetn225To229EleAng4 1;
BA_ "GenSigSendType" SG_ 227 FLR2RdrDetn225To229Mode0 1;
BA_ "GenSigSendType" SG_ 227 FLR2RdrDetn225To229Mode1 1;
BA_ "GenSigSendType" SG_ 227 FLR2RdrDetn225To229Mode2 1;
BA_ "GenSigSendType" SG_ 227 FLR2RdrDetn225To229Mode3 1;
BA_ "GenSigSendType" SG_ 227 FLR2RdrDetn225To229Mode4 1;
BA_ "GenSigSendType" SG_ 227 FLR2RdrDetn225To229Quality0 1;
BA_ "GenSigSendType" SG_ 227 FLR2RdrDetn225To229Quality1 1;
BA_ "GenSigSendType" SG_ 227 FLR2RdrDetn225To229Quality2 1;
BA_ "GenSigSendType" SG_ 227 FLR2RdrDetn225To229Quality3 1;
BA_ "GenSigSendType" SG_ 227 FLR2RdrDetn225To229Quality4 1;
BA_ "GenSigSendType" SG_ 227 FLR2RdrDetn225To229RCS0 1;
BA_ "GenSigStartValue" SG_ 227 FLR2RdrDetn225To229RCS0 500;
BA_ "GenSigSendType" SG_ 227 FLR2RdrDetn225To229RCS1 1;
BA_ "GenSigStartValue" SG_ 227 FLR2RdrDetn225To229RCS1 500;
BA_ "GenSigSendType" SG_ 227 FLR2RdrDetn225To229RCS2 1;
BA_ "GenSigStartValue" SG_ 227 FLR2RdrDetn225To229RCS2 500;
BA_ "GenSigSendType" SG_ 227 FLR2RdrDetn225To229RCS3 1;
BA_ "GenSigStartValue" SG_ 227 FLR2RdrDetn225To229RCS3 500;
BA_ "GenSigSendType" SG_ 227 FLR2RdrDetn225To229RCS4 1;
BA_ "GenSigStartValue" SG_ 227 FLR2RdrDetn225To229RCS4 500;
BA_ "GenSigSendType" SG_ 227 FLR2RdrDetn225To229Range0 1;
BA_ "GenSigSendType" SG_ 227 FLR2RdrDetn225To229Range1 1;
BA_ "GenSigSendType" SG_ 227 FLR2RdrDetn225To229Range2 1;
BA_ "GenSigSendType" SG_ 227 FLR2RdrDetn225To229Range3 1;
BA_ "GenSigSendType" SG_ 227 FLR2RdrDetn225To229Range4 1;
BA_ "GenSigSendType" SG_ 227 FLR2RdrDetn225To229RngRt0 1;
BA_ "GenSigStartValue" SG_ 227 FLR2RdrDetn225To229RngRt0 1111;
BA_ "GenSigSendType" SG_ 227 FLR2RdrDetn225To229RngRt1 1;
BA_ "GenSigStartValue" SG_ 227 FLR2RdrDetn225To229RngRt1 1111;
BA_ "GenSigSendType" SG_ 227 FLR2RdrDetn225To229RngRt2 1;
BA_ "GenSigStartValue" SG_ 227 FLR2RdrDetn225To229RngRt2 1111;
BA_ "GenSigSendType" SG_ 227 FLR2RdrDetn225To229RngRt3 1;
BA_ "GenSigStartValue" SG_ 227 FLR2RdrDetn225To229RngRt3 1111;
BA_ "GenSigSendType" SG_ 227 FLR2RdrDetn225To229RngRt4 1;
BA_ "GenSigStartValue" SG_ 227 FLR2RdrDetn225To229RngRt4 1111;
BA_ "GenSigSendType" SG_ 227 FLR2RdrDetn225To229SNR0 1;
BA_ "GenSigSendType" SG_ 227 FLR2RdrDetn225To229SNR1 1;
BA_ "GenSigSendType" SG_ 227 FLR2RdrDetn225To229SNR2 1;
BA_ "GenSigSendType" SG_ 227 FLR2RdrDetn225To229SNR3 1;
BA_ "GenSigSendType" SG_ 227 FLR2RdrDetn225To229SNR4 1;
BA_ "GenSigSendType" SG_ 227 FLR2RdrDetn225To229ScanID 1;
BA_ "GenSigSendType" SG_ 230 FLR2RdrDetn230To234AziAng0 1;
BA_ "GenSigSendType" SG_ 230 FLR2RdrDetn230To234AziAng1 1;
BA_ "GenSigSendType" SG_ 230 FLR2RdrDetn230To234AziAng2 1;
BA_ "GenSigSendType" SG_ 230 FLR2RdrDetn230To234AziAng3 1;
BA_ "GenSigSendType" SG_ 230 FLR2RdrDetn230To234AziAng4 1;
BA_ "GenSigDataID" SG_ 230 FLR2RdrDetn230To234CRC "0xAE7";
BA_ "GenSigFuncType" SG_ 230 FLR2RdrDetn230To234CRC 28;
BA_ "GenSigSendType" SG_ 230 FLR2RdrDetn230To234CRC 1;
BA_ "GenSigFuncType" SG_ 230 FLR2RdrDetn230To234Counter 27;
BA_ "GenSigSendType" SG_ 230 FLR2RdrDetn230To234Counter 1;
BA_ "GenSigSendType" SG_ 230 FLR2RdrDetn230To234DynPrpty0 1;
BA_ "GenSigSendType" SG_ 230 FLR2RdrDetn230To234DynPrpty1 1;
BA_ "GenSigSendType" SG_ 230 FLR2RdrDetn230To234DynPrpty2 1;
BA_ "GenSigSendType" SG_ 230 FLR2RdrDetn230To234DynPrpty3 1;
BA_ "GenSigSendType" SG_ 230 FLR2RdrDetn230To234DynPrpty4 1;
BA_ "GenSigSendType" SG_ 230 FLR2RdrDetn230To234EleAng0 1;
BA_ "GenSigSendType" SG_ 230 FLR2RdrDetn230To234EleAng1 1;
BA_ "GenSigSendType" SG_ 230 FLR2RdrDetn230To234EleAng2 1;
BA_ "GenSigSendType" SG_ 230 FLR2RdrDetn230To234EleAng3 1;
BA_ "GenSigSendType" SG_ 230 FLR2RdrDetn230To234EleAng4 1;
BA_ "GenSigSendType" SG_ 230 FLR2RdrDetn230To234Mode0 1;
BA_ "GenSigSendType" SG_ 230 FLR2RdrDetn230To234Mode1 1;
BA_ "GenSigSendType" SG_ 230 FLR2RdrDetn230To234Mode2 1;
BA_ "GenSigSendType" SG_ 230 FLR2RdrDetn230To234Mode3 1;
BA_ "GenSigSendType" SG_ 230 FLR2RdrDetn230To234Mode4 1;
BA_ "GenSigSendType" SG_ 230 FLR2RdrDetn230To234Quality0 1;
BA_ "GenSigSendType" SG_ 230 FLR2RdrDetn230To234Quality1 1;
BA_ "GenSigSendType" SG_ 230 FLR2RdrDetn230To234Quality2 1;
BA_ "GenSigSendType" SG_ 230 FLR2RdrDetn230To234Quality3 1;
BA_ "GenSigSendType" SG_ 230 FLR2RdrDetn230To234Quality4 1;
BA_ "GenSigSendType" SG_ 230 FLR2RdrDetn230To234RCS0 1;
BA_ "GenSigStartValue" SG_ 230 FLR2RdrDetn230To234RCS0 500;
BA_ "GenSigSendType" SG_ 230 FLR2RdrDetn230To234RCS1 1;
BA_ "GenSigStartValue" SG_ 230 FLR2RdrDetn230To234RCS1 500;
BA_ "GenSigSendType" SG_ 230 FLR2RdrDetn230To234RCS2 1;
BA_ "GenSigStartValue" SG_ 230 FLR2RdrDetn230To234RCS2 500;
BA_ "GenSigSendType" SG_ 230 FLR2RdrDetn230To234RCS3 1;
BA_ "GenSigStartValue" SG_ 230 FLR2RdrDetn230To234RCS3 500;
BA_ "GenSigSendType" SG_ 230 FLR2RdrDetn230To234RCS4 1;
BA_ "GenSigStartValue" SG_ 230 FLR2RdrDetn230To234RCS4 500;
BA_ "GenSigSendType" SG_ 230 FLR2RdrDetn230To234Range0 1;
BA_ "GenSigSendType" SG_ 230 FLR2RdrDetn230To234Range1 1;
BA_ "GenSigSendType" SG_ 230 FLR2RdrDetn230To234Range2 1;
BA_ "GenSigSendType" SG_ 230 FLR2RdrDetn230To234Range3 1;
BA_ "GenSigSendType" SG_ 230 FLR2RdrDetn230To234Range4 1;
BA_ "GenSigSendType" SG_ 230 FLR2RdrDetn230To234RngRt0 1;
BA_ "GenSigStartValue" SG_ 230 FLR2RdrDetn230To234RngRt0 1111;
BA_ "GenSigSendType" SG_ 230 FLR2RdrDetn230To234RngRt1 1;
BA_ "GenSigStartValue" SG_ 230 FLR2RdrDetn230To234RngRt1 1111;
BA_ "GenSigSendType" SG_ 230 FLR2RdrDetn230To234RngRt2 1;
BA_ "GenSigStartValue" SG_ 230 FLR2RdrDetn230To234RngRt2 1111;
BA_ "GenSigSendType" SG_ 230 FLR2RdrDetn230To234RngRt3 1;
BA_ "GenSigStartValue" SG_ 230 FLR2RdrDetn230To234RngRt3 1111;
BA_ "GenSigSendType" SG_ 230 FLR2RdrDetn230To234RngRt4 1;
BA_ "GenSigStartValue" SG_ 230 FLR2RdrDetn230To234RngRt4 1111;
BA_ "GenSigSendType" SG_ 230 FLR2RdrDetn230To234SNR0 1;
BA_ "GenSigSendType" SG_ 230 FLR2RdrDetn230To234SNR1 1;
BA_ "GenSigSendType" SG_ 230 FLR2RdrDetn230To234SNR2 1;
BA_ "GenSigSendType" SG_ 230 FLR2RdrDetn230To234SNR3 1;
BA_ "GenSigSendType" SG_ 230 FLR2RdrDetn230To234SNR4 1;
BA_ "GenSigSendType" SG_ 230 FLR2RdrDetn230To234ScanID 1;
BA_ "GenSigSendType" SG_ 233 FLR2RdrDetn235To239AziAng0 1;
BA_ "GenSigSendType" SG_ 233 FLR2RdrDetn235To239AziAng1 1;
BA_ "GenSigSendType" SG_ 233 FLR2RdrDetn235To239AziAng2 1;
BA_ "GenSigSendType" SG_ 233 FLR2RdrDetn235To239AziAng3 1;
BA_ "GenSigSendType" SG_ 233 FLR2RdrDetn235To239AziAng4 1;
BA_ "GenSigDataID" SG_ 233 FLR2RdrDetn235To239CRC "0xAE8";
BA_ "GenSigFuncType" SG_ 233 FLR2RdrDetn235To239CRC 28;
BA_ "GenSigSendType" SG_ 233 FLR2RdrDetn235To239CRC 1;
BA_ "GenSigFuncType" SG_ 233 FLR2RdrDetn235To239Counter 27;
BA_ "GenSigSendType" SG_ 233 FLR2RdrDetn235To239Counter 1;
BA_ "GenSigSendType" SG_ 233 FLR2RdrDetn235To239DynPrpty0 1;
BA_ "GenSigSendType" SG_ 233 FLR2RdrDetn235To239DynPrpty1 1;
BA_ "GenSigSendType" SG_ 233 FLR2RdrDetn235To239DynPrpty2 1;
BA_ "GenSigSendType" SG_ 233 FLR2RdrDetn235To239DynPrpty3 1;
BA_ "GenSigSendType" SG_ 233 FLR2RdrDetn235To239DynPrpty4 1;
BA_ "GenSigSendType" SG_ 233 FLR2RdrDetn235To239EleAng0 1;
BA_ "GenSigSendType" SG_ 233 FLR2RdrDetn235To239EleAng1 1;
BA_ "GenSigSendType" SG_ 233 FLR2RdrDetn235To239EleAng2 1;
BA_ "GenSigSendType" SG_ 233 FLR2RdrDetn235To239EleAng3 1;
BA_ "GenSigSendType" SG_ 233 FLR2RdrDetn235To239EleAng4 1;
BA_ "GenSigSendType" SG_ 233 FLR2RdrDetn235To239Mode0 1;
BA_ "GenSigSendType" SG_ 233 FLR2RdrDetn235To239Mode1 1;
BA_ "GenSigSendType" SG_ 233 FLR2RdrDetn235To239Mode2 1;
BA_ "GenSigSendType" SG_ 233 FLR2RdrDetn235To239Mode3 1;
BA_ "GenSigSendType" SG_ 233 FLR2RdrDetn235To239Mode4 1;
BA_ "GenSigSendType" SG_ 233 FLR2RdrDetn235To239Quality0 1;
BA_ "GenSigSendType" SG_ 233 FLR2RdrDetn235To239Quality1 1;
BA_ "GenSigSendType" SG_ 233 FLR2RdrDetn235To239Quality2 1;
BA_ "GenSigSendType" SG_ 233 FLR2RdrDetn235To239Quality3 1;
BA_ "GenSigSendType" SG_ 233 FLR2RdrDetn235To239Quality4 1;
BA_ "GenSigSendType" SG_ 233 FLR2RdrDetn235To239RCS0 1;
BA_ "GenSigStartValue" SG_ 233 FLR2RdrDetn235To239RCS0 500;
BA_ "GenSigSendType" SG_ 233 FLR2RdrDetn235To239RCS1 1;
BA_ "GenSigStartValue" SG_ 233 FLR2RdrDetn235To239RCS1 500;
BA_ "GenSigSendType" SG_ 233 FLR2RdrDetn235To239RCS2 1;
BA_ "GenSigStartValue" SG_ 233 FLR2RdrDetn235To239RCS2 500;
BA_ "GenSigSendType" SG_ 233 FLR2RdrDetn235To239RCS3 1;
BA_ "GenSigStartValue" SG_ 233 FLR2RdrDetn235To239RCS3 500;
BA_ "GenSigSendType" SG_ 233 FLR2RdrDetn235To239RCS4 1;
BA_ "GenSigStartValue" SG_ 233 FLR2RdrDetn235To239RCS4 500;
BA_ "GenSigSendType" SG_ 233 FLR2RdrDetn235To239Range0 1;
BA_ "GenSigSendType" SG_ 233 FLR2RdrDetn235To239Range1 1;
BA_ "GenSigSendType" SG_ 233 FLR2RdrDetn235To239Range2 1;
BA_ "GenSigSendType" SG_ 233 FLR2RdrDetn235To239Range3 1;
BA_ "GenSigSendType" SG_ 233 FLR2RdrDetn235To239Range4 1;
BA_ "GenSigSendType" SG_ 233 FLR2RdrDetn235To239RngRt0 1;
BA_ "GenSigStartValue" SG_ 233 FLR2RdrDetn235To239RngRt0 1111;
BA_ "GenSigSendType" SG_ 233 FLR2RdrDetn235To239RngRt1 1;
BA_ "GenSigStartValue" SG_ 233 FLR2RdrDetn235To239RngRt1 1111;
BA_ "GenSigSendType" SG_ 233 FLR2RdrDetn235To239RngRt2 1;
BA_ "GenSigStartValue" SG_ 233 FLR2RdrDetn235To239RngRt2 1111;
BA_ "GenSigSendType" SG_ 233 FLR2RdrDetn235To239RngRt3 1;
BA_ "GenSigStartValue" SG_ 233 FLR2RdrDetn235To239RngRt3 1111;
BA_ "GenSigSendType" SG_ 233 FLR2RdrDetn235To239RngRt4 1;
BA_ "GenSigStartValue" SG_ 233 FLR2RdrDetn235To239RngRt4 1111;
BA_ "GenSigSendType" SG_ 233 FLR2RdrDetn235To239SNR0 1;
BA_ "GenSigSendType" SG_ 233 FLR2RdrDetn235To239SNR1 1;
BA_ "GenSigSendType" SG_ 233 FLR2RdrDetn235To239SNR2 1;
BA_ "GenSigSendType" SG_ 233 FLR2RdrDetn235To239SNR3 1;
BA_ "GenSigSendType" SG_ 233 FLR2RdrDetn235To239SNR4 1;
BA_ "GenSigSendType" SG_ 233 FLR2RdrDetn235To239ScanID 1;
BA_ "GenSigSendType" SG_ 236 FLR2RdrDetn240To244AziAng0 1;
BA_ "GenSigSendType" SG_ 236 FLR2RdrDetn240To244AziAng1 1;
BA_ "GenSigSendType" SG_ 236 FLR2RdrDetn240To244AziAng2 1;
BA_ "GenSigSendType" SG_ 236 FLR2RdrDetn240To244AziAng3 1;
BA_ "GenSigSendType" SG_ 236 FLR2RdrDetn240To244AziAng4 1;
BA_ "GenSigDataID" SG_ 236 FLR2RdrDetn240To244CRC "0xAE9";
BA_ "GenSigFuncType" SG_ 236 FLR2RdrDetn240To244CRC 28;
BA_ "GenSigSendType" SG_ 236 FLR2RdrDetn240To244CRC 1;
BA_ "GenSigFuncType" SG_ 236 FLR2RdrDetn240To244Counter 27;
BA_ "GenSigSendType" SG_ 236 FLR2RdrDetn240To244Counter 1;
BA_ "GenSigSendType" SG_ 236 FLR2RdrDetn240To244DynPrpty0 1;
BA_ "GenSigSendType" SG_ 236 FLR2RdrDetn240To244DynPrpty1 1;
BA_ "GenSigSendType" SG_ 236 FLR2RdrDetn240To244DynPrpty2 1;
BA_ "GenSigSendType" SG_ 236 FLR2RdrDetn240To244DynPrpty3 1;
BA_ "GenSigSendType" SG_ 236 FLR2RdrDetn240To244DynPrpty4 1;
BA_ "GenSigSendType" SG_ 236 FLR2RdrDetn240To244EleAng0 1;
BA_ "GenSigSendType" SG_ 236 FLR2RdrDetn240To244EleAng1 1;
BA_ "GenSigSendType" SG_ 236 FLR2RdrDetn240To244EleAng2 1;
BA_ "GenSigSendType" SG_ 236 FLR2RdrDetn240To244EleAng3 1;
BA_ "GenSigSendType" SG_ 236 FLR2RdrDetn240To244EleAng4 1;
BA_ "GenSigSendType" SG_ 236 FLR2RdrDetn240To244Mode0 1;
BA_ "GenSigSendType" SG_ 236 FLR2RdrDetn240To244Mode1 1;
BA_ "GenSigSendType" SG_ 236 FLR2RdrDetn240To244Mode2 1;
BA_ "GenSigSendType" SG_ 236 FLR2RdrDetn240To244Mode3 1;
BA_ "GenSigSendType" SG_ 236 FLR2RdrDetn240To244Mode4 1;
BA_ "GenSigSendType" SG_ 236 FLR2RdrDetn240To244Quality0 1;
BA_ "GenSigSendType" SG_ 236 FLR2RdrDetn240To244Quality1 1;
BA_ "GenSigSendType" SG_ 236 FLR2RdrDetn240To244Quality2 1;
BA_ "GenSigSendType" SG_ 236 FLR2RdrDetn240To244Quality3 1;
BA_ "GenSigSendType" SG_ 236 FLR2RdrDetn240To244Quality4 1;
BA_ "GenSigSendType" SG_ 236 FLR2RdrDetn240To244RCS0 1;
BA_ "GenSigStartValue" SG_ 236 FLR2RdrDetn240To244RCS0 500;
BA_ "GenSigSendType" SG_ 236 FLR2RdrDetn240To244RCS1 1;
BA_ "GenSigStartValue" SG_ 236 FLR2RdrDetn240To244RCS1 500;
BA_ "GenSigSendType" SG_ 236 FLR2RdrDetn240To244RCS2 1;
BA_ "GenSigStartValue" SG_ 236 FLR2RdrDetn240To244RCS2 500;
BA_ "GenSigSendType" SG_ 236 FLR2RdrDetn240To244RCS3 1;
BA_ "GenSigStartValue" SG_ 236 FLR2RdrDetn240To244RCS3 500;
BA_ "GenSigSendType" SG_ 236 FLR2RdrDetn240To244RCS4 1;
BA_ "GenSigStartValue" SG_ 236 FLR2RdrDetn240To244RCS4 500;
BA_ "GenSigSendType" SG_ 236 FLR2RdrDetn240To244Range0 1;
BA_ "GenSigSendType" SG_ 236 FLR2RdrDetn240To244Range1 1;
BA_ "GenSigSendType" SG_ 236 FLR2RdrDetn240To244Range2 1;
BA_ "GenSigSendType" SG_ 236 FLR2RdrDetn240To244Range3 1;
BA_ "GenSigSendType" SG_ 236 FLR2RdrDetn240To244Range4 1;
BA_ "GenSigSendType" SG_ 236 FLR2RdrDetn240To244RngRt0 1;
BA_ "GenSigStartValue" SG_ 236 FLR2RdrDetn240To244RngRt0 1111;
BA_ "GenSigSendType" SG_ 236 FLR2RdrDetn240To244RngRt1 1;
BA_ "GenSigStartValue" SG_ 236 FLR2RdrDetn240To244RngRt1 1111;
BA_ "GenSigSendType" SG_ 236 FLR2RdrDetn240To244RngRt2 1;
BA_ "GenSigStartValue" SG_ 236 FLR2RdrDetn240To244RngRt2 1111;
BA_ "GenSigSendType" SG_ 236 FLR2RdrDetn240To244RngRt3 1;
BA_ "GenSigStartValue" SG_ 236 FLR2RdrDetn240To244RngRt3 1111;
BA_ "GenSigSendType" SG_ 236 FLR2RdrDetn240To244RngRt4 1;
BA_ "GenSigStartValue" SG_ 236 FLR2RdrDetn240To244RngRt4 1111;
BA_ "GenSigSendType" SG_ 236 FLR2RdrDetn240To244SNR0 1;
BA_ "GenSigSendType" SG_ 236 FLR2RdrDetn240To244SNR1 1;
BA_ "GenSigSendType" SG_ 236 FLR2RdrDetn240To244SNR2 1;
BA_ "GenSigSendType" SG_ 236 FLR2RdrDetn240To244SNR3 1;
BA_ "GenSigSendType" SG_ 236 FLR2RdrDetn240To244SNR4 1;
BA_ "GenSigSendType" SG_ 236 FLR2RdrDetn240To244ScanID 1;
BA_ "GenSigSendType" SG_ 240 FLR2RdrDetn245To249AziAng0 1;
BA_ "GenSigSendType" SG_ 240 FLR2RdrDetn245To249AziAng1 1;
BA_ "GenSigSendType" SG_ 240 FLR2RdrDetn245To249AziAng2 1;
BA_ "GenSigSendType" SG_ 240 FLR2RdrDetn245To249AziAng3 1;
BA_ "GenSigSendType" SG_ 240 FLR2RdrDetn245To249AziAng4 1;
BA_ "GenSigDataID" SG_ 240 FLR2RdrDetn245To249CRC "0xAEA";
BA_ "GenSigFuncType" SG_ 240 FLR2RdrDetn245To249CRC 28;
BA_ "GenSigSendType" SG_ 240 FLR2RdrDetn245To249CRC 1;
BA_ "GenSigFuncType" SG_ 240 FLR2RdrDetn245To249Counter 27;
BA_ "GenSigSendType" SG_ 240 FLR2RdrDetn245To249Counter 1;
BA_ "GenSigSendType" SG_ 240 FLR2RdrDetn245To249DynPrpty0 1;
BA_ "GenSigSendType" SG_ 240 FLR2RdrDetn245To249DynPrpty1 1;
BA_ "GenSigSendType" SG_ 240 FLR2RdrDetn245To249DynPrpty2 1;
BA_ "GenSigSendType" SG_ 240 FLR2RdrDetn245To249DynPrpty3 1;
BA_ "GenSigSendType" SG_ 240 FLR2RdrDetn245To249DynPrpty4 1;
BA_ "GenSigSendType" SG_ 240 FLR2RdrDetn245To249EleAng0 1;
BA_ "GenSigSendType" SG_ 240 FLR2RdrDetn245To249EleAng1 1;
BA_ "GenSigSendType" SG_ 240 FLR2RdrDetn245To249EleAng2 1;
BA_ "GenSigSendType" SG_ 240 FLR2RdrDetn245To249EleAng3 1;
BA_ "GenSigSendType" SG_ 240 FLR2RdrDetn245To249EleAng4 1;
BA_ "GenSigSendType" SG_ 240 FLR2RdrDetn245To249Mode0 1;
BA_ "GenSigSendType" SG_ 240 FLR2RdrDetn245To249Mode1 1;
BA_ "GenSigSendType" SG_ 240 FLR2RdrDetn245To249Mode2 1;
BA_ "GenSigSendType" SG_ 240 FLR2RdrDetn245To249Mode3 1;
BA_ "GenSigSendType" SG_ 240 FLR2RdrDetn245To249Mode4 1;
BA_ "GenSigSendType" SG_ 240 FLR2RdrDetn245To249Quality0 1;
BA_ "GenSigSendType" SG_ 240 FLR2RdrDetn245To249Quality1 1;
BA_ "GenSigSendType" SG_ 240 FLR2RdrDetn245To249Quality2 1;
BA_ "GenSigSendType" SG_ 240 FLR2RdrDetn245To249Quality3 1;
BA_ "GenSigSendType" SG_ 240 FLR2RdrDetn245To249Quality4 1;
BA_ "GenSigSendType" SG_ 240 FLR2RdrDetn245To249RCS0 1;
BA_ "GenSigStartValue" SG_ 240 FLR2RdrDetn245To249RCS0 500;
BA_ "GenSigSendType" SG_ 240 FLR2RdrDetn245To249RCS1 1;
BA_ "GenSigStartValue" SG_ 240 FLR2RdrDetn245To249RCS1 500;
BA_ "GenSigSendType" SG_ 240 FLR2RdrDetn245To249RCS2 1;
BA_ "GenSigStartValue" SG_ 240 FLR2RdrDetn245To249RCS2 500;
BA_ "GenSigSendType" SG_ 240 FLR2RdrDetn245To249RCS3 1;
BA_ "GenSigStartValue" SG_ 240 FLR2RdrDetn245To249RCS3 500;
BA_ "GenSigSendType" SG_ 240 FLR2RdrDetn245To249RCS4 1;
BA_ "GenSigStartValue" SG_ 240 FLR2RdrDetn245To249RCS4 500;
BA_ "GenSigSendType" SG_ 240 FLR2RdrDetn245To249Range0 1;
BA_ "GenSigSendType" SG_ 240 FLR2RdrDetn245To249Range1 1;
BA_ "GenSigSendType" SG_ 240 FLR2RdrDetn245To249Range2 1;
BA_ "GenSigSendType" SG_ 240 FLR2RdrDetn245To249Range3 1;
BA_ "GenSigSendType" SG_ 240 FLR2RdrDetn245To249Range4 1;
BA_ "GenSigSendType" SG_ 240 FLR2RdrDetn245To249RngRt0 1;
BA_ "GenSigStartValue" SG_ 240 FLR2RdrDetn245To249RngRt0 1111;
BA_ "GenSigSendType" SG_ 240 FLR2RdrDetn245To249RngRt1 1;
BA_ "GenSigStartValue" SG_ 240 FLR2RdrDetn245To249RngRt1 1111;
BA_ "GenSigSendType" SG_ 240 FLR2RdrDetn245To249RngRt2 1;
BA_ "GenSigStartValue" SG_ 240 FLR2RdrDetn245To249RngRt2 1111;
BA_ "GenSigSendType" SG_ 240 FLR2RdrDetn245To249RngRt3 1;
BA_ "GenSigStartValue" SG_ 240 FLR2RdrDetn245To249RngRt3 1111;
BA_ "GenSigSendType" SG_ 240 FLR2RdrDetn245To249RngRt4 1;
BA_ "GenSigStartValue" SG_ 240 FLR2RdrDetn245To249RngRt4 1111;
BA_ "GenSigSendType" SG_ 240 FLR2RdrDetn245To249SNR0 1;
BA_ "GenSigSendType" SG_ 240 FLR2RdrDetn245To249SNR1 1;
BA_ "GenSigSendType" SG_ 240 FLR2RdrDetn245To249SNR2 1;
BA_ "GenSigSendType" SG_ 240 FLR2RdrDetn245To249SNR3 1;
BA_ "GenSigSendType" SG_ 240 FLR2RdrDetn245To249SNR4 1;
BA_ "GenSigSendType" SG_ 240 FLR2RdrDetn245To249ScanID 1;
BA_ "GenSigSendType" SG_ 242 FLR2RdrDetn250To254AziAng0 1;
BA_ "GenSigSendType" SG_ 242 FLR2RdrDetn250To254AziAng1 1;
BA_ "GenSigSendType" SG_ 242 FLR2RdrDetn250To254AziAng2 1;
BA_ "GenSigSendType" SG_ 242 FLR2RdrDetn250To254AziAng3 1;
BA_ "GenSigSendType" SG_ 242 FLR2RdrDetn250To254AziAng4 1;
BA_ "GenSigDataID" SG_ 242 FLR2RdrDetn250To254CRC "0xAEB";
BA_ "GenSigFuncType" SG_ 242 FLR2RdrDetn250To254CRC 28;
BA_ "GenSigSendType" SG_ 242 FLR2RdrDetn250To254CRC 1;
BA_ "GenSigFuncType" SG_ 242 FLR2RdrDetn250To254Counter 27;
BA_ "GenSigSendType" SG_ 242 FLR2RdrDetn250To254Counter 1;
BA_ "GenSigSendType" SG_ 242 FLR2RdrDetn250To254DynPrpty0 1;
BA_ "GenSigSendType" SG_ 242 FLR2RdrDetn250To254DynPrpty1 1;
BA_ "GenSigSendType" SG_ 242 FLR2RdrDetn250To254DynPrpty2 1;
BA_ "GenSigSendType" SG_ 242 FLR2RdrDetn250To254DynPrpty3 1;
BA_ "GenSigSendType" SG_ 242 FLR2RdrDetn250To254DynPrpty4 1;
BA_ "GenSigSendType" SG_ 242 FLR2RdrDetn250To254EleAng0 1;
BA_ "GenSigSendType" SG_ 242 FLR2RdrDetn250To254EleAng1 1;
BA_ "GenSigSendType" SG_ 242 FLR2RdrDetn250To254EleAng2 1;
BA_ "GenSigSendType" SG_ 242 FLR2RdrDetn250To254EleAng3 1;
BA_ "GenSigSendType" SG_ 242 FLR2RdrDetn250To254EleAng4 1;
BA_ "GenSigSendType" SG_ 242 FLR2RdrDetn250To254Mode0 1;
BA_ "GenSigSendType" SG_ 242 FLR2RdrDetn250To254Mode1 1;
BA_ "GenSigSendType" SG_ 242 FLR2RdrDetn250To254Mode2 1;
BA_ "GenSigSendType" SG_ 242 FLR2RdrDetn250To254Mode3 1;
BA_ "GenSigSendType" SG_ 242 FLR2RdrDetn250To254Mode4 1;
BA_ "GenSigSendType" SG_ 242 FLR2RdrDetn250To254Quality0 1;
BA_ "GenSigSendType" SG_ 242 FLR2RdrDetn250To254Quality1 1;
BA_ "GenSigSendType" SG_ 242 FLR2RdrDetn250To254Quality2 1;
BA_ "GenSigSendType" SG_ 242 FLR2RdrDetn250To254Quality3 1;
BA_ "GenSigSendType" SG_ 242 FLR2RdrDetn250To254Quality4 1;
BA_ "GenSigSendType" SG_ 242 FLR2RdrDetn250To254RCS0 1;
BA_ "GenSigStartValue" SG_ 242 FLR2RdrDetn250To254RCS0 500;
BA_ "GenSigSendType" SG_ 242 FLR2RdrDetn250To254RCS1 1;
BA_ "GenSigStartValue" SG_ 242 FLR2RdrDetn250To254RCS1 500;
BA_ "GenSigSendType" SG_ 242 FLR2RdrDetn250To254RCS2 1;
BA_ "GenSigStartValue" SG_ 242 FLR2RdrDetn250To254RCS2 500;
BA_ "GenSigSendType" SG_ 242 FLR2RdrDetn250To254RCS3 1;
BA_ "GenSigStartValue" SG_ 242 FLR2RdrDetn250To254RCS3 500;
BA_ "GenSigSendType" SG_ 242 FLR2RdrDetn250To254RCS4 1;
BA_ "GenSigStartValue" SG_ 242 FLR2RdrDetn250To254RCS4 500;
BA_ "GenSigSendType" SG_ 242 FLR2RdrDetn250To254Range0 1;
BA_ "GenSigSendType" SG_ 242 FLR2RdrDetn250To254Range1 1;
BA_ "GenSigSendType" SG_ 242 FLR2RdrDetn250To254Range2 1;
BA_ "GenSigSendType" SG_ 242 FLR2RdrDetn250To254Range3 1;
BA_ "GenSigSendType" SG_ 242 FLR2RdrDetn250To254Range4 1;
BA_ "GenSigSendType" SG_ 242 FLR2RdrDetn250To254RngRt0 1;
BA_ "GenSigStartValue" SG_ 242 FLR2RdrDetn250To254RngRt0 1111;
BA_ "GenSigSendType" SG_ 242 FLR2RdrDetn250To254RngRt1 1;
BA_ "GenSigStartValue" SG_ 242 FLR2RdrDetn250To254RngRt1 1111;
BA_ "GenSigSendType" SG_ 242 FLR2RdrDetn250To254RngRt2 1;
BA_ "GenSigStartValue" SG_ 242 FLR2RdrDetn250To254RngRt2 1111;
BA_ "GenSigSendType" SG_ 242 FLR2RdrDetn250To254RngRt3 1;
BA_ "GenSigStartValue" SG_ 242 FLR2RdrDetn250To254RngRt3 1111;
BA_ "GenSigSendType" SG_ 242 FLR2RdrDetn250To254RngRt4 1;
BA_ "GenSigStartValue" SG_ 242 FLR2RdrDetn250To254RngRt4 1111;
BA_ "GenSigSendType" SG_ 242 FLR2RdrDetn250To254SNR0 1;
BA_ "GenSigSendType" SG_ 242 FLR2RdrDetn250To254SNR1 1;
BA_ "GenSigSendType" SG_ 242 FLR2RdrDetn250To254SNR2 1;
BA_ "GenSigSendType" SG_ 242 FLR2RdrDetn250To254SNR3 1;
BA_ "GenSigSendType" SG_ 242 FLR2RdrDetn250To254SNR4 1;
BA_ "GenSigSendType" SG_ 242 FLR2RdrDetn250To254ScanID 1;
BA_ "GenSigSendType" SG_ 244 FLR2RdrDetn255To259AziAng0 1;
BA_ "GenSigSendType" SG_ 244 FLR2RdrDetn255To259AziAng1 1;
BA_ "GenSigSendType" SG_ 244 FLR2RdrDetn255To259AziAng2 1;
BA_ "GenSigSendType" SG_ 244 FLR2RdrDetn255To259AziAng3 1;
BA_ "GenSigSendType" SG_ 244 FLR2RdrDetn255To259AziAng4 1;
BA_ "GenSigDataID" SG_ 244 FLR2RdrDetn255To259CRC "0xAEC";
BA_ "GenSigFuncType" SG_ 244 FLR2RdrDetn255To259CRC 28;
BA_ "GenSigSendType" SG_ 244 FLR2RdrDetn255To259CRC 1;
BA_ "GenSigFuncType" SG_ 244 FLR2RdrDetn255To259Counter 27;
BA_ "GenSigSendType" SG_ 244 FLR2RdrDetn255To259Counter 1;
BA_ "GenSigSendType" SG_ 244 FLR2RdrDetn255To259DynPrpty0 1;
BA_ "GenSigSendType" SG_ 244 FLR2RdrDetn255To259DynPrpty1 1;
BA_ "GenSigSendType" SG_ 244 FLR2RdrDetn255To259DynPrpty2 1;
BA_ "GenSigSendType" SG_ 244 FLR2RdrDetn255To259DynPrpty3 1;
BA_ "GenSigSendType" SG_ 244 FLR2RdrDetn255To259DynPrpty4 1;
BA_ "GenSigSendType" SG_ 244 FLR2RdrDetn255To259EleAng0 1;
BA_ "GenSigSendType" SG_ 244 FLR2RdrDetn255To259EleAng1 1;
BA_ "GenSigSendType" SG_ 244 FLR2RdrDetn255To259EleAng2 1;
BA_ "GenSigSendType" SG_ 244 FLR2RdrDetn255To259EleAng3 1;
BA_ "GenSigSendType" SG_ 244 FLR2RdrDetn255To259EleAng4 1;
BA_ "GenSigSendType" SG_ 244 FLR2RdrDetn255To259Mode0 1;
BA_ "GenSigSendType" SG_ 244 FLR2RdrDetn255To259Mode1 1;
BA_ "GenSigSendType" SG_ 244 FLR2RdrDetn255To259Mode2 1;
BA_ "GenSigSendType" SG_ 244 FLR2RdrDetn255To259Mode3 1;
BA_ "GenSigSendType" SG_ 244 FLR2RdrDetn255To259Mode4 1;
BA_ "GenSigSendType" SG_ 244 FLR2RdrDetn255To259Quality0 1;
BA_ "GenSigSendType" SG_ 244 FLR2RdrDetn255To259Quality1 1;
BA_ "GenSigSendType" SG_ 244 FLR2RdrDetn255To259Quality2 1;
BA_ "GenSigSendType" SG_ 244 FLR2RdrDetn255To259Quality3 1;
BA_ "GenSigSendType" SG_ 244 FLR2RdrDetn255To259Quality4 1;
BA_ "GenSigSendType" SG_ 244 FLR2RdrDetn255To259RCS0 1;
BA_ "GenSigStartValue" SG_ 244 FLR2RdrDetn255To259RCS0 500;
BA_ "GenSigSendType" SG_ 244 FLR2RdrDetn255To259RCS1 1;
BA_ "GenSigStartValue" SG_ 244 FLR2RdrDetn255To259RCS1 500;
BA_ "GenSigSendType" SG_ 244 FLR2RdrDetn255To259RCS2 1;
BA_ "GenSigStartValue" SG_ 244 FLR2RdrDetn255To259RCS2 500;
BA_ "GenSigSendType" SG_ 244 FLR2RdrDetn255To259RCS3 1;
BA_ "GenSigStartValue" SG_ 244 FLR2RdrDetn255To259RCS3 500;
BA_ "GenSigSendType" SG_ 244 FLR2RdrDetn255To259RCS4 1;
BA_ "GenSigStartValue" SG_ 244 FLR2RdrDetn255To259RCS4 500;
BA_ "GenSigSendType" SG_ 244 FLR2RdrDetn255To259Range0 1;
BA_ "GenSigSendType" SG_ 244 FLR2RdrDetn255To259Range1 1;
BA_ "GenSigSendType" SG_ 244 FLR2RdrDetn255To259Range2 1;
BA_ "GenSigSendType" SG_ 244 FLR2RdrDetn255To259Range3 1;
BA_ "GenSigSendType" SG_ 244 FLR2RdrDetn255To259Range4 1;
BA_ "GenSigSendType" SG_ 244 FLR2RdrDetn255To259RngRt0 1;
BA_ "GenSigStartValue" SG_ 244 FLR2RdrDetn255To259RngRt0 1111;
BA_ "GenSigSendType" SG_ 244 FLR2RdrDetn255To259RngRt1 1;
BA_ "GenSigStartValue" SG_ 244 FLR2RdrDetn255To259RngRt1 1111;
BA_ "GenSigSendType" SG_ 244 FLR2RdrDetn255To259RngRt2 1;
BA_ "GenSigStartValue" SG_ 244 FLR2RdrDetn255To259RngRt2 1111;
BA_ "GenSigSendType" SG_ 244 FLR2RdrDetn255To259RngRt3 1;
BA_ "GenSigStartValue" SG_ 244 FLR2RdrDetn255To259RngRt3 1111;
BA_ "GenSigSendType" SG_ 244 FLR2RdrDetn255To259RngRt4 1;
BA_ "GenSigStartValue" SG_ 244 FLR2RdrDetn255To259RngRt4 1111;
BA_ "GenSigSendType" SG_ 244 FLR2RdrDetn255To259SNR0 1;
BA_ "GenSigSendType" SG_ 244 FLR2RdrDetn255To259SNR1 1;
BA_ "GenSigSendType" SG_ 244 FLR2RdrDetn255To259SNR2 1;
BA_ "GenSigSendType" SG_ 244 FLR2RdrDetn255To259SNR3 1;
BA_ "GenSigSendType" SG_ 244 FLR2RdrDetn255To259SNR4 1;
BA_ "GenSigSendType" SG_ 244 FLR2RdrDetn255To259ScanID 1;
BA_ "GenSigSendType" SG_ 246 FLR2RdrDetn260To264AziAng0 1;
BA_ "GenSigSendType" SG_ 246 FLR2RdrDetn260To264AziAng1 1;
BA_ "GenSigSendType" SG_ 246 FLR2RdrDetn260To264AziAng2 1;
BA_ "GenSigSendType" SG_ 246 FLR2RdrDetn260To264AziAng3 1;
BA_ "GenSigSendType" SG_ 246 FLR2RdrDetn260To264AziAng4 1;
BA_ "GenSigDataID" SG_ 246 FLR2RdrDetn260To264CRC "0xAED";
BA_ "GenSigFuncType" SG_ 246 FLR2RdrDetn260To264CRC 28;
BA_ "GenSigSendType" SG_ 246 FLR2RdrDetn260To264CRC 1;
BA_ "GenSigFuncType" SG_ 246 FLR2RdrDetn260To264Counter 27;
BA_ "GenSigSendType" SG_ 246 FLR2RdrDetn260To264Counter 1;
BA_ "GenSigSendType" SG_ 246 FLR2RdrDetn260To264DynPrpty0 1;
BA_ "GenSigSendType" SG_ 246 FLR2RdrDetn260To264DynPrpty1 1;
BA_ "GenSigSendType" SG_ 246 FLR2RdrDetn260To264DynPrpty2 1;
BA_ "GenSigSendType" SG_ 246 FLR2RdrDetn260To264DynPrpty3 1;
BA_ "GenSigSendType" SG_ 246 FLR2RdrDetn260To264DynPrpty4 1;
BA_ "GenSigSendType" SG_ 246 FLR2RdrDetn260To264EleAng0 1;
BA_ "GenSigSendType" SG_ 246 FLR2RdrDetn260To264EleAng1 1;
BA_ "GenSigSendType" SG_ 246 FLR2RdrDetn260To264EleAng2 1;
BA_ "GenSigSendType" SG_ 246 FLR2RdrDetn260To264EleAng3 1;
BA_ "GenSigSendType" SG_ 246 FLR2RdrDetn260To264EleAng4 1;
BA_ "GenSigSendType" SG_ 246 FLR2RdrDetn260To264Mode0 1;
BA_ "GenSigSendType" SG_ 246 FLR2RdrDetn260To264Mode1 1;
BA_ "GenSigSendType" SG_ 246 FLR2RdrDetn260To264Mode2 1;
BA_ "GenSigSendType" SG_ 246 FLR2RdrDetn260To264Mode3 1;
BA_ "GenSigSendType" SG_ 246 FLR2RdrDetn260To264Mode4 1;
BA_ "GenSigSendType" SG_ 246 FLR2RdrDetn260To264Quality0 1;
BA_ "GenSigSendType" SG_ 246 FLR2RdrDetn260To264Quality1 1;
BA_ "GenSigSendType" SG_ 246 FLR2RdrDetn260To264Quality2 1;
BA_ "GenSigSendType" SG_ 246 FLR2RdrDetn260To264Quality3 1;
BA_ "GenSigSendType" SG_ 246 FLR2RdrDetn260To264Quality4 1;
BA_ "GenSigSendType" SG_ 246 FLR2RdrDetn260To264RCS0 1;
BA_ "GenSigStartValue" SG_ 246 FLR2RdrDetn260To264RCS0 500;
BA_ "GenSigSendType" SG_ 246 FLR2RdrDetn260To264RCS1 1;
BA_ "GenSigStartValue" SG_ 246 FLR2RdrDetn260To264RCS1 500;
BA_ "GenSigSendType" SG_ 246 FLR2RdrDetn260To264RCS2 1;
BA_ "GenSigStartValue" SG_ 246 FLR2RdrDetn260To264RCS2 500;
BA_ "GenSigSendType" SG_ 246 FLR2RdrDetn260To264RCS3 1;
BA_ "GenSigStartValue" SG_ 246 FLR2RdrDetn260To264RCS3 500;
BA_ "GenSigSendType" SG_ 246 FLR2RdrDetn260To264RCS4 1;
BA_ "GenSigStartValue" SG_ 246 FLR2RdrDetn260To264RCS4 500;
BA_ "GenSigSendType" SG_ 246 FLR2RdrDetn260To264Range0 1;
BA_ "GenSigSendType" SG_ 246 FLR2RdrDetn260To264Range1 1;
BA_ "GenSigSendType" SG_ 246 FLR2RdrDetn260To264Range2 1;
BA_ "GenSigSendType" SG_ 246 FLR2RdrDetn260To264Range3 1;
BA_ "GenSigSendType" SG_ 246 FLR2RdrDetn260To264Range4 1;
BA_ "GenSigSendType" SG_ 246 FLR2RdrDetn260To264RngRt0 1;
BA_ "GenSigStartValue" SG_ 246 FLR2RdrDetn260To264RngRt0 1111;
BA_ "GenSigSendType" SG_ 246 FLR2RdrDetn260To264RngRt1 1;
BA_ "GenSigStartValue" SG_ 246 FLR2RdrDetn260To264RngRt1 1111;
BA_ "GenSigSendType" SG_ 246 FLR2RdrDetn260To264RngRt2 1;
BA_ "GenSigStartValue" SG_ 246 FLR2RdrDetn260To264RngRt2 1111;
BA_ "GenSigSendType" SG_ 246 FLR2RdrDetn260To264RngRt3 1;
BA_ "GenSigStartValue" SG_ 246 FLR2RdrDetn260To264RngRt3 1111;
BA_ "GenSigSendType" SG_ 246 FLR2RdrDetn260To264RngRt4 1;
BA_ "GenSigStartValue" SG_ 246 FLR2RdrDetn260To264RngRt4 1111;
BA_ "GenSigSendType" SG_ 246 FLR2RdrDetn260To264SNR0 1;
BA_ "GenSigSendType" SG_ 246 FLR2RdrDetn260To264SNR1 1;
BA_ "GenSigSendType" SG_ 246 FLR2RdrDetn260To264SNR2 1;
BA_ "GenSigSendType" SG_ 246 FLR2RdrDetn260To264SNR3 1;
BA_ "GenSigSendType" SG_ 246 FLR2RdrDetn260To264SNR4 1;
BA_ "GenSigSendType" SG_ 246 FLR2RdrDetn260To264ScanID 1;
BA_ "GenSigSendType" SG_ 248 FLR2RdrDetn265To269AziAng0 1;
BA_ "GenSigSendType" SG_ 248 FLR2RdrDetn265To269AziAng1 1;
BA_ "GenSigSendType" SG_ 248 FLR2RdrDetn265To269AziAng2 1;
BA_ "GenSigSendType" SG_ 248 FLR2RdrDetn265To269AziAng3 1;
BA_ "GenSigSendType" SG_ 248 FLR2RdrDetn265To269AziAng4 1;
BA_ "GenSigDataID" SG_ 248 FLR2RdrDetn265To269CRC "0xAEE";
BA_ "GenSigFuncType" SG_ 248 FLR2RdrDetn265To269CRC 28;
BA_ "GenSigSendType" SG_ 248 FLR2RdrDetn265To269CRC 1;
BA_ "GenSigFuncType" SG_ 248 FLR2RdrDetn265To269Counter 27;
BA_ "GenSigSendType" SG_ 248 FLR2RdrDetn265To269Counter 1;
BA_ "GenSigSendType" SG_ 248 FLR2RdrDetn265To269DynPrpty0 1;
BA_ "GenSigSendType" SG_ 248 FLR2RdrDetn265To269DynPrpty1 1;
BA_ "GenSigSendType" SG_ 248 FLR2RdrDetn265To269DynPrpty2 1;
BA_ "GenSigSendType" SG_ 248 FLR2RdrDetn265To269DynPrpty3 1;
BA_ "GenSigSendType" SG_ 248 FLR2RdrDetn265To269DynPrpty4 1;
BA_ "GenSigSendType" SG_ 248 FLR2RdrDetn265To269EleAng0 1;
BA_ "GenSigSendType" SG_ 248 FLR2RdrDetn265To269EleAng1 1;
BA_ "GenSigSendType" SG_ 248 FLR2RdrDetn265To269EleAng2 1;
BA_ "GenSigSendType" SG_ 248 FLR2RdrDetn265To269EleAng3 1;
BA_ "GenSigSendType" SG_ 248 FLR2RdrDetn265To269EleAng4 1;
BA_ "GenSigSendType" SG_ 248 FLR2RdrDetn265To269Mode0 1;
BA_ "GenSigSendType" SG_ 248 FLR2RdrDetn265To269Mode1 1;
BA_ "GenSigSendType" SG_ 248 FLR2RdrDetn265To269Mode2 1;
BA_ "GenSigSendType" SG_ 248 FLR2RdrDetn265To269Mode3 1;
BA_ "GenSigSendType" SG_ 248 FLR2RdrDetn265To269Mode4 1;
BA_ "GenSigSendType" SG_ 248 FLR2RdrDetn265To269Quality0 1;
BA_ "GenSigSendType" SG_ 248 FLR2RdrDetn265To269Quality1 1;
BA_ "GenSigSendType" SG_ 248 FLR2RdrDetn265To269Quality2 1;
BA_ "GenSigSendType" SG_ 248 FLR2RdrDetn265To269Quality3 1;
BA_ "GenSigSendType" SG_ 248 FLR2RdrDetn265To269Quality4 1;
BA_ "GenSigSendType" SG_ 248 FLR2RdrDetn265To269RCS0 1;
BA_ "GenSigStartValue" SG_ 248 FLR2RdrDetn265To269RCS0 500;
BA_ "GenSigSendType" SG_ 248 FLR2RdrDetn265To269RCS1 1;
BA_ "GenSigStartValue" SG_ 248 FLR2RdrDetn265To269RCS1 500;
BA_ "GenSigSendType" SG_ 248 FLR2RdrDetn265To269RCS2 1;
BA_ "GenSigStartValue" SG_ 248 FLR2RdrDetn265To269RCS2 500;
BA_ "GenSigSendType" SG_ 248 FLR2RdrDetn265To269RCS3 1;
BA_ "GenSigStartValue" SG_ 248 FLR2RdrDetn265To269RCS3 500;
BA_ "GenSigSendType" SG_ 248 FLR2RdrDetn265To269RCS4 1;
BA_ "GenSigStartValue" SG_ 248 FLR2RdrDetn265To269RCS4 500;
BA_ "GenSigSendType" SG_ 248 FLR2RdrDetn265To269Range0 1;
BA_ "GenSigSendType" SG_ 248 FLR2RdrDetn265To269Range1 1;
BA_ "GenSigSendType" SG_ 248 FLR2RdrDetn265To269Range2 1;
BA_ "GenSigSendType" SG_ 248 FLR2RdrDetn265To269Range3 1;
BA_ "GenSigSendType" SG_ 248 FLR2RdrDetn265To269Range4 1;
BA_ "GenSigSendType" SG_ 248 FLR2RdrDetn265To269RngRt0 1;
BA_ "GenSigStartValue" SG_ 248 FLR2RdrDetn265To269RngRt0 1111;
BA_ "GenSigSendType" SG_ 248 FLR2RdrDetn265To269RngRt1 1;
BA_ "GenSigStartValue" SG_ 248 FLR2RdrDetn265To269RngRt1 1111;
BA_ "GenSigSendType" SG_ 248 FLR2RdrDetn265To269RngRt2 1;
BA_ "GenSigStartValue" SG_ 248 FLR2RdrDetn265To269RngRt2 1111;
BA_ "GenSigSendType" SG_ 248 FLR2RdrDetn265To269RngRt3 1;
BA_ "GenSigStartValue" SG_ 248 FLR2RdrDetn265To269RngRt3 1111;
BA_ "GenSigSendType" SG_ 248 FLR2RdrDetn265To269RngRt4 1;
BA_ "GenSigStartValue" SG_ 248 FLR2RdrDetn265To269RngRt4 1111;
BA_ "GenSigSendType" SG_ 248 FLR2RdrDetn265To269SNR0 1;
BA_ "GenSigSendType" SG_ 248 FLR2RdrDetn265To269SNR1 1;
BA_ "GenSigSendType" SG_ 248 FLR2RdrDetn265To269SNR2 1;
BA_ "GenSigSendType" SG_ 248 FLR2RdrDetn265To269SNR3 1;
BA_ "GenSigSendType" SG_ 248 FLR2RdrDetn265To269SNR4 1;
BA_ "GenSigSendType" SG_ 248 FLR2RdrDetn265To269ScanID 1;
VAL_ 211 FLR2RdrDetn200To204Mode0 0 "FLR2RadrDetnMode_RngNearReslMod" 1 "FLR2RadrDetnMode_RngMidReslMod" 2 "FLR2RadrDetnMode_RngLongReslMod" 3 "FLR2RadrDetnMode_DetectionUnpopulated";
VAL_ 211 FLR2RdrDetn200To204Mode1 0 "FLR2RadrDetnMode_RngNearReslMod" 1 "FLR2RadrDetnMode_RngMidReslMod" 2 "FLR2RadrDetnMode_RngLongReslMod" 3 "FLR2RadrDetnMode_DetectionUnpopulated";
VAL_ 211 FLR2RdrDetn200To204Mode2 0 "FLR2RadrDetnMode_RngNearReslMod" 1 "FLR2RadrDetnMode_RngMidReslMod" 2 "FLR2RadrDetnMode_RngLongReslMod" 3 "FLR2RadrDetnMode_DetectionUnpopulated";
VAL_ 211 FLR2RdrDetn200To204Mode3 0 "FLR2RadrDetnMode_RngNearReslMod" 1 "FLR2RadrDetnMode_RngMidReslMod" 2 "FLR2RadrDetnMode_RngLongReslMod" 3 "FLR2RadrDetnMode_DetectionUnpopulated";
VAL_ 211 FLR2RdrDetn200To204Mode4 0 "FLR2RadrDetnMode_RngNearReslMod" 1 "FLR2RadrDetnMode_RngMidReslMod" 2 "FLR2RadrDetnMode_RngLongReslMod" 3 "FLR2RadrDetnMode_DetectionUnpopulated";
VAL_ 211 FLR2RdrDetn200To204Quality0 0 "Quality_Low" 1 "Quality_Medium" 2 "Quality_High" 3 "Quality_DetectionUnpopulated";
VAL_ 211 FLR2RdrDetn200To204Quality1 0 "Quality_Low" 1 "Quality_Medium" 2 "Quality_High" 3 "Quality_DetectionUnpopulated";
VAL_ 211 FLR2RdrDetn200To204Quality2 0 "Quality_Low" 1 "Quality_Medium" 2 "Quality_High" 3 "Quality_DetectionUnpopulated";
VAL_ 211 FLR2RdrDetn200To204Quality3 0 "Quality_Low" 1 "Quality_Medium" 2 "Quality_High" 3 "Quality_DetectionUnpopulated";
VAL_ 211 FLR2RdrDetn200To204Quality4 0 "Quality_Low" 1 "Quality_Medium" 2 "Quality_High" 3 "Quality_DetectionUnpopulated";
VAL_ 214 FLR2RdrDetn205To209Mode0 0 "FLR2RadrDetnMode_RngNearReslMod" 1 "FLR2RadrDetnMode_RngMidReslMod" 2 "FLR2RadrDetnMode_RngLongReslMod" 3 "FLR2RadrDetnMode_DetectionUnpopulated";
VAL_ 214 FLR2RdrDetn205To209Mode1 0 "FLR2RadrDetnMode_RngNearReslMod" 1 "FLR2RadrDetnMode_RngMidReslMod" 2 "FLR2RadrDetnMode_RngLongReslMod" 3 "FLR2RadrDetnMode_DetectionUnpopulated";
VAL_ 214 FLR2RdrDetn205To209Mode2 0 "FLR2RadrDetnMode_RngNearReslMod" 1 "FLR2RadrDetnMode_RngMidReslMod" 2 "FLR2RadrDetnMode_RngLongReslMod" 3 "FLR2RadrDetnMode_DetectionUnpopulated";
VAL_ 214 FLR2RdrDetn205To209Mode3 0 "FLR2RadrDetnMode_RngNearReslMod" 1 "FLR2RadrDetnMode_RngMidReslMod" 2 "FLR2RadrDetnMode_RngLongReslMod" 3 "FLR2RadrDetnMode_DetectionUnpopulated";
VAL_ 214 FLR2RdrDetn205To209Mode4 0 "FLR2RadrDetnMode_RngNearReslMod" 1 "FLR2RadrDetnMode_RngMidReslMod" 2 "FLR2RadrDetnMode_RngLongReslMod" 3 "FLR2RadrDetnMode_DetectionUnpopulated";
VAL_ 214 FLR2RdrDetn205To209Quality0 0 "Quality_Low" 1 "Quality_Medium" 2 "Quality_High" 3 "Quality_DetectionUnpopulated";
VAL_ 214 FLR2RdrDetn205To209Quality1 0 "Quality_Low" 1 "Quality_Medium" 2 "Quality_High" 3 "Quality_DetectionUnpopulated";
VAL_ 214 FLR2RdrDetn205To209Quality2 0 "Quality_Low" 1 "Quality_Medium" 2 "Quality_High" 3 "Quality_DetectionUnpopulated";
VAL_ 214 FLR2RdrDetn205To209Quality3 0 "Quality_Low" 1 "Quality_Medium" 2 "Quality_High" 3 "Quality_DetectionUnpopulated";
VAL_ 214 FLR2RdrDetn205To209Quality4 0 "Quality_Low" 1 "Quality_Medium" 2 "Quality_High" 3 "Quality_DetectionUnpopulated";
VAL_ 217 FLR2RdrDetn210To214Mode0 0 "FLR2RadrDetnMode_RngNearReslMod" 1 "FLR2RadrDetnMode_RngMidReslMod" 2 "FLR2RadrDetnMode_RngLongReslMod" 3 "FLR2RadrDetnMode_DetectionUnpopulated";
VAL_ 217 FLR2RdrDetn210To214Mode1 0 "FLR2RadrDetnMode_RngNearReslMod" 1 "FLR2RadrDetnMode_RngMidReslMod" 2 "FLR2RadrDetnMode_RngLongReslMod" 3 "FLR2RadrDetnMode_DetectionUnpopulated";
VAL_ 217 FLR2RdrDetn210To214Mode2 0 "FLR2RadrDetnMode_RngNearReslMod" 1 "FLR2RadrDetnMode_RngMidReslMod" 2 "FLR2RadrDetnMode_RngLongReslMod" 3 "FLR2RadrDetnMode_DetectionUnpopulated";
VAL_ 217 FLR2RdrDetn210To214Mode3 0 "FLR2RadrDetnMode_RngNearReslMod" 1 "FLR2RadrDetnMode_RngMidReslMod" 2 "FLR2RadrDetnMode_RngLongReslMod" 3 "FLR2RadrDetnMode_DetectionUnpopulated";
VAL_ 217 FLR2RdrDetn210To214Mode4 0 "FLR2RadrDetnMode_RngNearReslMod" 1 "FLR2RadrDetnMode_RngMidReslMod" 2 "FLR2RadrDetnMode_RngLongReslMod" 3 "FLR2RadrDetnMode_DetectionUnpopulated";
VAL_ 217 FLR2RdrDetn210To214Quality0 0 "Quality_Low" 1 "Quality_Medium" 2 "Quality_High" 3 "Quality_DetectionUnpopulated";
VAL_ 217 FLR2RdrDetn210To214Quality1 0 "Quality_Low" 1 "Quality_Medium" 2 "Quality_High" 3 "Quality_DetectionUnpopulated";
VAL_ 217 FLR2RdrDetn210To214Quality2 0 "Quality_Low" 1 "Quality_Medium" 2 "Quality_High" 3 "Quality_DetectionUnpopulated";
VAL_ 217 FLR2RdrDetn210To214Quality3 0 "Quality_Low" 1 "Quality_Medium" 2 "Quality_High" 3 "Quality_DetectionUnpopulated";
VAL_ 217 FLR2RdrDetn210To214Quality4 0 "Quality_Low" 1 "Quality_Medium" 2 "Quality_High" 3 "Quality_DetectionUnpopulated";
VAL_ 220 FLR2RdrDetn215To219Mode0 0 "FLR2RadrDetnMode_RngNearReslMod" 1 "FLR2RadrDetnMode_RngMidReslMod" 2 "FLR2RadrDetnMode_RngLongReslMod" 3 "FLR2RadrDetnMode_DetectionUnpopulated";
VAL_ 220 FLR2RdrDetn215To219Mode1 0 "FLR2RadrDetnMode_RngNearReslMod" 1 "FLR2RadrDetnMode_RngMidReslMod" 2 "FLR2RadrDetnMode_RngLongReslMod" 3 "FLR2RadrDetnMode_DetectionUnpopulated";
VAL_ 220 FLR2RdrDetn215To219Mode2 0 "FLR2RadrDetnMode_RngNearReslMod" 1 "FLR2RadrDetnMode_RngMidReslMod" 2 "FLR2RadrDetnMode_RngLongReslMod" 3 "FLR2RadrDetnMode_DetectionUnpopulated";
VAL_ 220 FLR2RdrDetn215To219Mode3 0 "FLR2RadrDetnMode_RngNearReslMod" 1 "FLR2RadrDetnMode_RngMidReslMod" 2 "FLR2RadrDetnMode_RngLongReslMod" 3 "FLR2RadrDetnMode_DetectionUnpopulated";
VAL_ 220 FLR2RdrDetn215To219Mode4 0 "FLR2RadrDetnMode_RngNearReslMod" 1 "FLR2RadrDetnMode_RngMidReslMod" 2 "FLR2RadrDetnMode_RngLongReslMod" 3 "FLR2RadrDetnMode_DetectionUnpopulated";
VAL_ 220 FLR2RdrDetn215To219Quality0 0 "Quality_Low" 1 "Quality_Medium" 2 "Quality_High" 3 "Quality_DetectionUnpopulated";
VAL_ 220 FLR2RdrDetn215To219Quality1 0 "Quality_Low" 1 "Quality_Medium" 2 "Quality_High" 3 "Quality_DetectionUnpopulated";
VAL_ 220 FLR2RdrDetn215To219Quality2 0 "Quality_Low" 1 "Quality_Medium" 2 "Quality_High" 3 "Quality_DetectionUnpopulated";
VAL_ 220 FLR2RdrDetn215To219Quality3 0 "Quality_Low" 1 "Quality_Medium" 2 "Quality_High" 3 "Quality_DetectionUnpopulated";
VAL_ 220 FLR2RdrDetn215To219Quality4 0 "Quality_Low" 1 "Quality_Medium" 2 "Quality_High" 3 "Quality_DetectionUnpopulated";
VAL_ 224 FLR2RdrDetn220To224Mode0 0 "FLR2RadrDetnMode_RngNearReslMod" 1 "FLR2RadrDetnMode_RngMidReslMod" 2 "FLR2RadrDetnMode_RngLongReslMod" 3 "FLR2RadrDetnMode_DetectionUnpopulated";
VAL_ 224 FLR2RdrDetn220To224Mode1 0 "FLR2RadrDetnMode_RngNearReslMod" 1 "FLR2RadrDetnMode_RngMidReslMod" 2 "FLR2RadrDetnMode_RngLongReslMod" 3 "FLR2RadrDetnMode_DetectionUnpopulated";
VAL_ 224 FLR2RdrDetn220To224Mode2 0 "FLR2RadrDetnMode_RngNearReslMod" 1 "FLR2RadrDetnMode_RngMidReslMod" 2 "FLR2RadrDetnMode_RngLongReslMod" 3 "FLR2RadrDetnMode_DetectionUnpopulated";
VAL_ 224 FLR2RdrDetn220To224Mode3 0 "FLR2RadrDetnMode_RngNearReslMod" 1 "FLR2RadrDetnMode_RngMidReslMod" 2 "FLR2RadrDetnMode_RngLongReslMod" 3 "FLR2RadrDetnMode_DetectionUnpopulated";
VAL_ 224 FLR2RdrDetn220To224Mode4 0 "FLR2RadrDetnMode_RngNearReslMod" 1 "FLR2RadrDetnMode_RngMidReslMod" 2 "FLR2RadrDetnMode_RngLongReslMod" 3 "FLR2RadrDetnMode_DetectionUnpopulated";
VAL_ 224 FLR2RdrDetn220To224Quality0 0 "Quality_Low" 1 "Quality_Medium" 2 "Quality_High" 3 "Quality_DetectionUnpopulated";
VAL_ 224 FLR2RdrDetn220To224Quality1 0 "Quality_Low" 1 "Quality_Medium" 2 "Quality_High" 3 "Quality_DetectionUnpopulated";
VAL_ 224 FLR2RdrDetn220To224Quality2 0 "Quality_Low" 1 "Quality_Medium" 2 "Quality_High" 3 "Quality_DetectionUnpopulated";
VAL_ 224 FLR2RdrDetn220To224Quality3 0 "Quality_Low" 1 "Quality_Medium" 2 "Quality_High" 3 "Quality_DetectionUnpopulated";
VAL_ 224 FLR2RdrDetn220To224Quality4 0 "Quality_Low" 1 "Quality_Medium" 2 "Quality_High" 3 "Quality_DetectionUnpopulated";
VAL_ 227 FLR2RdrDetn225To229Mode0 0 "FLR2RadrDetnMode_RngNearReslMod" 1 "FLR2RadrDetnMode_RngMidReslMod" 2 "FLR2RadrDetnMode_RngLongReslMod" 3 "FLR2RadrDetnMode_DetectionUnpopulated";
VAL_ 227 FLR2RdrDetn225To229Mode1 0 "FLR2RadrDetnMode_RngNearReslMod" 1 "FLR2RadrDetnMode_RngMidReslMod" 2 "FLR2RadrDetnMode_RngLongReslMod" 3 "FLR2RadrDetnMode_DetectionUnpopulated";
VAL_ 227 FLR2RdrDetn225To229Mode2 0 "FLR2RadrDetnMode_RngNearReslMod" 1 "FLR2RadrDetnMode_RngMidReslMod" 2 "FLR2RadrDetnMode_RngLongReslMod" 3 "FLR2RadrDetnMode_DetectionUnpopulated";
VAL_ 227 FLR2RdrDetn225To229Mode3 0 "FLR2RadrDetnMode_RngNearReslMod" 1 "FLR2RadrDetnMode_RngMidReslMod" 2 "FLR2RadrDetnMode_RngLongReslMod" 3 "FLR2RadrDetnMode_DetectionUnpopulated";
VAL_ 227 FLR2RdrDetn225To229Mode4 0 "FLR2RadrDetnMode_RngNearReslMod" 1 "FLR2RadrDetnMode_RngMidReslMod" 2 "FLR2RadrDetnMode_RngLongReslMod" 3 "FLR2RadrDetnMode_DetectionUnpopulated";
VAL_ 227 FLR2RdrDetn225To229Quality0 0 "Quality_Low" 1 "Quality_Medium" 2 "Quality_High" 3 "Quality_DetectionUnpopulated";
VAL_ 227 FLR2RdrDetn225To229Quality1 0 "Quality_Low" 1 "Quality_Medium" 2 "Quality_High" 3 "Quality_DetectionUnpopulated";
VAL_ 227 FLR2RdrDetn225To229Quality2 0 "Quality_Low" 1 "Quality_Medium" 2 "Quality_High" 3 "Quality_DetectionUnpopulated";
VAL_ 227 FLR2RdrDetn225To229Quality3 0 "Quality_Low" 1 "Quality_Medium" 2 "Quality_High" 3 "Quality_DetectionUnpopulated";
VAL_ 227 FLR2RdrDetn225To229Quality4 0 "Quality_Low" 1 "Quality_Medium" 2 "Quality_High" 3 "Quality_DetectionUnpopulated";
VAL_ 230 FLR2RdrDetn230To234Mode0 0 "FLR2RadrDetnMode_RngNearReslMod" 1 "FLR2RadrDetnMode_RngMidReslMod" 2 "FLR2RadrDetnMode_RngLongReslMod" 3 "FLR2RadrDetnMode_DetectionUnpopulated";
VAL_ 230 FLR2RdrDetn230To234Mode1 0 "FLR2RadrDetnMode_RngNearReslMod" 1 "FLR2RadrDetnMode_RngMidReslMod" 2 "FLR2RadrDetnMode_RngLongReslMod" 3 "FLR2RadrDetnMode_DetectionUnpopulated";
VAL_ 230 FLR2RdrDetn230To234Mode2 0 "FLR2RadrDetnMode_RngNearReslMod" 1 "FLR2RadrDetnMode_RngMidReslMod" 2 "FLR2RadrDetnMode_RngLongReslMod" 3 "FLR2RadrDetnMode_DetectionUnpopulated";
VAL_ 230 FLR2RdrDetn230To234Mode3 0 "FLR2RadrDetnMode_RngNearReslMod" 1 "FLR2RadrDetnMode_RngMidReslMod" 2 "FLR2RadrDetnMode_RngLongReslMod" 3 "FLR2RadrDetnMode_DetectionUnpopulated";
VAL_ 230 FLR2RdrDetn230To234Mode4 0 "FLR2RadrDetnMode_RngNearReslMod" 1 "FLR2RadrDetnMode_RngMidReslMod" 2 "FLR2RadrDetnMode_RngLongReslMod" 3 "FLR2RadrDetnMode_DetectionUnpopulated";
VAL_ 230 FLR2RdrDetn230To234Quality0 0 "Quality_Low" 1 "Quality_Medium" 2 "Quality_High" 3 "Quality_DetectionUnpopulated";
VAL_ 230 FLR2RdrDetn230To234Quality1 0 "Quality_Low" 1 "Quality_Medium" 2 "Quality_High" 3 "Quality_DetectionUnpopulated";
VAL_ 230 FLR2RdrDetn230To234Quality2 0 "Quality_Low" 1 "Quality_Medium" 2 "Quality_High" 3 "Quality_DetectionUnpopulated";
VAL_ 230 FLR2RdrDetn230To234Quality3 0 "Quality_Low" 1 "Quality_Medium" 2 "Quality_High" 3 "Quality_DetectionUnpopulated";
VAL_ 230 FLR2RdrDetn230To234Quality4 0 "Quality_Low" 1 "Quality_Medium" 2 "Quality_High" 3 "Quality_DetectionUnpopulated";
VAL_ 233 FLR2RdrDetn235To239Mode0 0 "FLR2RadrDetnMode_RngNearReslMod" 1 "FLR2RadrDetnMode_RngMidReslMod" 2 "FLR2RadrDetnMode_RngLongReslMod" 3 "FLR2RadrDetnMode_DetectionUnpopulated";
VAL_ 233 FLR2RdrDetn235To239Mode1 0 "FLR2RadrDetnMode_RngNearReslMod" 1 "FLR2RadrDetnMode_RngMidReslMod" 2 "FLR2RadrDetnMode_RngLongReslMod" 3 "FLR2RadrDetnMode_DetectionUnpopulated";
VAL_ 233 FLR2RdrDetn235To239Mode2 0 "FLR2RadrDetnMode_RngNearReslMod" 1 "FLR2RadrDetnMode_RngMidReslMod" 2 "FLR2RadrDetnMode_RngLongReslMod" 3 "FLR2RadrDetnMode_DetectionUnpopulated";
VAL_ 233 FLR2RdrDetn235To239Mode3 0 "FLR2RadrDetnMode_RngNearReslMod" 1 "FLR2RadrDetnMode_RngMidReslMod" 2 "FLR2RadrDetnMode_RngLongReslMod" 3 "FLR2RadrDetnMode_DetectionUnpopulated";
VAL_ 233 FLR2RdrDetn235To239Mode4 0 "FLR2RadrDetnMode_RngNearReslMod" 1 "FLR2RadrDetnMode_RngMidReslMod" 2 "FLR2RadrDetnMode_RngLongReslMod" 3 "FLR2RadrDetnMode_DetectionUnpopulated";
VAL_ 233 FLR2RdrDetn235To239Quality0 0 "Quality_Low" 1 "Quality_Medium" 2 "Quality_High" 3 "Quality_DetectionUnpopulated";
VAL_ 233 FLR2RdrDetn235To239Quality1 0 "Quality_Low" 1 "Quality_Medium" 2 "Quality_High" 3 "Quality_DetectionUnpopulated";
VAL_ 233 FLR2RdrDetn235To239Quality2 0 "Quality_Low" 1 "Quality_Medium" 2 "Quality_High" 3 "Quality_DetectionUnpopulated";
VAL_ 233 FLR2RdrDetn235To239Quality3 0 "Quality_Low" 1 "Quality_Medium" 2 "Quality_High" 3 "Quality_DetectionUnpopulated";
VAL_ 233 FLR2RdrDetn235To239Quality4 0 "Quality_Low" 1 "Quality_Medium" 2 "Quality_High" 3 "Quality_DetectionUnpopulated";
VAL_ 236 FLR2RdrDetn240To244Mode0 0 "FLR2RadrDetnMode_RngNearReslMod" 1 "FLR2RadrDetnMode_RngMidReslMod" 2 "FLR2RadrDetnMode_RngLongReslMod" 3 "FLR2RadrDetnMode_DetectionUnpopulated";
VAL_ 236 FLR2RdrDetn240To244Mode1 0 "FLR2RadrDetnMode_RngNearReslMod" 1 "FLR2RadrDetnMode_RngMidReslMod" 2 "FLR2RadrDetnMode_RngLongReslMod" 3 "FLR2RadrDetnMode_DetectionUnpopulated";
VAL_ 236 FLR2RdrDetn240To244Mode2 0 "FLR2RadrDetnMode_RngNearReslMod" 1 "FLR2RadrDetnMode_RngMidReslMod" 2 "FLR2RadrDetnMode_RngLongReslMod" 3 "FLR2RadrDetnMode_DetectionUnpopulated";
VAL_ 236 FLR2RdrDetn240To244Mode3 0 "FLR2RadrDetnMode_RngNearReslMod" 1 "FLR2RadrDetnMode_RngMidReslMod" 2 "FLR2RadrDetnMode_RngLongReslMod" 3 "FLR2RadrDetnMode_DetectionUnpopulated";
VAL_ 236 FLR2RdrDetn240To244Mode4 0 "FLR2RadrDetnMode_RngNearReslMod" 1 "FLR2RadrDetnMode_RngMidReslMod" 2 "FLR2RadrDetnMode_RngLongReslMod" 3 "FLR2RadrDetnMode_DetectionUnpopulated";
VAL_ 236 FLR2RdrDetn240To244Quality0 0 "Quality_Low" 1 "Quality_Medium" 2 "Quality_High" 3 "Quality_DetectionUnpopulated";
VAL_ 236 FLR2RdrDetn240To244Quality1 0 "Quality_Low" 1 "Quality_Medium" 2 "Quality_High" 3 "Quality_DetectionUnpopulated";
VAL_ 236 FLR2RdrDetn240To244Quality2 0 "Quality_Low" 1 "Quality_Medium" 2 "Quality_High" 3 "Quality_DetectionUnpopulated";
VAL_ 236 FLR2RdrDetn240To244Quality3 0 "Quality_Low" 1 "Quality_Medium" 2 "Quality_High" 3 "Quality_DetectionUnpopulated";
VAL_ 236 FLR2RdrDetn240To244Quality4 0 "Quality_Low" 1 "Quality_Medium" 2 "Quality_High" 3 "Quality_DetectionUnpopulated";
VAL_ 240 FLR2RdrDetn245To249Mode0 0 "FLR2RadrDetnMode_RngNearReslMod" 1 "FLR2RadrDetnMode_RngMidReslMod" 2 "FLR2RadrDetnMode_RngLongReslMod" 3 "FLR2RadrDetnMode_DetectionUnpopulated";
VAL_ 240 FLR2RdrDetn245To249Mode1 0 "FLR2RadrDetnMode_RngNearReslMod" 1 "FLR2RadrDetnMode_RngMidReslMod" 2 "FLR2RadrDetnMode_RngLongReslMod" 3 "FLR2RadrDetnMode_DetectionUnpopulated";
VAL_ 240 FLR2RdrDetn245To249Mode2 0 "FLR2RadrDetnMode_RngNearReslMod" 1 "FLR2RadrDetnMode_RngMidReslMod" 2 "FLR2RadrDetnMode_RngLongReslMod" 3 "FLR2RadrDetnMode_DetectionUnpopulated";
VAL_ 240 FLR2RdrDetn245To249Mode3 0 "FLR2RadrDetnMode_RngNearReslMod" 1 "FLR2RadrDetnMode_RngMidReslMod" 2 "FLR2RadrDetnMode_RngLongReslMod" 3 "FLR2RadrDetnMode_DetectionUnpopulated";
VAL_ 240 FLR2RdrDetn245To249Mode4 0 "FLR2RadrDetnMode_RngNearReslMod" 1 "FLR2RadrDetnMode_RngMidReslMod" 2 "FLR2RadrDetnMode_RngLongReslMod" 3 "FLR2RadrDetnMode_DetectionUnpopulated";
VAL_ 240 FLR2RdrDetn245To249Quality0 0 "Quality_Low" 1 "Quality_Medium" 2 "Quality_High" 3 "Quality_DetectionUnpopulated";
VAL_ 240 FLR2RdrDetn245To249Quality1 0 "Quality_Low" 1 "Quality_Medium" 2 "Quality_High" 3 "Quality_DetectionUnpopulated";
VAL_ 240 FLR2RdrDetn245To249Quality2 0 "Quality_Low" 1 "Quality_Medium" 2 "Quality_High" 3 "Quality_DetectionUnpopulated";
VAL_ 240 FLR2RdrDetn245To249Quality3 0 "Quality_Low" 1 "Quality_Medium" 2 "Quality_High" 3 "Quality_DetectionUnpopulated";
VAL_ 240 FLR2RdrDetn245To249Quality4 0 "Quality_Low" 1 "Quality_Medium" 2 "Quality_High" 3 "Quality_DetectionUnpopulated";
VAL_ 242 FLR2RdrDetn250To254Mode0 0 "FLR2RadrDetnMode_RngNearReslMod" 1 "FLR2RadrDetnMode_RngMidReslMod" 2 "FLR2RadrDetnMode_RngLongReslMod" 3 "FLR2RadrDetnMode_DetectionUnpopulated";
VAL_ 242 FLR2RdrDetn250To254Mode1 0 "FLR2RadrDetnMode_RngNearReslMod" 1 "FLR2RadrDetnMode_RngMidReslMod" 2 "FLR2RadrDetnMode_RngLongReslMod" 3 "FLR2RadrDetnMode_DetectionUnpopulated";
VAL_ 242 FLR2RdrDetn250To254Mode2 0 "FLR2RadrDetnMode_RngNearReslMod" 1 "FLR2RadrDetnMode_RngMidReslMod" 2 "FLR2RadrDetnMode_RngLongReslMod" 3 "FLR2RadrDetnMode_DetectionUnpopulated";
VAL_ 242 FLR2RdrDetn250To254Mode3 0 "FLR2RadrDetnMode_RngNearReslMod" 1 "FLR2RadrDetnMode_RngMidReslMod" 2 "FLR2RadrDetnMode_RngLongReslMod" 3 "FLR2RadrDetnMode_DetectionUnpopulated";
VAL_ 242 FLR2RdrDetn250To254Mode4 0 "FLR2RadrDetnMode_RngNearReslMod" 1 "FLR2RadrDetnMode_RngMidReslMod" 2 "FLR2RadrDetnMode_RngLongReslMod" 3 "FLR2RadrDetnMode_DetectionUnpopulated";
VAL_ 242 FLR2RdrDetn250To254Quality0 0 "Quality_Low" 1 "Quality_Medium" 2 "Quality_High" 3 "Quality_DetectionUnpopulated";
VAL_ 242 FLR2RdrDetn250To254Quality1 0 "Quality_Low" 1 "Quality_Medium" 2 "Quality_High" 3 "Quality_DetectionUnpopulated";
VAL_ 242 FLR2RdrDetn250To254Quality2 0 "Quality_Low" 1 "Quality_Medium" 2 "Quality_High" 3 "Quality_DetectionUnpopulated";
VAL_ 242 FLR2RdrDetn250To254Quality3 0 "Quality_Low" 1 "Quality_Medium" 2 "Quality_High" 3 "Quality_DetectionUnpopulated";
VAL_ 242 FLR2RdrDetn250To254Quality4 0 "Quality_Low" 1 "Quality_Medium" 2 "Quality_High" 3 "Quality_DetectionUnpopulated";
VAL_ 244 FLR2RdrDetn255To259Mode0 0 "FLR2RadrDetnMode_RngNearReslMod" 1 "FLR2RadrDetnMode_RngMidReslMod" 2 "FLR2RadrDetnMode_RngLongReslMod" 3 "FLR2RadrDetnMode_DetectionUnpopulated";
VAL_ 244 FLR2RdrDetn255To259Mode1 0 "FLR2RadrDetnMode_RngNearReslMod" 1 "FLR2RadrDetnMode_RngMidReslMod" 2 "FLR2RadrDetnMode_RngLongReslMod" 3 "FLR2RadrDetnMode_DetectionUnpopulated";
VAL_ 244 FLR2RdrDetn255To259Mode2 0 "FLR2RadrDetnMode_RngNearReslMod" 1 "FLR2RadrDetnMode_RngMidReslMod" 2 "FLR2RadrDetnMode_RngLongReslMod" 3 "FLR2RadrDetnMode_DetectionUnpopulated";
VAL_ 244 FLR2RdrDetn255To259Mode3 0 "FLR2RadrDetnMode_RngNearReslMod" 1 "FLR2RadrDetnMode_RngMidReslMod" 2 "FLR2RadrDetnMode_RngLongReslMod" 3 "FLR2RadrDetnMode_DetectionUnpopulated";
VAL_ 244 FLR2RdrDetn255To259Mode4 0 "FLR2RadrDetnMode_RngNearReslMod" 1 "FLR2RadrDetnMode_RngMidReslMod" 2 "FLR2RadrDetnMode_RngLongReslMod" 3 "FLR2RadrDetnMode_DetectionUnpopulated";
VAL_ 244 FLR2RdrDetn255To259Quality0 0 "Quality_Low" 1 "Quality_Medium" 2 "Quality_High" 3 "Quality_DetectionUnpopulated";
VAL_ 244 FLR2RdrDetn255To259Quality1 0 "Quality_Low" 1 "Quality_Medium" 2 "Quality_High" 3 "Quality_DetectionUnpopulated";
VAL_ 244 FLR2RdrDetn255To259Quality2 0 "Quality_Low" 1 "Quality_Medium" 2 "Quality_High" 3 "Quality_DetectionUnpopulated";
VAL_ 244 FLR2RdrDetn255To259Quality3 0 "Quality_Low" 1 "Quality_Medium" 2 "Quality_High" 3 "Quality_DetectionUnpopulated";
VAL_ 244 FLR2RdrDetn255To259Quality4 0 "Quality_Low" 1 "Quality_Medium" 2 "Quality_High" 3 "Quality_DetectionUnpopulated";
VAL_ 246 FLR2RdrDetn260To264Mode0 0 "FLR2RadrDetnMode_RngNearReslMod" 1 "FLR2RadrDetnMode_RngMidReslMod" 2 "FLR2RadrDetnMode_RngLongReslMod" 3 "FLR2RadrDetnMode_DetectionUnpopulated";
VAL_ 246 FLR2RdrDetn260To264Mode1 0 "FLR2RadrDetnMode_RngNearReslMod" 1 "FLR2RadrDetnMode_RngMidReslMod" 2 "FLR2RadrDetnMode_RngLongReslMod" 3 "FLR2RadrDetnMode_DetectionUnpopulated";
VAL_ 246 FLR2RdrDetn260To264Mode2 0 "FLR2RadrDetnMode_RngNearReslMod" 1 "FLR2RadrDetnMode_RngMidReslMod" 2 "FLR2RadrDetnMode_RngLongReslMod" 3 "FLR2RadrDetnMode_DetectionUnpopulated";
VAL_ 246 FLR2RdrDetn260To264Mode3 0 "FLR2RadrDetnMode_RngNearReslMod" 1 "FLR2RadrDetnMode_RngMidReslMod" 2 "FLR2RadrDetnMode_RngLongReslMod" 3 "FLR2RadrDetnMode_DetectionUnpopulated";
VAL_ 246 FLR2RdrDetn260To264Mode4 0 "FLR2RadrDetnMode_RngNearReslMod" 1 "FLR2RadrDetnMode_RngMidReslMod" 2 "FLR2RadrDetnMode_RngLongReslMod" 3 "FLR2RadrDetnMode_DetectionUnpopulated";
VAL_ 246 FLR2RdrDetn260To264Quality0 0 "Quality_Low" 1 "Quality_Medium" 2 "Quality_High" 3 "Quality_DetectionUnpopulated";
VAL_ 246 FLR2RdrDetn260To264Quality1 0 "Quality_Low" 1 "Quality_Medium" 2 "Quality_High" 3 "Quality_DetectionUnpopulated";
VAL_ 246 FLR2RdrDetn260To264Quality2 0 "Quality_Low" 1 "Quality_Medium" 2 "Quality_High" 3 "Quality_DetectionUnpopulated";
VAL_ 246 FLR2RdrDetn260To264Quality3 0 "Quality_Low" 1 "Quality_Medium" 2 "Quality_High" 3 "Quality_DetectionUnpopulated";
VAL_ 246 FLR2RdrDetn260To264Quality4 0 "Quality_Low" 1 "Quality_Medium" 2 "Quality_High" 3 "Quality_DetectionUnpopulated";
VAL_ 248 FLR2RdrDetn265To269Mode0 0 "FLR2RadrDetnMode_RngNearReslMod" 1 "FLR2RadrDetnMode_RngMidReslMod" 2 "FLR2RadrDetnMode_RngLongReslMod" 3 "FLR2RadrDetnMode_DetectionUnpopulated";
VAL_ 248 FLR2RdrDetn265To269Mode1 0 "FLR2RadrDetnMode_RngNearReslMod" 1 "FLR2RadrDetnMode_RngMidReslMod" 2 "FLR2RadrDetnMode_RngLongReslMod" 3 "FLR2RadrDetnMode_DetectionUnpopulated";
VAL_ 248 FLR2RdrDetn265To269Mode2 0 "FLR2RadrDetnMode_RngNearReslMod" 1 "FLR2RadrDetnMode_RngMidReslMod" 2 "FLR2RadrDetnMode_RngLongReslMod" 3 "FLR2RadrDetnMode_DetectionUnpopulated";
VAL_ 248 FLR2RdrDetn265To269Mode3 0 "FLR2RadrDetnMode_RngNearReslMod" 1 "FLR2RadrDetnMode_RngMidReslMod" 2 "FLR2RadrDetnMode_RngLongReslMod" 3 "FLR2RadrDetnMode_DetectionUnpopulated";
VAL_ 248 FLR2RdrDetn265To269Mode4 0 "FLR2RadrDetnMode_RngNearReslMod" 1 "FLR2RadrDetnMode_RngMidReslMod" 2 "FLR2RadrDetnMode_RngLongReslMod" 3 "FLR2RadrDetnMode_DetectionUnpopulated";
VAL_ 248 FLR2RdrDetn265To269Quality0 0 "Quality_Low" 1 "Quality_Medium" 2 "Quality_High" 3 "Quality_DetectionUnpopulated";
VAL_ 248 FLR2RdrDetn265To269Quality1 0 "Quality_Low" 1 "Quality_Medium" 2 "Quality_High" 3 "Quality_DetectionUnpopulated";
VAL_ 248 FLR2RdrDetn265To269Quality2 0 "Quality_Low" 1 "Quality_Medium" 2 "Quality_High" 3 "Quality_DetectionUnpopulated";
VAL_ 248 FLR2RdrDetn265To269Quality3 0 "Quality_Low" 1 "Quality_Medium" 2 "Quality_High" 3 "Quality_DetectionUnpopulated";
VAL_ 248 FLR2RdrDetn265To269Quality4 0 "Quality_Low" 1 "Quality_Medium" 2 "Quality_High" 3 "Quality_DetectionUnpopulated";
SIG_GROUP_ 211 FLR2RdrDetn200To204 1 : FLR2RdrDetn200To204AziAng0 FLR2RdrDetn200To204AziAng1 FLR2RdrDetn200To204AziAng2 FLR2RdrDetn200To204AziAng3 FLR2RdrDetn200To204AziAng4 FLR2RdrDetn200To204Counter FLR2RdrDetn200To204CRC FLR2RdrDetn200To204DynPrpty0 FLR2RdrDetn200To204DynPrpty1 FLR2RdrDetn200To204DynPrpty2 FLR2RdrDetn200To204DynPrpty3 FLR2RdrDetn200To204DynPrpty4 FLR2RdrDetn200To204EleAng0 FLR2RdrDetn200To204EleAng1 FLR2RdrDetn200To204EleAng2 FLR2RdrDetn200To204EleAng3 FLR2RdrDetn200To204EleAng4 FLR2RdrDetn200To204Mode0 FLR2RdrDetn200To204Mode1 FLR2RdrDetn200To204Mode2 FLR2RdrDetn200To204Mode3 FLR2RdrDetn200To204Mode4 FLR2RdrDetn200To204Quality0 FLR2RdrDetn200To204Quality1 FLR2RdrDetn200To204Quality2 FLR2RdrDetn200To204Quality3 FLR2RdrDetn200To204Quality4 FLR2RdrDetn200To204Range0 FLR2RdrDetn200To204Range1 FLR2RdrDetn200To204Range2 FLR2RdrDetn200To204Range3 FLR2RdrDetn200To204Range4 FLR2RdrDetn200To204RCS0 FLR2RdrDetn200To204RCS1 FLR2RdrDetn200To204RCS2 FLR2RdrDetn200To204RCS3 FLR2RdrDetn200To204RCS4 FLR2RdrDetn200To204RngRt0 FLR2RdrDetn200To204RngRt1 FLR2RdrDetn200To204RngRt2 FLR2RdrDetn200To204RngRt3 FLR2RdrDetn200To204RngRt4 FLR2RdrDetn200To204ScanID FLR2RdrDetn200To204SNR0 FLR2RdrDetn200To204SNR1 FLR2RdrDetn200To204SNR2 FLR2RdrDetn200To204SNR3 FLR2RdrDetn200To204SNR4;
SIG_GROUP_ 214 FLR2RdrDetn205To209 1 : FLR2RdrDetn205To209AziAng0 FLR2RdrDetn205To209AziAng1 FLR2RdrDetn205To209AziAng2 FLR2RdrDetn205To209AziAng3 FLR2RdrDetn205To209AziAng4 FLR2RdrDetn205To209Counter FLR2RdrDetn205To209CRC FLR2RdrDetn205To209DynPrpty0 FLR2RdrDetn205To209DynPrpty1 FLR2RdrDetn205To209DynPrpty2 FLR2RdrDetn205To209DynPrpty3 FLR2RdrDetn205To209DynPrpty4 FLR2RdrDetn205To209EleAng0 FLR2RdrDetn205To209EleAng1 FLR2RdrDetn205To209EleAng2 FLR2RdrDetn205To209EleAng3 FLR2RdrDetn205To209EleAng4 FLR2RdrDetn205To209Mode0 FLR2RdrDetn205To209Mode1 FLR2RdrDetn205To209Mode2 FLR2RdrDetn205To209Mode3 FLR2RdrDetn205To209Mode4 FLR2RdrDetn205To209Quality0 FLR2RdrDetn205To209Quality1 FLR2RdrDetn205To209Quality2 FLR2RdrDetn205To209Quality3 FLR2RdrDetn205To209Quality4 FLR2RdrDetn205To209Range0 FLR2RdrDetn205To209Range1 FLR2RdrDetn205To209Range2 FLR2RdrDetn205To209Range3 FLR2RdrDetn205To209Range4 FLR2RdrDetn205To209RCS0 FLR2RdrDetn205To209RCS1 FLR2RdrDetn205To209RCS2 FLR2RdrDetn205To209RCS3 FLR2RdrDetn205To209RCS4 FLR2RdrDetn205To209RngRt0 FLR2RdrDetn205To209RngRt1 FLR2RdrDetn205To209RngRt2 FLR2RdrDetn205To209RngRt3 FLR2RdrDetn205To209RngRt4 FLR2RdrDetn205To209ScanID FLR2RdrDetn205To209SNR0 FLR2RdrDetn205To209SNR1 FLR2RdrDetn205To209SNR2 FLR2RdrDetn205To209SNR3 FLR2RdrDetn205To209SNR4;
SIG_GROUP_ 217 FLR2RdrDetn210To214 1 : FLR2RdrDetn210To214AziAng0 FLR2RdrDetn210To214AziAng1 FLR2RdrDetn210To214AziAng2 FLR2RdrDetn210To214AziAng3 FLR2RdrDetn210To214AziAng4 FLR2RdrDetn210To214Counter FLR2RdrDetn210To214CRC FLR2RdrDetn210To214DynPrpty0 FLR2RdrDetn210To214DynPrpty1 FLR2RdrDetn210To214DynPrpty2 FLR2RdrDetn210To214DynPrpty3 FLR2RdrDetn210To214DynPrpty4 FLR2RdrDetn210To214EleAng0 FLR2RdrDetn210To214EleAng1 FLR2RdrDetn210To214EleAng2 FLR2RdrDetn210To214EleAng3 FLR2RdrDetn210To214EleAng4 FLR2RdrDetn210To214Mode0 FLR2RdrDetn210To214Mode1 FLR2RdrDetn210To214Mode2 FLR2RdrDetn210To214Mode3 FLR2RdrDetn210To214Mode4 FLR2RdrDetn210To214Quality0 FLR2RdrDetn210To214Quality1 FLR2RdrDetn210To214Quality2 FLR2RdrDetn210To214Quality3 FLR2RdrDetn210To214Quality4 FLR2RdrDetn210To214Range0 FLR2RdrDetn210To214Range1 FLR2RdrDetn210To214Range2 FLR2RdrDetn210To214Range3 FLR2RdrDetn210To214Range4 FLR2RdrDetn210To214RCS0 FLR2RdrDetn210To214RCS1 FLR2RdrDetn210To214RCS2 FLR2RdrDetn210To214RCS3 FLR2RdrDetn210To214RCS4 FLR2RdrDetn210To214RngRt0 FLR2RdrDetn210To214RngRt1 FLR2RdrDetn210To214RngRt2 FLR2RdrDetn210To214RngRt3 FLR2RdrDetn210To214RngRt4 FLR2RdrDetn210To214ScanID FLR2RdrDetn210To214SNR0 FLR2RdrDetn210To214SNR1 FLR2RdrDetn210To214SNR2 FLR2RdrDetn210To214SNR3 FLR2RdrDetn210To214SNR4;
SIG_GROUP_ 220 FLR2RdrDetn215To219 1 : FLR2RdrDetn215To219AziAng0 FLR2RdrDetn215To219AziAng1 FLR2RdrDetn215To219AziAng2 FLR2RdrDetn215To219AziAng3 FLR2RdrDetn215To219AziAng4 FLR2RdrDetn215To219Counter FLR2RdrDetn215To219CRC FLR2RdrDetn215To219DynPrpty0 FLR2RdrDetn215To219DynPrpty1 FLR2RdrDetn215To219DynPrpty2 FLR2RdrDetn215To219DynPrpty3 FLR2RdrDetn215To219DynPrpty4 FLR2RdrDetn215To219EleAng0 FLR2RdrDetn215To219EleAng1 FLR2RdrDetn215To219EleAng2 FLR2RdrDetn215To219EleAng3 FLR2RdrDetn215To219EleAng4 FLR2RdrDetn215To219Mode0 FLR2RdrDetn215To219Mode1 FLR2RdrDetn215To219Mode2 FLR2RdrDetn215To219Mode3 FLR2RdrDetn215To219Mode4 FLR2RdrDetn215To219Quality0 FLR2RdrDetn215To219Quality1 FLR2RdrDetn215To219Quality2 FLR2RdrDetn215To219Quality3 FLR2RdrDetn215To219Quality4 FLR2RdrDetn215To219Range0 FLR2RdrDetn215To219Range1 FLR2RdrDetn215To219Range2 FLR2RdrDetn215To219Range3 FLR2RdrDetn215To219Range4 FLR2RdrDetn215To219RCS0 FLR2RdrDetn215To219RCS1 FLR2RdrDetn215To219RCS2 FLR2RdrDetn215To219RCS3 FLR2RdrDetn215To219RCS4 FLR2RdrDetn215To219RngRt0 FLR2RdrDetn215To219RngRt1 FLR2RdrDetn215To219RngRt2 FLR2RdrDetn215To219RngRt3 FLR2RdrDetn215To219RngRt4 FLR2RdrDetn215To219ScanID FLR2RdrDetn215To219SNR0 FLR2RdrDetn215To219SNR1 FLR2RdrDetn215To219SNR2 FLR2RdrDetn215To219SNR3 FLR2RdrDetn215To219SNR4;
SIG_GROUP_ 224 FLR2RdrDetn220To224 1 : FLR2RdrDetn220To224AziAng0 FLR2RdrDetn220To224AziAng1 FLR2RdrDetn220To224AziAng2 FLR2RdrDetn220To224AziAng3 FLR2RdrDetn220To224AziAng4 FLR2RdrDetn220To224Counter FLR2RdrDetn220To224CRC FLR2RdrDetn220To224DynPrpty0 FLR2RdrDetn220To224DynPrpty1 FLR2RdrDetn220To224DynPrpty2 FLR2RdrDetn220To224DynPrpty3 FLR2RdrDetn220To224DynPrpty4 FLR2RdrDetn220To224EleAng0 FLR2RdrDetn220To224EleAng1 FLR2RdrDetn220To224EleAng2 FLR2RdrDetn220To224EleAng3 FLR2RdrDetn220To224EleAng4 FLR2RdrDetn220To224Mode0 FLR2RdrDetn220To224Mode1 FLR2RdrDetn220To224Mode2 FLR2RdrDetn220To224Mode3 FLR2RdrDetn220To224Mode4 FLR2RdrDetn220To224Quality0 FLR2RdrDetn220To224Quality1 FLR2RdrDetn220To224Quality2 FLR2RdrDetn220To224Quality3 FLR2RdrDetn220To224Quality4 FLR2RdrDetn220To224Range0 FLR2RdrDetn220To224Range1 FLR2RdrDetn220To224Range2 FLR2RdrDetn220To224Range3 FLR2RdrDetn220To224Range4 FLR2RdrDetn220To224RCS0 FLR2RdrDetn220To224RCS1 FLR2RdrDetn220To224RCS2 FLR2RdrDetn220To224RCS3 FLR2RdrDetn220To224RCS4 FLR2RdrDetn220To224RngRt0 FLR2RdrDetn220To224RngRt1 FLR2RdrDetn220To224RngRt2 FLR2RdrDetn220To224RngRt3 FLR2RdrDetn220To224RngRt4 FLR2RdrDetn220To224ScanID FLR2RdrDetn220To224SNR0 FLR2RdrDetn220To224SNR1 FLR2RdrDetn220To224SNR2 FLR2RdrDetn220To224SNR3 FLR2RdrDetn220To224SNR4;
SIG_GROUP_ 227 FLR2RdrDetn225To229 1 : FLR2RdrDetn225To229AziAng0 FLR2RdrDetn225To229AziAng1 FLR2RdrDetn225To229AziAng2 FLR2RdrDetn225To229AziAng3 FLR2RdrDetn225To229AziAng4 FLR2RdrDetn225To229Counter FLR2RdrDetn225To229CRC FLR2RdrDetn225To229DynPrpty0 FLR2RdrDetn225To229DynPrpty1 FLR2RdrDetn225To229DynPrpty2 FLR2RdrDetn225To229DynPrpty3 FLR2RdrDetn225To229DynPrpty4 FLR2RdrDetn225To229EleAng0 FLR2RdrDetn225To229EleAng1 FLR2RdrDetn225To229EleAng2 FLR2RdrDetn225To229EleAng3 FLR2RdrDetn225To229EleAng4 FLR2RdrDetn225To229Mode0 FLR2RdrDetn225To229Mode1 FLR2RdrDetn225To229Mode2 FLR2RdrDetn225To229Mode3 FLR2RdrDetn225To229Mode4 FLR2RdrDetn225To229Quality0 FLR2RdrDetn225To229Quality1 FLR2RdrDetn225To229Quality2 FLR2RdrDetn225To229Quality3 FLR2RdrDetn225To229Quality4 FLR2RdrDetn225To229Range0 FLR2RdrDetn225To229Range1 FLR2RdrDetn225To229Range2 FLR2RdrDetn225To229Range3 FLR2RdrDetn225To229Range4 FLR2RdrDetn225To229RCS0 FLR2RdrDetn225To229RCS1 FLR2RdrDetn225To229RCS2 FLR2RdrDetn225To229RCS3 FLR2RdrDetn225To229RCS4 FLR2RdrDetn225To229RngRt0 FLR2RdrDetn225To229RngRt1 FLR2RdrDetn225To229RngRt2 FLR2RdrDetn225To229RngRt3 FLR2RdrDetn225To229RngRt4 FLR2RdrDetn225To229ScanID FLR2RdrDetn225To229SNR0 FLR2RdrDetn225To229SNR1 FLR2RdrDetn225To229SNR2 FLR2RdrDetn225To229SNR3 FLR2RdrDetn225To229SNR4;
SIG_GROUP_ 230 FLR2RdrDetn230To234 1 : FLR2RdrDetn230To234AziAng0 FLR2RdrDetn230To234AziAng1 FLR2RdrDetn230To234AziAng2 FLR2RdrDetn230To234AziAng3 FLR2RdrDetn230To234AziAng4 FLR2RdrDetn230To234Counter FLR2RdrDetn230To234CRC FLR2RdrDetn230To234DynPrpty0 FLR2RdrDetn230To234DynPrpty1 FLR2RdrDetn230To234DynPrpty2 FLR2RdrDetn230To234DynPrpty3 FLR2RdrDetn230To234DynPrpty4 FLR2RdrDetn230To234EleAng0 FLR2RdrDetn230To234EleAng1 FLR2RdrDetn230To234EleAng2 FLR2RdrDetn230To234EleAng3 FLR2RdrDetn230To234EleAng4 FLR2RdrDetn230To234Mode0 FLR2RdrDetn230To234Mode1 FLR2RdrDetn230To234Mode2 FLR2RdrDetn230To234Mode3 FLR2RdrDetn230To234Mode4 FLR2RdrDetn230To234Quality0 FLR2RdrDetn230To234Quality1 FLR2RdrDetn230To234Quality2 FLR2RdrDetn230To234Quality3 FLR2RdrDetn230To234Quality4 FLR2RdrDetn230To234Range0 FLR2RdrDetn230To234Range1 FLR2RdrDetn230To234Range2 FLR2RdrDetn230To234Range3 FLR2RdrDetn230To234Range4 FLR2RdrDetn230To234RCS0 FLR2RdrDetn230To234RCS1 FLR2RdrDetn230To234RCS2 FLR2RdrDetn230To234RCS3 FLR2RdrDetn230To234RCS4 FLR2RdrDetn230To234RngRt0 FLR2RdrDetn230To234RngRt1 FLR2RdrDetn230To234RngRt2 FLR2RdrDetn230To234RngRt3 FLR2RdrDetn230To234RngRt4 FLR2RdrDetn230To234ScanID FLR2RdrDetn230To234SNR0 FLR2RdrDetn230To234SNR1 FLR2RdrDetn230To234SNR2 FLR2RdrDetn230To234SNR3 FLR2RdrDetn230To234SNR4;
SIG_GROUP_ 233 FLR2RdrDetn235To239 1 : FLR2RdrDetn235To239AziAng0 FLR2RdrDetn235To239AziAng1 FLR2RdrDetn235To239AziAng2 FLR2RdrDetn235To239AziAng3 FLR2RdrDetn235To239AziAng4 FLR2RdrDetn235To239Counter FLR2RdrDetn235To239CRC FLR2RdrDetn235To239DynPrpty0 FLR2RdrDetn235To239DynPrpty1 FLR2RdrDetn235To239DynPrpty2 FLR2RdrDetn235To239DynPrpty3 FLR2RdrDetn235To239DynPrpty4 FLR2RdrDetn235To239EleAng0 FLR2RdrDetn235To239EleAng1 FLR2RdrDetn235To239EleAng2 FLR2RdrDetn235To239EleAng3 FLR2RdrDetn235To239EleAng4 FLR2RdrDetn235To239Mode0 FLR2RdrDetn235To239Mode1 FLR2RdrDetn235To239Mode2 FLR2RdrDetn235To239Mode3 FLR2RdrDetn235To239Mode4 FLR2RdrDetn235To239Quality0 FLR2RdrDetn235To239Quality1 FLR2RdrDetn235To239Quality2 FLR2RdrDetn235To239Quality3 FLR2RdrDetn235To239Quality4 FLR2RdrDetn235To239Range0 FLR2RdrDetn235To239Range1 FLR2RdrDetn235To239Range2 FLR2RdrDetn235To239Range3 FLR2RdrDetn235To239Range4 FLR2RdrDetn235To239RCS0 FLR2RdrDetn235To239RCS1 FLR2RdrDetn235To239RCS2 FLR2RdrDetn235To239RCS3 FLR2RdrDetn235To239RCS4 FLR2RdrDetn235To239RngRt0 FLR2RdrDetn235To239RngRt1 FLR2RdrDetn235To239RngRt2 FLR2RdrDetn235To239RngRt3 FLR2RdrDetn235To239RngRt4 FLR2RdrDetn235To239ScanID FLR2RdrDetn235To239SNR0 FLR2RdrDetn235To239SNR1 FLR2RdrDetn235To239SNR2 FLR2RdrDetn235To239SNR3 FLR2RdrDetn235To239SNR4;
SIG_GROUP_ 236 FLR2RdrDetn240To244 1 : FLR2RdrDetn240To244AziAng0 FLR2RdrDetn240To244AziAng1 FLR2RdrDetn240To244AziAng2 FLR2RdrDetn240To244AziAng3 FLR2RdrDetn240To244AziAng4 FLR2RdrDetn240To244Counter FLR2RdrDetn240To244CRC FLR2RdrDetn240To244DynPrpty0 FLR2RdrDetn240To244DynPrpty1 FLR2RdrDetn240To244DynPrpty2 FLR2RdrDetn240To244DynPrpty3 FLR2RdrDetn240To244DynPrpty4 FLR2RdrDetn240To244EleAng0 FLR2RdrDetn240To244EleAng1 FLR2RdrDetn240To244EleAng2 FLR2RdrDetn240To244EleAng3 FLR2RdrDetn240To244EleAng4 FLR2RdrDetn240To244Mode0 FLR2RdrDetn240To244Mode1 FLR2RdrDetn240To244Mode2 FLR2RdrDetn240To244Mode3 FLR2RdrDetn240To244Mode4 FLR2RdrDetn240To244Quality0 FLR2RdrDetn240To244Quality1 FLR2RdrDetn240To244Quality2 FLR2RdrDetn240To244Quality3 FLR2RdrDetn240To244Quality4 FLR2RdrDetn240To244Range0 FLR2RdrDetn240To244Range1 FLR2RdrDetn240To244Range2 FLR2RdrDetn240To244Range3 FLR2RdrDetn240To244Range4 FLR2RdrDetn240To244RCS0 FLR2RdrDetn240To244RCS1 FLR2RdrDetn240To244RCS2 FLR2RdrDetn240To244RCS3 FLR2RdrDetn240To244RCS4 FLR2RdrDetn240To244RngRt0 FLR2RdrDetn240To244RngRt1 FLR2RdrDetn240To244RngRt2 FLR2RdrDetn240To244RngRt3 FLR2RdrDetn240To244RngRt4 FLR2RdrDetn240To244ScanID FLR2RdrDetn240To244SNR0 FLR2RdrDetn240To244SNR1 FLR2RdrDetn240To244SNR2 FLR2RdrDetn240To244SNR3 FLR2RdrDetn240To244SNR4;
SIG_GROUP_ 240 FLR2RdrDetn245To249 1 : FLR2RdrDetn245To249AziAng0 FLR2RdrDetn245To249AziAng1 FLR2RdrDetn245To249AziAng2 FLR2RdrDetn245To249AziAng3 FLR2RdrDetn245To249AziAng4 FLR2RdrDetn245To249Counter FLR2RdrDetn245To249CRC FLR2RdrDetn245To249DynPrpty0 FLR2RdrDetn245To249DynPrpty1 FLR2RdrDetn245To249DynPrpty2 FLR2RdrDetn245To249DynPrpty3 FLR2RdrDetn245To249DynPrpty4 FLR2RdrDetn245To249EleAng0 FLR2RdrDetn245To249EleAng1 FLR2RdrDetn245To249EleAng2 FLR2RdrDetn245To249EleAng3 FLR2RdrDetn245To249EleAng4 FLR2RdrDetn245To249Mode0 FLR2RdrDetn245To249Mode1 FLR2RdrDetn245To249Mode2 FLR2RdrDetn245To249Mode3 FLR2RdrDetn245To249Mode4 FLR2RdrDetn245To249Quality0 FLR2RdrDetn245To249Quality1 FLR2RdrDetn245To249Quality2 FLR2RdrDetn245To249Quality3 FLR2RdrDetn245To249Quality4 FLR2RdrDetn245To249Range0 FLR2RdrDetn245To249Range1 FLR2RdrDetn245To249Range2 FLR2RdrDetn245To249Range3 FLR2RdrDetn245To249Range4 FLR2RdrDetn245To249RCS0 FLR2RdrDetn245To249RCS1 FLR2RdrDetn245To249RCS2 FLR2RdrDetn245To249RCS3 FLR2RdrDetn245To249RCS4 FLR2RdrDetn245To249RngRt0 FLR2RdrDetn245To249RngRt1 FLR2RdrDetn245To249RngRt2 FLR2RdrDetn245To249RngRt3 FLR2RdrDetn245To249RngRt4 FLR2RdrDetn245To249ScanID FLR2RdrDetn245To249SNR0 FLR2RdrDetn245To249SNR1 FLR2RdrDetn245To249SNR2 FLR2RdrDetn245To249SNR3 FLR2RdrDetn245To249SNR4;
SIG_GROUP_ 242 FLR2RdrDetn250To254 1 : FLR2RdrDetn250To254AziAng0 FLR2RdrDetn250To254AziAng1 FLR2RdrDetn250To254AziAng2 FLR2RdrDetn250To254AziAng3 FLR2RdrDetn250To254AziAng4 FLR2RdrDetn250To254Counter FLR2RdrDetn250To254CRC FLR2RdrDetn250To254DynPrpty0 FLR2RdrDetn250To254DynPrpty1 FLR2RdrDetn250To254DynPrpty2 FLR2RdrDetn250To254DynPrpty3 FLR2RdrDetn250To254DynPrpty4 FLR2RdrDetn250To254EleAng0 FLR2RdrDetn250To254EleAng1 FLR2RdrDetn250To254EleAng2 FLR2RdrDetn250To254EleAng3 FLR2RdrDetn250To254EleAng4 FLR2RdrDetn250To254Mode0 FLR2RdrDetn250To254Mode1 FLR2RdrDetn250To254Mode2 FLR2RdrDetn250To254Mode3 FLR2RdrDetn250To254Mode4 FLR2RdrDetn250To254Quality0 FLR2RdrDetn250To254Quality1 FLR2RdrDetn250To254Quality2 FLR2RdrDetn250To254Quality3 FLR2RdrDetn250To254Quality4 FLR2RdrDetn250To254Range0 FLR2RdrDetn250To254Range1 FLR2RdrDetn250To254Range2 FLR2RdrDetn250To254Range3 FLR2RdrDetn250To254Range4 FLR2RdrDetn250To254RCS0 FLR2RdrDetn250To254RCS1 FLR2RdrDetn250To254RCS2 FLR2RdrDetn250To254RCS3 FLR2RdrDetn250To254RCS4 FLR2RdrDetn250To254RngRt0 FLR2RdrDetn250To254RngRt1 FLR2RdrDetn250To254RngRt2 FLR2RdrDetn250To254RngRt3 FLR2RdrDetn250To254RngRt4 FLR2RdrDetn250To254ScanID FLR2RdrDetn250To254SNR0 FLR2RdrDetn250To254SNR1 FLR2RdrDetn250To254SNR2 FLR2RdrDetn250To254SNR3 FLR2RdrDetn250To254SNR4;
SIG_GROUP_ 244 FLR2RdrDetn255To259 1 : FLR2RdrDetn255To259AziAng0 FLR2RdrDetn255To259AziAng1 FLR2RdrDetn255To259AziAng2 FLR2RdrDetn255To259AziAng3 FLR2RdrDetn255To259AziAng4 FLR2RdrDetn255To259Counter FLR2RdrDetn255To259CRC FLR2RdrDetn255To259DynPrpty0 FLR2RdrDetn255To259DynPrpty1 FLR2RdrDetn255To259DynPrpty2 FLR2RdrDetn255To259DynPrpty3 FLR2RdrDetn255To259DynPrpty4 FLR2RdrDetn255To259EleAng0 FLR2RdrDetn255To259EleAng1 FLR2RdrDetn255To259EleAng2 FLR2RdrDetn255To259EleAng3 FLR2RdrDetn255To259EleAng4 FLR2RdrDetn255To259Mode0 FLR2RdrDetn255To259Mode1 FLR2RdrDetn255To259Mode2 FLR2RdrDetn255To259Mode3 FLR2RdrDetn255To259Mode4 FLR2RdrDetn255To259Quality0 FLR2RdrDetn255To259Quality1 FLR2RdrDetn255To259Quality2 FLR2RdrDetn255To259Quality3 FLR2RdrDetn255To259Quality4 FLR2RdrDetn255To259Range0 FLR2RdrDetn255To259Range1 FLR2RdrDetn255To259Range2 FLR2RdrDetn255To259Range3 FLR2RdrDetn255To259Range4 FLR2RdrDetn255To259RCS0 FLR2RdrDetn255To259RCS1 FLR2RdrDetn255To259RCS2 FLR2RdrDetn255To259RCS3 FLR2RdrDetn255To259RCS4 FLR2RdrDetn255To259RngRt0 FLR2RdrDetn255To259RngRt1 FLR2RdrDetn255To259RngRt2 FLR2RdrDetn255To259RngRt3 FLR2RdrDetn255To259RngRt4 FLR2RdrDetn255To259ScanID FLR2RdrDetn255To259SNR0 FLR2RdrDetn255To259SNR1 FLR2RdrDetn255To259SNR2 FLR2RdrDetn255To259SNR3 FLR2RdrDetn255To259SNR4;
SIG_GROUP_ 246 FLR2RdrDetn260To264 1 : FLR2RdrDetn260To264AziAng0 FLR2RdrDetn260To264AziAng1 FLR2RdrDetn260To264AziAng2 FLR2RdrDetn260To264AziAng3 FLR2RdrDetn260To264AziAng4 FLR2RdrDetn260To264Counter FLR2RdrDetn260To264CRC FLR2RdrDetn260To264DynPrpty0 FLR2RdrDetn260To264DynPrpty1 FLR2RdrDetn260To264DynPrpty2 FLR2RdrDetn260To264DynPrpty3 FLR2RdrDetn260To264DynPrpty4 FLR2RdrDetn260To264EleAng0 FLR2RdrDetn260To264EleAng1 FLR2RdrDetn260To264EleAng2 FLR2RdrDetn260To264EleAng3 FLR2RdrDetn260To264EleAng4 FLR2RdrDetn260To264Mode0 FLR2RdrDetn260To264Mode1 FLR2RdrDetn260To264Mode2 FLR2RdrDetn260To264Mode3 FLR2RdrDetn260To264Mode4 FLR2RdrDetn260To264Quality0 FLR2RdrDetn260To264Quality1 FLR2RdrDetn260To264Quality2 FLR2RdrDetn260To264Quality3 FLR2RdrDetn260To264Quality4 FLR2RdrDetn260To264Range0 FLR2RdrDetn260To264Range1 FLR2RdrDetn260To264Range2 FLR2RdrDetn260To264Range3 FLR2RdrDetn260To264Range4 FLR2RdrDetn260To264RCS0 FLR2RdrDetn260To264RCS1 FLR2RdrDetn260To264RCS2 FLR2RdrDetn260To264RCS3 FLR2RdrDetn260To264RCS4 FLR2RdrDetn260To264RngRt0 FLR2RdrDetn260To264RngRt1 FLR2RdrDetn260To264RngRt2 FLR2RdrDetn260To264RngRt3 FLR2RdrDetn260To264RngRt4 FLR2RdrDetn260To264ScanID FLR2RdrDetn260To264SNR0 FLR2RdrDetn260To264SNR1 FLR2RdrDetn260To264SNR2 FLR2RdrDetn260To264SNR3 FLR2RdrDetn260To264SNR4;
SIG_GROUP_ 248 FLR2RdrDetn265To269 1 : FLR2RdrDetn265To269AziAng0 FLR2RdrDetn265To269AziAng1 FLR2RdrDetn265To269AziAng2 FLR2RdrDetn265To269AziAng3 FLR2RdrDetn265To269AziAng4 FLR2RdrDetn265To269Counter FLR2RdrDetn265To269CRC FLR2RdrDetn265To269DynPrpty0 FLR2RdrDetn265To269DynPrpty1 FLR2RdrDetn265To269DynPrpty2 FLR2RdrDetn265To269DynPrpty3 FLR2RdrDetn265To269DynPrpty4 FLR2RdrDetn265To269EleAng0 FLR2RdrDetn265To269EleAng1 FLR2RdrDetn265To269EleAng2 FLR2RdrDetn265To269EleAng3 FLR2RdrDetn265To269EleAng4 FLR2RdrDetn265To269Mode0 FLR2RdrDetn265To269Mode1 FLR2RdrDetn265To269Mode2 FLR2RdrDetn265To269Mode3 FLR2RdrDetn265To269Mode4 FLR2RdrDetn265To269Quality0 FLR2RdrDetn265To269Quality1 FLR2RdrDetn265To269Quality2 FLR2RdrDetn265To269Quality3 FLR2RdrDetn265To269Quality4 FLR2RdrDetn265To269Range0 FLR2RdrDetn265To269Range1 FLR2RdrDetn265To269Range2 FLR2RdrDetn265To269Range3 FLR2RdrDetn265To269Range4 FLR2RdrDetn265To269RCS0 FLR2RdrDetn265To269RCS1 FLR2RdrDetn265To269RCS2 FLR2RdrDetn265To269RCS3 FLR2RdrDetn265To269RCS4 FLR2RdrDetn265To269RngRt0 FLR2RdrDetn265To269RngRt1 FLR2RdrDetn265To269RngRt2 FLR2RdrDetn265To269RngRt3 FLR2RdrDetn265To269RngRt4 FLR2RdrDetn265To269ScanID FLR2RdrDetn265To269SNR0 FLR2RdrDetn265To269SNR1 FLR2RdrDetn265To269SNR2 FLR2RdrDetn265To269SNR3 FLR2RdrDetn265To269SNR4;
