// *************************************************************************** *
// *                                                                           *
// * Description:         CANDB File                                           *
// * Generated at:        2023-01-05 13:51                                     *
// * System:              FLRsystem_MAIN_26                                    *
// * Network:             FLR1CAN                                              *
// *                                                                           *
// *************************************************************************** *
VERSION "FLR1CAN"

NS_ :

BS_ :

BU_ :  FLR FLRdpHPA FLRdpHPB

BO_ 166 FlrFlr1canFr27 : 64 FLR
 SG_ FLR2RdrDetn130To134_UB : 359|1@0+ (1,0) [0|1] "" FLRdpHPA,FLRdpHPB
 SG_ FLR2RdrDetn130To134AziAng0 : 32|9@1+ (0.0035,-0.87266) [-0.87266|0.91584] "rad" FLRdpHPA,FLRdpHPB
 SG_ FLR2RdrDetn130To134AziAng1 : 96|9@1+ (0.0035,-0.87266) [-0.87266|0.91584] "rad" FLRdpHPA,FLRdpHPB
 SG_ FLR2RdrDetn130To134AziAng2 : 160|9@1+ (0.0035,-0.87266) [-0.87266|0.91584] "rad" FLRdpHPA,FLRdpHPB
 SG_ FLR2RdrDetn130To134AziAng3 : 224|9@1+ (0.0035,-0.87266) [-0.87266|0.91584] "rad" FLRdpHPA,FLRdpHPB
 SG_ FLR2RdrDetn130To134AziAng4 : 288|9@1+ (0.0035,-0.87266) [-0.87266|0.91584] "rad" FLRdpHPA,FLRdpHPB
 SG_ FLR2RdrDetn130To134Counter : 16|8@1+ (1.0,0.0) [0.0|255.0] "Unitless" FLRdpHPA,FLRdpHPB
 SG_ FLR2RdrDetn130To134CRC : 0|16@1+ (1.0,0.0) [0.0|65535.0] "Unitless" FLRdpHPA,FLRdpHPB
 SG_ FLR2RdrDetn130To134DynPrpty0 : 93|1@1+ (1.0,0.0) [0.0|1.0] "Unitless" FLRdpHPA,FLRdpHPB
 SG_ FLR2RdrDetn130To134DynPrpty1 : 157|1@1+ (1.0,0.0) [0.0|1.0] "Unitless" FLRdpHPA,FLRdpHPB
 SG_ FLR2RdrDetn130To134DynPrpty2 : 221|1@1+ (1.0,0.0) [0.0|1.0] "Unitless" FLRdpHPA,FLRdpHPB
 SG_ FLR2RdrDetn130To134DynPrpty3 : 285|1@1+ (1.0,0.0) [0.0|1.0] "Unitless" FLRdpHPA,FLRdpHPB
 SG_ FLR2RdrDetn130To134DynPrpty4 : 349|1@1+ (1.0,0.0) [0.0|1.0] "Unitless" FLRdpHPA,FLRdpHPB
 SG_ FLR2RdrDetn130To134EleAng0 : 64|8@1+ (0.002,0.0) [0.0|0.5] "rad" FLRdpHPA,FLRdpHPB
 SG_ FLR2RdrDetn130To134EleAng1 : 128|8@1+ (0.002,0.0) [0.0|0.5] "rad" FLRdpHPA,FLRdpHPB
 SG_ FLR2RdrDetn130To134EleAng2 : 192|8@1+ (0.002,0.0) [0.0|0.5] "rad" FLRdpHPA,FLRdpHPB
 SG_ FLR2RdrDetn130To134EleAng3 : 256|8@1+ (0.002,0.0) [0.0|0.5] "rad" FLRdpHPA,FLRdpHPB
 SG_ FLR2RdrDetn130To134EleAng4 : 320|8@1+ (0.002,0.0) [0.0|0.5] "rad" FLRdpHPA,FLRdpHPB
 SG_ FLR2RdrDetn130To134Mode0 : 60|2@1+ (1,0) [0|3] "" FLRdpHPA,FLRdpHPB
 SG_ FLR2RdrDetn130To134Mode1 : 124|2@1+ (1,0) [0|3] "" FLRdpHPA,FLRdpHPB
 SG_ FLR2RdrDetn130To134Mode2 : 188|2@1+ (1,0) [0|3] "" FLRdpHPA,FLRdpHPB
 SG_ FLR2RdrDetn130To134Mode3 : 252|2@1+ (1,0) [0|3] "" FLRdpHPA,FLRdpHPB
 SG_ FLR2RdrDetn130To134Mode4 : 316|2@1+ (1,0) [0|3] "" FLRdpHPA,FLRdpHPB
 SG_ FLR2RdrDetn130To134Quality0 : 62|2@1+ (1,0) [0|3] "" FLRdpHPA,FLRdpHPB
 SG_ FLR2RdrDetn130To134Quality1 : 126|2@1+ (1,0) [0|3] "" FLRdpHPA,FLRdpHPB
 SG_ FLR2RdrDetn130To134Quality2 : 190|2@1+ (1,0) [0|3] "" FLRdpHPA,FLRdpHPB
 SG_ FLR2RdrDetn130To134Quality3 : 254|2@1+ (1,0) [0|3] "" FLRdpHPA,FLRdpHPB
 SG_ FLR2RdrDetn130To134Quality4 : 318|2@1+ (1,0) [0|3] "" FLRdpHPA,FLRdpHPB
 SG_ FLR2RdrDetn130To134Range0 : 48|12@1+ (0.1,0.4) [0.4|300.0] "m" FLRdpHPA,FLRdpHPB
 SG_ FLR2RdrDetn130To134Range1 : 112|12@1+ (0.1,0.4) [0.4|300.0] "m" FLRdpHPA,FLRdpHPB
 SG_ FLR2RdrDetn130To134Range2 : 176|12@1+ (0.1,0.4) [0.4|300.0] "m" FLRdpHPA,FLRdpHPB
 SG_ FLR2RdrDetn130To134Range3 : 240|12@1+ (0.1,0.4) [0.4|300.0] "m" FLRdpHPA,FLRdpHPB
 SG_ FLR2RdrDetn130To134Range4 : 304|12@1+ (0.1,0.4) [0.4|300.0] "m" FLRdpHPA,FLRdpHPB
 SG_ FLR2RdrDetn130To134RCS0 : 83|10@1+ (0.2,-100.0) [-100.0|70.0] "dBsm" FLRdpHPA,FLRdpHPB
 SG_ FLR2RdrDetn130To134RCS1 : 147|10@1+ (0.2,-100.0) [-100.0|70.0] "dBsm" FLRdpHPA,FLRdpHPB
 SG_ FLR2RdrDetn130To134RCS2 : 211|10@1+ (0.2,-100.0) [-100.0|70.0] "dBsm" FLRdpHPA,FLRdpHPB
 SG_ FLR2RdrDetn130To134RCS3 : 275|10@1+ (0.2,-100.0) [-100.0|70.0] "dBsm" FLRdpHPA,FLRdpHPB
 SG_ FLR2RdrDetn130To134RCS4 : 339|10@1+ (0.2,-100.0) [-100.0|70.0] "dBsm" FLRdpHPA,FLRdpHPB
 SG_ FLR2RdrDetn130To134RngRt0 : 72|11@1+ (0.1,-111.11) [-111.11|55.59000000000002] "m/s" FLRdpHPA,FLRdpHPB
 SG_ FLR2RdrDetn130To134RngRt1 : 136|11@1+ (0.1,-111.11) [-111.11|55.59000000000002] "m/s" FLRdpHPA,FLRdpHPB
 SG_ FLR2RdrDetn130To134RngRt2 : 200|11@1+ (0.1,-111.11) [-111.11|55.59000000000002] "m/s" FLRdpHPA,FLRdpHPB
 SG_ FLR2RdrDetn130To134RngRt3 : 264|11@1+ (0.1,-111.11) [-111.11|55.59000000000002] "m/s" FLRdpHPA,FLRdpHPB
 SG_ FLR2RdrDetn130To134RngRt4 : 328|11@1+ (0.1,-111.11) [-111.11|55.59000000000002] "m/s" FLRdpHPA,FLRdpHPB
 SG_ FLR2RdrDetn130To134ScanID : 24|8@1+ (1.0,0.0) [0.0|255.0] "Unitless" FLRdpHPA,FLRdpHPB
 SG_ FLR2RdrDetn130To134SNR0 : 41|7@1+ (0.5,0.0) [0.0|63.5] "dB" FLRdpHPA,FLRdpHPB
 SG_ FLR2RdrDetn130To134SNR1 : 105|7@1+ (0.5,0.0) [0.0|63.5] "dB" FLRdpHPA,FLRdpHPB
 SG_ FLR2RdrDetn130To134SNR2 : 169|7@1+ (0.5,0.0) [0.0|63.5] "dB" FLRdpHPA,FLRdpHPB
 SG_ FLR2RdrDetn130To134SNR3 : 233|7@1+ (0.5,0.0) [0.0|63.5] "dB" FLRdpHPA,FLRdpHPB
 SG_ FLR2RdrDetn130To134SNR4 : 297|7@1+ (0.5,0.0) [0.0|63.5] "dB" FLRdpHPA,FLRdpHPB

BO_ 169 FlrFlr1canFr28 : 64 FLR
 SG_ FLR2RdrDetn135To139_UB : 359|1@0+ (1,0) [0|1] "" FLRdpHPA,FLRdpHPB
 SG_ FLR2RdrDetn135To139AziAng0 : 32|9@1+ (0.0035,-0.87266) [-0.87266|0.91584] "rad" FLRdpHPA,FLRdpHPB
 SG_ FLR2RdrDetn135To139AziAng1 : 96|9@1+ (0.0035,-0.87266) [-0.87266|0.91584] "rad" FLRdpHPA,FLRdpHPB
 SG_ FLR2RdrDetn135To139AziAng2 : 160|9@1+ (0.0035,-0.87266) [-0.87266|0.91584] "rad" FLRdpHPA,FLRdpHPB
 SG_ FLR2RdrDetn135To139AziAng3 : 224|9@1+ (0.0035,-0.87266) [-0.87266|0.91584] "rad" FLRdpHPA,FLRdpHPB
 SG_ FLR2RdrDetn135To139AziAng4 : 288|9@1+ (0.0035,-0.87266) [-0.87266|0.91584] "rad" FLRdpHPA,FLRdpHPB
 SG_ FLR2RdrDetn135To139Counter : 16|8@1+ (1.0,0.0) [0.0|255.0] "Unitless" FLRdpHPA,FLRdpHPB
 SG_ FLR2RdrDetn135To139CRC : 0|16@1+ (1.0,0.0) [0.0|65535.0] "Unitless" FLRdpHPA,FLRdpHPB
 SG_ FLR2RdrDetn135To139DynPrpty0 : 93|1@1+ (1.0,0.0) [0.0|1.0] "Unitless" FLRdpHPA,FLRdpHPB
 SG_ FLR2RdrDetn135To139DynPrpty1 : 157|1@1+ (1.0,0.0) [0.0|1.0] "Unitless" FLRdpHPA,FLRdpHPB
 SG_ FLR2RdrDetn135To139DynPrpty2 : 221|1@1+ (1.0,0.0) [0.0|1.0] "Unitless" FLRdpHPA,FLRdpHPB
 SG_ FLR2RdrDetn135To139DynPrpty3 : 285|1@1+ (1.0,0.0) [0.0|1.0] "Unitless" FLRdpHPA,FLRdpHPB
 SG_ FLR2RdrDetn135To139DynPrpty4 : 349|1@1+ (1.0,0.0) [0.0|1.0] "Unitless" FLRdpHPA,FLRdpHPB
 SG_ FLR2RdrDetn135To139EleAng0 : 64|8@1+ (0.002,0.0) [0.0|0.5] "rad" FLRdpHPA,FLRdpHPB
 SG_ FLR2RdrDetn135To139EleAng1 : 128|8@1+ (0.002,0.0) [0.0|0.5] "rad" FLRdpHPA,FLRdpHPB
 SG_ FLR2RdrDetn135To139EleAng2 : 192|8@1+ (0.002,0.0) [0.0|0.5] "rad" FLRdpHPA,FLRdpHPB
 SG_ FLR2RdrDetn135To139EleAng3 : 256|8@1+ (0.002,0.0) [0.0|0.5] "rad" FLRdpHPA,FLRdpHPB
 SG_ FLR2RdrDetn135To139EleAng4 : 320|8@1+ (0.002,0.0) [0.0|0.5] "rad" FLRdpHPA,FLRdpHPB
 SG_ FLR2RdrDetn135To139Mode0 : 60|2@1+ (1,0) [0|3] "" FLRdpHPA,FLRdpHPB
 SG_ FLR2RdrDetn135To139Mode1 : 124|2@1+ (1,0) [0|3] "" FLRdpHPA,FLRdpHPB
 SG_ FLR2RdrDetn135To139Mode2 : 188|2@1+ (1,0) [0|3] "" FLRdpHPA,FLRdpHPB
 SG_ FLR2RdrDetn135To139Mode3 : 252|2@1+ (1,0) [0|3] "" FLRdpHPA,FLRdpHPB
 SG_ FLR2RdrDetn135To139Mode4 : 316|2@1+ (1,0) [0|3] "" FLRdpHPA,FLRdpHPB
 SG_ FLR2RdrDetn135To139Quality0 : 62|2@1+ (1,0) [0|3] "" FLRdpHPA,FLRdpHPB
 SG_ FLR2RdrDetn135To139Quality1 : 126|2@1+ (1,0) [0|3] "" FLRdpHPA,FLRdpHPB
 SG_ FLR2RdrDetn135To139Quality2 : 190|2@1+ (1,0) [0|3] "" FLRdpHPA,FLRdpHPB
 SG_ FLR2RdrDetn135To139Quality3 : 254|2@1+ (1,0) [0|3] "" FLRdpHPA,FLRdpHPB
 SG_ FLR2RdrDetn135To139Quality4 : 318|2@1+ (1,0) [0|3] "" FLRdpHPA,FLRdpHPB
 SG_ FLR2RdrDetn135To139Range0 : 48|12@1+ (0.1,0.4) [0.4|300.0] "m" FLRdpHPA,FLRdpHPB
 SG_ FLR2RdrDetn135To139Range1 : 112|12@1+ (0.1,0.4) [0.4|300.0] "m" FLRdpHPA,FLRdpHPB
 SG_ FLR2RdrDetn135To139Range2 : 176|12@1+ (0.1,0.4) [0.4|300.0] "m" FLRdpHPA,FLRdpHPB
 SG_ FLR2RdrDetn135To139Range3 : 240|12@1+ (0.1,0.4) [0.4|300.0] "m" FLRdpHPA,FLRdpHPB
 SG_ FLR2RdrDetn135To139Range4 : 304|12@1+ (0.1,0.4) [0.4|300.0] "m" FLRdpHPA,FLRdpHPB
 SG_ FLR2RdrDetn135To139RCS0 : 83|10@1+ (0.2,-100.0) [-100.0|70.0] "dBsm" FLRdpHPA,FLRdpHPB
 SG_ FLR2RdrDetn135To139RCS1 : 147|10@1+ (0.2,-100.0) [-100.0|70.0] "dBsm" FLRdpHPA,FLRdpHPB
 SG_ FLR2RdrDetn135To139RCS2 : 211|10@1+ (0.2,-100.0) [-100.0|70.0] "dBsm" FLRdpHPA,FLRdpHPB
 SG_ FLR2RdrDetn135To139RCS3 : 275|10@1+ (0.2,-100.0) [-100.0|70.0] "dBsm" FLRdpHPA,FLRdpHPB
 SG_ FLR2RdrDetn135To139RCS4 : 339|10@1+ (0.2,-100.0) [-100.0|70.0] "dBsm" FLRdpHPA,FLRdpHPB
 SG_ FLR2RdrDetn135To139RngRt0 : 72|11@1+ (0.1,-111.11) [-111.11|55.59000000000002] "m/s" FLRdpHPA,FLRdpHPB
 SG_ FLR2RdrDetn135To139RngRt1 : 136|11@1+ (0.1,-111.11) [-111.11|55.59000000000002] "m/s" FLRdpHPA,FLRdpHPB
 SG_ FLR2RdrDetn135To139RngRt2 : 200|11@1+ (0.1,-111.11) [-111.11|55.59000000000002] "m/s" FLRdpHPA,FLRdpHPB
 SG_ FLR2RdrDetn135To139RngRt3 : 264|11@1+ (0.1,-111.11) [-111.11|55.59000000000002] "m/s" FLRdpHPA,FLRdpHPB
 SG_ FLR2RdrDetn135To139RngRt4 : 328|11@1+ (0.1,-111.11) [-111.11|55.59000000000002] "m/s" FLRdpHPA,FLRdpHPB
 SG_ FLR2RdrDetn135To139ScanID : 24|8@1+ (1.0,0.0) [0.0|255.0] "Unitless" FLRdpHPA,FLRdpHPB
 SG_ FLR2RdrDetn135To139SNR0 : 41|7@1+ (0.5,0.0) [0.0|63.5] "dB" FLRdpHPA,FLRdpHPB
 SG_ FLR2RdrDetn135To139SNR1 : 105|7@1+ (0.5,0.0) [0.0|63.5] "dB" FLRdpHPA,FLRdpHPB
 SG_ FLR2RdrDetn135To139SNR2 : 169|7@1+ (0.5,0.0) [0.0|63.5] "dB" FLRdpHPA,FLRdpHPB
 SG_ FLR2RdrDetn135To139SNR3 : 233|7@1+ (0.5,0.0) [0.0|63.5] "dB" FLRdpHPA,FLRdpHPB
 SG_ FLR2RdrDetn135To139SNR4 : 297|7@1+ (0.5,0.0) [0.0|63.5] "dB" FLRdpHPA,FLRdpHPB

BO_ 172 FlrFlr1canFr29 : 64 FLR
 SG_ FLR2RdrDetn140To144_UB : 359|1@0+ (1,0) [0|1] "" FLRdpHPA,FLRdpHPB
 SG_ FLR2RdrDetn140To144AziAng0 : 32|9@1+ (0.0035,-0.87266) [-0.87266|0.91584] "rad" FLRdpHPA,FLRdpHPB
 SG_ FLR2RdrDetn140To144AziAng1 : 96|9@1+ (0.0035,-0.87266) [-0.87266|0.91584] "rad" FLRdpHPA,FLRdpHPB
 SG_ FLR2RdrDetn140To144AziAng2 : 160|9@1+ (0.0035,-0.87266) [-0.87266|0.91584] "rad" FLRdpHPA,FLRdpHPB
 SG_ FLR2RdrDetn140To144AziAng3 : 224|9@1+ (0.0035,-0.87266) [-0.87266|0.91584] "rad" FLRdpHPA,FLRdpHPB
 SG_ FLR2RdrDetn140To144AziAng4 : 288|9@1+ (0.0035,-0.87266) [-0.87266|0.91584] "rad" FLRdpHPA,FLRdpHPB
 SG_ FLR2RdrDetn140To144Counter : 16|8@1+ (1.0,0.0) [0.0|255.0] "Unitless" FLRdpHPA,FLRdpHPB
 SG_ FLR2RdrDetn140To144CRC : 0|16@1+ (1.0,0.0) [0.0|65535.0] "Unitless" FLRdpHPA,FLRdpHPB
 SG_ FLR2RdrDetn140To144DynPrpty0 : 93|1@1+ (1.0,0.0) [0.0|1.0] "Unitless" FLRdpHPA,FLRdpHPB
 SG_ FLR2RdrDetn140To144DynPrpty1 : 157|1@1+ (1.0,0.0) [0.0|1.0] "Unitless" FLRdpHPA,FLRdpHPB
 SG_ FLR2RdrDetn140To144DynPrpty2 : 221|1@1+ (1.0,0.0) [0.0|1.0] "Unitless" FLRdpHPA,FLRdpHPB
 SG_ FLR2RdrDetn140To144DynPrpty3 : 285|1@1+ (1.0,0.0) [0.0|1.0] "Unitless" FLRdpHPA,FLRdpHPB
 SG_ FLR2RdrDetn140To144DynPrpty4 : 349|1@1+ (1.0,0.0) [0.0|1.0] "Unitless" FLRdpHPA,FLRdpHPB
 SG_ FLR2RdrDetn140To144EleAng0 : 64|8@1+ (0.002,0.0) [0.0|0.5] "rad" FLRdpHPA,FLRdpHPB
 SG_ FLR2RdrDetn140To144EleAng1 : 128|8@1+ (0.002,0.0) [0.0|0.5] "rad" FLRdpHPA,FLRdpHPB
 SG_ FLR2RdrDetn140To144EleAng2 : 192|8@1+ (0.002,0.0) [0.0|0.5] "rad" FLRdpHPA,FLRdpHPB
 SG_ FLR2RdrDetn140To144EleAng3 : 256|8@1+ (0.002,0.0) [0.0|0.5] "rad" FLRdpHPA,FLRdpHPB
 SG_ FLR2RdrDetn140To144EleAng4 : 320|8@1+ (0.002,0.0) [0.0|0.5] "rad" FLRdpHPA,FLRdpHPB
 SG_ FLR2RdrDetn140To144Mode0 : 60|2@1+ (1,0) [0|3] "" FLRdpHPA,FLRdpHPB
 SG_ FLR2RdrDetn140To144Mode1 : 124|2@1+ (1,0) [0|3] "" FLRdpHPA,FLRdpHPB
 SG_ FLR2RdrDetn140To144Mode2 : 188|2@1+ (1,0) [0|3] "" FLRdpHPA,FLRdpHPB
 SG_ FLR2RdrDetn140To144Mode3 : 252|2@1+ (1,0) [0|3] "" FLRdpHPA,FLRdpHPB
 SG_ FLR2RdrDetn140To144Mode4 : 316|2@1+ (1,0) [0|3] "" FLRdpHPA,FLRdpHPB
 SG_ FLR2RdrDetn140To144Quality0 : 62|2@1+ (1,0) [0|3] "" FLRdpHPA,FLRdpHPB
 SG_ FLR2RdrDetn140To144Quality1 : 126|2@1+ (1,0) [0|3] "" FLRdpHPA,FLRdpHPB
 SG_ FLR2RdrDetn140To144Quality2 : 190|2@1+ (1,0) [0|3] "" FLRdpHPA,FLRdpHPB
 SG_ FLR2RdrDetn140To144Quality3 : 254|2@1+ (1,0) [0|3] "" FLRdpHPA,FLRdpHPB
 SG_ FLR2RdrDetn140To144Quality4 : 318|2@1+ (1,0) [0|3] "" FLRdpHPA,FLRdpHPB
 SG_ FLR2RdrDetn140To144Range0 : 48|12@1+ (0.1,0.4) [0.4|300.0] "m" FLRdpHPA,FLRdpHPB
 SG_ FLR2RdrDetn140To144Range1 : 112|12@1+ (0.1,0.4) [0.4|300.0] "m" FLRdpHPA,FLRdpHPB
 SG_ FLR2RdrDetn140To144Range2 : 176|12@1+ (0.1,0.4) [0.4|300.0] "m" FLRdpHPA,FLRdpHPB
 SG_ FLR2RdrDetn140To144Range3 : 240|12@1+ (0.1,0.4) [0.4|300.0] "m" FLRdpHPA,FLRdpHPB
 SG_ FLR2RdrDetn140To144Range4 : 304|12@1+ (0.1,0.4) [0.4|300.0] "m" FLRdpHPA,FLRdpHPB
 SG_ FLR2RdrDetn140To144RCS0 : 83|10@1+ (0.2,-100.0) [-100.0|70.0] "dBsm" FLRdpHPA,FLRdpHPB
 SG_ FLR2RdrDetn140To144RCS1 : 147|10@1+ (0.2,-100.0) [-100.0|70.0] "dBsm" FLRdpHPA,FLRdpHPB
 SG_ FLR2RdrDetn140To144RCS2 : 211|10@1+ (0.2,-100.0) [-100.0|70.0] "dBsm" FLRdpHPA,FLRdpHPB
 SG_ FLR2RdrDetn140To144RCS3 : 275|10@1+ (0.2,-100.0) [-100.0|70.0] "dBsm" FLRdpHPA,FLRdpHPB
 SG_ FLR2RdrDetn140To144RCS4 : 339|10@1+ (0.2,-100.0) [-100.0|70.0] "dBsm" FLRdpHPA,FLRdpHPB
 SG_ FLR2RdrDetn140To144RngRt0 : 72|11@1+ (0.1,-111.11) [-111.11|55.59000000000002] "m/s" FLRdpHPA,FLRdpHPB
 SG_ FLR2RdrDetn140To144RngRt1 : 136|11@1+ (0.1,-111.11) [-111.11|55.59000000000002] "m/s" FLRdpHPA,FLRdpHPB
 SG_ FLR2RdrDetn140To144RngRt2 : 200|11@1+ (0.1,-111.11) [-111.11|55.59000000000002] "m/s" FLRdpHPA,FLRdpHPB
 SG_ FLR2RdrDetn140To144RngRt3 : 264|11@1+ (0.1,-111.11) [-111.11|55.59000000000002] "m/s" FLRdpHPA,FLRdpHPB
 SG_ FLR2RdrDetn140To144RngRt4 : 328|11@1+ (0.1,-111.11) [-111.11|55.59000000000002] "m/s" FLRdpHPA,FLRdpHPB
 SG_ FLR2RdrDetn140To144ScanID : 24|8@1+ (1.0,0.0) [0.0|255.0] "Unitless" FLRdpHPA,FLRdpHPB
 SG_ FLR2RdrDetn140To144SNR0 : 41|7@1+ (0.5,0.0) [0.0|63.5] "dB" FLRdpHPA,FLRdpHPB
 SG_ FLR2RdrDetn140To144SNR1 : 105|7@1+ (0.5,0.0) [0.0|63.5] "dB" FLRdpHPA,FLRdpHPB
 SG_ FLR2RdrDetn140To144SNR2 : 169|7@1+ (0.5,0.0) [0.0|63.5] "dB" FLRdpHPA,FLRdpHPB
 SG_ FLR2RdrDetn140To144SNR3 : 233|7@1+ (0.5,0.0) [0.0|63.5] "dB" FLRdpHPA,FLRdpHPB
 SG_ FLR2RdrDetn140To144SNR4 : 297|7@1+ (0.5,0.0) [0.0|63.5] "dB" FLRdpHPA,FLRdpHPB

BO_ 176 FlrFlr1canFr30 : 64 FLR
 SG_ FLR2RdrDetn145To149_UB : 359|1@0+ (1,0) [0|1] "" FLRdpHPA,FLRdpHPB
 SG_ FLR2RdrDetn145To149AziAng0 : 32|9@1+ (0.0035,-0.87266) [-0.87266|0.91584] "rad" FLRdpHPA,FLRdpHPB
 SG_ FLR2RdrDetn145To149AziAng1 : 96|9@1+ (0.0035,-0.87266) [-0.87266|0.91584] "rad" FLRdpHPA,FLRdpHPB
 SG_ FLR2RdrDetn145To149AziAng2 : 160|9@1+ (0.0035,-0.87266) [-0.87266|0.91584] "rad" FLRdpHPA,FLRdpHPB
 SG_ FLR2RdrDetn145To149AziAng3 : 224|9@1+ (0.0035,-0.87266) [-0.87266|0.91584] "rad" FLRdpHPA,FLRdpHPB
 SG_ FLR2RdrDetn145To149AziAng4 : 288|9@1+ (0.0035,-0.87266) [-0.87266|0.91584] "rad" FLRdpHPA,FLRdpHPB
 SG_ FLR2RdrDetn145To149Counter : 16|8@1+ (1.0,0.0) [0.0|255.0] "Unitless" FLRdpHPA,FLRdpHPB
 SG_ FLR2RdrDetn145To149CRC : 0|16@1+ (1.0,0.0) [0.0|65535.0] "Unitless" FLRdpHPA,FLRdpHPB
 SG_ FLR2RdrDetn145To149DynPrpty0 : 93|1@1+ (1.0,0.0) [0.0|1.0] "Unitless" FLRdpHPA,FLRdpHPB
 SG_ FLR2RdrDetn145To149DynPrpty1 : 157|1@1+ (1.0,0.0) [0.0|1.0] "Unitless" FLRdpHPA,FLRdpHPB
 SG_ FLR2RdrDetn145To149DynPrpty2 : 221|1@1+ (1.0,0.0) [0.0|1.0] "Unitless" FLRdpHPA,FLRdpHPB
 SG_ FLR2RdrDetn145To149DynPrpty3 : 285|1@1+ (1.0,0.0) [0.0|1.0] "Unitless" FLRdpHPA,FLRdpHPB
 SG_ FLR2RdrDetn145To149DynPrpty4 : 349|1@1+ (1.0,0.0) [0.0|1.0] "Unitless" FLRdpHPA,FLRdpHPB
 SG_ FLR2RdrDetn145To149EleAng0 : 64|8@1+ (0.002,0.0) [0.0|0.5] "rad" FLRdpHPA,FLRdpHPB
 SG_ FLR2RdrDetn145To149EleAng1 : 128|8@1+ (0.002,0.0) [0.0|0.5] "rad" FLRdpHPA,FLRdpHPB
 SG_ FLR2RdrDetn145To149EleAng2 : 192|8@1+ (0.002,0.0) [0.0|0.5] "rad" FLRdpHPA,FLRdpHPB
 SG_ FLR2RdrDetn145To149EleAng3 : 256|8@1+ (0.002,0.0) [0.0|0.5] "rad" FLRdpHPA,FLRdpHPB
 SG_ FLR2RdrDetn145To149EleAng4 : 320|8@1+ (0.002,0.0) [0.0|0.5] "rad" FLRdpHPA,FLRdpHPB
 SG_ FLR2RdrDetn145To149Mode0 : 60|2@1+ (1,0) [0|3] "" FLRdpHPA,FLRdpHPB
 SG_ FLR2RdrDetn145To149Mode1 : 124|2@1+ (1,0) [0|3] "" FLRdpHPA,FLRdpHPB
 SG_ FLR2RdrDetn145To149Mode2 : 188|2@1+ (1,0) [0|3] "" FLRdpHPA,FLRdpHPB
 SG_ FLR2RdrDetn145To149Mode3 : 252|2@1+ (1,0) [0|3] "" FLRdpHPA,FLRdpHPB
 SG_ FLR2RdrDetn145To149Mode4 : 316|2@1+ (1,0) [0|3] "" FLRdpHPA,FLRdpHPB
 SG_ FLR2RdrDetn145To149Quality0 : 62|2@1+ (1,0) [0|3] "" FLRdpHPA,FLRdpHPB
 SG_ FLR2RdrDetn145To149Quality1 : 126|2@1+ (1,0) [0|3] "" FLRdpHPA,FLRdpHPB
 SG_ FLR2RdrDetn145To149Quality2 : 190|2@1+ (1,0) [0|3] "" FLRdpHPA,FLRdpHPB
 SG_ FLR2RdrDetn145To149Quality3 : 254|2@1+ (1,0) [0|3] "" FLRdpHPA,FLRdpHPB
 SG_ FLR2RdrDetn145To149Quality4 : 318|2@1+ (1,0) [0|3] "" FLRdpHPA,FLRdpHPB
 SG_ FLR2RdrDetn145To149Range0 : 48|12@1+ (0.1,0.4) [0.4|300.0] "m" FLRdpHPA,FLRdpHPB
 SG_ FLR2RdrDetn145To149Range1 : 112|12@1+ (0.1,0.4) [0.4|300.0] "m" FLRdpHPA,FLRdpHPB
 SG_ FLR2RdrDetn145To149Range2 : 176|12@1+ (0.1,0.4) [0.4|300.0] "m" FLRdpHPA,FLRdpHPB
 SG_ FLR2RdrDetn145To149Range3 : 240|12@1+ (0.1,0.4) [0.4|300.0] "m" FLRdpHPA,FLRdpHPB
 SG_ FLR2RdrDetn145To149Range4 : 304|12@1+ (0.1,0.4) [0.4|300.0] "m" FLRdpHPA,FLRdpHPB
 SG_ FLR2RdrDetn145To149RCS0 : 83|10@1+ (0.2,-100.0) [-100.0|70.0] "dBsm" FLRdpHPA,FLRdpHPB
 SG_ FLR2RdrDetn145To149RCS1 : 147|10@1+ (0.2,-100.0) [-100.0|70.0] "dBsm" FLRdpHPA,FLRdpHPB
 SG_ FLR2RdrDetn145To149RCS2 : 211|10@1+ (0.2,-100.0) [-100.0|70.0] "dBsm" FLRdpHPA,FLRdpHPB
 SG_ FLR2RdrDetn145To149RCS3 : 275|10@1+ (0.2,-100.0) [-100.0|70.0] "dBsm" FLRdpHPA,FLRdpHPB
 SG_ FLR2RdrDetn145To149RCS4 : 339|10@1+ (0.2,-100.0) [-100.0|70.0] "dBsm" FLRdpHPA,FLRdpHPB
 SG_ FLR2RdrDetn145To149RngRt0 : 72|11@1+ (0.1,-111.11) [-111.11|55.59000000000002] "m/s" FLRdpHPA,FLRdpHPB
 SG_ FLR2RdrDetn145To149RngRt1 : 136|11@1+ (0.1,-111.11) [-111.11|55.59000000000002] "m/s" FLRdpHPA,FLRdpHPB
 SG_ FLR2RdrDetn145To149RngRt2 : 200|11@1+ (0.1,-111.11) [-111.11|55.59000000000002] "m/s" FLRdpHPA,FLRdpHPB
 SG_ FLR2RdrDetn145To149RngRt3 : 264|11@1+ (0.1,-111.11) [-111.11|55.59000000000002] "m/s" FLRdpHPA,FLRdpHPB
 SG_ FLR2RdrDetn145To149RngRt4 : 328|11@1+ (0.1,-111.11) [-111.11|55.59000000000002] "m/s" FLRdpHPA,FLRdpHPB
 SG_ FLR2RdrDetn145To149ScanID : 24|8@1+ (1.0,0.0) [0.0|255.0] "Unitless" FLRdpHPA,FLRdpHPB
 SG_ FLR2RdrDetn145To149SNR0 : 41|7@1+ (0.5,0.0) [0.0|63.5] "dB" FLRdpHPA,FLRdpHPB
 SG_ FLR2RdrDetn145To149SNR1 : 105|7@1+ (0.5,0.0) [0.0|63.5] "dB" FLRdpHPA,FLRdpHPB
 SG_ FLR2RdrDetn145To149SNR2 : 169|7@1+ (0.5,0.0) [0.0|63.5] "dB" FLRdpHPA,FLRdpHPB
 SG_ FLR2RdrDetn145To149SNR3 : 233|7@1+ (0.5,0.0) [0.0|63.5] "dB" FLRdpHPA,FLRdpHPB
 SG_ FLR2RdrDetn145To149SNR4 : 297|7@1+ (0.5,0.0) [0.0|63.5] "dB" FLRdpHPA,FLRdpHPB

BO_ 179 FlrFlr1canFr31 : 64 FLR
 SG_ FLR2RdrDetn150To154_UB : 359|1@0+ (1,0) [0|1] "" FLRdpHPA,FLRdpHPB
 SG_ FLR2RdrDetn150To154AziAng0 : 32|9@1+ (0.0035,-0.87266) [-0.87266|0.91584] "rad" FLRdpHPA,FLRdpHPB
 SG_ FLR2RdrDetn150To154AziAng1 : 96|9@1+ (0.0035,-0.87266) [-0.87266|0.91584] "rad" FLRdpHPA,FLRdpHPB
 SG_ FLR2RdrDetn150To154AziAng2 : 160|9@1+ (0.0035,-0.87266) [-0.87266|0.91584] "rad" FLRdpHPA,FLRdpHPB
 SG_ FLR2RdrDetn150To154AziAng3 : 224|9@1+ (0.0035,-0.87266) [-0.87266|0.91584] "rad" FLRdpHPA,FLRdpHPB
 SG_ FLR2RdrDetn150To154AziAng4 : 288|9@1+ (0.0035,-0.87266) [-0.87266|0.91584] "rad" FLRdpHPA,FLRdpHPB
 SG_ FLR2RdrDetn150To154Counter : 16|8@1+ (1.0,0.0) [0.0|255.0] "Unitless" FLRdpHPA,FLRdpHPB
 SG_ FLR2RdrDetn150To154CRC : 0|16@1+ (1.0,0.0) [0.0|65535.0] "Unitless" FLRdpHPA,FLRdpHPB
 SG_ FLR2RdrDetn150To154DynPrpty0 : 93|1@1+ (1.0,0.0) [0.0|1.0] "Unitless" FLRdpHPA,FLRdpHPB
 SG_ FLR2RdrDetn150To154DynPrpty1 : 157|1@1+ (1.0,0.0) [0.0|1.0] "Unitless" FLRdpHPA,FLRdpHPB
 SG_ FLR2RdrDetn150To154DynPrpty2 : 221|1@1+ (1.0,0.0) [0.0|1.0] "Unitless" FLRdpHPA,FLRdpHPB
 SG_ FLR2RdrDetn150To154DynPrpty3 : 285|1@1+ (1.0,0.0) [0.0|1.0] "Unitless" FLRdpHPA,FLRdpHPB
 SG_ FLR2RdrDetn150To154DynPrpty4 : 349|1@1+ (1.0,0.0) [0.0|1.0] "Unitless" FLRdpHPA,FLRdpHPB
 SG_ FLR2RdrDetn150To154EleAng0 : 64|8@1+ (0.002,0.0) [0.0|0.5] "rad" FLRdpHPA,FLRdpHPB
 SG_ FLR2RdrDetn150To154EleAng1 : 128|8@1+ (0.002,0.0) [0.0|0.5] "rad" FLRdpHPA,FLRdpHPB
 SG_ FLR2RdrDetn150To154EleAng2 : 192|8@1+ (0.002,0.0) [0.0|0.5] "rad" FLRdpHPA,FLRdpHPB
 SG_ FLR2RdrDetn150To154EleAng3 : 256|8@1+ (0.002,0.0) [0.0|0.5] "rad" FLRdpHPA,FLRdpHPB
 SG_ FLR2RdrDetn150To154EleAng4 : 320|8@1+ (0.002,0.0) [0.0|0.5] "rad" FLRdpHPA,FLRdpHPB
 SG_ FLR2RdrDetn150To154Mode0 : 60|2@1+ (1,0) [0|3] "" FLRdpHPA,FLRdpHPB
 SG_ FLR2RdrDetn150To154Mode1 : 124|2@1+ (1,0) [0|3] "" FLRdpHPA,FLRdpHPB
 SG_ FLR2RdrDetn150To154Mode2 : 188|2@1+ (1,0) [0|3] "" FLRdpHPA,FLRdpHPB
 SG_ FLR2RdrDetn150To154Mode3 : 252|2@1+ (1,0) [0|3] "" FLRdpHPA,FLRdpHPB
 SG_ FLR2RdrDetn150To154Mode4 : 316|2@1+ (1,0) [0|3] "" FLRdpHPA,FLRdpHPB
 SG_ FLR2RdrDetn150To154Quality0 : 62|2@1+ (1,0) [0|3] "" FLRdpHPA,FLRdpHPB
 SG_ FLR2RdrDetn150To154Quality1 : 126|2@1+ (1,0) [0|3] "" FLRdpHPA,FLRdpHPB
 SG_ FLR2RdrDetn150To154Quality2 : 190|2@1+ (1,0) [0|3] "" FLRdpHPA,FLRdpHPB
 SG_ FLR2RdrDetn150To154Quality3 : 254|2@1+ (1,0) [0|3] "" FLRdpHPA,FLRdpHPB
 SG_ FLR2RdrDetn150To154Quality4 : 318|2@1+ (1,0) [0|3] "" FLRdpHPA,FLRdpHPB
 SG_ FLR2RdrDetn150To154Range0 : 48|12@1+ (0.1,0.4) [0.4|300.0] "m" FLRdpHPA,FLRdpHPB
 SG_ FLR2RdrDetn150To154Range1 : 112|12@1+ (0.1,0.4) [0.4|300.0] "m" FLRdpHPA,FLRdpHPB
 SG_ FLR2RdrDetn150To154Range2 : 176|12@1+ (0.1,0.4) [0.4|300.0] "m" FLRdpHPA,FLRdpHPB
 SG_ FLR2RdrDetn150To154Range3 : 240|12@1+ (0.1,0.4) [0.4|300.0] "m" FLRdpHPA,FLRdpHPB
 SG_ FLR2RdrDetn150To154Range4 : 304|12@1+ (0.1,0.4) [0.4|300.0] "m" FLRdpHPA,FLRdpHPB
 SG_ FLR2RdrDetn150To154RCS0 : 83|10@1+ (0.2,-100.0) [-100.0|70.0] "dBsm" FLRdpHPA,FLRdpHPB
 SG_ FLR2RdrDetn150To154RCS1 : 147|10@1+ (0.2,-100.0) [-100.0|70.0] "dBsm" FLRdpHPA,FLRdpHPB
 SG_ FLR2RdrDetn150To154RCS2 : 211|10@1+ (0.2,-100.0) [-100.0|70.0] "dBsm" FLRdpHPA,FLRdpHPB
 SG_ FLR2RdrDetn150To154RCS3 : 275|10@1+ (0.2,-100.0) [-100.0|70.0] "dBsm" FLRdpHPA,FLRdpHPB
 SG_ FLR2RdrDetn150To154RCS4 : 339|10@1+ (0.2,-100.0) [-100.0|70.0] "dBsm" FLRdpHPA,FLRdpHPB
 SG_ FLR2RdrDetn150To154RngRt0 : 72|11@1+ (0.1,-111.11) [-111.11|55.59000000000002] "m/s" FLRdpHPA,FLRdpHPB
 SG_ FLR2RdrDetn150To154RngRt1 : 136|11@1+ (0.1,-111.11) [-111.11|55.59000000000002] "m/s" FLRdpHPA,FLRdpHPB
 SG_ FLR2RdrDetn150To154RngRt2 : 200|11@1+ (0.1,-111.11) [-111.11|55.59000000000002] "m/s" FLRdpHPA,FLRdpHPB
 SG_ FLR2RdrDetn150To154RngRt3 : 264|11@1+ (0.1,-111.11) [-111.11|55.59000000000002] "m/s" FLRdpHPA,FLRdpHPB
 SG_ FLR2RdrDetn150To154RngRt4 : 328|11@1+ (0.1,-111.11) [-111.11|55.59000000000002] "m/s" FLRdpHPA,FLRdpHPB
 SG_ FLR2RdrDetn150To154ScanID : 24|8@1+ (1.0,0.0) [0.0|255.0] "Unitless" FLRdpHPA,FLRdpHPB
 SG_ FLR2RdrDetn150To154SNR0 : 41|7@1+ (0.5,0.0) [0.0|63.5] "dB" FLRdpHPA,FLRdpHPB
 SG_ FLR2RdrDetn150To154SNR1 : 105|7@1+ (0.5,0.0) [0.0|63.5] "dB" FLRdpHPA,FLRdpHPB
 SG_ FLR2RdrDetn150To154SNR2 : 169|7@1+ (0.5,0.0) [0.0|63.5] "dB" FLRdpHPA,FLRdpHPB
 SG_ FLR2RdrDetn150To154SNR3 : 233|7@1+ (0.5,0.0) [0.0|63.5] "dB" FLRdpHPA,FLRdpHPB
 SG_ FLR2RdrDetn150To154SNR4 : 297|7@1+ (0.5,0.0) [0.0|63.5] "dB" FLRdpHPA,FLRdpHPB

BO_ 182 FlrFlr1canFr32 : 64 FLR
 SG_ FLR2RdrDetn155To159_UB : 359|1@0+ (1,0) [0|1] "" FLRdpHPA,FLRdpHPB
 SG_ FLR2RdrDetn155To159AziAng0 : 32|9@1+ (0.0035,-0.87266) [-0.87266|0.91584] "rad" FLRdpHPA,FLRdpHPB
 SG_ FLR2RdrDetn155To159AziAng1 : 96|9@1+ (0.0035,-0.87266) [-0.87266|0.91584] "rad" FLRdpHPA,FLRdpHPB
 SG_ FLR2RdrDetn155To159AziAng2 : 160|9@1+ (0.0035,-0.87266) [-0.87266|0.91584] "rad" FLRdpHPA,FLRdpHPB
 SG_ FLR2RdrDetn155To159AziAng3 : 224|9@1+ (0.0035,-0.87266) [-0.87266|0.91584] "rad" FLRdpHPA,FLRdpHPB
 SG_ FLR2RdrDetn155To159AziAng4 : 288|9@1+ (0.0035,-0.87266) [-0.87266|0.91584] "rad" FLRdpHPA,FLRdpHPB
 SG_ FLR2RdrDetn155To159Counter : 16|8@1+ (1.0,0.0) [0.0|255.0] "Unitless" FLRdpHPA,FLRdpHPB
 SG_ FLR2RdrDetn155To159CRC : 0|16@1+ (1.0,0.0) [0.0|65535.0] "Unitless" FLRdpHPA,FLRdpHPB
 SG_ FLR2RdrDetn155To159DynPrpty0 : 93|1@1+ (1.0,0.0) [0.0|1.0] "Unitless" FLRdpHPA,FLRdpHPB
 SG_ FLR2RdrDetn155To159DynPrpty1 : 157|1@1+ (1.0,0.0) [0.0|1.0] "Unitless" FLRdpHPA,FLRdpHPB
 SG_ FLR2RdrDetn155To159DynPrpty2 : 221|1@1+ (1.0,0.0) [0.0|1.0] "Unitless" FLRdpHPA,FLRdpHPB
 SG_ FLR2RdrDetn155To159DynPrpty3 : 285|1@1+ (1.0,0.0) [0.0|1.0] "Unitless" FLRdpHPA,FLRdpHPB
 SG_ FLR2RdrDetn155To159DynPrpty4 : 349|1@1+ (1.0,0.0) [0.0|1.0] "Unitless" FLRdpHPA,FLRdpHPB
 SG_ FLR2RdrDetn155To159EleAng0 : 64|8@1+ (0.002,0.0) [0.0|0.5] "rad" FLRdpHPA,FLRdpHPB
 SG_ FLR2RdrDetn155To159EleAng1 : 128|8@1+ (0.002,0.0) [0.0|0.5] "rad" FLRdpHPA,FLRdpHPB
 SG_ FLR2RdrDetn155To159EleAng2 : 192|8@1+ (0.002,0.0) [0.0|0.5] "rad" FLRdpHPA,FLRdpHPB
 SG_ FLR2RdrDetn155To159EleAng3 : 256|8@1+ (0.002,0.0) [0.0|0.5] "rad" FLRdpHPA,FLRdpHPB
 SG_ FLR2RdrDetn155To159EleAng4 : 320|8@1+ (0.002,0.0) [0.0|0.5] "rad" FLRdpHPA,FLRdpHPB
 SG_ FLR2RdrDetn155To159Mode0 : 60|2@1+ (1,0) [0|3] "" FLRdpHPA,FLRdpHPB
 SG_ FLR2RdrDetn155To159Mode1 : 124|2@1+ (1,0) [0|3] "" FLRdpHPA,FLRdpHPB
 SG_ FLR2RdrDetn155To159Mode2 : 188|2@1+ (1,0) [0|3] "" FLRdpHPA,FLRdpHPB
 SG_ FLR2RdrDetn155To159Mode3 : 252|2@1+ (1,0) [0|3] "" FLRdpHPA,FLRdpHPB
 SG_ FLR2RdrDetn155To159Mode4 : 316|2@1+ (1,0) [0|3] "" FLRdpHPA,FLRdpHPB
 SG_ FLR2RdrDetn155To159Quality0 : 62|2@1+ (1,0) [0|3] "" FLRdpHPA,FLRdpHPB
 SG_ FLR2RdrDetn155To159Quality1 : 126|2@1+ (1,0) [0|3] "" FLRdpHPA,FLRdpHPB
 SG_ FLR2RdrDetn155To159Quality2 : 190|2@1+ (1,0) [0|3] "" FLRdpHPA,FLRdpHPB
 SG_ FLR2RdrDetn155To159Quality3 : 254|2@1+ (1,0) [0|3] "" FLRdpHPA,FLRdpHPB
 SG_ FLR2RdrDetn155To159Quality4 : 318|2@1+ (1,0) [0|3] "" FLRdpHPA,FLRdpHPB
 SG_ FLR2RdrDetn155To159Range0 : 48|12@1+ (0.1,0.4) [0.4|300.0] "m" FLRdpHPA,FLRdpHPB
 SG_ FLR2RdrDetn155To159Range1 : 112|12@1+ (0.1,0.4) [0.4|300.0] "m" FLRdpHPA,FLRdpHPB
 SG_ FLR2RdrDetn155To159Range2 : 176|12@1+ (0.1,0.4) [0.4|300.0] "m" FLRdpHPA,FLRdpHPB
 SG_ FLR2RdrDetn155To159Range3 : 240|12@1+ (0.1,0.4) [0.4|300.0] "m" FLRdpHPA,FLRdpHPB
 SG_ FLR2RdrDetn155To159Range4 : 304|12@1+ (0.1,0.4) [0.4|300.0] "m" FLRdpHPA,FLRdpHPB
 SG_ FLR2RdrDetn155To159RCS0 : 83|10@1+ (0.2,-100.0) [-100.0|70.0] "dBsm" FLRdpHPA,FLRdpHPB
 SG_ FLR2RdrDetn155To159RCS1 : 147|10@1+ (0.2,-100.0) [-100.0|70.0] "dBsm" FLRdpHPA,FLRdpHPB
 SG_ FLR2RdrDetn155To159RCS2 : 211|10@1+ (0.2,-100.0) [-100.0|70.0] "dBsm" FLRdpHPA,FLRdpHPB
 SG_ FLR2RdrDetn155To159RCS3 : 275|10@1+ (0.2,-100.0) [-100.0|70.0] "dBsm" FLRdpHPA,FLRdpHPB
 SG_ FLR2RdrDetn155To159RCS4 : 339|10@1+ (0.2,-100.0) [-100.0|70.0] "dBsm" FLRdpHPA,FLRdpHPB
 SG_ FLR2RdrDetn155To159RngRt0 : 72|11@1+ (0.1,-111.11) [-111.11|55.59000000000002] "m/s" FLRdpHPA,FLRdpHPB
 SG_ FLR2RdrDetn155To159RngRt1 : 136|11@1+ (0.1,-111.11) [-111.11|55.59000000000002] "m/s" FLRdpHPA,FLRdpHPB
 SG_ FLR2RdrDetn155To159RngRt2 : 200|11@1+ (0.1,-111.11) [-111.11|55.59000000000002] "m/s" FLRdpHPA,FLRdpHPB
 SG_ FLR2RdrDetn155To159RngRt3 : 264|11@1+ (0.1,-111.11) [-111.11|55.59000000000002] "m/s" FLRdpHPA,FLRdpHPB
 SG_ FLR2RdrDetn155To159RngRt4 : 328|11@1+ (0.1,-111.11) [-111.11|55.59000000000002] "m/s" FLRdpHPA,FLRdpHPB
 SG_ FLR2RdrDetn155To159ScanID : 24|8@1+ (1.0,0.0) [0.0|255.0] "Unitless" FLRdpHPA,FLRdpHPB
 SG_ FLR2RdrDetn155To159SNR0 : 41|7@1+ (0.5,0.0) [0.0|63.5] "dB" FLRdpHPA,FLRdpHPB
 SG_ FLR2RdrDetn155To159SNR1 : 105|7@1+ (0.5,0.0) [0.0|63.5] "dB" FLRdpHPA,FLRdpHPB
 SG_ FLR2RdrDetn155To159SNR2 : 169|7@1+ (0.5,0.0) [0.0|63.5] "dB" FLRdpHPA,FLRdpHPB
 SG_ FLR2RdrDetn155To159SNR3 : 233|7@1+ (0.5,0.0) [0.0|63.5] "dB" FLRdpHPA,FLRdpHPB
 SG_ FLR2RdrDetn155To159SNR4 : 297|7@1+ (0.5,0.0) [0.0|63.5] "dB" FLRdpHPA,FLRdpHPB

BO_ 185 FlrFlr1canFr33 : 64 FLR
 SG_ FLR2RdrDetn160To164_UB : 359|1@0+ (1,0) [0|1] "" FLRdpHPA,FLRdpHPB
 SG_ FLR2RdrDetn160To164AziAng0 : 32|9@1+ (0.0035,-0.87266) [-0.87266|0.91584] "rad" FLRdpHPA,FLRdpHPB
 SG_ FLR2RdrDetn160To164AziAng1 : 96|9@1+ (0.0035,-0.87266) [-0.87266|0.91584] "rad" FLRdpHPA,FLRdpHPB
 SG_ FLR2RdrDetn160To164AziAng2 : 160|9@1+ (0.0035,-0.87266) [-0.87266|0.91584] "rad" FLRdpHPA,FLRdpHPB
 SG_ FLR2RdrDetn160To164AziAng3 : 224|9@1+ (0.0035,-0.87266) [-0.87266|0.91584] "rad" FLRdpHPA,FLRdpHPB
 SG_ FLR2RdrDetn160To164AziAng4 : 288|9@1+ (0.0035,-0.87266) [-0.87266|0.91584] "rad" FLRdpHPA,FLRdpHPB
 SG_ FLR2RdrDetn160To164Counter : 16|8@1+ (1.0,0.0) [0.0|255.0] "Unitless" FLRdpHPA,FLRdpHPB
 SG_ FLR2RdrDetn160To164CRC : 0|16@1+ (1.0,0.0) [0.0|65535.0] "Unitless" FLRdpHPA,FLRdpHPB
 SG_ FLR2RdrDetn160To164DynPrpty0 : 93|1@1+ (1.0,0.0) [0.0|1.0] "Unitless" FLRdpHPA,FLRdpHPB
 SG_ FLR2RdrDetn160To164DynPrpty1 : 157|1@1+ (1.0,0.0) [0.0|1.0] "Unitless" FLRdpHPA,FLRdpHPB
 SG_ FLR2RdrDetn160To164DynPrpty2 : 221|1@1+ (1.0,0.0) [0.0|1.0] "Unitless" FLRdpHPA,FLRdpHPB
 SG_ FLR2RdrDetn160To164DynPrpty3 : 285|1@1+ (1.0,0.0) [0.0|1.0] "Unitless" FLRdpHPA,FLRdpHPB
 SG_ FLR2RdrDetn160To164DynPrpty4 : 349|1@1+ (1.0,0.0) [0.0|1.0] "Unitless" FLRdpHPA,FLRdpHPB
 SG_ FLR2RdrDetn160To164EleAng0 : 64|8@1+ (0.002,0.0) [0.0|0.5] "rad" FLRdpHPA,FLRdpHPB
 SG_ FLR2RdrDetn160To164EleAng1 : 128|8@1+ (0.002,0.0) [0.0|0.5] "rad" FLRdpHPA,FLRdpHPB
 SG_ FLR2RdrDetn160To164EleAng2 : 192|8@1+ (0.002,0.0) [0.0|0.5] "rad" FLRdpHPA,FLRdpHPB
 SG_ FLR2RdrDetn160To164EleAng3 : 256|8@1+ (0.002,0.0) [0.0|0.5] "rad" FLRdpHPA,FLRdpHPB
 SG_ FLR2RdrDetn160To164EleAng4 : 320|8@1+ (0.002,0.0) [0.0|0.5] "rad" FLRdpHPA,FLRdpHPB
 SG_ FLR2RdrDetn160To164Mode0 : 60|2@1+ (1,0) [0|3] "" FLRdpHPA,FLRdpHPB
 SG_ FLR2RdrDetn160To164Mode1 : 124|2@1+ (1,0) [0|3] "" FLRdpHPA,FLRdpHPB
 SG_ FLR2RdrDetn160To164Mode2 : 188|2@1+ (1,0) [0|3] "" FLRdpHPA,FLRdpHPB
 SG_ FLR2RdrDetn160To164Mode3 : 252|2@1+ (1,0) [0|3] "" FLRdpHPA,FLRdpHPB
 SG_ FLR2RdrDetn160To164Mode4 : 316|2@1+ (1,0) [0|3] "" FLRdpHPA,FLRdpHPB
 SG_ FLR2RdrDetn160To164Quality0 : 62|2@1+ (1,0) [0|3] "" FLRdpHPA,FLRdpHPB
 SG_ FLR2RdrDetn160To164Quality1 : 126|2@1+ (1,0) [0|3] "" FLRdpHPA,FLRdpHPB
 SG_ FLR2RdrDetn160To164Quality2 : 190|2@1+ (1,0) [0|3] "" FLRdpHPA,FLRdpHPB
 SG_ FLR2RdrDetn160To164Quality3 : 254|2@1+ (1,0) [0|3] "" FLRdpHPA,FLRdpHPB
 SG_ FLR2RdrDetn160To164Quality4 : 318|2@1+ (1,0) [0|3] "" FLRdpHPA,FLRdpHPB
 SG_ FLR2RdrDetn160To164Range0 : 48|12@1+ (0.1,0.4) [0.4|300.0] "m" FLRdpHPA,FLRdpHPB
 SG_ FLR2RdrDetn160To164Range1 : 112|12@1+ (0.1,0.4) [0.4|300.0] "m" FLRdpHPA,FLRdpHPB
 SG_ FLR2RdrDetn160To164Range2 : 176|12@1+ (0.1,0.4) [0.4|300.0] "m" FLRdpHPA,FLRdpHPB
 SG_ FLR2RdrDetn160To164Range3 : 240|12@1+ (0.1,0.4) [0.4|300.0] "m" FLRdpHPA,FLRdpHPB
 SG_ FLR2RdrDetn160To164Range4 : 304|12@1+ (0.1,0.4) [0.4|300.0] "m" FLRdpHPA,FLRdpHPB
 SG_ FLR2RdrDetn160To164RCS0 : 83|10@1+ (0.2,-100.0) [-100.0|70.0] "dBsm" FLRdpHPA,FLRdpHPB
 SG_ FLR2RdrDetn160To164RCS1 : 147|10@1+ (0.2,-100.0) [-100.0|70.0] "dBsm" FLRdpHPA,FLRdpHPB
 SG_ FLR2RdrDetn160To164RCS2 : 211|10@1+ (0.2,-100.0) [-100.0|70.0] "dBsm" FLRdpHPA,FLRdpHPB
 SG_ FLR2RdrDetn160To164RCS3 : 275|10@1+ (0.2,-100.0) [-100.0|70.0] "dBsm" FLRdpHPA,FLRdpHPB
 SG_ FLR2RdrDetn160To164RCS4 : 339|10@1+ (0.2,-100.0) [-100.0|70.0] "dBsm" FLRdpHPA,FLRdpHPB
 SG_ FLR2RdrDetn160To164RngRt0 : 72|11@1+ (0.1,-111.11) [-111.11|55.59000000000002] "m/s" FLRdpHPA,FLRdpHPB
 SG_ FLR2RdrDetn160To164RngRt1 : 136|11@1+ (0.1,-111.11) [-111.11|55.59000000000002] "m/s" FLRdpHPA,FLRdpHPB
 SG_ FLR2RdrDetn160To164RngRt2 : 200|11@1+ (0.1,-111.11) [-111.11|55.59000000000002] "m/s" FLRdpHPA,FLRdpHPB
 SG_ FLR2RdrDetn160To164RngRt3 : 264|11@1+ (0.1,-111.11) [-111.11|55.59000000000002] "m/s" FLRdpHPA,FLRdpHPB
 SG_ FLR2RdrDetn160To164RngRt4 : 328|11@1+ (0.1,-111.11) [-111.11|55.59000000000002] "m/s" FLRdpHPA,FLRdpHPB
 SG_ FLR2RdrDetn160To164ScanID : 24|8@1+ (1.0,0.0) [0.0|255.0] "Unitless" FLRdpHPA,FLRdpHPB
 SG_ FLR2RdrDetn160To164SNR0 : 41|7@1+ (0.5,0.0) [0.0|63.5] "dB" FLRdpHPA,FLRdpHPB
 SG_ FLR2RdrDetn160To164SNR1 : 105|7@1+ (0.5,0.0) [0.0|63.5] "dB" FLRdpHPA,FLRdpHPB
 SG_ FLR2RdrDetn160To164SNR2 : 169|7@1+ (0.5,0.0) [0.0|63.5] "dB" FLRdpHPA,FLRdpHPB
 SG_ FLR2RdrDetn160To164SNR3 : 233|7@1+ (0.5,0.0) [0.0|63.5] "dB" FLRdpHPA,FLRdpHPB
 SG_ FLR2RdrDetn160To164SNR4 : 297|7@1+ (0.5,0.0) [0.0|63.5] "dB" FLRdpHPA,FLRdpHPB

BO_ 188 FlrFlr1canFr34 : 64 FLR
 SG_ FLR2RdrDetn165To169_UB : 359|1@0+ (1,0) [0|1] "" FLRdpHPA,FLRdpHPB
 SG_ FLR2RdrDetn165To169AziAng0 : 32|9@1+ (0.0035,-0.87266) [-0.87266|0.91584] "rad" FLRdpHPA,FLRdpHPB
 SG_ FLR2RdrDetn165To169AziAng1 : 96|9@1+ (0.0035,-0.87266) [-0.87266|0.91584] "rad" FLRdpHPA,FLRdpHPB
 SG_ FLR2RdrDetn165To169AziAng2 : 160|9@1+ (0.0035,-0.87266) [-0.87266|0.91584] "rad" FLRdpHPA,FLRdpHPB
 SG_ FLR2RdrDetn165To169AziAng3 : 224|9@1+ (0.0035,-0.87266) [-0.87266|0.91584] "rad" FLRdpHPA,FLRdpHPB
 SG_ FLR2RdrDetn165To169AziAng4 : 288|9@1+ (0.0035,-0.87266) [-0.87266|0.91584] "rad" FLRdpHPA,FLRdpHPB
 SG_ FLR2RdrDetn165To169Counter : 16|8@1+ (1.0,0.0) [0.0|255.0] "Unitless" FLRdpHPA,FLRdpHPB
 SG_ FLR2RdrDetn165To169CRC : 0|16@1+ (1.0,0.0) [0.0|65535.0] "Unitless" FLRdpHPA,FLRdpHPB
 SG_ FLR2RdrDetn165To169DynPrpty0 : 93|1@1+ (1.0,0.0) [0.0|1.0] "Unitless" FLRdpHPA,FLRdpHPB
 SG_ FLR2RdrDetn165To169DynPrpty1 : 157|1@1+ (1.0,0.0) [0.0|1.0] "Unitless" FLRdpHPA,FLRdpHPB
 SG_ FLR2RdrDetn165To169DynPrpty2 : 221|1@1+ (1.0,0.0) [0.0|1.0] "Unitless" FLRdpHPA,FLRdpHPB
 SG_ FLR2RdrDetn165To169DynPrpty3 : 285|1@1+ (1.0,0.0) [0.0|1.0] "Unitless" FLRdpHPA,FLRdpHPB
 SG_ FLR2RdrDetn165To169DynPrpty4 : 349|1@1+ (1.0,0.0) [0.0|1.0] "Unitless" FLRdpHPA,FLRdpHPB
 SG_ FLR2RdrDetn165To169EleAng0 : 64|8@1+ (0.002,0.0) [0.0|0.5] "rad" FLRdpHPA,FLRdpHPB
 SG_ FLR2RdrDetn165To169EleAng1 : 128|8@1+ (0.002,0.0) [0.0|0.5] "rad" FLRdpHPA,FLRdpHPB
 SG_ FLR2RdrDetn165To169EleAng2 : 192|8@1+ (0.002,0.0) [0.0|0.5] "rad" FLRdpHPA,FLRdpHPB
 SG_ FLR2RdrDetn165To169EleAng3 : 256|8@1+ (0.002,0.0) [0.0|0.5] "rad" FLRdpHPA,FLRdpHPB
 SG_ FLR2RdrDetn165To169EleAng4 : 320|8@1+ (0.002,0.0) [0.0|0.5] "rad" FLRdpHPA,FLRdpHPB
 SG_ FLR2RdrDetn165To169Mode0 : 60|2@1+ (1,0) [0|3] "" FLRdpHPA,FLRdpHPB
 SG_ FLR2RdrDetn165To169Mode1 : 124|2@1+ (1,0) [0|3] "" FLRdpHPA,FLRdpHPB
 SG_ FLR2RdrDetn165To169Mode2 : 188|2@1+ (1,0) [0|3] "" FLRdpHPA,FLRdpHPB
 SG_ FLR2RdrDetn165To169Mode3 : 252|2@1+ (1,0) [0|3] "" FLRdpHPA,FLRdpHPB
 SG_ FLR2RdrDetn165To169Mode4 : 316|2@1+ (1,0) [0|3] "" FLRdpHPA,FLRdpHPB
 SG_ FLR2RdrDetn165To169Quality0 : 62|2@1+ (1,0) [0|3] "" FLRdpHPA,FLRdpHPB
 SG_ FLR2RdrDetn165To169Quality1 : 126|2@1+ (1,0) [0|3] "" FLRdpHPA,FLRdpHPB
 SG_ FLR2RdrDetn165To169Quality2 : 190|2@1+ (1,0) [0|3] "" FLRdpHPA,FLRdpHPB
 SG_ FLR2RdrDetn165To169Quality3 : 254|2@1+ (1,0) [0|3] "" FLRdpHPA,FLRdpHPB
 SG_ FLR2RdrDetn165To169Quality4 : 318|2@1+ (1,0) [0|3] "" FLRdpHPA,FLRdpHPB
 SG_ FLR2RdrDetn165To169Range0 : 48|12@1+ (0.1,0.4) [0.4|300.0] "m" FLRdpHPA,FLRdpHPB
 SG_ FLR2RdrDetn165To169Range1 : 112|12@1+ (0.1,0.4) [0.4|300.0] "m" FLRdpHPA,FLRdpHPB
 SG_ FLR2RdrDetn165To169Range2 : 176|12@1+ (0.1,0.4) [0.4|300.0] "m" FLRdpHPA,FLRdpHPB
 SG_ FLR2RdrDetn165To169Range3 : 240|12@1+ (0.1,0.4) [0.4|300.0] "m" FLRdpHPA,FLRdpHPB
 SG_ FLR2RdrDetn165To169Range4 : 304|12@1+ (0.1,0.4) [0.4|300.0] "m" FLRdpHPA,FLRdpHPB
 SG_ FLR2RdrDetn165To169RCS0 : 83|10@1+ (0.2,-100.0) [-100.0|70.0] "dBsm" FLRdpHPA,FLRdpHPB
 SG_ FLR2RdrDetn165To169RCS1 : 147|10@1+ (0.2,-100.0) [-100.0|70.0] "dBsm" FLRdpHPA,FLRdpHPB
 SG_ FLR2RdrDetn165To169RCS2 : 211|10@1+ (0.2,-100.0) [-100.0|70.0] "dBsm" FLRdpHPA,FLRdpHPB
 SG_ FLR2RdrDetn165To169RCS3 : 275|10@1+ (0.2,-100.0) [-100.0|70.0] "dBsm" FLRdpHPA,FLRdpHPB
 SG_ FLR2RdrDetn165To169RCS4 : 339|10@1+ (0.2,-100.0) [-100.0|70.0] "dBsm" FLRdpHPA,FLRdpHPB
 SG_ FLR2RdrDetn165To169RngRt0 : 72|11@1+ (0.1,-111.11) [-111.11|55.59000000000002] "m/s" FLRdpHPA,FLRdpHPB
 SG_ FLR2RdrDetn165To169RngRt1 : 136|11@1+ (0.1,-111.11) [-111.11|55.59000000000002] "m/s" FLRdpHPA,FLRdpHPB
 SG_ FLR2RdrDetn165To169RngRt2 : 200|11@1+ (0.1,-111.11) [-111.11|55.59000000000002] "m/s" FLRdpHPA,FLRdpHPB
 SG_ FLR2RdrDetn165To169RngRt3 : 264|11@1+ (0.1,-111.11) [-111.11|55.59000000000002] "m/s" FLRdpHPA,FLRdpHPB
 SG_ FLR2RdrDetn165To169RngRt4 : 328|11@1+ (0.1,-111.11) [-111.11|55.59000000000002] "m/s" FLRdpHPA,FLRdpHPB
 SG_ FLR2RdrDetn165To169ScanID : 24|8@1+ (1.0,0.0) [0.0|255.0] "Unitless" FLRdpHPA,FLRdpHPB
 SG_ FLR2RdrDetn165To169SNR0 : 41|7@1+ (0.5,0.0) [0.0|63.5] "dB" FLRdpHPA,FLRdpHPB
 SG_ FLR2RdrDetn165To169SNR1 : 105|7@1+ (0.5,0.0) [0.0|63.5] "dB" FLRdpHPA,FLRdpHPB
 SG_ FLR2RdrDetn165To169SNR2 : 169|7@1+ (0.5,0.0) [0.0|63.5] "dB" FLRdpHPA,FLRdpHPB
 SG_ FLR2RdrDetn165To169SNR3 : 233|7@1+ (0.5,0.0) [0.0|63.5] "dB" FLRdpHPA,FLRdpHPB
 SG_ FLR2RdrDetn165To169SNR4 : 297|7@1+ (0.5,0.0) [0.0|63.5] "dB" FLRdpHPA,FLRdpHPB

BO_ 192 FlrFlr1canFr35 : 64 FLR
 SG_ FLR2RdrDetn170To174_UB : 359|1@0+ (1,0) [0|1] "" FLRdpHPA,FLRdpHPB
 SG_ FLR2RdrDetn170To174AziAng0 : 32|9@1+ (0.0035,-0.87266) [-0.87266|0.91584] "rad" FLRdpHPA,FLRdpHPB
 SG_ FLR2RdrDetn170To174AziAng1 : 96|9@1+ (0.0035,-0.87266) [-0.87266|0.91584] "rad" FLRdpHPA,FLRdpHPB
 SG_ FLR2RdrDetn170To174AziAng2 : 160|9@1+ (0.0035,-0.87266) [-0.87266|0.91584] "rad" FLRdpHPA,FLRdpHPB
 SG_ FLR2RdrDetn170To174AziAng3 : 224|9@1+ (0.0035,-0.87266) [-0.87266|0.91584] "rad" FLRdpHPA,FLRdpHPB
 SG_ FLR2RdrDetn170To174AziAng4 : 288|9@1+ (0.0035,-0.87266) [-0.87266|0.91584] "rad" FLRdpHPA,FLRdpHPB
 SG_ FLR2RdrDetn170To174Counter : 16|8@1+ (1.0,0.0) [0.0|255.0] "Unitless" FLRdpHPA,FLRdpHPB
 SG_ FLR2RdrDetn170To174CRC : 0|16@1+ (1.0,0.0) [0.0|65535.0] "Unitless" FLRdpHPA,FLRdpHPB
 SG_ FLR2RdrDetn170To174DynPrpty0 : 93|1@1+ (1.0,0.0) [0.0|1.0] "Unitless" FLRdpHPA,FLRdpHPB
 SG_ FLR2RdrDetn170To174DynPrpty1 : 157|1@1+ (1.0,0.0) [0.0|1.0] "Unitless" FLRdpHPA,FLRdpHPB
 SG_ FLR2RdrDetn170To174DynPrpty2 : 221|1@1+ (1.0,0.0) [0.0|1.0] "Unitless" FLRdpHPA,FLRdpHPB
 SG_ FLR2RdrDetn170To174DynPrpty3 : 285|1@1+ (1.0,0.0) [0.0|1.0] "Unitless" FLRdpHPA,FLRdpHPB
 SG_ FLR2RdrDetn170To174DynPrpty4 : 349|1@1+ (1.0,0.0) [0.0|1.0] "Unitless" FLRdpHPA,FLRdpHPB
 SG_ FLR2RdrDetn170To174EleAng0 : 64|8@1+ (0.002,0.0) [0.0|0.5] "rad" FLRdpHPA,FLRdpHPB
 SG_ FLR2RdrDetn170To174EleAng1 : 128|8@1+ (0.002,0.0) [0.0|0.5] "rad" FLRdpHPA,FLRdpHPB
 SG_ FLR2RdrDetn170To174EleAng2 : 192|8@1+ (0.002,0.0) [0.0|0.5] "rad" FLRdpHPA,FLRdpHPB
 SG_ FLR2RdrDetn170To174EleAng3 : 256|8@1+ (0.002,0.0) [0.0|0.5] "rad" FLRdpHPA,FLRdpHPB
 SG_ FLR2RdrDetn170To174EleAng4 : 320|8@1+ (0.002,0.0) [0.0|0.5] "rad" FLRdpHPA,FLRdpHPB
 SG_ FLR2RdrDetn170To174Mode0 : 60|2@1+ (1,0) [0|3] "" FLRdpHPA,FLRdpHPB
 SG_ FLR2RdrDetn170To174Mode1 : 124|2@1+ (1,0) [0|3] "" FLRdpHPA,FLRdpHPB
 SG_ FLR2RdrDetn170To174Mode2 : 188|2@1+ (1,0) [0|3] "" FLRdpHPA,FLRdpHPB
 SG_ FLR2RdrDetn170To174Mode3 : 252|2@1+ (1,0) [0|3] "" FLRdpHPA,FLRdpHPB
 SG_ FLR2RdrDetn170To174Mode4 : 316|2@1+ (1,0) [0|3] "" FLRdpHPA,FLRdpHPB
 SG_ FLR2RdrDetn170To174Quality0 : 62|2@1+ (1,0) [0|3] "" FLRdpHPA,FLRdpHPB
 SG_ FLR2RdrDetn170To174Quality1 : 126|2@1+ (1,0) [0|3] "" FLRdpHPA,FLRdpHPB
 SG_ FLR2RdrDetn170To174Quality2 : 190|2@1+ (1,0) [0|3] "" FLRdpHPA,FLRdpHPB
 SG_ FLR2RdrDetn170To174Quality3 : 254|2@1+ (1,0) [0|3] "" FLRdpHPA,FLRdpHPB
 SG_ FLR2RdrDetn170To174Quality4 : 318|2@1+ (1,0) [0|3] "" FLRdpHPA,FLRdpHPB
 SG_ FLR2RdrDetn170To174Range0 : 48|12@1+ (0.1,0.4) [0.4|300.0] "m" FLRdpHPA,FLRdpHPB
 SG_ FLR2RdrDetn170To174Range1 : 112|12@1+ (0.1,0.4) [0.4|300.0] "m" FLRdpHPA,FLRdpHPB
 SG_ FLR2RdrDetn170To174Range2 : 176|12@1+ (0.1,0.4) [0.4|300.0] "m" FLRdpHPA,FLRdpHPB
 SG_ FLR2RdrDetn170To174Range3 : 240|12@1+ (0.1,0.4) [0.4|300.0] "m" FLRdpHPA,FLRdpHPB
 SG_ FLR2RdrDetn170To174Range4 : 304|12@1+ (0.1,0.4) [0.4|300.0] "m" FLRdpHPA,FLRdpHPB
 SG_ FLR2RdrDetn170To174RCS0 : 83|10@1+ (0.2,-100.0) [-100.0|70.0] "dBsm" FLRdpHPA,FLRdpHPB
 SG_ FLR2RdrDetn170To174RCS1 : 147|10@1+ (0.2,-100.0) [-100.0|70.0] "dBsm" FLRdpHPA,FLRdpHPB
 SG_ FLR2RdrDetn170To174RCS2 : 211|10@1+ (0.2,-100.0) [-100.0|70.0] "dBsm" FLRdpHPA,FLRdpHPB
 SG_ FLR2RdrDetn170To174RCS3 : 275|10@1+ (0.2,-100.0) [-100.0|70.0] "dBsm" FLRdpHPA,FLRdpHPB
 SG_ FLR2RdrDetn170To174RCS4 : 339|10@1+ (0.2,-100.0) [-100.0|70.0] "dBsm" FLRdpHPA,FLRdpHPB
 SG_ FLR2RdrDetn170To174RngRt0 : 72|11@1+ (0.1,-111.11) [-111.11|55.59000000000002] "m/s" FLRdpHPA,FLRdpHPB
 SG_ FLR2RdrDetn170To174RngRt1 : 136|11@1+ (0.1,-111.11) [-111.11|55.59000000000002] "m/s" FLRdpHPA,FLRdpHPB
 SG_ FLR2RdrDetn170To174RngRt2 : 200|11@1+ (0.1,-111.11) [-111.11|55.59000000000002] "m/s" FLRdpHPA,FLRdpHPB
 SG_ FLR2RdrDetn170To174RngRt3 : 264|11@1+ (0.1,-111.11) [-111.11|55.59000000000002] "m/s" FLRdpHPA,FLRdpHPB
 SG_ FLR2RdrDetn170To174RngRt4 : 328|11@1+ (0.1,-111.11) [-111.11|55.59000000000002] "m/s" FLRdpHPA,FLRdpHPB
 SG_ FLR2RdrDetn170To174ScanID : 24|8@1+ (1.0,0.0) [0.0|255.0] "Unitless" FLRdpHPA,FLRdpHPB
 SG_ FLR2RdrDetn170To174SNR0 : 41|7@1+ (0.5,0.0) [0.0|63.5] "dB" FLRdpHPA,FLRdpHPB
 SG_ FLR2RdrDetn170To174SNR1 : 105|7@1+ (0.5,0.0) [0.0|63.5] "dB" FLRdpHPA,FLRdpHPB
 SG_ FLR2RdrDetn170To174SNR2 : 169|7@1+ (0.5,0.0) [0.0|63.5] "dB" FLRdpHPA,FLRdpHPB
 SG_ FLR2RdrDetn170To174SNR3 : 233|7@1+ (0.5,0.0) [0.0|63.5] "dB" FLRdpHPA,FLRdpHPB
 SG_ FLR2RdrDetn170To174SNR4 : 297|7@1+ (0.5,0.0) [0.0|63.5] "dB" FLRdpHPA,FLRdpHPB

BO_ 195 FlrFlr1canFr36 : 64 FLR
 SG_ FLR2RdrDetn175To179_UB : 359|1@0+ (1,0) [0|1] "" FLRdpHPA,FLRdpHPB
 SG_ FLR2RdrDetn175To179AziAng0 : 32|9@1+ (0.0035,-0.87266) [-0.87266|0.91584] "rad" FLRdpHPA,FLRdpHPB
 SG_ FLR2RdrDetn175To179AziAng1 : 96|9@1+ (0.0035,-0.87266) [-0.87266|0.91584] "rad" FLRdpHPA,FLRdpHPB
 SG_ FLR2RdrDetn175To179AziAng2 : 160|9@1+ (0.0035,-0.87266) [-0.87266|0.91584] "rad" FLRdpHPA,FLRdpHPB
 SG_ FLR2RdrDetn175To179AziAng3 : 224|9@1+ (0.0035,-0.87266) [-0.87266|0.91584] "rad" FLRdpHPA,FLRdpHPB
 SG_ FLR2RdrDetn175To179AziAng4 : 288|9@1+ (0.0035,-0.87266) [-0.87266|0.91584] "rad" FLRdpHPA,FLRdpHPB
 SG_ FLR2RdrDetn175To179Counter : 16|8@1+ (1.0,0.0) [0.0|255.0] "Unitless" FLRdpHPA,FLRdpHPB
 SG_ FLR2RdrDetn175To179CRC : 0|16@1+ (1.0,0.0) [0.0|65535.0] "Unitless" FLRdpHPA,FLRdpHPB
 SG_ FLR2RdrDetn175To179DynPrpty0 : 93|1@1+ (1.0,0.0) [0.0|1.0] "Unitless" FLRdpHPA,FLRdpHPB
 SG_ FLR2RdrDetn175To179DynPrpty1 : 157|1@1+ (1.0,0.0) [0.0|1.0] "Unitless" FLRdpHPA,FLRdpHPB
 SG_ FLR2RdrDetn175To179DynPrpty2 : 221|1@1+ (1.0,0.0) [0.0|1.0] "Unitless" FLRdpHPA,FLRdpHPB
 SG_ FLR2RdrDetn175To179DynPrpty3 : 285|1@1+ (1.0,0.0) [0.0|1.0] "Unitless" FLRdpHPA,FLRdpHPB
 SG_ FLR2RdrDetn175To179DynPrpty4 : 349|1@1+ (1.0,0.0) [0.0|1.0] "Unitless" FLRdpHPA,FLRdpHPB
 SG_ FLR2RdrDetn175To179EleAng0 : 64|8@1+ (0.002,0.0) [0.0|0.5] "rad" FLRdpHPA,FLRdpHPB
 SG_ FLR2RdrDetn175To179EleAng1 : 128|8@1+ (0.002,0.0) [0.0|0.5] "rad" FLRdpHPA,FLRdpHPB
 SG_ FLR2RdrDetn175To179EleAng2 : 192|8@1+ (0.002,0.0) [0.0|0.5] "rad" FLRdpHPA,FLRdpHPB
 SG_ FLR2RdrDetn175To179EleAng3 : 256|8@1+ (0.002,0.0) [0.0|0.5] "rad" FLRdpHPA,FLRdpHPB
 SG_ FLR2RdrDetn175To179EleAng4 : 320|8@1+ (0.002,0.0) [0.0|0.5] "rad" FLRdpHPA,FLRdpHPB
 SG_ FLR2RdrDetn175To179Mode0 : 60|2@1+ (1,0) [0|3] "" FLRdpHPA,FLRdpHPB
 SG_ FLR2RdrDetn175To179Mode1 : 124|2@1+ (1,0) [0|3] "" FLRdpHPA,FLRdpHPB
 SG_ FLR2RdrDetn175To179Mode2 : 188|2@1+ (1,0) [0|3] "" FLRdpHPA,FLRdpHPB
 SG_ FLR2RdrDetn175To179Mode3 : 252|2@1+ (1,0) [0|3] "" FLRdpHPA,FLRdpHPB
 SG_ FLR2RdrDetn175To179Mode4 : 316|2@1+ (1,0) [0|3] "" FLRdpHPA,FLRdpHPB
 SG_ FLR2RdrDetn175To179Quality0 : 62|2@1+ (1,0) [0|3] "" FLRdpHPA,FLRdpHPB
 SG_ FLR2RdrDetn175To179Quality1 : 126|2@1+ (1,0) [0|3] "" FLRdpHPA,FLRdpHPB
 SG_ FLR2RdrDetn175To179Quality2 : 190|2@1+ (1,0) [0|3] "" FLRdpHPA,FLRdpHPB
 SG_ FLR2RdrDetn175To179Quality3 : 254|2@1+ (1,0) [0|3] "" FLRdpHPA,FLRdpHPB
 SG_ FLR2RdrDetn175To179Quality4 : 318|2@1+ (1,0) [0|3] "" FLRdpHPA,FLRdpHPB
 SG_ FLR2RdrDetn175To179Range0 : 48|12@1+ (0.1,0.4) [0.4|300.0] "m" FLRdpHPA,FLRdpHPB
 SG_ FLR2RdrDetn175To179Range1 : 112|12@1+ (0.1,0.4) [0.4|300.0] "m" FLRdpHPA,FLRdpHPB
 SG_ FLR2RdrDetn175To179Range2 : 176|12@1+ (0.1,0.4) [0.4|300.0] "m" FLRdpHPA,FLRdpHPB
 SG_ FLR2RdrDetn175To179Range3 : 240|12@1+ (0.1,0.4) [0.4|300.0] "m" FLRdpHPA,FLRdpHPB
 SG_ FLR2RdrDetn175To179Range4 : 304|12@1+ (0.1,0.4) [0.4|300.0] "m" FLRdpHPA,FLRdpHPB
 SG_ FLR2RdrDetn175To179RCS0 : 83|10@1+ (0.2,-100.0) [-100.0|70.0] "dBsm" FLRdpHPA,FLRdpHPB
 SG_ FLR2RdrDetn175To179RCS1 : 147|10@1+ (0.2,-100.0) [-100.0|70.0] "dBsm" FLRdpHPA,FLRdpHPB
 SG_ FLR2RdrDetn175To179RCS2 : 211|10@1+ (0.2,-100.0) [-100.0|70.0] "dBsm" FLRdpHPA,FLRdpHPB
 SG_ FLR2RdrDetn175To179RCS3 : 275|10@1+ (0.2,-100.0) [-100.0|70.0] "dBsm" FLRdpHPA,FLRdpHPB
 SG_ FLR2RdrDetn175To179RCS4 : 339|10@1+ (0.2,-100.0) [-100.0|70.0] "dBsm" FLRdpHPA,FLRdpHPB
 SG_ FLR2RdrDetn175To179RngRt0 : 72|11@1+ (0.1,-111.11) [-111.11|55.59000000000002] "m/s" FLRdpHPA,FLRdpHPB
 SG_ FLR2RdrDetn175To179RngRt1 : 136|11@1+ (0.1,-111.11) [-111.11|55.59000000000002] "m/s" FLRdpHPA,FLRdpHPB
 SG_ FLR2RdrDetn175To179RngRt2 : 200|11@1+ (0.1,-111.11) [-111.11|55.59000000000002] "m/s" FLRdpHPA,FLRdpHPB
 SG_ FLR2RdrDetn175To179RngRt3 : 264|11@1+ (0.1,-111.11) [-111.11|55.59000000000002] "m/s" FLRdpHPA,FLRdpHPB
 SG_ FLR2RdrDetn175To179RngRt4 : 328|11@1+ (0.1,-111.11) [-111.11|55.59000000000002] "m/s" FLRdpHPA,FLRdpHPB
 SG_ FLR2RdrDetn175To179ScanID : 24|8@1+ (1.0,0.0) [0.0|255.0] "Unitless" FLRdpHPA,FLRdpHPB
 SG_ FLR2RdrDetn175To179SNR0 : 41|7@1+ (0.5,0.0) [0.0|63.5] "dB" FLRdpHPA,FLRdpHPB
 SG_ FLR2RdrDetn175To179SNR1 : 105|7@1+ (0.5,0.0) [0.0|63.5] "dB" FLRdpHPA,FLRdpHPB
 SG_ FLR2RdrDetn175To179SNR2 : 169|7@1+ (0.5,0.0) [0.0|63.5] "dB" FLRdpHPA,FLRdpHPB
 SG_ FLR2RdrDetn175To179SNR3 : 233|7@1+ (0.5,0.0) [0.0|63.5] "dB" FLRdpHPA,FLRdpHPB
 SG_ FLR2RdrDetn175To179SNR4 : 297|7@1+ (0.5,0.0) [0.0|63.5] "dB" FLRdpHPA,FLRdpHPB

BO_ 198 FlrFlr1canFr37 : 64 FLR
 SG_ FLR2RdrDetn180To184_UB : 359|1@0+ (1,0) [0|1] "" FLRdpHPA,FLRdpHPB
 SG_ FLR2RdrDetn180To184AziAng0 : 32|9@1+ (0.0035,-0.87266) [-0.87266|0.91584] "rad" FLRdpHPA,FLRdpHPB
 SG_ FLR2RdrDetn180To184AziAng1 : 96|9@1+ (0.0035,-0.87266) [-0.87266|0.91584] "rad" FLRdpHPA,FLRdpHPB
 SG_ FLR2RdrDetn180To184AziAng2 : 160|9@1+ (0.0035,-0.87266) [-0.87266|0.91584] "rad" FLRdpHPA,FLRdpHPB
 SG_ FLR2RdrDetn180To184AziAng3 : 224|9@1+ (0.0035,-0.87266) [-0.87266|0.91584] "rad" FLRdpHPA,FLRdpHPB
 SG_ FLR2RdrDetn180To184AziAng4 : 288|9@1+ (0.0035,-0.87266) [-0.87266|0.91584] "rad" FLRdpHPA,FLRdpHPB
 SG_ FLR2RdrDetn180To184Counter : 16|8@1+ (1.0,0.0) [0.0|255.0] "Unitless" FLRdpHPA,FLRdpHPB
 SG_ FLR2RdrDetn180To184CRC : 0|16@1+ (1.0,0.0) [0.0|65535.0] "Unitless" FLRdpHPA,FLRdpHPB
 SG_ FLR2RdrDetn180To184DynPrpty0 : 93|1@1+ (1.0,0.0) [0.0|1.0] "Unitless" FLRdpHPA,FLRdpHPB
 SG_ FLR2RdrDetn180To184DynPrpty1 : 157|1@1+ (1.0,0.0) [0.0|1.0] "Unitless" FLRdpHPA,FLRdpHPB
 SG_ FLR2RdrDetn180To184DynPrpty2 : 221|1@1+ (1.0,0.0) [0.0|1.0] "Unitless" FLRdpHPA,FLRdpHPB
 SG_ FLR2RdrDetn180To184DynPrpty3 : 285|1@1+ (1.0,0.0) [0.0|1.0] "Unitless" FLRdpHPA,FLRdpHPB
 SG_ FLR2RdrDetn180To184DynPrpty4 : 349|1@1+ (1.0,0.0) [0.0|1.0] "Unitless" FLRdpHPA,FLRdpHPB
 SG_ FLR2RdrDetn180To184EleAng0 : 64|8@1+ (0.002,0.0) [0.0|0.5] "rad" FLRdpHPA,FLRdpHPB
 SG_ FLR2RdrDetn180To184EleAng1 : 128|8@1+ (0.002,0.0) [0.0|0.5] "rad" FLRdpHPA,FLRdpHPB
 SG_ FLR2RdrDetn180To184EleAng2 : 192|8@1+ (0.002,0.0) [0.0|0.5] "rad" FLRdpHPA,FLRdpHPB
 SG_ FLR2RdrDetn180To184EleAng3 : 256|8@1+ (0.002,0.0) [0.0|0.5] "rad" FLRdpHPA,FLRdpHPB
 SG_ FLR2RdrDetn180To184EleAng4 : 320|8@1+ (0.002,0.0) [0.0|0.5] "rad" FLRdpHPA,FLRdpHPB
 SG_ FLR2RdrDetn180To184Mode0 : 60|2@1+ (1,0) [0|3] "" FLRdpHPA,FLRdpHPB
 SG_ FLR2RdrDetn180To184Mode1 : 124|2@1+ (1,0) [0|3] "" FLRdpHPA,FLRdpHPB
 SG_ FLR2RdrDetn180To184Mode2 : 188|2@1+ (1,0) [0|3] "" FLRdpHPA,FLRdpHPB
 SG_ FLR2RdrDetn180To184Mode3 : 252|2@1+ (1,0) [0|3] "" FLRdpHPA,FLRdpHPB
 SG_ FLR2RdrDetn180To184Mode4 : 316|2@1+ (1,0) [0|3] "" FLRdpHPA,FLRdpHPB
 SG_ FLR2RdrDetn180To184Quality0 : 62|2@1+ (1,0) [0|3] "" FLRdpHPA,FLRdpHPB
 SG_ FLR2RdrDetn180To184Quality1 : 126|2@1+ (1,0) [0|3] "" FLRdpHPA,FLRdpHPB
 SG_ FLR2RdrDetn180To184Quality2 : 190|2@1+ (1,0) [0|3] "" FLRdpHPA,FLRdpHPB
 SG_ FLR2RdrDetn180To184Quality3 : 254|2@1+ (1,0) [0|3] "" FLRdpHPA,FLRdpHPB
 SG_ FLR2RdrDetn180To184Quality4 : 318|2@1+ (1,0) [0|3] "" FLRdpHPA,FLRdpHPB
 SG_ FLR2RdrDetn180To184Range0 : 48|12@1+ (0.1,0.4) [0.4|300.0] "m" FLRdpHPA,FLRdpHPB
 SG_ FLR2RdrDetn180To184Range1 : 112|12@1+ (0.1,0.4) [0.4|300.0] "m" FLRdpHPA,FLRdpHPB
 SG_ FLR2RdrDetn180To184Range2 : 176|12@1+ (0.1,0.4) [0.4|300.0] "m" FLRdpHPA,FLRdpHPB
 SG_ FLR2RdrDetn180To184Range3 : 240|12@1+ (0.1,0.4) [0.4|300.0] "m" FLRdpHPA,FLRdpHPB
 SG_ FLR2RdrDetn180To184Range4 : 304|12@1+ (0.1,0.4) [0.4|300.0] "m" FLRdpHPA,FLRdpHPB
 SG_ FLR2RdrDetn180To184RCS0 : 83|10@1+ (0.2,-100.0) [-100.0|70.0] "dBsm" FLRdpHPA,FLRdpHPB
 SG_ FLR2RdrDetn180To184RCS1 : 147|10@1+ (0.2,-100.0) [-100.0|70.0] "dBsm" FLRdpHPA,FLRdpHPB
 SG_ FLR2RdrDetn180To184RCS2 : 211|10@1+ (0.2,-100.0) [-100.0|70.0] "dBsm" FLRdpHPA,FLRdpHPB
 SG_ FLR2RdrDetn180To184RCS3 : 275|10@1+ (0.2,-100.0) [-100.0|70.0] "dBsm" FLRdpHPA,FLRdpHPB
 SG_ FLR2RdrDetn180To184RCS4 : 339|10@1+ (0.2,-100.0) [-100.0|70.0] "dBsm" FLRdpHPA,FLRdpHPB
 SG_ FLR2RdrDetn180To184RngRt0 : 72|11@1+ (0.1,-111.11) [-111.11|55.59000000000002] "m/s" FLRdpHPA,FLRdpHPB
 SG_ FLR2RdrDetn180To184RngRt1 : 136|11@1+ (0.1,-111.11) [-111.11|55.59000000000002] "m/s" FLRdpHPA,FLRdpHPB
 SG_ FLR2RdrDetn180To184RngRt2 : 200|11@1+ (0.1,-111.11) [-111.11|55.59000000000002] "m/s" FLRdpHPA,FLRdpHPB
 SG_ FLR2RdrDetn180To184RngRt3 : 264|11@1+ (0.1,-111.11) [-111.11|55.59000000000002] "m/s" FLRdpHPA,FLRdpHPB
 SG_ FLR2RdrDetn180To184RngRt4 : 328|11@1+ (0.1,-111.11) [-111.11|55.59000000000002] "m/s" FLRdpHPA,FLRdpHPB
 SG_ FLR2RdrDetn180To184ScanID : 24|8@1+ (1.0,0.0) [0.0|255.0] "Unitless" FLRdpHPA,FLRdpHPB
 SG_ FLR2RdrDetn180To184SNR0 : 41|7@1+ (0.5,0.0) [0.0|63.5] "dB" FLRdpHPA,FLRdpHPB
 SG_ FLR2RdrDetn180To184SNR1 : 105|7@1+ (0.5,0.0) [0.0|63.5] "dB" FLRdpHPA,FLRdpHPB
 SG_ FLR2RdrDetn180To184SNR2 : 169|7@1+ (0.5,0.0) [0.0|63.5] "dB" FLRdpHPA,FLRdpHPB
 SG_ FLR2RdrDetn180To184SNR3 : 233|7@1+ (0.5,0.0) [0.0|63.5] "dB" FLRdpHPA,FLRdpHPB
 SG_ FLR2RdrDetn180To184SNR4 : 297|7@1+ (0.5,0.0) [0.0|63.5] "dB" FLRdpHPA,FLRdpHPB

BO_ 201 FlrFlr1canFr38 : 64 FLR
 SG_ FLR2RdrDetn185To189_UB : 359|1@0+ (1,0) [0|1] "" FLRdpHPA,FLRdpHPB
 SG_ FLR2RdrDetn185To189AziAng0 : 32|9@1+ (0.0035,-0.87266) [-0.87266|0.91584] "rad" FLRdpHPA,FLRdpHPB
 SG_ FLR2RdrDetn185To189AziAng1 : 96|9@1+ (0.0035,-0.87266) [-0.87266|0.91584] "rad" FLRdpHPA,FLRdpHPB
 SG_ FLR2RdrDetn185To189AziAng2 : 160|9@1+ (0.0035,-0.87266) [-0.87266|0.91584] "rad" FLRdpHPA,FLRdpHPB
 SG_ FLR2RdrDetn185To189AziAng3 : 224|9@1+ (0.0035,-0.87266) [-0.87266|0.91584] "rad" FLRdpHPA,FLRdpHPB
 SG_ FLR2RdrDetn185To189AziAng4 : 288|9@1+ (0.0035,-0.87266) [-0.87266|0.91584] "rad" FLRdpHPA,FLRdpHPB
 SG_ FLR2RdrDetn185To189Counter : 16|8@1+ (1.0,0.0) [0.0|255.0] "Unitless" FLRdpHPA,FLRdpHPB
 SG_ FLR2RdrDetn185To189CRC : 0|16@1+ (1.0,0.0) [0.0|65535.0] "Unitless" FLRdpHPA,FLRdpHPB
 SG_ FLR2RdrDetn185To189DynPrpty0 : 93|1@1+ (1.0,0.0) [0.0|1.0] "Unitless" FLRdpHPA,FLRdpHPB
 SG_ FLR2RdrDetn185To189DynPrpty1 : 157|1@1+ (1.0,0.0) [0.0|1.0] "Unitless" FLRdpHPA,FLRdpHPB
 SG_ FLR2RdrDetn185To189DynPrpty2 : 221|1@1+ (1.0,0.0) [0.0|1.0] "Unitless" FLRdpHPA,FLRdpHPB
 SG_ FLR2RdrDetn185To189DynPrpty3 : 285|1@1+ (1.0,0.0) [0.0|1.0] "Unitless" FLRdpHPA,FLRdpHPB
 SG_ FLR2RdrDetn185To189DynPrpty4 : 349|1@1+ (1.0,0.0) [0.0|1.0] "Unitless" FLRdpHPA,FLRdpHPB
 SG_ FLR2RdrDetn185To189EleAng0 : 64|8@1+ (0.002,0.0) [0.0|0.5] "rad" FLRdpHPA,FLRdpHPB
 SG_ FLR2RdrDetn185To189EleAng1 : 128|8@1+ (0.002,0.0) [0.0|0.5] "rad" FLRdpHPA,FLRdpHPB
 SG_ FLR2RdrDetn185To189EleAng2 : 192|8@1+ (0.002,0.0) [0.0|0.5] "rad" FLRdpHPA,FLRdpHPB
 SG_ FLR2RdrDetn185To189EleAng3 : 256|8@1+ (0.002,0.0) [0.0|0.5] "rad" FLRdpHPA,FLRdpHPB
 SG_ FLR2RdrDetn185To189EleAng4 : 320|8@1+ (0.002,0.0) [0.0|0.5] "rad" FLRdpHPA,FLRdpHPB
 SG_ FLR2RdrDetn185To189Mode0 : 60|2@1+ (1,0) [0|3] "" FLRdpHPA,FLRdpHPB
 SG_ FLR2RdrDetn185To189Mode1 : 124|2@1+ (1,0) [0|3] "" FLRdpHPA,FLRdpHPB
 SG_ FLR2RdrDetn185To189Mode2 : 188|2@1+ (1,0) [0|3] "" FLRdpHPA,FLRdpHPB
 SG_ FLR2RdrDetn185To189Mode3 : 252|2@1+ (1,0) [0|3] "" FLRdpHPA,FLRdpHPB
 SG_ FLR2RdrDetn185To189Mode4 : 316|2@1+ (1,0) [0|3] "" FLRdpHPA,FLRdpHPB
 SG_ FLR2RdrDetn185To189Quality0 : 62|2@1+ (1,0) [0|3] "" FLRdpHPA,FLRdpHPB
 SG_ FLR2RdrDetn185To189Quality1 : 126|2@1+ (1,0) [0|3] "" FLRdpHPA,FLRdpHPB
 SG_ FLR2RdrDetn185To189Quality2 : 190|2@1+ (1,0) [0|3] "" FLRdpHPA,FLRdpHPB
 SG_ FLR2RdrDetn185To189Quality3 : 254|2@1+ (1,0) [0|3] "" FLRdpHPA,FLRdpHPB
 SG_ FLR2RdrDetn185To189Quality4 : 318|2@1+ (1,0) [0|3] "" FLRdpHPA,FLRdpHPB
 SG_ FLR2RdrDetn185To189Range0 : 48|12@1+ (0.1,0.4) [0.4|300.0] "m" FLRdpHPA,FLRdpHPB
 SG_ FLR2RdrDetn185To189Range1 : 112|12@1+ (0.1,0.4) [0.4|300.0] "m" FLRdpHPA,FLRdpHPB
 SG_ FLR2RdrDetn185To189Range2 : 176|12@1+ (0.1,0.4) [0.4|300.0] "m" FLRdpHPA,FLRdpHPB
 SG_ FLR2RdrDetn185To189Range3 : 240|12@1+ (0.1,0.4) [0.4|300.0] "m" FLRdpHPA,FLRdpHPB
 SG_ FLR2RdrDetn185To189Range4 : 304|12@1+ (0.1,0.4) [0.4|300.0] "m" FLRdpHPA,FLRdpHPB
 SG_ FLR2RdrDetn185To189RCS0 : 83|10@1+ (0.2,-100.0) [-100.0|70.0] "dBsm" FLRdpHPA,FLRdpHPB
 SG_ FLR2RdrDetn185To189RCS1 : 147|10@1+ (0.2,-100.0) [-100.0|70.0] "dBsm" FLRdpHPA,FLRdpHPB
 SG_ FLR2RdrDetn185To189RCS2 : 211|10@1+ (0.2,-100.0) [-100.0|70.0] "dBsm" FLRdpHPA,FLRdpHPB
 SG_ FLR2RdrDetn185To189RCS3 : 275|10@1+ (0.2,-100.0) [-100.0|70.0] "dBsm" FLRdpHPA,FLRdpHPB
 SG_ FLR2RdrDetn185To189RCS4 : 339|10@1+ (0.2,-100.0) [-100.0|70.0] "dBsm" FLRdpHPA,FLRdpHPB
 SG_ FLR2RdrDetn185To189RngRt0 : 72|11@1+ (0.1,-111.11) [-111.11|55.59000000000002] "m/s" FLRdpHPA,FLRdpHPB
 SG_ FLR2RdrDetn185To189RngRt1 : 136|11@1+ (0.1,-111.11) [-111.11|55.59000000000002] "m/s" FLRdpHPA,FLRdpHPB
 SG_ FLR2RdrDetn185To189RngRt2 : 200|11@1+ (0.1,-111.11) [-111.11|55.59000000000002] "m/s" FLRdpHPA,FLRdpHPB
 SG_ FLR2RdrDetn185To189RngRt3 : 264|11@1+ (0.1,-111.11) [-111.11|55.59000000000002] "m/s" FLRdpHPA,FLRdpHPB
 SG_ FLR2RdrDetn185To189RngRt4 : 328|11@1+ (0.1,-111.11) [-111.11|55.59000000000002] "m/s" FLRdpHPA,FLRdpHPB
 SG_ FLR2RdrDetn185To189ScanID : 24|8@1+ (1.0,0.0) [0.0|255.0] "Unitless" FLRdpHPA,FLRdpHPB
 SG_ FLR2RdrDetn185To189SNR0 : 41|7@1+ (0.5,0.0) [0.0|63.5] "dB" FLRdpHPA,FLRdpHPB
 SG_ FLR2RdrDetn185To189SNR1 : 105|7@1+ (0.5,0.0) [0.0|63.5] "dB" FLRdpHPA,FLRdpHPB
 SG_ FLR2RdrDetn185To189SNR2 : 169|7@1+ (0.5,0.0) [0.0|63.5] "dB" FLRdpHPA,FLRdpHPB
 SG_ FLR2RdrDetn185To189SNR3 : 233|7@1+ (0.5,0.0) [0.0|63.5] "dB" FLRdpHPA,FLRdpHPB
 SG_ FLR2RdrDetn185To189SNR4 : 297|7@1+ (0.5,0.0) [0.0|63.5] "dB" FLRdpHPA,FLRdpHPB

BO_ 204 FlrFlr1canFr39 : 64 FLR
 SG_ FLR2RdrDetn190To194_UB : 359|1@0+ (1,0) [0|1] "" FLRdpHPA,FLRdpHPB
 SG_ FLR2RdrDetn190To194AziAng0 : 32|9@1+ (0.0035,-0.87266) [-0.87266|0.91584] "rad" FLRdpHPA,FLRdpHPB
 SG_ FLR2RdrDetn190To194AziAng1 : 96|9@1+ (0.0035,-0.87266) [-0.87266|0.91584] "rad" FLRdpHPA,FLRdpHPB
 SG_ FLR2RdrDetn190To194AziAng2 : 160|9@1+ (0.0035,-0.87266) [-0.87266|0.91584] "rad" FLRdpHPA,FLRdpHPB
 SG_ FLR2RdrDetn190To194AziAng3 : 224|9@1+ (0.0035,-0.87266) [-0.87266|0.91584] "rad" FLRdpHPA,FLRdpHPB
 SG_ FLR2RdrDetn190To194AziAng4 : 288|9@1+ (0.0035,-0.87266) [-0.87266|0.91584] "rad" FLRdpHPA,FLRdpHPB
 SG_ FLR2RdrDetn190To194Counter : 16|8@1+ (1.0,0.0) [0.0|255.0] "Unitless" FLRdpHPA,FLRdpHPB
 SG_ FLR2RdrDetn190To194CRC : 0|16@1+ (1.0,0.0) [0.0|65535.0] "Unitless" FLRdpHPA,FLRdpHPB
 SG_ FLR2RdrDetn190To194DynPrpty0 : 93|1@1+ (1.0,0.0) [0.0|1.0] "Unitless" FLRdpHPA,FLRdpHPB
 SG_ FLR2RdrDetn190To194DynPrpty1 : 157|1@1+ (1.0,0.0) [0.0|1.0] "Unitless" FLRdpHPA,FLRdpHPB
 SG_ FLR2RdrDetn190To194DynPrpty2 : 221|1@1+ (1.0,0.0) [0.0|1.0] "Unitless" FLRdpHPA,FLRdpHPB
 SG_ FLR2RdrDetn190To194DynPrpty3 : 285|1@1+ (1.0,0.0) [0.0|1.0] "Unitless" FLRdpHPA,FLRdpHPB
 SG_ FLR2RdrDetn190To194DynPrpty4 : 349|1@1+ (1.0,0.0) [0.0|1.0] "Unitless" FLRdpHPA,FLRdpHPB
 SG_ FLR2RdrDetn190To194EleAng0 : 64|8@1+ (0.002,0.0) [0.0|0.5] "rad" FLRdpHPA,FLRdpHPB
 SG_ FLR2RdrDetn190To194EleAng1 : 128|8@1+ (0.002,0.0) [0.0|0.5] "rad" FLRdpHPA,FLRdpHPB
 SG_ FLR2RdrDetn190To194EleAng2 : 192|8@1+ (0.002,0.0) [0.0|0.5] "rad" FLRdpHPA,FLRdpHPB
 SG_ FLR2RdrDetn190To194EleAng3 : 256|8@1+ (0.002,0.0) [0.0|0.5] "rad" FLRdpHPA,FLRdpHPB
 SG_ FLR2RdrDetn190To194EleAng4 : 320|8@1+ (0.002,0.0) [0.0|0.5] "rad" FLRdpHPA,FLRdpHPB
 SG_ FLR2RdrDetn190To194Mode0 : 60|2@1+ (1,0) [0|3] "" FLRdpHPA,FLRdpHPB
 SG_ FLR2RdrDetn190To194Mode1 : 124|2@1+ (1,0) [0|3] "" FLRdpHPA,FLRdpHPB
 SG_ FLR2RdrDetn190To194Mode2 : 188|2@1+ (1,0) [0|3] "" FLRdpHPA,FLRdpHPB
 SG_ FLR2RdrDetn190To194Mode3 : 252|2@1+ (1,0) [0|3] "" FLRdpHPA,FLRdpHPB
 SG_ FLR2RdrDetn190To194Mode4 : 316|2@1+ (1,0) [0|3] "" FLRdpHPA,FLRdpHPB
 SG_ FLR2RdrDetn190To194Quality0 : 62|2@1+ (1,0) [0|3] "" FLRdpHPA,FLRdpHPB
 SG_ FLR2RdrDetn190To194Quality1 : 126|2@1+ (1,0) [0|3] "" FLRdpHPA,FLRdpHPB
 SG_ FLR2RdrDetn190To194Quality2 : 190|2@1+ (1,0) [0|3] "" FLRdpHPA,FLRdpHPB
 SG_ FLR2RdrDetn190To194Quality3 : 254|2@1+ (1,0) [0|3] "" FLRdpHPA,FLRdpHPB
 SG_ FLR2RdrDetn190To194Quality4 : 318|2@1+ (1,0) [0|3] "" FLRdpHPA,FLRdpHPB
 SG_ FLR2RdrDetn190To194Range0 : 48|12@1+ (0.1,0.4) [0.4|300.0] "m" FLRdpHPA,FLRdpHPB
 SG_ FLR2RdrDetn190To194Range1 : 112|12@1+ (0.1,0.4) [0.4|300.0] "m" FLRdpHPA,FLRdpHPB
 SG_ FLR2RdrDetn190To194Range2 : 176|12@1+ (0.1,0.4) [0.4|300.0] "m" FLRdpHPA,FLRdpHPB
 SG_ FLR2RdrDetn190To194Range3 : 240|12@1+ (0.1,0.4) [0.4|300.0] "m" FLRdpHPA,FLRdpHPB
 SG_ FLR2RdrDetn190To194Range4 : 304|12@1+ (0.1,0.4) [0.4|300.0] "m" FLRdpHPA,FLRdpHPB
 SG_ FLR2RdrDetn190To194RCS0 : 83|10@1+ (0.2,-100.0) [-100.0|70.0] "dBsm" FLRdpHPA,FLRdpHPB
 SG_ FLR2RdrDetn190To194RCS1 : 147|10@1+ (0.2,-100.0) [-100.0|70.0] "dBsm" FLRdpHPA,FLRdpHPB
 SG_ FLR2RdrDetn190To194RCS2 : 211|10@1+ (0.2,-100.0) [-100.0|70.0] "dBsm" FLRdpHPA,FLRdpHPB
 SG_ FLR2RdrDetn190To194RCS3 : 275|10@1+ (0.2,-100.0) [-100.0|70.0] "dBsm" FLRdpHPA,FLRdpHPB
 SG_ FLR2RdrDetn190To194RCS4 : 339|10@1+ (0.2,-100.0) [-100.0|70.0] "dBsm" FLRdpHPA,FLRdpHPB
 SG_ FLR2RdrDetn190To194RngRt0 : 72|11@1+ (0.1,-111.11) [-111.11|55.59000000000002] "m/s" FLRdpHPA,FLRdpHPB
 SG_ FLR2RdrDetn190To194RngRt1 : 136|11@1+ (0.1,-111.11) [-111.11|55.59000000000002] "m/s" FLRdpHPA,FLRdpHPB
 SG_ FLR2RdrDetn190To194RngRt2 : 200|11@1+ (0.1,-111.11) [-111.11|55.59000000000002] "m/s" FLRdpHPA,FLRdpHPB
 SG_ FLR2RdrDetn190To194RngRt3 : 264|11@1+ (0.1,-111.11) [-111.11|55.59000000000002] "m/s" FLRdpHPA,FLRdpHPB
 SG_ FLR2RdrDetn190To194RngRt4 : 328|11@1+ (0.1,-111.11) [-111.11|55.59000000000002] "m/s" FLRdpHPA,FLRdpHPB
 SG_ FLR2RdrDetn190To194ScanID : 24|8@1+ (1.0,0.0) [0.0|255.0] "Unitless" FLRdpHPA,FLRdpHPB
 SG_ FLR2RdrDetn190To194SNR0 : 41|7@1+ (0.5,0.0) [0.0|63.5] "dB" FLRdpHPA,FLRdpHPB
 SG_ FLR2RdrDetn190To194SNR1 : 105|7@1+ (0.5,0.0) [0.0|63.5] "dB" FLRdpHPA,FLRdpHPB
 SG_ FLR2RdrDetn190To194SNR2 : 169|7@1+ (0.5,0.0) [0.0|63.5] "dB" FLRdpHPA,FLRdpHPB
 SG_ FLR2RdrDetn190To194SNR3 : 233|7@1+ (0.5,0.0) [0.0|63.5] "dB" FLRdpHPA,FLRdpHPB
 SG_ FLR2RdrDetn190To194SNR4 : 297|7@1+ (0.5,0.0) [0.0|63.5] "dB" FLRdpHPA,FLRdpHPB

BO_ 208 FlrFlr1canFr40 : 64 FLR
 SG_ FLR2RdrDetn195To199_UB : 359|1@0+ (1,0) [0|1] "" FLRdpHPA,FLRdpHPB
 SG_ FLR2RdrDetn195To199AziAng0 : 32|9@1+ (0.0035,-0.87266) [-0.87266|0.91584] "rad" FLRdpHPA,FLRdpHPB
 SG_ FLR2RdrDetn195To199AziAng1 : 96|9@1+ (0.0035,-0.87266) [-0.87266|0.91584] "rad" FLRdpHPA,FLRdpHPB
 SG_ FLR2RdrDetn195To199AziAng2 : 160|9@1+ (0.0035,-0.87266) [-0.87266|0.91584] "rad" FLRdpHPA,FLRdpHPB
 SG_ FLR2RdrDetn195To199AziAng3 : 224|9@1+ (0.0035,-0.87266) [-0.87266|0.91584] "rad" FLRdpHPA,FLRdpHPB
 SG_ FLR2RdrDetn195To199AziAng4 : 288|9@1+ (0.0035,-0.87266) [-0.87266|0.91584] "rad" FLRdpHPA,FLRdpHPB
 SG_ FLR2RdrDetn195To199Counter : 16|8@1+ (1.0,0.0) [0.0|255.0] "Unitless" FLRdpHPA,FLRdpHPB
 SG_ FLR2RdrDetn195To199CRC : 0|16@1+ (1.0,0.0) [0.0|65535.0] "Unitless" FLRdpHPA,FLRdpHPB
 SG_ FLR2RdrDetn195To199DynPrpty0 : 93|1@1+ (1.0,0.0) [0.0|1.0] "Unitless" FLRdpHPA,FLRdpHPB
 SG_ FLR2RdrDetn195To199DynPrpty1 : 157|1@1+ (1.0,0.0) [0.0|1.0] "Unitless" FLRdpHPA,FLRdpHPB
 SG_ FLR2RdrDetn195To199DynPrpty2 : 221|1@1+ (1.0,0.0) [0.0|1.0] "Unitless" FLRdpHPA,FLRdpHPB
 SG_ FLR2RdrDetn195To199DynPrpty3 : 285|1@1+ (1.0,0.0) [0.0|1.0] "Unitless" FLRdpHPA,FLRdpHPB
 SG_ FLR2RdrDetn195To199DynPrpty4 : 349|1@1+ (1.0,0.0) [0.0|1.0] "Unitless" FLRdpHPA,FLRdpHPB
 SG_ FLR2RdrDetn195To199EleAng0 : 64|8@1+ (0.002,0.0) [0.0|0.5] "rad" FLRdpHPA,FLRdpHPB
 SG_ FLR2RdrDetn195To199EleAng1 : 128|8@1+ (0.002,0.0) [0.0|0.5] "rad" FLRdpHPA,FLRdpHPB
 SG_ FLR2RdrDetn195To199EleAng2 : 192|8@1+ (0.002,0.0) [0.0|0.5] "rad" FLRdpHPA,FLRdpHPB
 SG_ FLR2RdrDetn195To199EleAng3 : 256|8@1+ (0.002,0.0) [0.0|0.5] "rad" FLRdpHPA,FLRdpHPB
 SG_ FLR2RdrDetn195To199EleAng4 : 320|8@1+ (0.002,0.0) [0.0|0.5] "rad" FLRdpHPA,FLRdpHPB
 SG_ FLR2RdrDetn195To199Mode0 : 60|2@1+ (1,0) [0|3] "" FLRdpHPA,FLRdpHPB
 SG_ FLR2RdrDetn195To199Mode1 : 124|2@1+ (1,0) [0|3] "" FLRdpHPA,FLRdpHPB
 SG_ FLR2RdrDetn195To199Mode2 : 188|2@1+ (1,0) [0|3] "" FLRdpHPA,FLRdpHPB
 SG_ FLR2RdrDetn195To199Mode3 : 252|2@1+ (1,0) [0|3] "" FLRdpHPA,FLRdpHPB
 SG_ FLR2RdrDetn195To199Mode4 : 316|2@1+ (1,0) [0|3] "" FLRdpHPA,FLRdpHPB
 SG_ FLR2RdrDetn195To199Quality0 : 62|2@1+ (1,0) [0|3] "" FLRdpHPA,FLRdpHPB
 SG_ FLR2RdrDetn195To199Quality1 : 126|2@1+ (1,0) [0|3] "" FLRdpHPA,FLRdpHPB
 SG_ FLR2RdrDetn195To199Quality2 : 190|2@1+ (1,0) [0|3] "" FLRdpHPA,FLRdpHPB
 SG_ FLR2RdrDetn195To199Quality3 : 254|2@1+ (1,0) [0|3] "" FLRdpHPA,FLRdpHPB
 SG_ FLR2RdrDetn195To199Quality4 : 318|2@1+ (1,0) [0|3] "" FLRdpHPA,FLRdpHPB
 SG_ FLR2RdrDetn195To199Range0 : 48|12@1+ (0.1,0.4) [0.4|300.0] "m" FLRdpHPA,FLRdpHPB
 SG_ FLR2RdrDetn195To199Range1 : 112|12@1+ (0.1,0.4) [0.4|300.0] "m" FLRdpHPA,FLRdpHPB
 SG_ FLR2RdrDetn195To199Range2 : 176|12@1+ (0.1,0.4) [0.4|300.0] "m" FLRdpHPA,FLRdpHPB
 SG_ FLR2RdrDetn195To199Range3 : 240|12@1+ (0.1,0.4) [0.4|300.0] "m" FLRdpHPA,FLRdpHPB
 SG_ FLR2RdrDetn195To199Range4 : 304|12@1+ (0.1,0.4) [0.4|300.0] "m" FLRdpHPA,FLRdpHPB
 SG_ FLR2RdrDetn195To199RCS0 : 83|10@1+ (0.2,-100.0) [-100.0|70.0] "dBsm" FLRdpHPA,FLRdpHPB
 SG_ FLR2RdrDetn195To199RCS1 : 147|10@1+ (0.2,-100.0) [-100.0|70.0] "dBsm" FLRdpHPA,FLRdpHPB
 SG_ FLR2RdrDetn195To199RCS2 : 211|10@1+ (0.2,-100.0) [-100.0|70.0] "dBsm" FLRdpHPA,FLRdpHPB
 SG_ FLR2RdrDetn195To199RCS3 : 275|10@1+ (0.2,-100.0) [-100.0|70.0] "dBsm" FLRdpHPA,FLRdpHPB
 SG_ FLR2RdrDetn195To199RCS4 : 339|10@1+ (0.2,-100.0) [-100.0|70.0] "dBsm" FLRdpHPA,FLRdpHPB
 SG_ FLR2RdrDetn195To199RngRt0 : 72|11@1+ (0.1,-111.11) [-111.11|55.59000000000002] "m/s" FLRdpHPA,FLRdpHPB
 SG_ FLR2RdrDetn195To199RngRt1 : 136|11@1+ (0.1,-111.11) [-111.11|55.59000000000002] "m/s" FLRdpHPA,FLRdpHPB
 SG_ FLR2RdrDetn195To199RngRt2 : 200|11@1+ (0.1,-111.11) [-111.11|55.59000000000002] "m/s" FLRdpHPA,FLRdpHPB
 SG_ FLR2RdrDetn195To199RngRt3 : 264|11@1+ (0.1,-111.11) [-111.11|55.59000000000002] "m/s" FLRdpHPA,FLRdpHPB
 SG_ FLR2RdrDetn195To199RngRt4 : 328|11@1+ (0.1,-111.11) [-111.11|55.59000000000002] "m/s" FLRdpHPA,FLRdpHPB
 SG_ FLR2RdrDetn195To199ScanID : 24|8@1+ (1.0,0.0) [0.0|255.0] "Unitless" FLRdpHPA,FLRdpHPB
 SG_ FLR2RdrDetn195To199SNR0 : 41|7@1+ (0.5,0.0) [0.0|63.5] "dB" FLRdpHPA,FLRdpHPB
 SG_ FLR2RdrDetn195To199SNR1 : 105|7@1+ (0.5,0.0) [0.0|63.5] "dB" FLRdpHPA,FLRdpHPB
 SG_ FLR2RdrDetn195To199SNR2 : 169|7@1+ (0.5,0.0) [0.0|63.5] "dB" FLRdpHPA,FLRdpHPB
 SG_ FLR2RdrDetn195To199SNR3 : 233|7@1+ (0.5,0.0) [0.0|63.5] "dB" FLRdpHPA,FLRdpHPB
 SG_ FLR2RdrDetn195To199SNR4 : 297|7@1+ (0.5,0.0) [0.0|63.5] "dB" FLRdpHPA,FLRdpHPB

CM_ SG_ 166 FLR2RdrDetn130To134AziAng0 "Azimuth Angle";
CM_ SG_ 166 FLR2RdrDetn130To134AziAng1 "Azimuth Angle";
CM_ SG_ 166 FLR2RdrDetn130To134AziAng2 "Azimuth Angle";
CM_ SG_ 166 FLR2RdrDetn130To134AziAng3 "Azimuth Angle";
CM_ SG_ 166 FLR2RdrDetn130To134AziAng4 "Azimuth Angle";
CM_ SG_ 166 FLR2RdrDetn130To134DynPrpty0 "Moving/Stationary";
CM_ SG_ 166 FLR2RdrDetn130To134DynPrpty1 "Moving/Stationary";
CM_ SG_ 166 FLR2RdrDetn130To134DynPrpty2 "Moving/Stationary";
CM_ SG_ 166 FLR2RdrDetn130To134DynPrpty3 "Moving/Stationary";
CM_ SG_ 166 FLR2RdrDetn130To134DynPrpty4 "Moving/Stationary";
CM_ SG_ 166 FLR2RdrDetn130To134EleAng0 "Elevation angle";
CM_ SG_ 166 FLR2RdrDetn130To134EleAng1 "Elevation angle";
CM_ SG_ 166 FLR2RdrDetn130To134EleAng2 "Elevation angle";
CM_ SG_ 166 FLR2RdrDetn130To134EleAng3 "Elevation angle";
CM_ SG_ 166 FLR2RdrDetn130To134EleAng4 "Elevation angle";
CM_ SG_ 166 FLR2RdrDetn130To134Mode0 "What chirp mode the detection is from";
CM_ SG_ 166 FLR2RdrDetn130To134Mode1 "What chirp mode the detection is from";
CM_ SG_ 166 FLR2RdrDetn130To134Mode2 "What chirp mode the detection is from";
CM_ SG_ 166 FLR2RdrDetn130To134Mode3 "What chirp mode the detection is from";
CM_ SG_ 166 FLR2RdrDetn130To134Mode4 "What chirp mode the detection is from";
CM_ SG_ 166 FLR2RdrDetn130To134Quality0 "Quality";
CM_ SG_ 166 FLR2RdrDetn130To134Quality1 "Quality";
CM_ SG_ 166 FLR2RdrDetn130To134Quality2 "Quality";
CM_ SG_ 166 FLR2RdrDetn130To134Quality3 "Quality";
CM_ SG_ 166 FLR2RdrDetn130To134Quality4 "Quality";
CM_ SG_ 166 FLR2RdrDetn130To134Range0 "Range from sensor to object";
CM_ SG_ 166 FLR2RdrDetn130To134Range1 "Range from sensor to object";
CM_ SG_ 166 FLR2RdrDetn130To134Range2 "Range from sensor to object";
CM_ SG_ 166 FLR2RdrDetn130To134Range3 "Range from sensor to object";
CM_ SG_ 166 FLR2RdrDetn130To134Range4 "Range from sensor to object";
CM_ SG_ 166 FLR2RdrDetn130To134RCS0 "RCS";
CM_ SG_ 166 FLR2RdrDetn130To134RCS1 "RCS";
CM_ SG_ 166 FLR2RdrDetn130To134RCS2 "RCS";
CM_ SG_ 166 FLR2RdrDetn130To134RCS3 "RCS";
CM_ SG_ 166 FLR2RdrDetn130To134RCS4 "RCS";
CM_ SG_ 166 FLR2RdrDetn130To134RngRt0 "Speed towards/away from the sensor";
CM_ SG_ 166 FLR2RdrDetn130To134RngRt1 "Speed towards/away from the sensor";
CM_ SG_ 166 FLR2RdrDetn130To134RngRt2 "Speed towards/away from the sensor";
CM_ SG_ 166 FLR2RdrDetn130To134RngRt3 "Speed towards/away from the sensor";
CM_ SG_ 166 FLR2RdrDetn130To134RngRt4 "Speed towards/away from the sensor";
CM_ SG_ 166 FLR2RdrDetn130To134ScanID "Value to tie status, detection data and object data frames together";
CM_ SG_ 166 FLR2RdrDetn130To134SNR0 "Signal to Noise Ratio";
CM_ SG_ 166 FLR2RdrDetn130To134SNR1 "Signal to Noise Ration";
CM_ SG_ 166 FLR2RdrDetn130To134SNR2 "Signal to Noise Ration";
CM_ SG_ 166 FLR2RdrDetn130To134SNR3 "Signal to Noise Ration";
CM_ SG_ 166 FLR2RdrDetn130To134SNR4 "Signal to Noise Ration";
CM_ SG_ 169 FLR2RdrDetn135To139AziAng0 "Azimuth Angle";
CM_ SG_ 169 FLR2RdrDetn135To139AziAng1 "Azimuth Angle";
CM_ SG_ 169 FLR2RdrDetn135To139AziAng2 "Azimuth Angle";
CM_ SG_ 169 FLR2RdrDetn135To139AziAng3 "Azimuth Angle";
CM_ SG_ 169 FLR2RdrDetn135To139AziAng4 "Azimuth Angle";
CM_ SG_ 169 FLR2RdrDetn135To139DynPrpty0 "Moving/Stationary";
CM_ SG_ 169 FLR2RdrDetn135To139DynPrpty1 "Moving/Stationary";
CM_ SG_ 169 FLR2RdrDetn135To139DynPrpty2 "Moving/Stationary";
CM_ SG_ 169 FLR2RdrDetn135To139DynPrpty3 "Moving/Stationary";
CM_ SG_ 169 FLR2RdrDetn135To139DynPrpty4 "Moving/Stationary";
CM_ SG_ 169 FLR2RdrDetn135To139EleAng0 "Elevation angle";
CM_ SG_ 169 FLR2RdrDetn135To139EleAng1 "Elevation angle";
CM_ SG_ 169 FLR2RdrDetn135To139EleAng2 "Elevation angle";
CM_ SG_ 169 FLR2RdrDetn135To139EleAng3 "Elevation angle";
CM_ SG_ 169 FLR2RdrDetn135To139EleAng4 "Elevation angle";
CM_ SG_ 169 FLR2RdrDetn135To139Mode0 "What chirp mode the detection is from";
CM_ SG_ 169 FLR2RdrDetn135To139Mode1 "What chirp mode the detection is from";
CM_ SG_ 169 FLR2RdrDetn135To139Mode2 "What chirp mode the detection is from";
CM_ SG_ 169 FLR2RdrDetn135To139Mode3 "What chirp mode the detection is from";
CM_ SG_ 169 FLR2RdrDetn135To139Mode4 "What chirp mode the detection is from";
CM_ SG_ 169 FLR2RdrDetn135To139Quality0 "Quality";
CM_ SG_ 169 FLR2RdrDetn135To139Quality1 "Quality";
CM_ SG_ 169 FLR2RdrDetn135To139Quality2 "Quality";
CM_ SG_ 169 FLR2RdrDetn135To139Quality3 "Quality";
CM_ SG_ 169 FLR2RdrDetn135To139Quality4 "Quality";
CM_ SG_ 169 FLR2RdrDetn135To139Range0 "Range from sensor to object";
CM_ SG_ 169 FLR2RdrDetn135To139Range1 "Range from sensor to object";
CM_ SG_ 169 FLR2RdrDetn135To139Range2 "Range from sensor to object";
CM_ SG_ 169 FLR2RdrDetn135To139Range3 "Range from sensor to object";
CM_ SG_ 169 FLR2RdrDetn135To139Range4 "Range from sensor to object";
CM_ SG_ 169 FLR2RdrDetn135To139RCS0 "RCS";
CM_ SG_ 169 FLR2RdrDetn135To139RCS1 "RCS";
CM_ SG_ 169 FLR2RdrDetn135To139RCS2 "RCS";
CM_ SG_ 169 FLR2RdrDetn135To139RCS3 "RCS";
CM_ SG_ 169 FLR2RdrDetn135To139RCS4 "RCS";
CM_ SG_ 169 FLR2RdrDetn135To139RngRt0 "Speed towards/away from the sensor";
CM_ SG_ 169 FLR2RdrDetn135To139RngRt1 "Speed towards/away from the sensor";
CM_ SG_ 169 FLR2RdrDetn135To139RngRt2 "Speed towards/away from the sensor";
CM_ SG_ 169 FLR2RdrDetn135To139RngRt3 "Speed towards/away from the sensor";
CM_ SG_ 169 FLR2RdrDetn135To139RngRt4 "Speed towards/away from the sensor";
CM_ SG_ 169 FLR2RdrDetn135To139ScanID "Value to tie status, detection data and object data frames together";
CM_ SG_ 169 FLR2RdrDetn135To139SNR0 "Signal to Noise Ratio";
CM_ SG_ 169 FLR2RdrDetn135To139SNR1 "Signal to Noise Ration";
CM_ SG_ 169 FLR2RdrDetn135To139SNR2 "Signal to Noise Ration";
CM_ SG_ 169 FLR2RdrDetn135To139SNR3 "Signal to Noise Ration";
CM_ SG_ 169 FLR2RdrDetn135To139SNR4 "Signal to Noise Ration";
CM_ SG_ 172 FLR2RdrDetn140To144AziAng0 "Azimuth Angle";
CM_ SG_ 172 FLR2RdrDetn140To144AziAng1 "Azimuth Angle";
CM_ SG_ 172 FLR2RdrDetn140To144AziAng2 "Azimuth Angle";
CM_ SG_ 172 FLR2RdrDetn140To144AziAng3 "Azimuth Angle";
CM_ SG_ 172 FLR2RdrDetn140To144AziAng4 "Azimuth Angle";
CM_ SG_ 172 FLR2RdrDetn140To144DynPrpty0 "Moving/Stationary";
CM_ SG_ 172 FLR2RdrDetn140To144DynPrpty1 "Moving/Stationary";
CM_ SG_ 172 FLR2RdrDetn140To144DynPrpty2 "Moving/Stationary";
CM_ SG_ 172 FLR2RdrDetn140To144DynPrpty3 "Moving/Stationary";
CM_ SG_ 172 FLR2RdrDetn140To144DynPrpty4 "Moving/Stationary";
CM_ SG_ 172 FLR2RdrDetn140To144EleAng0 "Elevation angle";
CM_ SG_ 172 FLR2RdrDetn140To144EleAng1 "Elevation angle";
CM_ SG_ 172 FLR2RdrDetn140To144EleAng2 "Elevation angle";
CM_ SG_ 172 FLR2RdrDetn140To144EleAng3 "Elevation angle";
CM_ SG_ 172 FLR2RdrDetn140To144EleAng4 "Elevation angle";
CM_ SG_ 172 FLR2RdrDetn140To144Mode0 "What chirp mode the detection is from";
CM_ SG_ 172 FLR2RdrDetn140To144Mode1 "What chirp mode the detection is from";
CM_ SG_ 172 FLR2RdrDetn140To144Mode2 "What chirp mode the detection is from";
CM_ SG_ 172 FLR2RdrDetn140To144Mode3 "What chirp mode the detection is from";
CM_ SG_ 172 FLR2RdrDetn140To144Mode4 "What chirp mode the detection is from";
CM_ SG_ 172 FLR2RdrDetn140To144Quality0 "Quality";
CM_ SG_ 172 FLR2RdrDetn140To144Quality1 "Quality";
CM_ SG_ 172 FLR2RdrDetn140To144Quality2 "Quality";
CM_ SG_ 172 FLR2RdrDetn140To144Quality3 "Quality";
CM_ SG_ 172 FLR2RdrDetn140To144Quality4 "Quality";
CM_ SG_ 172 FLR2RdrDetn140To144Range0 "Range from sensor to object";
CM_ SG_ 172 FLR2RdrDetn140To144Range1 "Range from sensor to object";
CM_ SG_ 172 FLR2RdrDetn140To144Range2 "Range from sensor to object";
CM_ SG_ 172 FLR2RdrDetn140To144Range3 "Range from sensor to object";
CM_ SG_ 172 FLR2RdrDetn140To144Range4 "Range from sensor to object";
CM_ SG_ 172 FLR2RdrDetn140To144RCS0 "RCS";
CM_ SG_ 172 FLR2RdrDetn140To144RCS1 "RCS";
CM_ SG_ 172 FLR2RdrDetn140To144RCS2 "RCS";
CM_ SG_ 172 FLR2RdrDetn140To144RCS3 "RCS";
CM_ SG_ 172 FLR2RdrDetn140To144RCS4 "RCS";
CM_ SG_ 172 FLR2RdrDetn140To144RngRt0 "Speed towards/away from the sensor";
CM_ SG_ 172 FLR2RdrDetn140To144RngRt1 "Speed towards/away from the sensor";
CM_ SG_ 172 FLR2RdrDetn140To144RngRt2 "Speed towards/away from the sensor";
CM_ SG_ 172 FLR2RdrDetn140To144RngRt3 "Speed towards/away from the sensor";
CM_ SG_ 172 FLR2RdrDetn140To144RngRt4 "Speed towards/away from the sensor";
CM_ SG_ 172 FLR2RdrDetn140To144ScanID "Value to tie status, detection data and object data frames together";
CM_ SG_ 172 FLR2RdrDetn140To144SNR0 "Signal to Noise Ratio";
CM_ SG_ 172 FLR2RdrDetn140To144SNR1 "Signal to Noise Ration";
CM_ SG_ 172 FLR2RdrDetn140To144SNR2 "Signal to Noise Ration";
CM_ SG_ 172 FLR2RdrDetn140To144SNR3 "Signal to Noise Ration";
CM_ SG_ 172 FLR2RdrDetn140To144SNR4 "Signal to Noise Ration";
CM_ SG_ 176 FLR2RdrDetn145To149AziAng0 "Azimuth Angle";
CM_ SG_ 176 FLR2RdrDetn145To149AziAng1 "Azimuth Angle";
CM_ SG_ 176 FLR2RdrDetn145To149AziAng2 "Azimuth Angle";
CM_ SG_ 176 FLR2RdrDetn145To149AziAng3 "Azimuth Angle";
CM_ SG_ 176 FLR2RdrDetn145To149AziAng4 "Azimuth Angle";
CM_ SG_ 176 FLR2RdrDetn145To149DynPrpty0 "Moving/Stationary";
CM_ SG_ 176 FLR2RdrDetn145To149DynPrpty1 "Moving/Stationary";
CM_ SG_ 176 FLR2RdrDetn145To149DynPrpty2 "Moving/Stationary";
CM_ SG_ 176 FLR2RdrDetn145To149DynPrpty3 "Moving/Stationary";
CM_ SG_ 176 FLR2RdrDetn145To149DynPrpty4 "Moving/Stationary";
CM_ SG_ 176 FLR2RdrDetn145To149EleAng0 "Elevation angle";
CM_ SG_ 176 FLR2RdrDetn145To149EleAng1 "Elevation angle";
CM_ SG_ 176 FLR2RdrDetn145To149EleAng2 "Elevation angle";
CM_ SG_ 176 FLR2RdrDetn145To149EleAng3 "Elevation angle";
CM_ SG_ 176 FLR2RdrDetn145To149EleAng4 "Elevation angle";
CM_ SG_ 176 FLR2RdrDetn145To149Mode0 "What chirp mode the detection is from";
CM_ SG_ 176 FLR2RdrDetn145To149Mode1 "What chirp mode the detection is from";
CM_ SG_ 176 FLR2RdrDetn145To149Mode2 "What chirp mode the detection is from";
CM_ SG_ 176 FLR2RdrDetn145To149Mode3 "What chirp mode the detection is from";
CM_ SG_ 176 FLR2RdrDetn145To149Mode4 "What chirp mode the detection is from";
CM_ SG_ 176 FLR2RdrDetn145To149Quality0 "Quality";
CM_ SG_ 176 FLR2RdrDetn145To149Quality1 "Quality";
CM_ SG_ 176 FLR2RdrDetn145To149Quality2 "Quality";
CM_ SG_ 176 FLR2RdrDetn145To149Quality3 "Quality";
CM_ SG_ 176 FLR2RdrDetn145To149Quality4 "Quality";
CM_ SG_ 176 FLR2RdrDetn145To149Range0 "Range from sensor to object";
CM_ SG_ 176 FLR2RdrDetn145To149Range1 "Range from sensor to object";
CM_ SG_ 176 FLR2RdrDetn145To149Range2 "Range from sensor to object";
CM_ SG_ 176 FLR2RdrDetn145To149Range3 "Range from sensor to object";
CM_ SG_ 176 FLR2RdrDetn145To149Range4 "Range from sensor to object";
CM_ SG_ 176 FLR2RdrDetn145To149RCS0 "RCS";
CM_ SG_ 176 FLR2RdrDetn145To149RCS1 "RCS";
CM_ SG_ 176 FLR2RdrDetn145To149RCS2 "RCS";
CM_ SG_ 176 FLR2RdrDetn145To149RCS3 "RCS";
CM_ SG_ 176 FLR2RdrDetn145To149RCS4 "RCS";
CM_ SG_ 176 FLR2RdrDetn145To149RngRt0 "Speed towards/away from the sensor";
CM_ SG_ 176 FLR2RdrDetn145To149RngRt1 "Speed towards/away from the sensor";
CM_ SG_ 176 FLR2RdrDetn145To149RngRt2 "Speed towards/away from the sensor";
CM_ SG_ 176 FLR2RdrDetn145To149RngRt3 "Speed towards/away from the sensor";
CM_ SG_ 176 FLR2RdrDetn145To149RngRt4 "Speed towards/away from the sensor";
CM_ SG_ 176 FLR2RdrDetn145To149ScanID "Value to tie status, detection data and object data frames together";
CM_ SG_ 176 FLR2RdrDetn145To149SNR0 "Signal to Noise Ratio";
CM_ SG_ 176 FLR2RdrDetn145To149SNR1 "Signal to Noise Ration";
CM_ SG_ 176 FLR2RdrDetn145To149SNR2 "Signal to Noise Ration";
CM_ SG_ 176 FLR2RdrDetn145To149SNR3 "Signal to Noise Ration";
CM_ SG_ 176 FLR2RdrDetn145To149SNR4 "Signal to Noise Ration";
CM_ SG_ 179 FLR2RdrDetn150To154AziAng0 "Azimuth Angle";
CM_ SG_ 179 FLR2RdrDetn150To154AziAng1 "Azimuth Angle";
CM_ SG_ 179 FLR2RdrDetn150To154AziAng2 "Azimuth Angle";
CM_ SG_ 179 FLR2RdrDetn150To154AziAng3 "Azimuth Angle";
CM_ SG_ 179 FLR2RdrDetn150To154AziAng4 "Azimuth Angle";
CM_ SG_ 179 FLR2RdrDetn150To154DynPrpty0 "Moving/Stationary";
CM_ SG_ 179 FLR2RdrDetn150To154DynPrpty1 "Moving/Stationary";
CM_ SG_ 179 FLR2RdrDetn150To154DynPrpty2 "Moving/Stationary";
CM_ SG_ 179 FLR2RdrDetn150To154DynPrpty3 "Moving/Stationary";
CM_ SG_ 179 FLR2RdrDetn150To154DynPrpty4 "Moving/Stationary";
CM_ SG_ 179 FLR2RdrDetn150To154EleAng0 "Elevation angle";
CM_ SG_ 179 FLR2RdrDetn150To154EleAng1 "Elevation angle";
CM_ SG_ 179 FLR2RdrDetn150To154EleAng2 "Elevation angle";
CM_ SG_ 179 FLR2RdrDetn150To154EleAng3 "Elevation angle";
CM_ SG_ 179 FLR2RdrDetn150To154EleAng4 "Elevation angle";
CM_ SG_ 179 FLR2RdrDetn150To154Mode0 "What chirp mode the detection is from";
CM_ SG_ 179 FLR2RdrDetn150To154Mode1 "What chirp mode the detection is from";
CM_ SG_ 179 FLR2RdrDetn150To154Mode2 "What chirp mode the detection is from";
CM_ SG_ 179 FLR2RdrDetn150To154Mode3 "What chirp mode the detection is from";
CM_ SG_ 179 FLR2RdrDetn150To154Mode4 "What chirp mode the detection is from";
CM_ SG_ 179 FLR2RdrDetn150To154Quality0 "Quality";
CM_ SG_ 179 FLR2RdrDetn150To154Quality1 "Quality";
CM_ SG_ 179 FLR2RdrDetn150To154Quality2 "Quality";
CM_ SG_ 179 FLR2RdrDetn150To154Quality3 "Quality";
CM_ SG_ 179 FLR2RdrDetn150To154Quality4 "Quality";
CM_ SG_ 179 FLR2RdrDetn150To154Range0 "Range from sensor to object";
CM_ SG_ 179 FLR2RdrDetn150To154Range1 "Range from sensor to object";
CM_ SG_ 179 FLR2RdrDetn150To154Range2 "Range from sensor to object";
CM_ SG_ 179 FLR2RdrDetn150To154Range3 "Range from sensor to object";
CM_ SG_ 179 FLR2RdrDetn150To154Range4 "Range from sensor to object";
CM_ SG_ 179 FLR2RdrDetn150To154RCS0 "RCS";
CM_ SG_ 179 FLR2RdrDetn150To154RCS1 "RCS";
CM_ SG_ 179 FLR2RdrDetn150To154RCS2 "RCS";
CM_ SG_ 179 FLR2RdrDetn150To154RCS3 "RCS";
CM_ SG_ 179 FLR2RdrDetn150To154RCS4 "RCS";
CM_ SG_ 179 FLR2RdrDetn150To154RngRt0 "Speed towards/away from the sensor";
CM_ SG_ 179 FLR2RdrDetn150To154RngRt1 "Speed towards/away from the sensor";
CM_ SG_ 179 FLR2RdrDetn150To154RngRt2 "Speed towards/away from the sensor";
CM_ SG_ 179 FLR2RdrDetn150To154RngRt3 "Speed towards/away from the sensor";
CM_ SG_ 179 FLR2RdrDetn150To154RngRt4 "Speed towards/away from the sensor";
CM_ SG_ 179 FLR2RdrDetn150To154ScanID "Value to tie status, detection data and object data frames together";
CM_ SG_ 179 FLR2RdrDetn150To154SNR0 "Signal to Noise Ratio";
CM_ SG_ 179 FLR2RdrDetn150To154SNR1 "Signal to Noise Ration";
CM_ SG_ 179 FLR2RdrDetn150To154SNR2 "Signal to Noise Ration";
CM_ SG_ 179 FLR2RdrDetn150To154SNR3 "Signal to Noise Ration";
CM_ SG_ 179 FLR2RdrDetn150To154SNR4 "Signal to Noise Ration";
CM_ SG_ 182 FLR2RdrDetn155To159AziAng0 "Azimuth Angle";
CM_ SG_ 182 FLR2RdrDetn155To159AziAng1 "Azimuth Angle";
CM_ SG_ 182 FLR2RdrDetn155To159AziAng2 "Azimuth Angle";
CM_ SG_ 182 FLR2RdrDetn155To159AziAng3 "Azimuth Angle";
CM_ SG_ 182 FLR2RdrDetn155To159AziAng4 "Azimuth Angle";
CM_ SG_ 182 FLR2RdrDetn155To159DynPrpty0 "Moving/Stationary";
CM_ SG_ 182 FLR2RdrDetn155To159DynPrpty1 "Moving/Stationary";
CM_ SG_ 182 FLR2RdrDetn155To159DynPrpty2 "Moving/Stationary";
CM_ SG_ 182 FLR2RdrDetn155To159DynPrpty3 "Moving/Stationary";
CM_ SG_ 182 FLR2RdrDetn155To159DynPrpty4 "Moving/Stationary";
CM_ SG_ 182 FLR2RdrDetn155To159EleAng0 "Elevation angle";
CM_ SG_ 182 FLR2RdrDetn155To159EleAng1 "Elevation angle";
CM_ SG_ 182 FLR2RdrDetn155To159EleAng2 "Elevation angle";
CM_ SG_ 182 FLR2RdrDetn155To159EleAng3 "Elevation angle";
CM_ SG_ 182 FLR2RdrDetn155To159EleAng4 "Elevation angle";
CM_ SG_ 182 FLR2RdrDetn155To159Mode0 "What chirp mode the detection is from";
CM_ SG_ 182 FLR2RdrDetn155To159Mode1 "What chirp mode the detection is from";
CM_ SG_ 182 FLR2RdrDetn155To159Mode2 "What chirp mode the detection is from";
CM_ SG_ 182 FLR2RdrDetn155To159Mode3 "What chirp mode the detection is from";
CM_ SG_ 182 FLR2RdrDetn155To159Mode4 "What chirp mode the detection is from";
CM_ SG_ 182 FLR2RdrDetn155To159Quality0 "Quality";
CM_ SG_ 182 FLR2RdrDetn155To159Quality1 "Quality";
CM_ SG_ 182 FLR2RdrDetn155To159Quality2 "Quality";
CM_ SG_ 182 FLR2RdrDetn155To159Quality3 "Quality";
CM_ SG_ 182 FLR2RdrDetn155To159Quality4 "Quality";
CM_ SG_ 182 FLR2RdrDetn155To159Range0 "Range from sensor to object";
CM_ SG_ 182 FLR2RdrDetn155To159Range1 "Range from sensor to object";
CM_ SG_ 182 FLR2RdrDetn155To159Range2 "Range from sensor to object";
CM_ SG_ 182 FLR2RdrDetn155To159Range3 "Range from sensor to object";
CM_ SG_ 182 FLR2RdrDetn155To159Range4 "Range from sensor to object";
CM_ SG_ 182 FLR2RdrDetn155To159RCS0 "RCS";
CM_ SG_ 182 FLR2RdrDetn155To159RCS1 "RCS";
CM_ SG_ 182 FLR2RdrDetn155To159RCS2 "RCS";
CM_ SG_ 182 FLR2RdrDetn155To159RCS3 "RCS";
CM_ SG_ 182 FLR2RdrDetn155To159RCS4 "RCS";
CM_ SG_ 182 FLR2RdrDetn155To159RngRt0 "Speed towards/away from the sensor";
CM_ SG_ 182 FLR2RdrDetn155To159RngRt1 "Speed towards/away from the sensor";
CM_ SG_ 182 FLR2RdrDetn155To159RngRt2 "Speed towards/away from the sensor";
CM_ SG_ 182 FLR2RdrDetn155To159RngRt3 "Speed towards/away from the sensor";
CM_ SG_ 182 FLR2RdrDetn155To159RngRt4 "Speed towards/away from the sensor";
CM_ SG_ 182 FLR2RdrDetn155To159ScanID "Value to tie status, detection data and object data frames together";
CM_ SG_ 182 FLR2RdrDetn155To159SNR0 "Signal to Noise Ratio";
CM_ SG_ 182 FLR2RdrDetn155To159SNR1 "Signal to Noise Ration";
CM_ SG_ 182 FLR2RdrDetn155To159SNR2 "Signal to Noise Ration";
CM_ SG_ 182 FLR2RdrDetn155To159SNR3 "Signal to Noise Ration";
CM_ SG_ 182 FLR2RdrDetn155To159SNR4 "Signal to Noise Ration";
CM_ SG_ 185 FLR2RdrDetn160To164AziAng0 "Azimuth Angle";
CM_ SG_ 185 FLR2RdrDetn160To164AziAng1 "Azimuth Angle";
CM_ SG_ 185 FLR2RdrDetn160To164AziAng2 "Azimuth Angle";
CM_ SG_ 185 FLR2RdrDetn160To164AziAng3 "Azimuth Angle";
CM_ SG_ 185 FLR2RdrDetn160To164AziAng4 "Azimuth Angle";
CM_ SG_ 185 FLR2RdrDetn160To164DynPrpty0 "Moving/Stationary";
CM_ SG_ 185 FLR2RdrDetn160To164DynPrpty1 "Moving/Stationary";
CM_ SG_ 185 FLR2RdrDetn160To164DynPrpty2 "Moving/Stationary";
CM_ SG_ 185 FLR2RdrDetn160To164DynPrpty3 "Moving/Stationary";
CM_ SG_ 185 FLR2RdrDetn160To164DynPrpty4 "Moving/Stationary";
CM_ SG_ 185 FLR2RdrDetn160To164EleAng0 "Elevation angle";
CM_ SG_ 185 FLR2RdrDetn160To164EleAng1 "Elevation angle";
CM_ SG_ 185 FLR2RdrDetn160To164EleAng2 "Elevation angle";
CM_ SG_ 185 FLR2RdrDetn160To164EleAng3 "Elevation angle";
CM_ SG_ 185 FLR2RdrDetn160To164EleAng4 "Elevation angle";
CM_ SG_ 185 FLR2RdrDetn160To164Mode0 "What chirp mode the detection is from";
CM_ SG_ 185 FLR2RdrDetn160To164Mode1 "What chirp mode the detection is from";
CM_ SG_ 185 FLR2RdrDetn160To164Mode2 "What chirp mode the detection is from";
CM_ SG_ 185 FLR2RdrDetn160To164Mode3 "What chirp mode the detection is from";
CM_ SG_ 185 FLR2RdrDetn160To164Mode4 "What chirp mode the detection is from";
CM_ SG_ 185 FLR2RdrDetn160To164Quality0 "Quality";
CM_ SG_ 185 FLR2RdrDetn160To164Quality1 "Quality";
CM_ SG_ 185 FLR2RdrDetn160To164Quality2 "Quality";
CM_ SG_ 185 FLR2RdrDetn160To164Quality3 "Quality";
CM_ SG_ 185 FLR2RdrDetn160To164Quality4 "Quality";
CM_ SG_ 185 FLR2RdrDetn160To164Range0 "Range from sensor to object";
CM_ SG_ 185 FLR2RdrDetn160To164Range1 "Range from sensor to object";
CM_ SG_ 185 FLR2RdrDetn160To164Range2 "Range from sensor to object";
CM_ SG_ 185 FLR2RdrDetn160To164Range3 "Range from sensor to object";
CM_ SG_ 185 FLR2RdrDetn160To164Range4 "Range from sensor to object";
CM_ SG_ 185 FLR2RdrDetn160To164RCS0 "RCS";
CM_ SG_ 185 FLR2RdrDetn160To164RCS1 "RCS";
CM_ SG_ 185 FLR2RdrDetn160To164RCS2 "RCS";
CM_ SG_ 185 FLR2RdrDetn160To164RCS3 "RCS";
CM_ SG_ 185 FLR2RdrDetn160To164RCS4 "RCS";
CM_ SG_ 185 FLR2RdrDetn160To164RngRt0 "Speed towards/away from the sensor";
CM_ SG_ 185 FLR2RdrDetn160To164RngRt1 "Speed towards/away from the sensor";
CM_ SG_ 185 FLR2RdrDetn160To164RngRt2 "Speed towards/away from the sensor";
CM_ SG_ 185 FLR2RdrDetn160To164RngRt3 "Speed towards/away from the sensor";
CM_ SG_ 185 FLR2RdrDetn160To164RngRt4 "Speed towards/away from the sensor";
CM_ SG_ 185 FLR2RdrDetn160To164ScanID "Value to tie status, detection data and object data frames together";
CM_ SG_ 185 FLR2RdrDetn160To164SNR0 "Signal to Noise Ratio";
CM_ SG_ 185 FLR2RdrDetn160To164SNR1 "Signal to Noise Ration";
CM_ SG_ 185 FLR2RdrDetn160To164SNR2 "Signal to Noise Ration";
CM_ SG_ 185 FLR2RdrDetn160To164SNR3 "Signal to Noise Ration";
CM_ SG_ 185 FLR2RdrDetn160To164SNR4 "Signal to Noise Ration";
CM_ SG_ 188 FLR2RdrDetn165To169AziAng0 "Azimuth Angle";
CM_ SG_ 188 FLR2RdrDetn165To169AziAng1 "Azimuth Angle";
CM_ SG_ 188 FLR2RdrDetn165To169AziAng2 "Azimuth Angle";
CM_ SG_ 188 FLR2RdrDetn165To169AziAng3 "Azimuth Angle";
CM_ SG_ 188 FLR2RdrDetn165To169AziAng4 "Azimuth Angle";
CM_ SG_ 188 FLR2RdrDetn165To169DynPrpty0 "Moving/Stationary";
CM_ SG_ 188 FLR2RdrDetn165To169DynPrpty1 "Moving/Stationary";
CM_ SG_ 188 FLR2RdrDetn165To169DynPrpty2 "Moving/Stationary";
CM_ SG_ 188 FLR2RdrDetn165To169DynPrpty3 "Moving/Stationary";
CM_ SG_ 188 FLR2RdrDetn165To169DynPrpty4 "Moving/Stationary";
CM_ SG_ 188 FLR2RdrDetn165To169EleAng0 "Elevation angle";
CM_ SG_ 188 FLR2RdrDetn165To169EleAng1 "Elevation angle";
CM_ SG_ 188 FLR2RdrDetn165To169EleAng2 "Elevation angle";
CM_ SG_ 188 FLR2RdrDetn165To169EleAng3 "Elevation angle";
CM_ SG_ 188 FLR2RdrDetn165To169EleAng4 "Elevation angle";
CM_ SG_ 188 FLR2RdrDetn165To169Mode0 "What chirp mode the detection is from";
CM_ SG_ 188 FLR2RdrDetn165To169Mode1 "What chirp mode the detection is from";
CM_ SG_ 188 FLR2RdrDetn165To169Mode2 "What chirp mode the detection is from";
CM_ SG_ 188 FLR2RdrDetn165To169Mode3 "What chirp mode the detection is from";
CM_ SG_ 188 FLR2RdrDetn165To169Mode4 "What chirp mode the detection is from";
CM_ SG_ 188 FLR2RdrDetn165To169Quality0 "Quality";
CM_ SG_ 188 FLR2RdrDetn165To169Quality1 "Quality";
CM_ SG_ 188 FLR2RdrDetn165To169Quality2 "Quality";
CM_ SG_ 188 FLR2RdrDetn165To169Quality3 "Quality";
CM_ SG_ 188 FLR2RdrDetn165To169Quality4 "Quality";
CM_ SG_ 188 FLR2RdrDetn165To169Range0 "Range from sensor to object";
CM_ SG_ 188 FLR2RdrDetn165To169Range1 "Range from sensor to object";
CM_ SG_ 188 FLR2RdrDetn165To169Range2 "Range from sensor to object";
CM_ SG_ 188 FLR2RdrDetn165To169Range3 "Range from sensor to object";
CM_ SG_ 188 FLR2RdrDetn165To169Range4 "Range from sensor to object";
CM_ SG_ 188 FLR2RdrDetn165To169RCS0 "RCS";
CM_ SG_ 188 FLR2RdrDetn165To169RCS1 "RCS";
CM_ SG_ 188 FLR2RdrDetn165To169RCS2 "RCS";
CM_ SG_ 188 FLR2RdrDetn165To169RCS3 "RCS";
CM_ SG_ 188 FLR2RdrDetn165To169RCS4 "RCS";
CM_ SG_ 188 FLR2RdrDetn165To169RngRt0 "Speed towards/away from the sensor";
CM_ SG_ 188 FLR2RdrDetn165To169RngRt1 "Speed towards/away from the sensor";
CM_ SG_ 188 FLR2RdrDetn165To169RngRt2 "Speed towards/away from the sensor";
CM_ SG_ 188 FLR2RdrDetn165To169RngRt3 "Speed towards/away from the sensor";
CM_ SG_ 188 FLR2RdrDetn165To169RngRt4 "Speed towards/away from the sensor";
CM_ SG_ 188 FLR2RdrDetn165To169ScanID "Value to tie status, detection data and object data frames together";
CM_ SG_ 188 FLR2RdrDetn165To169SNR0 "Signal to Noise Ratio";
CM_ SG_ 188 FLR2RdrDetn165To169SNR1 "Signal to Noise Ration";
CM_ SG_ 188 FLR2RdrDetn165To169SNR2 "Signal to Noise Ration";
CM_ SG_ 188 FLR2RdrDetn165To169SNR3 "Signal to Noise Ration";
CM_ SG_ 188 FLR2RdrDetn165To169SNR4 "Signal to Noise Ration";
CM_ SG_ 192 FLR2RdrDetn170To174AziAng0 "Azimuth Angle";
CM_ SG_ 192 FLR2RdrDetn170To174AziAng1 "Azimuth Angle";
CM_ SG_ 192 FLR2RdrDetn170To174AziAng2 "Azimuth Angle";
CM_ SG_ 192 FLR2RdrDetn170To174AziAng3 "Azimuth Angle";
CM_ SG_ 192 FLR2RdrDetn170To174AziAng4 "Azimuth Angle";
CM_ SG_ 192 FLR2RdrDetn170To174DynPrpty0 "Moving/Stationary";
CM_ SG_ 192 FLR2RdrDetn170To174DynPrpty1 "Moving/Stationary";
CM_ SG_ 192 FLR2RdrDetn170To174DynPrpty2 "Moving/Stationary";
CM_ SG_ 192 FLR2RdrDetn170To174DynPrpty3 "Moving/Stationary";
CM_ SG_ 192 FLR2RdrDetn170To174DynPrpty4 "Moving/Stationary";
CM_ SG_ 192 FLR2RdrDetn170To174EleAng0 "Elevation angle";
CM_ SG_ 192 FLR2RdrDetn170To174EleAng1 "Elevation angle";
CM_ SG_ 192 FLR2RdrDetn170To174EleAng2 "Elevation angle";
CM_ SG_ 192 FLR2RdrDetn170To174EleAng3 "Elevation angle";
CM_ SG_ 192 FLR2RdrDetn170To174EleAng4 "Elevation angle";
CM_ SG_ 192 FLR2RdrDetn170To174Mode0 "What chirp mode the detection is from";
CM_ SG_ 192 FLR2RdrDetn170To174Mode1 "What chirp mode the detection is from";
CM_ SG_ 192 FLR2RdrDetn170To174Mode2 "What chirp mode the detection is from";
CM_ SG_ 192 FLR2RdrDetn170To174Mode3 "What chirp mode the detection is from";
CM_ SG_ 192 FLR2RdrDetn170To174Mode4 "What chirp mode the detection is from";
CM_ SG_ 192 FLR2RdrDetn170To174Quality0 "Quality";
CM_ SG_ 192 FLR2RdrDetn170To174Quality1 "Quality";
CM_ SG_ 192 FLR2RdrDetn170To174Quality2 "Quality";
CM_ SG_ 192 FLR2RdrDetn170To174Quality3 "Quality";
CM_ SG_ 192 FLR2RdrDetn170To174Quality4 "Quality";
CM_ SG_ 192 FLR2RdrDetn170To174Range0 "Range from sensor to object";
CM_ SG_ 192 FLR2RdrDetn170To174Range1 "Range from sensor to object";
CM_ SG_ 192 FLR2RdrDetn170To174Range2 "Range from sensor to object";
CM_ SG_ 192 FLR2RdrDetn170To174Range3 "Range from sensor to object";
CM_ SG_ 192 FLR2RdrDetn170To174Range4 "Range from sensor to object";
CM_ SG_ 192 FLR2RdrDetn170To174RCS0 "RCS";
CM_ SG_ 192 FLR2RdrDetn170To174RCS1 "RCS";
CM_ SG_ 192 FLR2RdrDetn170To174RCS2 "RCS";
CM_ SG_ 192 FLR2RdrDetn170To174RCS3 "RCS";
CM_ SG_ 192 FLR2RdrDetn170To174RCS4 "RCS";
CM_ SG_ 192 FLR2RdrDetn170To174RngRt0 "Speed towards/away from the sensor";
CM_ SG_ 192 FLR2RdrDetn170To174RngRt1 "Speed towards/away from the sensor";
CM_ SG_ 192 FLR2RdrDetn170To174RngRt2 "Speed towards/away from the sensor";
CM_ SG_ 192 FLR2RdrDetn170To174RngRt3 "Speed towards/away from the sensor";
CM_ SG_ 192 FLR2RdrDetn170To174RngRt4 "Speed towards/away from the sensor";
CM_ SG_ 192 FLR2RdrDetn170To174ScanID "Value to tie status, detection data and object data frames together";
CM_ SG_ 192 FLR2RdrDetn170To174SNR0 "Signal to Noise Ratio";
CM_ SG_ 192 FLR2RdrDetn170To174SNR1 "Signal to Noise Ration";
CM_ SG_ 192 FLR2RdrDetn170To174SNR2 "Signal to Noise Ration";
CM_ SG_ 192 FLR2RdrDetn170To174SNR3 "Signal to Noise Ration";
CM_ SG_ 192 FLR2RdrDetn170To174SNR4 "Signal to Noise Ration";
CM_ SG_ 195 FLR2RdrDetn175To179AziAng0 "Azimuth Angle";
CM_ SG_ 195 FLR2RdrDetn175To179AziAng1 "Azimuth Angle";
CM_ SG_ 195 FLR2RdrDetn175To179AziAng2 "Azimuth Angle";
CM_ SG_ 195 FLR2RdrDetn175To179AziAng3 "Azimuth Angle";
CM_ SG_ 195 FLR2RdrDetn175To179AziAng4 "Azimuth Angle";
CM_ SG_ 195 FLR2RdrDetn175To179DynPrpty0 "Moving/Stationary";
CM_ SG_ 195 FLR2RdrDetn175To179DynPrpty1 "Moving/Stationary";
CM_ SG_ 195 FLR2RdrDetn175To179DynPrpty2 "Moving/Stationary";
CM_ SG_ 195 FLR2RdrDetn175To179DynPrpty3 "Moving/Stationary";
CM_ SG_ 195 FLR2RdrDetn175To179DynPrpty4 "Moving/Stationary";
CM_ SG_ 195 FLR2RdrDetn175To179EleAng0 "Elevation angle";
CM_ SG_ 195 FLR2RdrDetn175To179EleAng1 "Elevation angle";
CM_ SG_ 195 FLR2RdrDetn175To179EleAng2 "Elevation angle";
CM_ SG_ 195 FLR2RdrDetn175To179EleAng3 "Elevation angle";
CM_ SG_ 195 FLR2RdrDetn175To179EleAng4 "Elevation angle";
CM_ SG_ 195 FLR2RdrDetn175To179Mode0 "What chirp mode the detection is from";
CM_ SG_ 195 FLR2RdrDetn175To179Mode1 "What chirp mode the detection is from";
CM_ SG_ 195 FLR2RdrDetn175To179Mode2 "What chirp mode the detection is from";
CM_ SG_ 195 FLR2RdrDetn175To179Mode3 "What chirp mode the detection is from";
CM_ SG_ 195 FLR2RdrDetn175To179Mode4 "What chirp mode the detection is from";
CM_ SG_ 195 FLR2RdrDetn175To179Quality0 "Quality";
CM_ SG_ 195 FLR2RdrDetn175To179Quality1 "Quality";
CM_ SG_ 195 FLR2RdrDetn175To179Quality2 "Quality";
CM_ SG_ 195 FLR2RdrDetn175To179Quality3 "Quality";
CM_ SG_ 195 FLR2RdrDetn175To179Quality4 "Quality";
CM_ SG_ 195 FLR2RdrDetn175To179Range0 "Range from sensor to object";
CM_ SG_ 195 FLR2RdrDetn175To179Range1 "Range from sensor to object";
CM_ SG_ 195 FLR2RdrDetn175To179Range2 "Range from sensor to object";
CM_ SG_ 195 FLR2RdrDetn175To179Range3 "Range from sensor to object";
CM_ SG_ 195 FLR2RdrDetn175To179Range4 "Range from sensor to object";
CM_ SG_ 195 FLR2RdrDetn175To179RCS0 "RCS";
CM_ SG_ 195 FLR2RdrDetn175To179RCS1 "RCS";
CM_ SG_ 195 FLR2RdrDetn175To179RCS2 "RCS";
CM_ SG_ 195 FLR2RdrDetn175To179RCS3 "RCS";
CM_ SG_ 195 FLR2RdrDetn175To179RCS4 "RCS";
CM_ SG_ 195 FLR2RdrDetn175To179RngRt0 "Speed towards/away from the sensor";
CM_ SG_ 195 FLR2RdrDetn175To179RngRt1 "Speed towards/away from the sensor";
CM_ SG_ 195 FLR2RdrDetn175To179RngRt2 "Speed towards/away from the sensor";
CM_ SG_ 195 FLR2RdrDetn175To179RngRt3 "Speed towards/away from the sensor";
CM_ SG_ 195 FLR2RdrDetn175To179RngRt4 "Speed towards/away from the sensor";
CM_ SG_ 195 FLR2RdrDetn175To179ScanID "Value to tie status, detection data and object data frames together";
CM_ SG_ 195 FLR2RdrDetn175To179SNR0 "Signal to Noise Ratio";
CM_ SG_ 195 FLR2RdrDetn175To179SNR1 "Signal to Noise Ration";
CM_ SG_ 195 FLR2RdrDetn175To179SNR2 "Signal to Noise Ration";
CM_ SG_ 195 FLR2RdrDetn175To179SNR3 "Signal to Noise Ration";
CM_ SG_ 195 FLR2RdrDetn175To179SNR4 "Signal to Noise Ration";
CM_ SG_ 198 FLR2RdrDetn180To184AziAng0 "Azimuth Angle";
CM_ SG_ 198 FLR2RdrDetn180To184AziAng1 "Azimuth Angle";
CM_ SG_ 198 FLR2RdrDetn180To184AziAng2 "Azimuth Angle";
CM_ SG_ 198 FLR2RdrDetn180To184AziAng3 "Azimuth Angle";
CM_ SG_ 198 FLR2RdrDetn180To184AziAng4 "Azimuth Angle";
CM_ SG_ 198 FLR2RdrDetn180To184DynPrpty0 "Moving/Stationary";
CM_ SG_ 198 FLR2RdrDetn180To184DynPrpty1 "Moving/Stationary";
CM_ SG_ 198 FLR2RdrDetn180To184DynPrpty2 "Moving/Stationary";
CM_ SG_ 198 FLR2RdrDetn180To184DynPrpty3 "Moving/Stationary";
CM_ SG_ 198 FLR2RdrDetn180To184DynPrpty4 "Moving/Stationary";
CM_ SG_ 198 FLR2RdrDetn180To184EleAng0 "Elevation angle";
CM_ SG_ 198 FLR2RdrDetn180To184EleAng1 "Elevation angle";
CM_ SG_ 198 FLR2RdrDetn180To184EleAng2 "Elevation angle";
CM_ SG_ 198 FLR2RdrDetn180To184EleAng3 "Elevation angle";
CM_ SG_ 198 FLR2RdrDetn180To184EleAng4 "Elevation angle";
CM_ SG_ 198 FLR2RdrDetn180To184Mode0 "What chirp mode the detection is from";
CM_ SG_ 198 FLR2RdrDetn180To184Mode1 "What chirp mode the detection is from";
CM_ SG_ 198 FLR2RdrDetn180To184Mode2 "What chirp mode the detection is from";
CM_ SG_ 198 FLR2RdrDetn180To184Mode3 "What chirp mode the detection is from";
CM_ SG_ 198 FLR2RdrDetn180To184Mode4 "What chirp mode the detection is from";
CM_ SG_ 198 FLR2RdrDetn180To184Quality0 "Quality";
CM_ SG_ 198 FLR2RdrDetn180To184Quality1 "Quality";
CM_ SG_ 198 FLR2RdrDetn180To184Quality2 "Quality";
CM_ SG_ 198 FLR2RdrDetn180To184Quality3 "Quality";
CM_ SG_ 198 FLR2RdrDetn180To184Quality4 "Quality";
CM_ SG_ 198 FLR2RdrDetn180To184Range0 "Range from sensor to object";
CM_ SG_ 198 FLR2RdrDetn180To184Range1 "Range from sensor to object";
CM_ SG_ 198 FLR2RdrDetn180To184Range2 "Range from sensor to object";
CM_ SG_ 198 FLR2RdrDetn180To184Range3 "Range from sensor to object";
CM_ SG_ 198 FLR2RdrDetn180To184Range4 "Range from sensor to object";
CM_ SG_ 198 FLR2RdrDetn180To184RCS0 "RCS";
CM_ SG_ 198 FLR2RdrDetn180To184RCS1 "RCS";
CM_ SG_ 198 FLR2RdrDetn180To184RCS2 "RCS";
CM_ SG_ 198 FLR2RdrDetn180To184RCS3 "RCS";
CM_ SG_ 198 FLR2RdrDetn180To184RCS4 "RCS";
CM_ SG_ 198 FLR2RdrDetn180To184RngRt0 "Speed towards/away from the sensor";
CM_ SG_ 198 FLR2RdrDetn180To184RngRt1 "Speed towards/away from the sensor";
CM_ SG_ 198 FLR2RdrDetn180To184RngRt2 "Speed towards/away from the sensor";
CM_ SG_ 198 FLR2RdrDetn180To184RngRt3 "Speed towards/away from the sensor";
CM_ SG_ 198 FLR2RdrDetn180To184RngRt4 "Speed towards/away from the sensor";
CM_ SG_ 198 FLR2RdrDetn180To184ScanID "Value to tie status, detection data and object data frames together";
CM_ SG_ 198 FLR2RdrDetn180To184SNR0 "Signal to Noise Ratio";
CM_ SG_ 198 FLR2RdrDetn180To184SNR1 "Signal to Noise Ration";
CM_ SG_ 198 FLR2RdrDetn180To184SNR2 "Signal to Noise Ration";
CM_ SG_ 198 FLR2RdrDetn180To184SNR3 "Signal to Noise Ration";
CM_ SG_ 198 FLR2RdrDetn180To184SNR4 "Signal to Noise Ration";
CM_ SG_ 201 FLR2RdrDetn185To189AziAng0 "Azimuth Angle";
CM_ SG_ 201 FLR2RdrDetn185To189AziAng1 "Azimuth Angle";
CM_ SG_ 201 FLR2RdrDetn185To189AziAng2 "Azimuth Angle";
CM_ SG_ 201 FLR2RdrDetn185To189AziAng3 "Azimuth Angle";
CM_ SG_ 201 FLR2RdrDetn185To189AziAng4 "Azimuth Angle";
CM_ SG_ 201 FLR2RdrDetn185To189DynPrpty0 "Moving/Stationary";
CM_ SG_ 201 FLR2RdrDetn185To189DynPrpty1 "Moving/Stationary";
CM_ SG_ 201 FLR2RdrDetn185To189DynPrpty2 "Moving/Stationary";
CM_ SG_ 201 FLR2RdrDetn185To189DynPrpty3 "Moving/Stationary";
CM_ SG_ 201 FLR2RdrDetn185To189DynPrpty4 "Moving/Stationary";
CM_ SG_ 201 FLR2RdrDetn185To189EleAng0 "Elevation angle";
CM_ SG_ 201 FLR2RdrDetn185To189EleAng1 "Elevation angle";
CM_ SG_ 201 FLR2RdrDetn185To189EleAng2 "Elevation angle";
CM_ SG_ 201 FLR2RdrDetn185To189EleAng3 "Elevation angle";
CM_ SG_ 201 FLR2RdrDetn185To189EleAng4 "Elevation angle";
CM_ SG_ 201 FLR2RdrDetn185To189Mode0 "What chirp mode the detection is from";
CM_ SG_ 201 FLR2RdrDetn185To189Mode1 "What chirp mode the detection is from";
CM_ SG_ 201 FLR2RdrDetn185To189Mode2 "What chirp mode the detection is from";
CM_ SG_ 201 FLR2RdrDetn185To189Mode3 "What chirp mode the detection is from";
CM_ SG_ 201 FLR2RdrDetn185To189Mode4 "What chirp mode the detection is from";
CM_ SG_ 201 FLR2RdrDetn185To189Quality0 "Quality";
CM_ SG_ 201 FLR2RdrDetn185To189Quality1 "Quality";
CM_ SG_ 201 FLR2RdrDetn185To189Quality2 "Quality";
CM_ SG_ 201 FLR2RdrDetn185To189Quality3 "Quality";
CM_ SG_ 201 FLR2RdrDetn185To189Quality4 "Quality";
CM_ SG_ 201 FLR2RdrDetn185To189Range0 "Range from sensor to object";
CM_ SG_ 201 FLR2RdrDetn185To189Range1 "Range from sensor to object";
CM_ SG_ 201 FLR2RdrDetn185To189Range2 "Range from sensor to object";
CM_ SG_ 201 FLR2RdrDetn185To189Range3 "Range from sensor to object";
CM_ SG_ 201 FLR2RdrDetn185To189Range4 "Range from sensor to object";
CM_ SG_ 201 FLR2RdrDetn185To189RCS0 "RCS";
CM_ SG_ 201 FLR2RdrDetn185To189RCS1 "RCS";
CM_ SG_ 201 FLR2RdrDetn185To189RCS2 "RCS";
CM_ SG_ 201 FLR2RdrDetn185To189RCS3 "RCS";
CM_ SG_ 201 FLR2RdrDetn185To189RCS4 "RCS";
CM_ SG_ 201 FLR2RdrDetn185To189RngRt0 "Speed towards/away from the sensor";
CM_ SG_ 201 FLR2RdrDetn185To189RngRt1 "Speed towards/away from the sensor";
CM_ SG_ 201 FLR2RdrDetn185To189RngRt2 "Speed towards/away from the sensor";
CM_ SG_ 201 FLR2RdrDetn185To189RngRt3 "Speed towards/away from the sensor";
CM_ SG_ 201 FLR2RdrDetn185To189RngRt4 "Speed towards/away from the sensor";
CM_ SG_ 201 FLR2RdrDetn185To189ScanID "Value to tie status, detection data and object data frames together";
CM_ SG_ 201 FLR2RdrDetn185To189SNR0 "Signal to Noise Ratio";
CM_ SG_ 201 FLR2RdrDetn185To189SNR1 "Signal to Noise Ration";
CM_ SG_ 201 FLR2RdrDetn185To189SNR2 "Signal to Noise Ration";
CM_ SG_ 201 FLR2RdrDetn185To189SNR3 "Signal to Noise Ration";
CM_ SG_ 201 FLR2RdrDetn185To189SNR4 "Signal to Noise Ration";
CM_ SG_ 204 FLR2RdrDetn190To194AziAng0 "Azimuth Angle";
CM_ SG_ 204 FLR2RdrDetn190To194AziAng1 "Azimuth Angle";
CM_ SG_ 204 FLR2RdrDetn190To194AziAng2 "Azimuth Angle";
CM_ SG_ 204 FLR2RdrDetn190To194AziAng3 "Azimuth Angle";
CM_ SG_ 204 FLR2RdrDetn190To194AziAng4 "Azimuth Angle";
CM_ SG_ 204 FLR2RdrDetn190To194DynPrpty0 "Moving/Stationary";
CM_ SG_ 204 FLR2RdrDetn190To194DynPrpty1 "Moving/Stationary";
CM_ SG_ 204 FLR2RdrDetn190To194DynPrpty2 "Moving/Stationary";
CM_ SG_ 204 FLR2RdrDetn190To194DynPrpty3 "Moving/Stationary";
CM_ SG_ 204 FLR2RdrDetn190To194DynPrpty4 "Moving/Stationary";
CM_ SG_ 204 FLR2RdrDetn190To194EleAng0 "Elevation angle";
CM_ SG_ 204 FLR2RdrDetn190To194EleAng1 "Elevation angle";
CM_ SG_ 204 FLR2RdrDetn190To194EleAng2 "Elevation angle";
CM_ SG_ 204 FLR2RdrDetn190To194EleAng3 "Elevation angle";
CM_ SG_ 204 FLR2RdrDetn190To194EleAng4 "Elevation angle";
CM_ SG_ 204 FLR2RdrDetn190To194Mode0 "What chirp mode the detection is from";
CM_ SG_ 204 FLR2RdrDetn190To194Mode1 "What chirp mode the detection is from";
CM_ SG_ 204 FLR2RdrDetn190To194Mode2 "What chirp mode the detection is from";
CM_ SG_ 204 FLR2RdrDetn190To194Mode3 "What chirp mode the detection is from";
CM_ SG_ 204 FLR2RdrDetn190To194Mode4 "What chirp mode the detection is from";
CM_ SG_ 204 FLR2RdrDetn190To194Quality0 "Quality";
CM_ SG_ 204 FLR2RdrDetn190To194Quality1 "Quality";
CM_ SG_ 204 FLR2RdrDetn190To194Quality2 "Quality";
CM_ SG_ 204 FLR2RdrDetn190To194Quality3 "Quality";
CM_ SG_ 204 FLR2RdrDetn190To194Quality4 "Quality";
CM_ SG_ 204 FLR2RdrDetn190To194Range0 "Range from sensor to object";
CM_ SG_ 204 FLR2RdrDetn190To194Range1 "Range from sensor to object";
CM_ SG_ 204 FLR2RdrDetn190To194Range2 "Range from sensor to object";
CM_ SG_ 204 FLR2RdrDetn190To194Range3 "Range from sensor to object";
CM_ SG_ 204 FLR2RdrDetn190To194Range4 "Range from sensor to object";
CM_ SG_ 204 FLR2RdrDetn190To194RCS0 "RCS";
CM_ SG_ 204 FLR2RdrDetn190To194RCS1 "RCS";
CM_ SG_ 204 FLR2RdrDetn190To194RCS2 "RCS";
CM_ SG_ 204 FLR2RdrDetn190To194RCS3 "RCS";
CM_ SG_ 204 FLR2RdrDetn190To194RCS4 "RCS";
CM_ SG_ 204 FLR2RdrDetn190To194RngRt0 "Speed towards/away from the sensor";
CM_ SG_ 204 FLR2RdrDetn190To194RngRt1 "Speed towards/away from the sensor";
CM_ SG_ 204 FLR2RdrDetn190To194RngRt2 "Speed towards/away from the sensor";
CM_ SG_ 204 FLR2RdrDetn190To194RngRt3 "Speed towards/away from the sensor";
CM_ SG_ 204 FLR2RdrDetn190To194RngRt4 "Speed towards/away from the sensor";
CM_ SG_ 204 FLR2RdrDetn190To194ScanID "Value to tie status, detection data and object data frames together";
CM_ SG_ 204 FLR2RdrDetn190To194SNR0 "Signal to Noise Ratio";
CM_ SG_ 204 FLR2RdrDetn190To194SNR1 "Signal to Noise Ration";
CM_ SG_ 204 FLR2RdrDetn190To194SNR2 "Signal to Noise Ration";
CM_ SG_ 204 FLR2RdrDetn190To194SNR3 "Signal to Noise Ration";
CM_ SG_ 204 FLR2RdrDetn190To194SNR4 "Signal to Noise Ration";
CM_ SG_ 208 FLR2RdrDetn195To199AziAng0 "Azimuth Angle";
CM_ SG_ 208 FLR2RdrDetn195To199AziAng1 "Azimuth Angle";
CM_ SG_ 208 FLR2RdrDetn195To199AziAng2 "Azimuth Angle";
CM_ SG_ 208 FLR2RdrDetn195To199AziAng3 "Azimuth Angle";
CM_ SG_ 208 FLR2RdrDetn195To199AziAng4 "Azimuth Angle";
CM_ SG_ 208 FLR2RdrDetn195To199DynPrpty0 "Moving/Stationary";
CM_ SG_ 208 FLR2RdrDetn195To199DynPrpty1 "Moving/Stationary";
CM_ SG_ 208 FLR2RdrDetn195To199DynPrpty2 "Moving/Stationary";
CM_ SG_ 208 FLR2RdrDetn195To199DynPrpty3 "Moving/Stationary";
CM_ SG_ 208 FLR2RdrDetn195To199DynPrpty4 "Moving/Stationary";
CM_ SG_ 208 FLR2RdrDetn195To199EleAng0 "Elevation angle";
CM_ SG_ 208 FLR2RdrDetn195To199EleAng1 "Elevation angle";
CM_ SG_ 208 FLR2RdrDetn195To199EleAng2 "Elevation angle";
CM_ SG_ 208 FLR2RdrDetn195To199EleAng3 "Elevation angle";
CM_ SG_ 208 FLR2RdrDetn195To199EleAng4 "Elevation angle";
CM_ SG_ 208 FLR2RdrDetn195To199Mode0 "What chirp mode the detection is from";
CM_ SG_ 208 FLR2RdrDetn195To199Mode1 "What chirp mode the detection is from";
CM_ SG_ 208 FLR2RdrDetn195To199Mode2 "What chirp mode the detection is from";
CM_ SG_ 208 FLR2RdrDetn195To199Mode3 "What chirp mode the detection is from";
CM_ SG_ 208 FLR2RdrDetn195To199Mode4 "What chirp mode the detection is from";
CM_ SG_ 208 FLR2RdrDetn195To199Quality0 "Quality";
CM_ SG_ 208 FLR2RdrDetn195To199Quality1 "Quality";
CM_ SG_ 208 FLR2RdrDetn195To199Quality2 "Quality";
CM_ SG_ 208 FLR2RdrDetn195To199Quality3 "Quality";
CM_ SG_ 208 FLR2RdrDetn195To199Quality4 "Quality";
CM_ SG_ 208 FLR2RdrDetn195To199Range0 "Range from sensor to object";
CM_ SG_ 208 FLR2RdrDetn195To199Range1 "Range from sensor to object";
CM_ SG_ 208 FLR2RdrDetn195To199Range2 "Range from sensor to object";
CM_ SG_ 208 FLR2RdrDetn195To199Range3 "Range from sensor to object";
CM_ SG_ 208 FLR2RdrDetn195To199Range4 "Range from sensor to object";
CM_ SG_ 208 FLR2RdrDetn195To199RCS0 "RCS";
CM_ SG_ 208 FLR2RdrDetn195To199RCS1 "RCS";
CM_ SG_ 208 FLR2RdrDetn195To199RCS2 "RCS";
CM_ SG_ 208 FLR2RdrDetn195To199RCS3 "RCS";
CM_ SG_ 208 FLR2RdrDetn195To199RCS4 "RCS";
CM_ SG_ 208 FLR2RdrDetn195To199RngRt0 "Speed towards/away from the sensor";
CM_ SG_ 208 FLR2RdrDetn195To199RngRt1 "Speed towards/away from the sensor";
CM_ SG_ 208 FLR2RdrDetn195To199RngRt2 "Speed towards/away from the sensor";
CM_ SG_ 208 FLR2RdrDetn195To199RngRt3 "Speed towards/away from the sensor";
CM_ SG_ 208 FLR2RdrDetn195To199RngRt4 "Speed towards/away from the sensor";
CM_ SG_ 208 FLR2RdrDetn195To199ScanID "Value to tie status, detection data and object data frames together";
CM_ SG_ 208 FLR2RdrDetn195To199SNR0 "Signal to Noise Ratio";
CM_ SG_ 208 FLR2RdrDetn195To199SNR1 "Signal to Noise Ration";
CM_ SG_ 208 FLR2RdrDetn195To199SNR2 "Signal to Noise Ration";
CM_ SG_ 208 FLR2RdrDetn195To199SNR3 "Signal to Noise Ration";
CM_ SG_ 208 FLR2RdrDetn195To199SNR4 "Signal to Noise Ration";
BA_DEF_ BO_ "CANFD_BRS" ENUM "0","1";
BA_DEF_ BO_ "GenMsgCycleTime" INT 0 65536; // [ms]
BA_DEF_ BO_ "GenMsgDelayTime" INT 0 65536; // [ms]
BA_DEF_ BO_ "GenMsgSendType" ENUM "cyclic", "spontaneous", "not-used", "not-used", "not-used", "cyclicAndSpontaneous", "not-used", "cyclicIfActive", "NoMsgSendType"; // [us]
BA_DEF_ BO_ "GenMsgStartDelayTime" INT 0 65536; // [ms]
BA_DEF_ BO_ "VFrameFormat" ENUM "StandardCAN","ExtendedCAN","reserved","J1939PG","reserved","reserved","reserved","reserved","reserved","reserved","reserved","reserved","reserved","reserved","StandardCAN_FD","ExtendedCAN_FD";
BA_DEF_ SG_ "GenSigSendType" ENUM "Cyclic","OnWrite","OnWriteWithRepetition","OnChange","OnChangeWithRepetition","IfActive","IfActiveWithRepetition","NoSigSendType";
BA_DEF_ SG_ "GenSigStartValue" HEX 0 80000000;
BA_DEF_ BO_ "GenMsgILSupport" ENUM "No","Yes";
BA_DEF_ BO_ "NmAsrMessage" ENUM "No","Yes";
BA_DEF_ SG_ "GenSigFuncType" ENUM "NoFunction","n/a","n/a","n/a","n/a","n/a","n/a","n/a","n/a","n/a","n/a","n/a","n/a","n/a","n/a","CHK","CNTR","n/a","n/a","n/a","CNTR_AR_01","CRC_AR_01_BOTH","CRC_AR_01_ALT","CRC_AR_01_LOW","CRC_AR_01_NIBBLE","CNTR_AR_04","CRC_AR_04A","CNTR_AR_05","CRC_AR_05";
BA_DEF_ SG_ "GenSigDataID" STRING;
BA_DEF_DEF_ "CANFD_BRS" "1";
BA_DEF_DEF_ "GenSigStartValue" 0;
BA_DEF_DEF_ "VFrameFormat" "J1939PG";
BA_DEF_DEF_ "GenSigSendType" "NoSigSendType";
BA_DEF_DEF_ "GenMsgCycleTime" 0;
BA_DEF_DEF_ "GenMsgDelayTime" 0;
BA_DEF_DEF_ "GenMsgStartDelayTime" 0;
BA_DEF_DEF_ "GenMsgSendType" "NoMsgSendType";
BA_DEF_DEF_ "GenMsgILSupport" "Yes";
BA_DEF_DEF_ "NmAsrMessage" "No";
BA_DEF_DEF_ "GenSigFuncType" "NoFunction";
BA_DEF_DEF_ "GenSigDataID" "";
// Frame: FlrFlr1canFr27
BA_ "GenMsgDelayTime" BO_ 166 40.000;
BA_ "GenMsgSendType" BO_ 166 1;
BA_ "VFrameFormat" BO_ 166 14;
// Frame: FlrFlr1canFr28
BA_ "GenMsgDelayTime" BO_ 169 40.000;
BA_ "GenMsgSendType" BO_ 169 1;
BA_ "VFrameFormat" BO_ 169 14;
// Frame: FlrFlr1canFr29
BA_ "GenMsgDelayTime" BO_ 172 40.000;
BA_ "GenMsgSendType" BO_ 172 1;
BA_ "VFrameFormat" BO_ 172 14;
// Frame: FlrFlr1canFr30
BA_ "GenMsgDelayTime" BO_ 176 40.000;
BA_ "GenMsgSendType" BO_ 176 1;
BA_ "VFrameFormat" BO_ 176 14;
// Frame: FlrFlr1canFr31
BA_ "GenMsgDelayTime" BO_ 179 40.000;
BA_ "GenMsgSendType" BO_ 179 1;
BA_ "VFrameFormat" BO_ 179 14;
// Frame: FlrFlr1canFr32
BA_ "GenMsgDelayTime" BO_ 182 40.000;
BA_ "GenMsgSendType" BO_ 182 1;
BA_ "VFrameFormat" BO_ 182 14;
// Frame: FlrFlr1canFr33
BA_ "GenMsgDelayTime" BO_ 185 40.000;
BA_ "GenMsgSendType" BO_ 185 1;
BA_ "VFrameFormat" BO_ 185 14;
// Frame: FlrFlr1canFr34
BA_ "GenMsgDelayTime" BO_ 188 40.000;
BA_ "GenMsgSendType" BO_ 188 1;
BA_ "VFrameFormat" BO_ 188 14;
// Frame: FlrFlr1canFr35
BA_ "GenMsgDelayTime" BO_ 192 40.000;
BA_ "GenMsgSendType" BO_ 192 1;
BA_ "VFrameFormat" BO_ 192 14;
// Frame: FlrFlr1canFr36
BA_ "GenMsgDelayTime" BO_ 195 40.000;
BA_ "GenMsgSendType" BO_ 195 1;
BA_ "VFrameFormat" BO_ 195 14;
// Frame: FlrFlr1canFr37
BA_ "GenMsgDelayTime" BO_ 198 40.000;
BA_ "GenMsgSendType" BO_ 198 1;
BA_ "VFrameFormat" BO_ 198 14;
// Frame: FlrFlr1canFr38
BA_ "GenMsgDelayTime" BO_ 201 40.000;
BA_ "GenMsgSendType" BO_ 201 1;
BA_ "VFrameFormat" BO_ 201 14;
// Frame: FlrFlr1canFr39
BA_ "GenMsgDelayTime" BO_ 204 40.000;
BA_ "GenMsgSendType" BO_ 204 1;
BA_ "VFrameFormat" BO_ 204 14;
// Frame: FlrFlr1canFr40
BA_ "GenMsgDelayTime" BO_ 208 40.000;
BA_ "GenMsgSendType" BO_ 208 1;
BA_ "VFrameFormat" BO_ 208 14;
BA_ "GenSigSendType" SG_ 166 FLR2RdrDetn130To134AziAng0 1;
BA_ "GenSigSendType" SG_ 166 FLR2RdrDetn130To134AziAng1 1;
BA_ "GenSigSendType" SG_ 166 FLR2RdrDetn130To134AziAng2 1;
BA_ "GenSigSendType" SG_ 166 FLR2RdrDetn130To134AziAng3 1;
BA_ "GenSigSendType" SG_ 166 FLR2RdrDetn130To134AziAng4 1;
BA_ "GenSigDataID" SG_ 166 FLR2RdrDetn130To134CRC "0xAD3";
BA_ "GenSigFuncType" SG_ 166 FLR2RdrDetn130To134CRC 28;
BA_ "GenSigSendType" SG_ 166 FLR2RdrDetn130To134CRC 1;
BA_ "GenSigFuncType" SG_ 166 FLR2RdrDetn130To134Counter 27;
BA_ "GenSigSendType" SG_ 166 FLR2RdrDetn130To134Counter 1;
BA_ "GenSigSendType" SG_ 166 FLR2RdrDetn130To134DynPrpty0 1;
BA_ "GenSigSendType" SG_ 166 FLR2RdrDetn130To134DynPrpty1 1;
BA_ "GenSigSendType" SG_ 166 FLR2RdrDetn130To134DynPrpty2 1;
BA_ "GenSigSendType" SG_ 166 FLR2RdrDetn130To134DynPrpty3 1;
BA_ "GenSigSendType" SG_ 166 FLR2RdrDetn130To134DynPrpty4 1;
BA_ "GenSigSendType" SG_ 166 FLR2RdrDetn130To134EleAng0 1;
BA_ "GenSigSendType" SG_ 166 FLR2RdrDetn130To134EleAng1 1;
BA_ "GenSigSendType" SG_ 166 FLR2RdrDetn130To134EleAng2 1;
BA_ "GenSigSendType" SG_ 166 FLR2RdrDetn130To134EleAng3 1;
BA_ "GenSigSendType" SG_ 166 FLR2RdrDetn130To134EleAng4 1;
BA_ "GenSigSendType" SG_ 166 FLR2RdrDetn130To134Mode0 1;
BA_ "GenSigSendType" SG_ 166 FLR2RdrDetn130To134Mode1 1;
BA_ "GenSigSendType" SG_ 166 FLR2RdrDetn130To134Mode2 1;
BA_ "GenSigSendType" SG_ 166 FLR2RdrDetn130To134Mode3 1;
BA_ "GenSigSendType" SG_ 166 FLR2RdrDetn130To134Mode4 1;
BA_ "GenSigSendType" SG_ 166 FLR2RdrDetn130To134Quality0 1;
BA_ "GenSigSendType" SG_ 166 FLR2RdrDetn130To134Quality1 1;
BA_ "GenSigSendType" SG_ 166 FLR2RdrDetn130To134Quality2 1;
BA_ "GenSigSendType" SG_ 166 FLR2RdrDetn130To134Quality3 1;
BA_ "GenSigSendType" SG_ 166 FLR2RdrDetn130To134Quality4 1;
BA_ "GenSigSendType" SG_ 166 FLR2RdrDetn130To134RCS0 1;
BA_ "GenSigStartValue" SG_ 166 FLR2RdrDetn130To134RCS0 500;
BA_ "GenSigSendType" SG_ 166 FLR2RdrDetn130To134RCS1 1;
BA_ "GenSigStartValue" SG_ 166 FLR2RdrDetn130To134RCS1 500;
BA_ "GenSigSendType" SG_ 166 FLR2RdrDetn130To134RCS2 1;
BA_ "GenSigStartValue" SG_ 166 FLR2RdrDetn130To134RCS2 500;
BA_ "GenSigSendType" SG_ 166 FLR2RdrDetn130To134RCS3 1;
BA_ "GenSigStartValue" SG_ 166 FLR2RdrDetn130To134RCS3 500;
BA_ "GenSigSendType" SG_ 166 FLR2RdrDetn130To134RCS4 1;
BA_ "GenSigStartValue" SG_ 166 FLR2RdrDetn130To134RCS4 500;
BA_ "GenSigSendType" SG_ 166 FLR2RdrDetn130To134Range0 1;
BA_ "GenSigSendType" SG_ 166 FLR2RdrDetn130To134Range1 1;
BA_ "GenSigSendType" SG_ 166 FLR2RdrDetn130To134Range2 1;
BA_ "GenSigSendType" SG_ 166 FLR2RdrDetn130To134Range3 1;
BA_ "GenSigSendType" SG_ 166 FLR2RdrDetn130To134Range4 1;
BA_ "GenSigSendType" SG_ 166 FLR2RdrDetn130To134RngRt0 1;
BA_ "GenSigStartValue" SG_ 166 FLR2RdrDetn130To134RngRt0 1111;
BA_ "GenSigSendType" SG_ 166 FLR2RdrDetn130To134RngRt1 1;
BA_ "GenSigStartValue" SG_ 166 FLR2RdrDetn130To134RngRt1 1111;
BA_ "GenSigSendType" SG_ 166 FLR2RdrDetn130To134RngRt2 1;
BA_ "GenSigStartValue" SG_ 166 FLR2RdrDetn130To134RngRt2 1111;
BA_ "GenSigSendType" SG_ 166 FLR2RdrDetn130To134RngRt3 1;
BA_ "GenSigStartValue" SG_ 166 FLR2RdrDetn130To134RngRt3 1111;
BA_ "GenSigSendType" SG_ 166 FLR2RdrDetn130To134RngRt4 1;
BA_ "GenSigStartValue" SG_ 166 FLR2RdrDetn130To134RngRt4 1111;
BA_ "GenSigSendType" SG_ 166 FLR2RdrDetn130To134SNR0 1;
BA_ "GenSigSendType" SG_ 166 FLR2RdrDetn130To134SNR1 1;
BA_ "GenSigSendType" SG_ 166 FLR2RdrDetn130To134SNR2 1;
BA_ "GenSigSendType" SG_ 166 FLR2RdrDetn130To134SNR3 1;
BA_ "GenSigSendType" SG_ 166 FLR2RdrDetn130To134SNR4 1;
BA_ "GenSigSendType" SG_ 166 FLR2RdrDetn130To134ScanID 1;
BA_ "GenSigSendType" SG_ 169 FLR2RdrDetn135To139AziAng0 1;
BA_ "GenSigSendType" SG_ 169 FLR2RdrDetn135To139AziAng1 1;
BA_ "GenSigSendType" SG_ 169 FLR2RdrDetn135To139AziAng2 1;
BA_ "GenSigSendType" SG_ 169 FLR2RdrDetn135To139AziAng3 1;
BA_ "GenSigSendType" SG_ 169 FLR2RdrDetn135To139AziAng4 1;
BA_ "GenSigDataID" SG_ 169 FLR2RdrDetn135To139CRC "0xAD4";
BA_ "GenSigFuncType" SG_ 169 FLR2RdrDetn135To139CRC 28;
BA_ "GenSigSendType" SG_ 169 FLR2RdrDetn135To139CRC 1;
BA_ "GenSigFuncType" SG_ 169 FLR2RdrDetn135To139Counter 27;
BA_ "GenSigSendType" SG_ 169 FLR2RdrDetn135To139Counter 1;
BA_ "GenSigSendType" SG_ 169 FLR2RdrDetn135To139DynPrpty0 1;
BA_ "GenSigSendType" SG_ 169 FLR2RdrDetn135To139DynPrpty1 1;
BA_ "GenSigSendType" SG_ 169 FLR2RdrDetn135To139DynPrpty2 1;
BA_ "GenSigSendType" SG_ 169 FLR2RdrDetn135To139DynPrpty3 1;
BA_ "GenSigSendType" SG_ 169 FLR2RdrDetn135To139DynPrpty4 1;
BA_ "GenSigSendType" SG_ 169 FLR2RdrDetn135To139EleAng0 1;
BA_ "GenSigSendType" SG_ 169 FLR2RdrDetn135To139EleAng1 1;
BA_ "GenSigSendType" SG_ 169 FLR2RdrDetn135To139EleAng2 1;
BA_ "GenSigSendType" SG_ 169 FLR2RdrDetn135To139EleAng3 1;
BA_ "GenSigSendType" SG_ 169 FLR2RdrDetn135To139EleAng4 1;
BA_ "GenSigSendType" SG_ 169 FLR2RdrDetn135To139Mode0 1;
BA_ "GenSigSendType" SG_ 169 FLR2RdrDetn135To139Mode1 1;
BA_ "GenSigSendType" SG_ 169 FLR2RdrDetn135To139Mode2 1;
BA_ "GenSigSendType" SG_ 169 FLR2RdrDetn135To139Mode3 1;
BA_ "GenSigSendType" SG_ 169 FLR2RdrDetn135To139Mode4 1;
BA_ "GenSigSendType" SG_ 169 FLR2RdrDetn135To139Quality0 1;
BA_ "GenSigSendType" SG_ 169 FLR2RdrDetn135To139Quality1 1;
BA_ "GenSigSendType" SG_ 169 FLR2RdrDetn135To139Quality2 1;
BA_ "GenSigSendType" SG_ 169 FLR2RdrDetn135To139Quality3 1;
BA_ "GenSigSendType" SG_ 169 FLR2RdrDetn135To139Quality4 1;
BA_ "GenSigSendType" SG_ 169 FLR2RdrDetn135To139RCS0 1;
BA_ "GenSigStartValue" SG_ 169 FLR2RdrDetn135To139RCS0 500;
BA_ "GenSigSendType" SG_ 169 FLR2RdrDetn135To139RCS1 1;
BA_ "GenSigStartValue" SG_ 169 FLR2RdrDetn135To139RCS1 500;
BA_ "GenSigSendType" SG_ 169 FLR2RdrDetn135To139RCS2 1;
BA_ "GenSigStartValue" SG_ 169 FLR2RdrDetn135To139RCS2 500;
BA_ "GenSigSendType" SG_ 169 FLR2RdrDetn135To139RCS3 1;
BA_ "GenSigStartValue" SG_ 169 FLR2RdrDetn135To139RCS3 500;
BA_ "GenSigSendType" SG_ 169 FLR2RdrDetn135To139RCS4 1;
BA_ "GenSigStartValue" SG_ 169 FLR2RdrDetn135To139RCS4 500;
BA_ "GenSigSendType" SG_ 169 FLR2RdrDetn135To139Range0 1;
BA_ "GenSigSendType" SG_ 169 FLR2RdrDetn135To139Range1 1;
BA_ "GenSigSendType" SG_ 169 FLR2RdrDetn135To139Range2 1;
BA_ "GenSigSendType" SG_ 169 FLR2RdrDetn135To139Range3 1;
BA_ "GenSigSendType" SG_ 169 FLR2RdrDetn135To139Range4 1;
BA_ "GenSigSendType" SG_ 169 FLR2RdrDetn135To139RngRt0 1;
BA_ "GenSigStartValue" SG_ 169 FLR2RdrDetn135To139RngRt0 1111;
BA_ "GenSigSendType" SG_ 169 FLR2RdrDetn135To139RngRt1 1;
BA_ "GenSigStartValue" SG_ 169 FLR2RdrDetn135To139RngRt1 1111;
BA_ "GenSigSendType" SG_ 169 FLR2RdrDetn135To139RngRt2 1;
BA_ "GenSigStartValue" SG_ 169 FLR2RdrDetn135To139RngRt2 1111;
BA_ "GenSigSendType" SG_ 169 FLR2RdrDetn135To139RngRt3 1;
BA_ "GenSigStartValue" SG_ 169 FLR2RdrDetn135To139RngRt3 1111;
BA_ "GenSigSendType" SG_ 169 FLR2RdrDetn135To139RngRt4 1;
BA_ "GenSigStartValue" SG_ 169 FLR2RdrDetn135To139RngRt4 1111;
BA_ "GenSigSendType" SG_ 169 FLR2RdrDetn135To139SNR0 1;
BA_ "GenSigSendType" SG_ 169 FLR2RdrDetn135To139SNR1 1;
BA_ "GenSigSendType" SG_ 169 FLR2RdrDetn135To139SNR2 1;
BA_ "GenSigSendType" SG_ 169 FLR2RdrDetn135To139SNR3 1;
BA_ "GenSigSendType" SG_ 169 FLR2RdrDetn135To139SNR4 1;
BA_ "GenSigSendType" SG_ 169 FLR2RdrDetn135To139ScanID 1;
BA_ "GenSigSendType" SG_ 172 FLR2RdrDetn140To144AziAng0 1;
BA_ "GenSigSendType" SG_ 172 FLR2RdrDetn140To144AziAng1 1;
BA_ "GenSigSendType" SG_ 172 FLR2RdrDetn140To144AziAng2 1;
BA_ "GenSigSendType" SG_ 172 FLR2RdrDetn140To144AziAng3 1;
BA_ "GenSigSendType" SG_ 172 FLR2RdrDetn140To144AziAng4 1;
BA_ "GenSigDataID" SG_ 172 FLR2RdrDetn140To144CRC "0xAD5";
BA_ "GenSigFuncType" SG_ 172 FLR2RdrDetn140To144CRC 28;
BA_ "GenSigSendType" SG_ 172 FLR2RdrDetn140To144CRC 1;
BA_ "GenSigFuncType" SG_ 172 FLR2RdrDetn140To144Counter 27;
BA_ "GenSigSendType" SG_ 172 FLR2RdrDetn140To144Counter 1;
BA_ "GenSigSendType" SG_ 172 FLR2RdrDetn140To144DynPrpty0 1;
BA_ "GenSigSendType" SG_ 172 FLR2RdrDetn140To144DynPrpty1 1;
BA_ "GenSigSendType" SG_ 172 FLR2RdrDetn140To144DynPrpty2 1;
BA_ "GenSigSendType" SG_ 172 FLR2RdrDetn140To144DynPrpty3 1;
BA_ "GenSigSendType" SG_ 172 FLR2RdrDetn140To144DynPrpty4 1;
BA_ "GenSigSendType" SG_ 172 FLR2RdrDetn140To144EleAng0 1;
BA_ "GenSigSendType" SG_ 172 FLR2RdrDetn140To144EleAng1 1;
BA_ "GenSigSendType" SG_ 172 FLR2RdrDetn140To144EleAng2 1;
BA_ "GenSigSendType" SG_ 172 FLR2RdrDetn140To144EleAng3 1;
BA_ "GenSigSendType" SG_ 172 FLR2RdrDetn140To144EleAng4 1;
BA_ "GenSigSendType" SG_ 172 FLR2RdrDetn140To144Mode0 1;
BA_ "GenSigSendType" SG_ 172 FLR2RdrDetn140To144Mode1 1;
BA_ "GenSigSendType" SG_ 172 FLR2RdrDetn140To144Mode2 1;
BA_ "GenSigSendType" SG_ 172 FLR2RdrDetn140To144Mode3 1;
BA_ "GenSigSendType" SG_ 172 FLR2RdrDetn140To144Mode4 1;
BA_ "GenSigSendType" SG_ 172 FLR2RdrDetn140To144Quality0 1;
BA_ "GenSigSendType" SG_ 172 FLR2RdrDetn140To144Quality1 1;
BA_ "GenSigSendType" SG_ 172 FLR2RdrDetn140To144Quality2 1;
BA_ "GenSigSendType" SG_ 172 FLR2RdrDetn140To144Quality3 1;
BA_ "GenSigSendType" SG_ 172 FLR2RdrDetn140To144Quality4 1;
BA_ "GenSigSendType" SG_ 172 FLR2RdrDetn140To144RCS0 1;
BA_ "GenSigStartValue" SG_ 172 FLR2RdrDetn140To144RCS0 500;
BA_ "GenSigSendType" SG_ 172 FLR2RdrDetn140To144RCS1 1;
BA_ "GenSigStartValue" SG_ 172 FLR2RdrDetn140To144RCS1 500;
BA_ "GenSigSendType" SG_ 172 FLR2RdrDetn140To144RCS2 1;
BA_ "GenSigStartValue" SG_ 172 FLR2RdrDetn140To144RCS2 500;
BA_ "GenSigSendType" SG_ 172 FLR2RdrDetn140To144RCS3 1;
BA_ "GenSigStartValue" SG_ 172 FLR2RdrDetn140To144RCS3 500;
BA_ "GenSigSendType" SG_ 172 FLR2RdrDetn140To144RCS4 1;
BA_ "GenSigStartValue" SG_ 172 FLR2RdrDetn140To144RCS4 500;
BA_ "GenSigSendType" SG_ 172 FLR2RdrDetn140To144Range0 1;
BA_ "GenSigSendType" SG_ 172 FLR2RdrDetn140To144Range1 1;
BA_ "GenSigSendType" SG_ 172 FLR2RdrDetn140To144Range2 1;
BA_ "GenSigSendType" SG_ 172 FLR2RdrDetn140To144Range3 1;
BA_ "GenSigSendType" SG_ 172 FLR2RdrDetn140To144Range4 1;
BA_ "GenSigSendType" SG_ 172 FLR2RdrDetn140To144RngRt0 1;
BA_ "GenSigStartValue" SG_ 172 FLR2RdrDetn140To144RngRt0 1111;
BA_ "GenSigSendType" SG_ 172 FLR2RdrDetn140To144RngRt1 1;
BA_ "GenSigStartValue" SG_ 172 FLR2RdrDetn140To144RngRt1 1111;
BA_ "GenSigSendType" SG_ 172 FLR2RdrDetn140To144RngRt2 1;
BA_ "GenSigStartValue" SG_ 172 FLR2RdrDetn140To144RngRt2 1111;
BA_ "GenSigSendType" SG_ 172 FLR2RdrDetn140To144RngRt3 1;
BA_ "GenSigStartValue" SG_ 172 FLR2RdrDetn140To144RngRt3 1111;
BA_ "GenSigSendType" SG_ 172 FLR2RdrDetn140To144RngRt4 1;
BA_ "GenSigStartValue" SG_ 172 FLR2RdrDetn140To144RngRt4 1111;
BA_ "GenSigSendType" SG_ 172 FLR2RdrDetn140To144SNR0 1;
BA_ "GenSigSendType" SG_ 172 FLR2RdrDetn140To144SNR1 1;
BA_ "GenSigSendType" SG_ 172 FLR2RdrDetn140To144SNR2 1;
BA_ "GenSigSendType" SG_ 172 FLR2RdrDetn140To144SNR3 1;
BA_ "GenSigSendType" SG_ 172 FLR2RdrDetn140To144SNR4 1;
BA_ "GenSigSendType" SG_ 172 FLR2RdrDetn140To144ScanID 1;
BA_ "GenSigSendType" SG_ 176 FLR2RdrDetn145To149AziAng0 1;
BA_ "GenSigSendType" SG_ 176 FLR2RdrDetn145To149AziAng1 1;
BA_ "GenSigSendType" SG_ 176 FLR2RdrDetn145To149AziAng2 1;
BA_ "GenSigSendType" SG_ 176 FLR2RdrDetn145To149AziAng3 1;
BA_ "GenSigSendType" SG_ 176 FLR2RdrDetn145To149AziAng4 1;
BA_ "GenSigDataID" SG_ 176 FLR2RdrDetn145To149CRC "0xAD6";
BA_ "GenSigFuncType" SG_ 176 FLR2RdrDetn145To149CRC 28;
BA_ "GenSigSendType" SG_ 176 FLR2RdrDetn145To149CRC 1;
BA_ "GenSigFuncType" SG_ 176 FLR2RdrDetn145To149Counter 27;
BA_ "GenSigSendType" SG_ 176 FLR2RdrDetn145To149Counter 1;
BA_ "GenSigSendType" SG_ 176 FLR2RdrDetn145To149DynPrpty0 1;
BA_ "GenSigSendType" SG_ 176 FLR2RdrDetn145To149DynPrpty1 1;
BA_ "GenSigSendType" SG_ 176 FLR2RdrDetn145To149DynPrpty2 1;
BA_ "GenSigSendType" SG_ 176 FLR2RdrDetn145To149DynPrpty3 1;
BA_ "GenSigSendType" SG_ 176 FLR2RdrDetn145To149DynPrpty4 1;
BA_ "GenSigSendType" SG_ 176 FLR2RdrDetn145To149EleAng0 1;
BA_ "GenSigSendType" SG_ 176 FLR2RdrDetn145To149EleAng1 1;
BA_ "GenSigSendType" SG_ 176 FLR2RdrDetn145To149EleAng2 1;
BA_ "GenSigSendType" SG_ 176 FLR2RdrDetn145To149EleAng3 1;
BA_ "GenSigSendType" SG_ 176 FLR2RdrDetn145To149EleAng4 1;
BA_ "GenSigSendType" SG_ 176 FLR2RdrDetn145To149Mode0 1;
BA_ "GenSigSendType" SG_ 176 FLR2RdrDetn145To149Mode1 1;
BA_ "GenSigSendType" SG_ 176 FLR2RdrDetn145To149Mode2 1;
BA_ "GenSigSendType" SG_ 176 FLR2RdrDetn145To149Mode3 1;
BA_ "GenSigSendType" SG_ 176 FLR2RdrDetn145To149Mode4 1;
BA_ "GenSigSendType" SG_ 176 FLR2RdrDetn145To149Quality0 1;
BA_ "GenSigSendType" SG_ 176 FLR2RdrDetn145To149Quality1 1;
BA_ "GenSigSendType" SG_ 176 FLR2RdrDetn145To149Quality2 1;
BA_ "GenSigSendType" SG_ 176 FLR2RdrDetn145To149Quality3 1;
BA_ "GenSigSendType" SG_ 176 FLR2RdrDetn145To149Quality4 1;
BA_ "GenSigSendType" SG_ 176 FLR2RdrDetn145To149RCS0 1;
BA_ "GenSigStartValue" SG_ 176 FLR2RdrDetn145To149RCS0 500;
BA_ "GenSigSendType" SG_ 176 FLR2RdrDetn145To149RCS1 1;
BA_ "GenSigStartValue" SG_ 176 FLR2RdrDetn145To149RCS1 500;
BA_ "GenSigSendType" SG_ 176 FLR2RdrDetn145To149RCS2 1;
BA_ "GenSigStartValue" SG_ 176 FLR2RdrDetn145To149RCS2 500;
BA_ "GenSigSendType" SG_ 176 FLR2RdrDetn145To149RCS3 1;
BA_ "GenSigStartValue" SG_ 176 FLR2RdrDetn145To149RCS3 500;
BA_ "GenSigSendType" SG_ 176 FLR2RdrDetn145To149RCS4 1;
BA_ "GenSigStartValue" SG_ 176 FLR2RdrDetn145To149RCS4 500;
BA_ "GenSigSendType" SG_ 176 FLR2RdrDetn145To149Range0 1;
BA_ "GenSigSendType" SG_ 176 FLR2RdrDetn145To149Range1 1;
BA_ "GenSigSendType" SG_ 176 FLR2RdrDetn145To149Range2 1;
BA_ "GenSigSendType" SG_ 176 FLR2RdrDetn145To149Range3 1;
BA_ "GenSigSendType" SG_ 176 FLR2RdrDetn145To149Range4 1;
BA_ "GenSigSendType" SG_ 176 FLR2RdrDetn145To149RngRt0 1;
BA_ "GenSigStartValue" SG_ 176 FLR2RdrDetn145To149RngRt0 1111;
BA_ "GenSigSendType" SG_ 176 FLR2RdrDetn145To149RngRt1 1;
BA_ "GenSigStartValue" SG_ 176 FLR2RdrDetn145To149RngRt1 1111;
BA_ "GenSigSendType" SG_ 176 FLR2RdrDetn145To149RngRt2 1;
BA_ "GenSigStartValue" SG_ 176 FLR2RdrDetn145To149RngRt2 1111;
BA_ "GenSigSendType" SG_ 176 FLR2RdrDetn145To149RngRt3 1;
BA_ "GenSigStartValue" SG_ 176 FLR2RdrDetn145To149RngRt3 1111;
BA_ "GenSigSendType" SG_ 176 FLR2RdrDetn145To149RngRt4 1;
BA_ "GenSigStartValue" SG_ 176 FLR2RdrDetn145To149RngRt4 1111;
BA_ "GenSigSendType" SG_ 176 FLR2RdrDetn145To149SNR0 1;
BA_ "GenSigSendType" SG_ 176 FLR2RdrDetn145To149SNR1 1;
BA_ "GenSigSendType" SG_ 176 FLR2RdrDetn145To149SNR2 1;
BA_ "GenSigSendType" SG_ 176 FLR2RdrDetn145To149SNR3 1;
BA_ "GenSigSendType" SG_ 176 FLR2RdrDetn145To149SNR4 1;
BA_ "GenSigSendType" SG_ 176 FLR2RdrDetn145To149ScanID 1;
BA_ "GenSigSendType" SG_ 179 FLR2RdrDetn150To154AziAng0 1;
BA_ "GenSigSendType" SG_ 179 FLR2RdrDetn150To154AziAng1 1;
BA_ "GenSigSendType" SG_ 179 FLR2RdrDetn150To154AziAng2 1;
BA_ "GenSigSendType" SG_ 179 FLR2RdrDetn150To154AziAng3 1;
BA_ "GenSigSendType" SG_ 179 FLR2RdrDetn150To154AziAng4 1;
BA_ "GenSigDataID" SG_ 179 FLR2RdrDetn150To154CRC "0xAD7";
BA_ "GenSigFuncType" SG_ 179 FLR2RdrDetn150To154CRC 28;
BA_ "GenSigSendType" SG_ 179 FLR2RdrDetn150To154CRC 1;
BA_ "GenSigFuncType" SG_ 179 FLR2RdrDetn150To154Counter 27;
BA_ "GenSigSendType" SG_ 179 FLR2RdrDetn150To154Counter 1;
BA_ "GenSigSendType" SG_ 179 FLR2RdrDetn150To154DynPrpty0 1;
BA_ "GenSigSendType" SG_ 179 FLR2RdrDetn150To154DynPrpty1 1;
BA_ "GenSigSendType" SG_ 179 FLR2RdrDetn150To154DynPrpty2 1;
BA_ "GenSigSendType" SG_ 179 FLR2RdrDetn150To154DynPrpty3 1;
BA_ "GenSigSendType" SG_ 179 FLR2RdrDetn150To154DynPrpty4 1;
BA_ "GenSigSendType" SG_ 179 FLR2RdrDetn150To154EleAng0 1;
BA_ "GenSigSendType" SG_ 179 FLR2RdrDetn150To154EleAng1 1;
BA_ "GenSigSendType" SG_ 179 FLR2RdrDetn150To154EleAng2 1;
BA_ "GenSigSendType" SG_ 179 FLR2RdrDetn150To154EleAng3 1;
BA_ "GenSigSendType" SG_ 179 FLR2RdrDetn150To154EleAng4 1;
BA_ "GenSigSendType" SG_ 179 FLR2RdrDetn150To154Mode0 1;
BA_ "GenSigSendType" SG_ 179 FLR2RdrDetn150To154Mode1 1;
BA_ "GenSigSendType" SG_ 179 FLR2RdrDetn150To154Mode2 1;
BA_ "GenSigSendType" SG_ 179 FLR2RdrDetn150To154Mode3 1;
BA_ "GenSigSendType" SG_ 179 FLR2RdrDetn150To154Mode4 1;
BA_ "GenSigSendType" SG_ 179 FLR2RdrDetn150To154Quality0 1;
BA_ "GenSigSendType" SG_ 179 FLR2RdrDetn150To154Quality1 1;
BA_ "GenSigSendType" SG_ 179 FLR2RdrDetn150To154Quality2 1;
BA_ "GenSigSendType" SG_ 179 FLR2RdrDetn150To154Quality3 1;
BA_ "GenSigSendType" SG_ 179 FLR2RdrDetn150To154Quality4 1;
BA_ "GenSigSendType" SG_ 179 FLR2RdrDetn150To154RCS0 1;
BA_ "GenSigStartValue" SG_ 179 FLR2RdrDetn150To154RCS0 500;
BA_ "GenSigSendType" SG_ 179 FLR2RdrDetn150To154RCS1 1;
BA_ "GenSigStartValue" SG_ 179 FLR2RdrDetn150To154RCS1 500;
BA_ "GenSigSendType" SG_ 179 FLR2RdrDetn150To154RCS2 1;
BA_ "GenSigStartValue" SG_ 179 FLR2RdrDetn150To154RCS2 500;
BA_ "GenSigSendType" SG_ 179 FLR2RdrDetn150To154RCS3 1;
BA_ "GenSigStartValue" SG_ 179 FLR2RdrDetn150To154RCS3 500;
BA_ "GenSigSendType" SG_ 179 FLR2RdrDetn150To154RCS4 1;
BA_ "GenSigStartValue" SG_ 179 FLR2RdrDetn150To154RCS4 500;
BA_ "GenSigSendType" SG_ 179 FLR2RdrDetn150To154Range0 1;
BA_ "GenSigSendType" SG_ 179 FLR2RdrDetn150To154Range1 1;
BA_ "GenSigSendType" SG_ 179 FLR2RdrDetn150To154Range2 1;
BA_ "GenSigSendType" SG_ 179 FLR2RdrDetn150To154Range3 1;
BA_ "GenSigSendType" SG_ 179 FLR2RdrDetn150To154Range4 1;
BA_ "GenSigSendType" SG_ 179 FLR2RdrDetn150To154RngRt0 1;
BA_ "GenSigStartValue" SG_ 179 FLR2RdrDetn150To154RngRt0 1111;
BA_ "GenSigSendType" SG_ 179 FLR2RdrDetn150To154RngRt1 1;
BA_ "GenSigStartValue" SG_ 179 FLR2RdrDetn150To154RngRt1 1111;
BA_ "GenSigSendType" SG_ 179 FLR2RdrDetn150To154RngRt2 1;
BA_ "GenSigStartValue" SG_ 179 FLR2RdrDetn150To154RngRt2 1111;
BA_ "GenSigSendType" SG_ 179 FLR2RdrDetn150To154RngRt3 1;
BA_ "GenSigStartValue" SG_ 179 FLR2RdrDetn150To154RngRt3 1111;
BA_ "GenSigSendType" SG_ 179 FLR2RdrDetn150To154RngRt4 1;
BA_ "GenSigStartValue" SG_ 179 FLR2RdrDetn150To154RngRt4 1111;
BA_ "GenSigSendType" SG_ 179 FLR2RdrDetn150To154SNR0 1;
BA_ "GenSigSendType" SG_ 179 FLR2RdrDetn150To154SNR1 1;
BA_ "GenSigSendType" SG_ 179 FLR2RdrDetn150To154SNR2 1;
BA_ "GenSigSendType" SG_ 179 FLR2RdrDetn150To154SNR3 1;
BA_ "GenSigSendType" SG_ 179 FLR2RdrDetn150To154SNR4 1;
BA_ "GenSigSendType" SG_ 179 FLR2RdrDetn150To154ScanID 1;
BA_ "GenSigSendType" SG_ 182 FLR2RdrDetn155To159AziAng0 1;
BA_ "GenSigSendType" SG_ 182 FLR2RdrDetn155To159AziAng1 1;
BA_ "GenSigSendType" SG_ 182 FLR2RdrDetn155To159AziAng2 1;
BA_ "GenSigSendType" SG_ 182 FLR2RdrDetn155To159AziAng3 1;
BA_ "GenSigSendType" SG_ 182 FLR2RdrDetn155To159AziAng4 1;
BA_ "GenSigDataID" SG_ 182 FLR2RdrDetn155To159CRC "0xAD8";
BA_ "GenSigFuncType" SG_ 182 FLR2RdrDetn155To159CRC 28;
BA_ "GenSigSendType" SG_ 182 FLR2RdrDetn155To159CRC 1;
BA_ "GenSigFuncType" SG_ 182 FLR2RdrDetn155To159Counter 27;
BA_ "GenSigSendType" SG_ 182 FLR2RdrDetn155To159Counter 1;
BA_ "GenSigSendType" SG_ 182 FLR2RdrDetn155To159DynPrpty0 1;
BA_ "GenSigSendType" SG_ 182 FLR2RdrDetn155To159DynPrpty1 1;
BA_ "GenSigSendType" SG_ 182 FLR2RdrDetn155To159DynPrpty2 1;
BA_ "GenSigSendType" SG_ 182 FLR2RdrDetn155To159DynPrpty3 1;
BA_ "GenSigSendType" SG_ 182 FLR2RdrDetn155To159DynPrpty4 1;
BA_ "GenSigSendType" SG_ 182 FLR2RdrDetn155To159EleAng0 1;
BA_ "GenSigSendType" SG_ 182 FLR2RdrDetn155To159EleAng1 1;
BA_ "GenSigSendType" SG_ 182 FLR2RdrDetn155To159EleAng2 1;
BA_ "GenSigSendType" SG_ 182 FLR2RdrDetn155To159EleAng3 1;
BA_ "GenSigSendType" SG_ 182 FLR2RdrDetn155To159EleAng4 1;
BA_ "GenSigSendType" SG_ 182 FLR2RdrDetn155To159Mode0 1;
BA_ "GenSigSendType" SG_ 182 FLR2RdrDetn155To159Mode1 1;
BA_ "GenSigSendType" SG_ 182 FLR2RdrDetn155To159Mode2 1;
BA_ "GenSigSendType" SG_ 182 FLR2RdrDetn155To159Mode3 1;
BA_ "GenSigSendType" SG_ 182 FLR2RdrDetn155To159Mode4 1;
BA_ "GenSigSendType" SG_ 182 FLR2RdrDetn155To159Quality0 1;
BA_ "GenSigSendType" SG_ 182 FLR2RdrDetn155To159Quality1 1;
BA_ "GenSigSendType" SG_ 182 FLR2RdrDetn155To159Quality2 1;
BA_ "GenSigSendType" SG_ 182 FLR2RdrDetn155To159Quality3 1;
BA_ "GenSigSendType" SG_ 182 FLR2RdrDetn155To159Quality4 1;
BA_ "GenSigSendType" SG_ 182 FLR2RdrDetn155To159RCS0 1;
BA_ "GenSigStartValue" SG_ 182 FLR2RdrDetn155To159RCS0 500;
BA_ "GenSigSendType" SG_ 182 FLR2RdrDetn155To159RCS1 1;
BA_ "GenSigStartValue" SG_ 182 FLR2RdrDetn155To159RCS1 500;
BA_ "GenSigSendType" SG_ 182 FLR2RdrDetn155To159RCS2 1;
BA_ "GenSigStartValue" SG_ 182 FLR2RdrDetn155To159RCS2 500;
BA_ "GenSigSendType" SG_ 182 FLR2RdrDetn155To159RCS3 1;
BA_ "GenSigStartValue" SG_ 182 FLR2RdrDetn155To159RCS3 500;
BA_ "GenSigSendType" SG_ 182 FLR2RdrDetn155To159RCS4 1;
BA_ "GenSigStartValue" SG_ 182 FLR2RdrDetn155To159RCS4 500;
BA_ "GenSigSendType" SG_ 182 FLR2RdrDetn155To159Range0 1;
BA_ "GenSigSendType" SG_ 182 FLR2RdrDetn155To159Range1 1;
BA_ "GenSigSendType" SG_ 182 FLR2RdrDetn155To159Range2 1;
BA_ "GenSigSendType" SG_ 182 FLR2RdrDetn155To159Range3 1;
BA_ "GenSigSendType" SG_ 182 FLR2RdrDetn155To159Range4 1;
BA_ "GenSigSendType" SG_ 182 FLR2RdrDetn155To159RngRt0 1;
BA_ "GenSigStartValue" SG_ 182 FLR2RdrDetn155To159RngRt0 1111;
BA_ "GenSigSendType" SG_ 182 FLR2RdrDetn155To159RngRt1 1;
BA_ "GenSigStartValue" SG_ 182 FLR2RdrDetn155To159RngRt1 1111;
BA_ "GenSigSendType" SG_ 182 FLR2RdrDetn155To159RngRt2 1;
BA_ "GenSigStartValue" SG_ 182 FLR2RdrDetn155To159RngRt2 1111;
BA_ "GenSigSendType" SG_ 182 FLR2RdrDetn155To159RngRt3 1;
BA_ "GenSigStartValue" SG_ 182 FLR2RdrDetn155To159RngRt3 1111;
BA_ "GenSigSendType" SG_ 182 FLR2RdrDetn155To159RngRt4 1;
BA_ "GenSigStartValue" SG_ 182 FLR2RdrDetn155To159RngRt4 1111;
BA_ "GenSigSendType" SG_ 182 FLR2RdrDetn155To159SNR0 1;
BA_ "GenSigSendType" SG_ 182 FLR2RdrDetn155To159SNR1 1;
BA_ "GenSigSendType" SG_ 182 FLR2RdrDetn155To159SNR2 1;
BA_ "GenSigSendType" SG_ 182 FLR2RdrDetn155To159SNR3 1;
BA_ "GenSigSendType" SG_ 182 FLR2RdrDetn155To159SNR4 1;
BA_ "GenSigSendType" SG_ 182 FLR2RdrDetn155To159ScanID 1;
BA_ "GenSigSendType" SG_ 185 FLR2RdrDetn160To164AziAng0 1;
BA_ "GenSigSendType" SG_ 185 FLR2RdrDetn160To164AziAng1 1;
BA_ "GenSigSendType" SG_ 185 FLR2RdrDetn160To164AziAng2 1;
BA_ "GenSigSendType" SG_ 185 FLR2RdrDetn160To164AziAng3 1;
BA_ "GenSigSendType" SG_ 185 FLR2RdrDetn160To164AziAng4 1;
BA_ "GenSigDataID" SG_ 185 FLR2RdrDetn160To164CRC "0xAD9";
BA_ "GenSigFuncType" SG_ 185 FLR2RdrDetn160To164CRC 28;
BA_ "GenSigSendType" SG_ 185 FLR2RdrDetn160To164CRC 1;
BA_ "GenSigFuncType" SG_ 185 FLR2RdrDetn160To164Counter 27;
BA_ "GenSigSendType" SG_ 185 FLR2RdrDetn160To164Counter 1;
BA_ "GenSigSendType" SG_ 185 FLR2RdrDetn160To164DynPrpty0 1;
BA_ "GenSigSendType" SG_ 185 FLR2RdrDetn160To164DynPrpty1 1;
BA_ "GenSigSendType" SG_ 185 FLR2RdrDetn160To164DynPrpty2 1;
BA_ "GenSigSendType" SG_ 185 FLR2RdrDetn160To164DynPrpty3 1;
BA_ "GenSigSendType" SG_ 185 FLR2RdrDetn160To164DynPrpty4 1;
BA_ "GenSigSendType" SG_ 185 FLR2RdrDetn160To164EleAng0 1;
BA_ "GenSigSendType" SG_ 185 FLR2RdrDetn160To164EleAng1 1;
BA_ "GenSigSendType" SG_ 185 FLR2RdrDetn160To164EleAng2 1;
BA_ "GenSigSendType" SG_ 185 FLR2RdrDetn160To164EleAng3 1;
BA_ "GenSigSendType" SG_ 185 FLR2RdrDetn160To164EleAng4 1;
BA_ "GenSigSendType" SG_ 185 FLR2RdrDetn160To164Mode0 1;
BA_ "GenSigSendType" SG_ 185 FLR2RdrDetn160To164Mode1 1;
BA_ "GenSigSendType" SG_ 185 FLR2RdrDetn160To164Mode2 1;
BA_ "GenSigSendType" SG_ 185 FLR2RdrDetn160To164Mode3 1;
BA_ "GenSigSendType" SG_ 185 FLR2RdrDetn160To164Mode4 1;
BA_ "GenSigSendType" SG_ 185 FLR2RdrDetn160To164Quality0 1;
BA_ "GenSigSendType" SG_ 185 FLR2RdrDetn160To164Quality1 1;
BA_ "GenSigSendType" SG_ 185 FLR2RdrDetn160To164Quality2 1;
BA_ "GenSigSendType" SG_ 185 FLR2RdrDetn160To164Quality3 1;
BA_ "GenSigSendType" SG_ 185 FLR2RdrDetn160To164Quality4 1;
BA_ "GenSigSendType" SG_ 185 FLR2RdrDetn160To164RCS0 1;
BA_ "GenSigStartValue" SG_ 185 FLR2RdrDetn160To164RCS0 500;
BA_ "GenSigSendType" SG_ 185 FLR2RdrDetn160To164RCS1 1;
BA_ "GenSigStartValue" SG_ 185 FLR2RdrDetn160To164RCS1 500;
BA_ "GenSigSendType" SG_ 185 FLR2RdrDetn160To164RCS2 1;
BA_ "GenSigStartValue" SG_ 185 FLR2RdrDetn160To164RCS2 500;
BA_ "GenSigSendType" SG_ 185 FLR2RdrDetn160To164RCS3 1;
BA_ "GenSigStartValue" SG_ 185 FLR2RdrDetn160To164RCS3 500;
BA_ "GenSigSendType" SG_ 185 FLR2RdrDetn160To164RCS4 1;
BA_ "GenSigStartValue" SG_ 185 FLR2RdrDetn160To164RCS4 500;
BA_ "GenSigSendType" SG_ 185 FLR2RdrDetn160To164Range0 1;
BA_ "GenSigSendType" SG_ 185 FLR2RdrDetn160To164Range1 1;
BA_ "GenSigSendType" SG_ 185 FLR2RdrDetn160To164Range2 1;
BA_ "GenSigSendType" SG_ 185 FLR2RdrDetn160To164Range3 1;
BA_ "GenSigSendType" SG_ 185 FLR2RdrDetn160To164Range4 1;
BA_ "GenSigSendType" SG_ 185 FLR2RdrDetn160To164RngRt0 1;
BA_ "GenSigStartValue" SG_ 185 FLR2RdrDetn160To164RngRt0 1111;
BA_ "GenSigSendType" SG_ 185 FLR2RdrDetn160To164RngRt1 1;
BA_ "GenSigStartValue" SG_ 185 FLR2RdrDetn160To164RngRt1 1111;
BA_ "GenSigSendType" SG_ 185 FLR2RdrDetn160To164RngRt2 1;
BA_ "GenSigStartValue" SG_ 185 FLR2RdrDetn160To164RngRt2 1111;
BA_ "GenSigSendType" SG_ 185 FLR2RdrDetn160To164RngRt3 1;
BA_ "GenSigStartValue" SG_ 185 FLR2RdrDetn160To164RngRt3 1111;
BA_ "GenSigSendType" SG_ 185 FLR2RdrDetn160To164RngRt4 1;
BA_ "GenSigStartValue" SG_ 185 FLR2RdrDetn160To164RngRt4 1111;
BA_ "GenSigSendType" SG_ 185 FLR2RdrDetn160To164SNR0 1;
BA_ "GenSigSendType" SG_ 185 FLR2RdrDetn160To164SNR1 1;
BA_ "GenSigSendType" SG_ 185 FLR2RdrDetn160To164SNR2 1;
BA_ "GenSigSendType" SG_ 185 FLR2RdrDetn160To164SNR3 1;
BA_ "GenSigSendType" SG_ 185 FLR2RdrDetn160To164SNR4 1;
BA_ "GenSigSendType" SG_ 185 FLR2RdrDetn160To164ScanID 1;
BA_ "GenSigSendType" SG_ 188 FLR2RdrDetn165To169AziAng0 1;
BA_ "GenSigSendType" SG_ 188 FLR2RdrDetn165To169AziAng1 1;
BA_ "GenSigSendType" SG_ 188 FLR2RdrDetn165To169AziAng2 1;
BA_ "GenSigSendType" SG_ 188 FLR2RdrDetn165To169AziAng3 1;
BA_ "GenSigSendType" SG_ 188 FLR2RdrDetn165To169AziAng4 1;
BA_ "GenSigDataID" SG_ 188 FLR2RdrDetn165To169CRC "0xADA";
BA_ "GenSigFuncType" SG_ 188 FLR2RdrDetn165To169CRC 28;
BA_ "GenSigSendType" SG_ 188 FLR2RdrDetn165To169CRC 1;
BA_ "GenSigFuncType" SG_ 188 FLR2RdrDetn165To169Counter 27;
BA_ "GenSigSendType" SG_ 188 FLR2RdrDetn165To169Counter 1;
BA_ "GenSigSendType" SG_ 188 FLR2RdrDetn165To169DynPrpty0 1;
BA_ "GenSigSendType" SG_ 188 FLR2RdrDetn165To169DynPrpty1 1;
BA_ "GenSigSendType" SG_ 188 FLR2RdrDetn165To169DynPrpty2 1;
BA_ "GenSigSendType" SG_ 188 FLR2RdrDetn165To169DynPrpty3 1;
BA_ "GenSigSendType" SG_ 188 FLR2RdrDetn165To169DynPrpty4 1;
BA_ "GenSigSendType" SG_ 188 FLR2RdrDetn165To169EleAng0 1;
BA_ "GenSigSendType" SG_ 188 FLR2RdrDetn165To169EleAng1 1;
BA_ "GenSigSendType" SG_ 188 FLR2RdrDetn165To169EleAng2 1;
BA_ "GenSigSendType" SG_ 188 FLR2RdrDetn165To169EleAng3 1;
BA_ "GenSigSendType" SG_ 188 FLR2RdrDetn165To169EleAng4 1;
BA_ "GenSigSendType" SG_ 188 FLR2RdrDetn165To169Mode0 1;
BA_ "GenSigSendType" SG_ 188 FLR2RdrDetn165To169Mode1 1;
BA_ "GenSigSendType" SG_ 188 FLR2RdrDetn165To169Mode2 1;
BA_ "GenSigSendType" SG_ 188 FLR2RdrDetn165To169Mode3 1;
BA_ "GenSigSendType" SG_ 188 FLR2RdrDetn165To169Mode4 1;
BA_ "GenSigSendType" SG_ 188 FLR2RdrDetn165To169Quality0 1;
BA_ "GenSigSendType" SG_ 188 FLR2RdrDetn165To169Quality1 1;
BA_ "GenSigSendType" SG_ 188 FLR2RdrDetn165To169Quality2 1;
BA_ "GenSigSendType" SG_ 188 FLR2RdrDetn165To169Quality3 1;
BA_ "GenSigSendType" SG_ 188 FLR2RdrDetn165To169Quality4 1;
BA_ "GenSigSendType" SG_ 188 FLR2RdrDetn165To169RCS0 1;
BA_ "GenSigStartValue" SG_ 188 FLR2RdrDetn165To169RCS0 500;
BA_ "GenSigSendType" SG_ 188 FLR2RdrDetn165To169RCS1 1;
BA_ "GenSigStartValue" SG_ 188 FLR2RdrDetn165To169RCS1 500;
BA_ "GenSigSendType" SG_ 188 FLR2RdrDetn165To169RCS2 1;
BA_ "GenSigStartValue" SG_ 188 FLR2RdrDetn165To169RCS2 500;
BA_ "GenSigSendType" SG_ 188 FLR2RdrDetn165To169RCS3 1;
BA_ "GenSigStartValue" SG_ 188 FLR2RdrDetn165To169RCS3 500;
BA_ "GenSigSendType" SG_ 188 FLR2RdrDetn165To169RCS4 1;
BA_ "GenSigStartValue" SG_ 188 FLR2RdrDetn165To169RCS4 500;
BA_ "GenSigSendType" SG_ 188 FLR2RdrDetn165To169Range0 1;
BA_ "GenSigSendType" SG_ 188 FLR2RdrDetn165To169Range1 1;
BA_ "GenSigSendType" SG_ 188 FLR2RdrDetn165To169Range2 1;
BA_ "GenSigSendType" SG_ 188 FLR2RdrDetn165To169Range3 1;
BA_ "GenSigSendType" SG_ 188 FLR2RdrDetn165To169Range4 1;
BA_ "GenSigSendType" SG_ 188 FLR2RdrDetn165To169RngRt0 1;
BA_ "GenSigStartValue" SG_ 188 FLR2RdrDetn165To169RngRt0 1111;
BA_ "GenSigSendType" SG_ 188 FLR2RdrDetn165To169RngRt1 1;
BA_ "GenSigStartValue" SG_ 188 FLR2RdrDetn165To169RngRt1 1111;
BA_ "GenSigSendType" SG_ 188 FLR2RdrDetn165To169RngRt2 1;
BA_ "GenSigStartValue" SG_ 188 FLR2RdrDetn165To169RngRt2 1111;
BA_ "GenSigSendType" SG_ 188 FLR2RdrDetn165To169RngRt3 1;
BA_ "GenSigStartValue" SG_ 188 FLR2RdrDetn165To169RngRt3 1111;
BA_ "GenSigSendType" SG_ 188 FLR2RdrDetn165To169RngRt4 1;
BA_ "GenSigStartValue" SG_ 188 FLR2RdrDetn165To169RngRt4 1111;
BA_ "GenSigSendType" SG_ 188 FLR2RdrDetn165To169SNR0 1;
BA_ "GenSigSendType" SG_ 188 FLR2RdrDetn165To169SNR1 1;
BA_ "GenSigSendType" SG_ 188 FLR2RdrDetn165To169SNR2 1;
BA_ "GenSigSendType" SG_ 188 FLR2RdrDetn165To169SNR3 1;
BA_ "GenSigSendType" SG_ 188 FLR2RdrDetn165To169SNR4 1;
BA_ "GenSigSendType" SG_ 188 FLR2RdrDetn165To169ScanID 1;
BA_ "GenSigSendType" SG_ 192 FLR2RdrDetn170To174AziAng0 1;
BA_ "GenSigSendType" SG_ 192 FLR2RdrDetn170To174AziAng1 1;
BA_ "GenSigSendType" SG_ 192 FLR2RdrDetn170To174AziAng2 1;
BA_ "GenSigSendType" SG_ 192 FLR2RdrDetn170To174AziAng3 1;
BA_ "GenSigSendType" SG_ 192 FLR2RdrDetn170To174AziAng4 1;
BA_ "GenSigDataID" SG_ 192 FLR2RdrDetn170To174CRC "0xADB";
BA_ "GenSigFuncType" SG_ 192 FLR2RdrDetn170To174CRC 28;
BA_ "GenSigSendType" SG_ 192 FLR2RdrDetn170To174CRC 1;
BA_ "GenSigFuncType" SG_ 192 FLR2RdrDetn170To174Counter 27;
BA_ "GenSigSendType" SG_ 192 FLR2RdrDetn170To174Counter 1;
BA_ "GenSigSendType" SG_ 192 FLR2RdrDetn170To174DynPrpty0 1;
BA_ "GenSigSendType" SG_ 192 FLR2RdrDetn170To174DynPrpty1 1;
BA_ "GenSigSendType" SG_ 192 FLR2RdrDetn170To174DynPrpty2 1;
BA_ "GenSigSendType" SG_ 192 FLR2RdrDetn170To174DynPrpty3 1;
BA_ "GenSigSendType" SG_ 192 FLR2RdrDetn170To174DynPrpty4 1;
BA_ "GenSigSendType" SG_ 192 FLR2RdrDetn170To174EleAng0 1;
BA_ "GenSigSendType" SG_ 192 FLR2RdrDetn170To174EleAng1 1;
BA_ "GenSigSendType" SG_ 192 FLR2RdrDetn170To174EleAng2 1;
BA_ "GenSigSendType" SG_ 192 FLR2RdrDetn170To174EleAng3 1;
BA_ "GenSigSendType" SG_ 192 FLR2RdrDetn170To174EleAng4 1;
BA_ "GenSigSendType" SG_ 192 FLR2RdrDetn170To174Mode0 1;
BA_ "GenSigSendType" SG_ 192 FLR2RdrDetn170To174Mode1 1;
BA_ "GenSigSendType" SG_ 192 FLR2RdrDetn170To174Mode2 1;
BA_ "GenSigSendType" SG_ 192 FLR2RdrDetn170To174Mode3 1;
BA_ "GenSigSendType" SG_ 192 FLR2RdrDetn170To174Mode4 1;
BA_ "GenSigSendType" SG_ 192 FLR2RdrDetn170To174Quality0 1;
BA_ "GenSigSendType" SG_ 192 FLR2RdrDetn170To174Quality1 1;
BA_ "GenSigSendType" SG_ 192 FLR2RdrDetn170To174Quality2 1;
BA_ "GenSigSendType" SG_ 192 FLR2RdrDetn170To174Quality3 1;
BA_ "GenSigSendType" SG_ 192 FLR2RdrDetn170To174Quality4 1;
BA_ "GenSigSendType" SG_ 192 FLR2RdrDetn170To174RCS0 1;
BA_ "GenSigStartValue" SG_ 192 FLR2RdrDetn170To174RCS0 500;
BA_ "GenSigSendType" SG_ 192 FLR2RdrDetn170To174RCS1 1;
BA_ "GenSigStartValue" SG_ 192 FLR2RdrDetn170To174RCS1 500;
BA_ "GenSigSendType" SG_ 192 FLR2RdrDetn170To174RCS2 1;
BA_ "GenSigStartValue" SG_ 192 FLR2RdrDetn170To174RCS2 500;
BA_ "GenSigSendType" SG_ 192 FLR2RdrDetn170To174RCS3 1;
BA_ "GenSigStartValue" SG_ 192 FLR2RdrDetn170To174RCS3 500;
BA_ "GenSigSendType" SG_ 192 FLR2RdrDetn170To174RCS4 1;
BA_ "GenSigStartValue" SG_ 192 FLR2RdrDetn170To174RCS4 500;
BA_ "GenSigSendType" SG_ 192 FLR2RdrDetn170To174Range0 1;
BA_ "GenSigSendType" SG_ 192 FLR2RdrDetn170To174Range1 1;
BA_ "GenSigSendType" SG_ 192 FLR2RdrDetn170To174Range2 1;
BA_ "GenSigSendType" SG_ 192 FLR2RdrDetn170To174Range3 1;
BA_ "GenSigSendType" SG_ 192 FLR2RdrDetn170To174Range4 1;
BA_ "GenSigSendType" SG_ 192 FLR2RdrDetn170To174RngRt0 1;
BA_ "GenSigStartValue" SG_ 192 FLR2RdrDetn170To174RngRt0 1111;
BA_ "GenSigSendType" SG_ 192 FLR2RdrDetn170To174RngRt1 1;
BA_ "GenSigStartValue" SG_ 192 FLR2RdrDetn170To174RngRt1 1111;
BA_ "GenSigSendType" SG_ 192 FLR2RdrDetn170To174RngRt2 1;
BA_ "GenSigStartValue" SG_ 192 FLR2RdrDetn170To174RngRt2 1111;
BA_ "GenSigSendType" SG_ 192 FLR2RdrDetn170To174RngRt3 1;
BA_ "GenSigStartValue" SG_ 192 FLR2RdrDetn170To174RngRt3 1111;
BA_ "GenSigSendType" SG_ 192 FLR2RdrDetn170To174RngRt4 1;
BA_ "GenSigStartValue" SG_ 192 FLR2RdrDetn170To174RngRt4 1111;
BA_ "GenSigSendType" SG_ 192 FLR2RdrDetn170To174SNR0 1;
BA_ "GenSigSendType" SG_ 192 FLR2RdrDetn170To174SNR1 1;
BA_ "GenSigSendType" SG_ 192 FLR2RdrDetn170To174SNR2 1;
BA_ "GenSigSendType" SG_ 192 FLR2RdrDetn170To174SNR3 1;
BA_ "GenSigSendType" SG_ 192 FLR2RdrDetn170To174SNR4 1;
BA_ "GenSigSendType" SG_ 192 FLR2RdrDetn170To174ScanID 1;
BA_ "GenSigSendType" SG_ 195 FLR2RdrDetn175To179AziAng0 1;
BA_ "GenSigSendType" SG_ 195 FLR2RdrDetn175To179AziAng1 1;
BA_ "GenSigSendType" SG_ 195 FLR2RdrDetn175To179AziAng2 1;
BA_ "GenSigSendType" SG_ 195 FLR2RdrDetn175To179AziAng3 1;
BA_ "GenSigSendType" SG_ 195 FLR2RdrDetn175To179AziAng4 1;
BA_ "GenSigDataID" SG_ 195 FLR2RdrDetn175To179CRC "0xADC";
BA_ "GenSigFuncType" SG_ 195 FLR2RdrDetn175To179CRC 28;
BA_ "GenSigSendType" SG_ 195 FLR2RdrDetn175To179CRC 1;
BA_ "GenSigFuncType" SG_ 195 FLR2RdrDetn175To179Counter 27;
BA_ "GenSigSendType" SG_ 195 FLR2RdrDetn175To179Counter 1;
BA_ "GenSigSendType" SG_ 195 FLR2RdrDetn175To179DynPrpty0 1;
BA_ "GenSigSendType" SG_ 195 FLR2RdrDetn175To179DynPrpty1 1;
BA_ "GenSigSendType" SG_ 195 FLR2RdrDetn175To179DynPrpty2 1;
BA_ "GenSigSendType" SG_ 195 FLR2RdrDetn175To179DynPrpty3 1;
BA_ "GenSigSendType" SG_ 195 FLR2RdrDetn175To179DynPrpty4 1;
BA_ "GenSigSendType" SG_ 195 FLR2RdrDetn175To179EleAng0 1;
BA_ "GenSigSendType" SG_ 195 FLR2RdrDetn175To179EleAng1 1;
BA_ "GenSigSendType" SG_ 195 FLR2RdrDetn175To179EleAng2 1;
BA_ "GenSigSendType" SG_ 195 FLR2RdrDetn175To179EleAng3 1;
BA_ "GenSigSendType" SG_ 195 FLR2RdrDetn175To179EleAng4 1;
BA_ "GenSigSendType" SG_ 195 FLR2RdrDetn175To179Mode0 1;
BA_ "GenSigSendType" SG_ 195 FLR2RdrDetn175To179Mode1 1;
BA_ "GenSigSendType" SG_ 195 FLR2RdrDetn175To179Mode2 1;
BA_ "GenSigSendType" SG_ 195 FLR2RdrDetn175To179Mode3 1;
BA_ "GenSigSendType" SG_ 195 FLR2RdrDetn175To179Mode4 1;
BA_ "GenSigSendType" SG_ 195 FLR2RdrDetn175To179Quality0 1;
BA_ "GenSigSendType" SG_ 195 FLR2RdrDetn175To179Quality1 1;
BA_ "GenSigSendType" SG_ 195 FLR2RdrDetn175To179Quality2 1;
BA_ "GenSigSendType" SG_ 195 FLR2RdrDetn175To179Quality3 1;
BA_ "GenSigSendType" SG_ 195 FLR2RdrDetn175To179Quality4 1;
BA_ "GenSigSendType" SG_ 195 FLR2RdrDetn175To179RCS0 1;
BA_ "GenSigStartValue" SG_ 195 FLR2RdrDetn175To179RCS0 500;
BA_ "GenSigSendType" SG_ 195 FLR2RdrDetn175To179RCS1 1;
BA_ "GenSigStartValue" SG_ 195 FLR2RdrDetn175To179RCS1 500;
BA_ "GenSigSendType" SG_ 195 FLR2RdrDetn175To179RCS2 1;
BA_ "GenSigStartValue" SG_ 195 FLR2RdrDetn175To179RCS2 500;
BA_ "GenSigSendType" SG_ 195 FLR2RdrDetn175To179RCS3 1;
BA_ "GenSigStartValue" SG_ 195 FLR2RdrDetn175To179RCS3 500;
BA_ "GenSigSendType" SG_ 195 FLR2RdrDetn175To179RCS4 1;
BA_ "GenSigStartValue" SG_ 195 FLR2RdrDetn175To179RCS4 500;
BA_ "GenSigSendType" SG_ 195 FLR2RdrDetn175To179Range0 1;
BA_ "GenSigSendType" SG_ 195 FLR2RdrDetn175To179Range1 1;
BA_ "GenSigSendType" SG_ 195 FLR2RdrDetn175To179Range2 1;
BA_ "GenSigSendType" SG_ 195 FLR2RdrDetn175To179Range3 1;
BA_ "GenSigSendType" SG_ 195 FLR2RdrDetn175To179Range4 1;
BA_ "GenSigSendType" SG_ 195 FLR2RdrDetn175To179RngRt0 1;
BA_ "GenSigStartValue" SG_ 195 FLR2RdrDetn175To179RngRt0 1111;
BA_ "GenSigSendType" SG_ 195 FLR2RdrDetn175To179RngRt1 1;
BA_ "GenSigStartValue" SG_ 195 FLR2RdrDetn175To179RngRt1 1111;
BA_ "GenSigSendType" SG_ 195 FLR2RdrDetn175To179RngRt2 1;
BA_ "GenSigStartValue" SG_ 195 FLR2RdrDetn175To179RngRt2 1111;
BA_ "GenSigSendType" SG_ 195 FLR2RdrDetn175To179RngRt3 1;
BA_ "GenSigStartValue" SG_ 195 FLR2RdrDetn175To179RngRt3 1111;
BA_ "GenSigSendType" SG_ 195 FLR2RdrDetn175To179RngRt4 1;
BA_ "GenSigStartValue" SG_ 195 FLR2RdrDetn175To179RngRt4 1111;
BA_ "GenSigSendType" SG_ 195 FLR2RdrDetn175To179SNR0 1;
BA_ "GenSigSendType" SG_ 195 FLR2RdrDetn175To179SNR1 1;
BA_ "GenSigSendType" SG_ 195 FLR2RdrDetn175To179SNR2 1;
BA_ "GenSigSendType" SG_ 195 FLR2RdrDetn175To179SNR3 1;
BA_ "GenSigSendType" SG_ 195 FLR2RdrDetn175To179SNR4 1;
BA_ "GenSigSendType" SG_ 195 FLR2RdrDetn175To179ScanID 1;
BA_ "GenSigSendType" SG_ 198 FLR2RdrDetn180To184AziAng0 1;
BA_ "GenSigSendType" SG_ 198 FLR2RdrDetn180To184AziAng1 1;
BA_ "GenSigSendType" SG_ 198 FLR2RdrDetn180To184AziAng2 1;
BA_ "GenSigSendType" SG_ 198 FLR2RdrDetn180To184AziAng3 1;
BA_ "GenSigSendType" SG_ 198 FLR2RdrDetn180To184AziAng4 1;
BA_ "GenSigDataID" SG_ 198 FLR2RdrDetn180To184CRC "0xADD";
BA_ "GenSigFuncType" SG_ 198 FLR2RdrDetn180To184CRC 28;
BA_ "GenSigSendType" SG_ 198 FLR2RdrDetn180To184CRC 1;
BA_ "GenSigFuncType" SG_ 198 FLR2RdrDetn180To184Counter 27;
BA_ "GenSigSendType" SG_ 198 FLR2RdrDetn180To184Counter 1;
BA_ "GenSigSendType" SG_ 198 FLR2RdrDetn180To184DynPrpty0 1;
BA_ "GenSigSendType" SG_ 198 FLR2RdrDetn180To184DynPrpty1 1;
BA_ "GenSigSendType" SG_ 198 FLR2RdrDetn180To184DynPrpty2 1;
BA_ "GenSigSendType" SG_ 198 FLR2RdrDetn180To184DynPrpty3 1;
BA_ "GenSigSendType" SG_ 198 FLR2RdrDetn180To184DynPrpty4 1;
BA_ "GenSigSendType" SG_ 198 FLR2RdrDetn180To184EleAng0 1;
BA_ "GenSigSendType" SG_ 198 FLR2RdrDetn180To184EleAng1 1;
BA_ "GenSigSendType" SG_ 198 FLR2RdrDetn180To184EleAng2 1;
BA_ "GenSigSendType" SG_ 198 FLR2RdrDetn180To184EleAng3 1;
BA_ "GenSigSendType" SG_ 198 FLR2RdrDetn180To184EleAng4 1;
BA_ "GenSigSendType" SG_ 198 FLR2RdrDetn180To184Mode0 1;
BA_ "GenSigSendType" SG_ 198 FLR2RdrDetn180To184Mode1 1;
BA_ "GenSigSendType" SG_ 198 FLR2RdrDetn180To184Mode2 1;
BA_ "GenSigSendType" SG_ 198 FLR2RdrDetn180To184Mode3 1;
BA_ "GenSigSendType" SG_ 198 FLR2RdrDetn180To184Mode4 1;
BA_ "GenSigSendType" SG_ 198 FLR2RdrDetn180To184Quality0 1;
BA_ "GenSigSendType" SG_ 198 FLR2RdrDetn180To184Quality1 1;
BA_ "GenSigSendType" SG_ 198 FLR2RdrDetn180To184Quality2 1;
BA_ "GenSigSendType" SG_ 198 FLR2RdrDetn180To184Quality3 1;
BA_ "GenSigSendType" SG_ 198 FLR2RdrDetn180To184Quality4 1;
BA_ "GenSigSendType" SG_ 198 FLR2RdrDetn180To184RCS0 1;
BA_ "GenSigStartValue" SG_ 198 FLR2RdrDetn180To184RCS0 500;
BA_ "GenSigSendType" SG_ 198 FLR2RdrDetn180To184RCS1 1;
BA_ "GenSigStartValue" SG_ 198 FLR2RdrDetn180To184RCS1 500;
BA_ "GenSigSendType" SG_ 198 FLR2RdrDetn180To184RCS2 1;
BA_ "GenSigStartValue" SG_ 198 FLR2RdrDetn180To184RCS2 500;
BA_ "GenSigSendType" SG_ 198 FLR2RdrDetn180To184RCS3 1;
BA_ "GenSigStartValue" SG_ 198 FLR2RdrDetn180To184RCS3 500;
BA_ "GenSigSendType" SG_ 198 FLR2RdrDetn180To184RCS4 1;
BA_ "GenSigStartValue" SG_ 198 FLR2RdrDetn180To184RCS4 500;
BA_ "GenSigSendType" SG_ 198 FLR2RdrDetn180To184Range0 1;
BA_ "GenSigSendType" SG_ 198 FLR2RdrDetn180To184Range1 1;
BA_ "GenSigSendType" SG_ 198 FLR2RdrDetn180To184Range2 1;
BA_ "GenSigSendType" SG_ 198 FLR2RdrDetn180To184Range3 1;
BA_ "GenSigSendType" SG_ 198 FLR2RdrDetn180To184Range4 1;
BA_ "GenSigSendType" SG_ 198 FLR2RdrDetn180To184RngRt0 1;
BA_ "GenSigStartValue" SG_ 198 FLR2RdrDetn180To184RngRt0 1111;
BA_ "GenSigSendType" SG_ 198 FLR2RdrDetn180To184RngRt1 1;
BA_ "GenSigStartValue" SG_ 198 FLR2RdrDetn180To184RngRt1 1111;
BA_ "GenSigSendType" SG_ 198 FLR2RdrDetn180To184RngRt2 1;
BA_ "GenSigStartValue" SG_ 198 FLR2RdrDetn180To184RngRt2 1111;
BA_ "GenSigSendType" SG_ 198 FLR2RdrDetn180To184RngRt3 1;
BA_ "GenSigStartValue" SG_ 198 FLR2RdrDetn180To184RngRt3 1111;
BA_ "GenSigSendType" SG_ 198 FLR2RdrDetn180To184RngRt4 1;
BA_ "GenSigStartValue" SG_ 198 FLR2RdrDetn180To184RngRt4 1111;
BA_ "GenSigSendType" SG_ 198 FLR2RdrDetn180To184SNR0 1;
BA_ "GenSigSendType" SG_ 198 FLR2RdrDetn180To184SNR1 1;
BA_ "GenSigSendType" SG_ 198 FLR2RdrDetn180To184SNR2 1;
BA_ "GenSigSendType" SG_ 198 FLR2RdrDetn180To184SNR3 1;
BA_ "GenSigSendType" SG_ 198 FLR2RdrDetn180To184SNR4 1;
BA_ "GenSigSendType" SG_ 198 FLR2RdrDetn180To184ScanID 1;
BA_ "GenSigSendType" SG_ 201 FLR2RdrDetn185To189AziAng0 1;
BA_ "GenSigSendType" SG_ 201 FLR2RdrDetn185To189AziAng1 1;
BA_ "GenSigSendType" SG_ 201 FLR2RdrDetn185To189AziAng2 1;
BA_ "GenSigSendType" SG_ 201 FLR2RdrDetn185To189AziAng3 1;
BA_ "GenSigSendType" SG_ 201 FLR2RdrDetn185To189AziAng4 1;
BA_ "GenSigDataID" SG_ 201 FLR2RdrDetn185To189CRC "0xADE";
BA_ "GenSigFuncType" SG_ 201 FLR2RdrDetn185To189CRC 28;
BA_ "GenSigSendType" SG_ 201 FLR2RdrDetn185To189CRC 1;
BA_ "GenSigFuncType" SG_ 201 FLR2RdrDetn185To189Counter 27;
BA_ "GenSigSendType" SG_ 201 FLR2RdrDetn185To189Counter 1;
BA_ "GenSigSendType" SG_ 201 FLR2RdrDetn185To189DynPrpty0 1;
BA_ "GenSigSendType" SG_ 201 FLR2RdrDetn185To189DynPrpty1 1;
BA_ "GenSigSendType" SG_ 201 FLR2RdrDetn185To189DynPrpty2 1;
BA_ "GenSigSendType" SG_ 201 FLR2RdrDetn185To189DynPrpty3 1;
BA_ "GenSigSendType" SG_ 201 FLR2RdrDetn185To189DynPrpty4 1;
BA_ "GenSigSendType" SG_ 201 FLR2RdrDetn185To189EleAng0 1;
BA_ "GenSigSendType" SG_ 201 FLR2RdrDetn185To189EleAng1 1;
BA_ "GenSigSendType" SG_ 201 FLR2RdrDetn185To189EleAng2 1;
BA_ "GenSigSendType" SG_ 201 FLR2RdrDetn185To189EleAng3 1;
BA_ "GenSigSendType" SG_ 201 FLR2RdrDetn185To189EleAng4 1;
BA_ "GenSigSendType" SG_ 201 FLR2RdrDetn185To189Mode0 1;
BA_ "GenSigSendType" SG_ 201 FLR2RdrDetn185To189Mode1 1;
BA_ "GenSigSendType" SG_ 201 FLR2RdrDetn185To189Mode2 1;
BA_ "GenSigSendType" SG_ 201 FLR2RdrDetn185To189Mode3 1;
BA_ "GenSigSendType" SG_ 201 FLR2RdrDetn185To189Mode4 1;
BA_ "GenSigSendType" SG_ 201 FLR2RdrDetn185To189Quality0 1;
BA_ "GenSigSendType" SG_ 201 FLR2RdrDetn185To189Quality1 1;
BA_ "GenSigSendType" SG_ 201 FLR2RdrDetn185To189Quality2 1;
BA_ "GenSigSendType" SG_ 201 FLR2RdrDetn185To189Quality3 1;
BA_ "GenSigSendType" SG_ 201 FLR2RdrDetn185To189Quality4 1;
BA_ "GenSigSendType" SG_ 201 FLR2RdrDetn185To189RCS0 1;
BA_ "GenSigStartValue" SG_ 201 FLR2RdrDetn185To189RCS0 500;
BA_ "GenSigSendType" SG_ 201 FLR2RdrDetn185To189RCS1 1;
BA_ "GenSigStartValue" SG_ 201 FLR2RdrDetn185To189RCS1 500;
BA_ "GenSigSendType" SG_ 201 FLR2RdrDetn185To189RCS2 1;
BA_ "GenSigStartValue" SG_ 201 FLR2RdrDetn185To189RCS2 500;
BA_ "GenSigSendType" SG_ 201 FLR2RdrDetn185To189RCS3 1;
BA_ "GenSigStartValue" SG_ 201 FLR2RdrDetn185To189RCS3 500;
BA_ "GenSigSendType" SG_ 201 FLR2RdrDetn185To189RCS4 1;
BA_ "GenSigStartValue" SG_ 201 FLR2RdrDetn185To189RCS4 500;
BA_ "GenSigSendType" SG_ 201 FLR2RdrDetn185To189Range0 1;
BA_ "GenSigSendType" SG_ 201 FLR2RdrDetn185To189Range1 1;
BA_ "GenSigSendType" SG_ 201 FLR2RdrDetn185To189Range2 1;
BA_ "GenSigSendType" SG_ 201 FLR2RdrDetn185To189Range3 1;
BA_ "GenSigSendType" SG_ 201 FLR2RdrDetn185To189Range4 1;
BA_ "GenSigSendType" SG_ 201 FLR2RdrDetn185To189RngRt0 1;
BA_ "GenSigStartValue" SG_ 201 FLR2RdrDetn185To189RngRt0 1111;
BA_ "GenSigSendType" SG_ 201 FLR2RdrDetn185To189RngRt1 1;
BA_ "GenSigStartValue" SG_ 201 FLR2RdrDetn185To189RngRt1 1111;
BA_ "GenSigSendType" SG_ 201 FLR2RdrDetn185To189RngRt2 1;
BA_ "GenSigStartValue" SG_ 201 FLR2RdrDetn185To189RngRt2 1111;
BA_ "GenSigSendType" SG_ 201 FLR2RdrDetn185To189RngRt3 1;
BA_ "GenSigStartValue" SG_ 201 FLR2RdrDetn185To189RngRt3 1111;
BA_ "GenSigSendType" SG_ 201 FLR2RdrDetn185To189RngRt4 1;
BA_ "GenSigStartValue" SG_ 201 FLR2RdrDetn185To189RngRt4 1111;
BA_ "GenSigSendType" SG_ 201 FLR2RdrDetn185To189SNR0 1;
BA_ "GenSigSendType" SG_ 201 FLR2RdrDetn185To189SNR1 1;
BA_ "GenSigSendType" SG_ 201 FLR2RdrDetn185To189SNR2 1;
BA_ "GenSigSendType" SG_ 201 FLR2RdrDetn185To189SNR3 1;
BA_ "GenSigSendType" SG_ 201 FLR2RdrDetn185To189SNR4 1;
BA_ "GenSigSendType" SG_ 201 FLR2RdrDetn185To189ScanID 1;
BA_ "GenSigSendType" SG_ 204 FLR2RdrDetn190To194AziAng0 1;
BA_ "GenSigSendType" SG_ 204 FLR2RdrDetn190To194AziAng1 1;
BA_ "GenSigSendType" SG_ 204 FLR2RdrDetn190To194AziAng2 1;
BA_ "GenSigSendType" SG_ 204 FLR2RdrDetn190To194AziAng3 1;
BA_ "GenSigSendType" SG_ 204 FLR2RdrDetn190To194AziAng4 1;
BA_ "GenSigDataID" SG_ 204 FLR2RdrDetn190To194CRC "0xADF";
BA_ "GenSigFuncType" SG_ 204 FLR2RdrDetn190To194CRC 28;
BA_ "GenSigSendType" SG_ 204 FLR2RdrDetn190To194CRC 1;
BA_ "GenSigFuncType" SG_ 204 FLR2RdrDetn190To194Counter 27;
BA_ "GenSigSendType" SG_ 204 FLR2RdrDetn190To194Counter 1;
BA_ "GenSigSendType" SG_ 204 FLR2RdrDetn190To194DynPrpty0 1;
BA_ "GenSigSendType" SG_ 204 FLR2RdrDetn190To194DynPrpty1 1;
BA_ "GenSigSendType" SG_ 204 FLR2RdrDetn190To194DynPrpty2 1;
BA_ "GenSigSendType" SG_ 204 FLR2RdrDetn190To194DynPrpty3 1;
BA_ "GenSigSendType" SG_ 204 FLR2RdrDetn190To194DynPrpty4 1;
BA_ "GenSigSendType" SG_ 204 FLR2RdrDetn190To194EleAng0 1;
BA_ "GenSigSendType" SG_ 204 FLR2RdrDetn190To194EleAng1 1;
BA_ "GenSigSendType" SG_ 204 FLR2RdrDetn190To194EleAng2 1;
BA_ "GenSigSendType" SG_ 204 FLR2RdrDetn190To194EleAng3 1;
BA_ "GenSigSendType" SG_ 204 FLR2RdrDetn190To194EleAng4 1;
BA_ "GenSigSendType" SG_ 204 FLR2RdrDetn190To194Mode0 1;
BA_ "GenSigSendType" SG_ 204 FLR2RdrDetn190To194Mode1 1;
BA_ "GenSigSendType" SG_ 204 FLR2RdrDetn190To194Mode2 1;
BA_ "GenSigSendType" SG_ 204 FLR2RdrDetn190To194Mode3 1;
BA_ "GenSigSendType" SG_ 204 FLR2RdrDetn190To194Mode4 1;
BA_ "GenSigSendType" SG_ 204 FLR2RdrDetn190To194Quality0 1;
BA_ "GenSigSendType" SG_ 204 FLR2RdrDetn190To194Quality1 1;
BA_ "GenSigSendType" SG_ 204 FLR2RdrDetn190To194Quality2 1;
BA_ "GenSigSendType" SG_ 204 FLR2RdrDetn190To194Quality3 1;
BA_ "GenSigSendType" SG_ 204 FLR2RdrDetn190To194Quality4 1;
BA_ "GenSigSendType" SG_ 204 FLR2RdrDetn190To194RCS0 1;
BA_ "GenSigStartValue" SG_ 204 FLR2RdrDetn190To194RCS0 500;
BA_ "GenSigSendType" SG_ 204 FLR2RdrDetn190To194RCS1 1;
BA_ "GenSigStartValue" SG_ 204 FLR2RdrDetn190To194RCS1 500;
BA_ "GenSigSendType" SG_ 204 FLR2RdrDetn190To194RCS2 1;
BA_ "GenSigStartValue" SG_ 204 FLR2RdrDetn190To194RCS2 500;
BA_ "GenSigSendType" SG_ 204 FLR2RdrDetn190To194RCS3 1;
BA_ "GenSigStartValue" SG_ 204 FLR2RdrDetn190To194RCS3 500;
BA_ "GenSigSendType" SG_ 204 FLR2RdrDetn190To194RCS4 1;
BA_ "GenSigStartValue" SG_ 204 FLR2RdrDetn190To194RCS4 500;
BA_ "GenSigSendType" SG_ 204 FLR2RdrDetn190To194Range0 1;
BA_ "GenSigSendType" SG_ 204 FLR2RdrDetn190To194Range1 1;
BA_ "GenSigSendType" SG_ 204 FLR2RdrDetn190To194Range2 1;
BA_ "GenSigSendType" SG_ 204 FLR2RdrDetn190To194Range3 1;
BA_ "GenSigSendType" SG_ 204 FLR2RdrDetn190To194Range4 1;
BA_ "GenSigSendType" SG_ 204 FLR2RdrDetn190To194RngRt0 1;
BA_ "GenSigStartValue" SG_ 204 FLR2RdrDetn190To194RngRt0 1111;
BA_ "GenSigSendType" SG_ 204 FLR2RdrDetn190To194RngRt1 1;
BA_ "GenSigStartValue" SG_ 204 FLR2RdrDetn190To194RngRt1 1111;
BA_ "GenSigSendType" SG_ 204 FLR2RdrDetn190To194RngRt2 1;
BA_ "GenSigStartValue" SG_ 204 FLR2RdrDetn190To194RngRt2 1111;
BA_ "GenSigSendType" SG_ 204 FLR2RdrDetn190To194RngRt3 1;
BA_ "GenSigStartValue" SG_ 204 FLR2RdrDetn190To194RngRt3 1111;
BA_ "GenSigSendType" SG_ 204 FLR2RdrDetn190To194RngRt4 1;
BA_ "GenSigStartValue" SG_ 204 FLR2RdrDetn190To194RngRt4 1111;
BA_ "GenSigSendType" SG_ 204 FLR2RdrDetn190To194SNR0 1;
BA_ "GenSigSendType" SG_ 204 FLR2RdrDetn190To194SNR1 1;
BA_ "GenSigSendType" SG_ 204 FLR2RdrDetn190To194SNR2 1;
BA_ "GenSigSendType" SG_ 204 FLR2RdrDetn190To194SNR3 1;
BA_ "GenSigSendType" SG_ 204 FLR2RdrDetn190To194SNR4 1;
BA_ "GenSigSendType" SG_ 204 FLR2RdrDetn190To194ScanID 1;
BA_ "GenSigSendType" SG_ 208 FLR2RdrDetn195To199AziAng0 1;
BA_ "GenSigSendType" SG_ 208 FLR2RdrDetn195To199AziAng1 1;
BA_ "GenSigSendType" SG_ 208 FLR2RdrDetn195To199AziAng2 1;
BA_ "GenSigSendType" SG_ 208 FLR2RdrDetn195To199AziAng3 1;
BA_ "GenSigSendType" SG_ 208 FLR2RdrDetn195To199AziAng4 1;
BA_ "GenSigDataID" SG_ 208 FLR2RdrDetn195To199CRC "0xAE0";
BA_ "GenSigFuncType" SG_ 208 FLR2RdrDetn195To199CRC 28;
BA_ "GenSigSendType" SG_ 208 FLR2RdrDetn195To199CRC 1;
BA_ "GenSigFuncType" SG_ 208 FLR2RdrDetn195To199Counter 27;
BA_ "GenSigSendType" SG_ 208 FLR2RdrDetn195To199Counter 1;
BA_ "GenSigSendType" SG_ 208 FLR2RdrDetn195To199DynPrpty0 1;
BA_ "GenSigSendType" SG_ 208 FLR2RdrDetn195To199DynPrpty1 1;
BA_ "GenSigSendType" SG_ 208 FLR2RdrDetn195To199DynPrpty2 1;
BA_ "GenSigSendType" SG_ 208 FLR2RdrDetn195To199DynPrpty3 1;
BA_ "GenSigSendType" SG_ 208 FLR2RdrDetn195To199DynPrpty4 1;
BA_ "GenSigSendType" SG_ 208 FLR2RdrDetn195To199EleAng0 1;
BA_ "GenSigSendType" SG_ 208 FLR2RdrDetn195To199EleAng1 1;
BA_ "GenSigSendType" SG_ 208 FLR2RdrDetn195To199EleAng2 1;
BA_ "GenSigSendType" SG_ 208 FLR2RdrDetn195To199EleAng3 1;
BA_ "GenSigSendType" SG_ 208 FLR2RdrDetn195To199EleAng4 1;
BA_ "GenSigSendType" SG_ 208 FLR2RdrDetn195To199Mode0 1;
BA_ "GenSigSendType" SG_ 208 FLR2RdrDetn195To199Mode1 1;
BA_ "GenSigSendType" SG_ 208 FLR2RdrDetn195To199Mode2 1;
BA_ "GenSigSendType" SG_ 208 FLR2RdrDetn195To199Mode3 1;
BA_ "GenSigSendType" SG_ 208 FLR2RdrDetn195To199Mode4 1;
BA_ "GenSigSendType" SG_ 208 FLR2RdrDetn195To199Quality0 1;
BA_ "GenSigSendType" SG_ 208 FLR2RdrDetn195To199Quality1 1;
BA_ "GenSigSendType" SG_ 208 FLR2RdrDetn195To199Quality2 1;
BA_ "GenSigSendType" SG_ 208 FLR2RdrDetn195To199Quality3 1;
BA_ "GenSigSendType" SG_ 208 FLR2RdrDetn195To199Quality4 1;
BA_ "GenSigSendType" SG_ 208 FLR2RdrDetn195To199RCS0 1;
BA_ "GenSigStartValue" SG_ 208 FLR2RdrDetn195To199RCS0 500;
BA_ "GenSigSendType" SG_ 208 FLR2RdrDetn195To199RCS1 1;
BA_ "GenSigStartValue" SG_ 208 FLR2RdrDetn195To199RCS1 500;
BA_ "GenSigSendType" SG_ 208 FLR2RdrDetn195To199RCS2 1;
BA_ "GenSigStartValue" SG_ 208 FLR2RdrDetn195To199RCS2 500;
BA_ "GenSigSendType" SG_ 208 FLR2RdrDetn195To199RCS3 1;
BA_ "GenSigStartValue" SG_ 208 FLR2RdrDetn195To199RCS3 500;
BA_ "GenSigSendType" SG_ 208 FLR2RdrDetn195To199RCS4 1;
BA_ "GenSigStartValue" SG_ 208 FLR2RdrDetn195To199RCS4 500;
BA_ "GenSigSendType" SG_ 208 FLR2RdrDetn195To199Range0 1;
BA_ "GenSigSendType" SG_ 208 FLR2RdrDetn195To199Range1 1;
BA_ "GenSigSendType" SG_ 208 FLR2RdrDetn195To199Range2 1;
BA_ "GenSigSendType" SG_ 208 FLR2RdrDetn195To199Range3 1;
BA_ "GenSigSendType" SG_ 208 FLR2RdrDetn195To199Range4 1;
BA_ "GenSigSendType" SG_ 208 FLR2RdrDetn195To199RngRt0 1;
BA_ "GenSigStartValue" SG_ 208 FLR2RdrDetn195To199RngRt0 1111;
BA_ "GenSigSendType" SG_ 208 FLR2RdrDetn195To199RngRt1 1;
BA_ "GenSigStartValue" SG_ 208 FLR2RdrDetn195To199RngRt1 1111;
BA_ "GenSigSendType" SG_ 208 FLR2RdrDetn195To199RngRt2 1;
BA_ "GenSigStartValue" SG_ 208 FLR2RdrDetn195To199RngRt2 1111;
BA_ "GenSigSendType" SG_ 208 FLR2RdrDetn195To199RngRt3 1;
BA_ "GenSigStartValue" SG_ 208 FLR2RdrDetn195To199RngRt3 1111;
BA_ "GenSigSendType" SG_ 208 FLR2RdrDetn195To199RngRt4 1;
BA_ "GenSigStartValue" SG_ 208 FLR2RdrDetn195To199RngRt4 1111;
BA_ "GenSigSendType" SG_ 208 FLR2RdrDetn195To199SNR0 1;
BA_ "GenSigSendType" SG_ 208 FLR2RdrDetn195To199SNR1 1;
BA_ "GenSigSendType" SG_ 208 FLR2RdrDetn195To199SNR2 1;
BA_ "GenSigSendType" SG_ 208 FLR2RdrDetn195To199SNR3 1;
BA_ "GenSigSendType" SG_ 208 FLR2RdrDetn195To199SNR4 1;
BA_ "GenSigSendType" SG_ 208 FLR2RdrDetn195To199ScanID 1;
VAL_ 166 FLR2RdrDetn130To134Mode0 0 "FLR2RadrDetnMode_RngNearReslMod" 1 "FLR2RadrDetnMode_RngMidReslMod" 2 "FLR2RadrDetnMode_RngLongReslMod" 3 "FLR2RadrDetnMode_DetectionUnpopulated";
VAL_ 166 FLR2RdrDetn130To134Mode1 0 "FLR2RadrDetnMode_RngNearReslMod" 1 "FLR2RadrDetnMode_RngMidReslMod" 2 "FLR2RadrDetnMode_RngLongReslMod" 3 "FLR2RadrDetnMode_DetectionUnpopulated";
VAL_ 166 FLR2RdrDetn130To134Mode2 0 "FLR2RadrDetnMode_RngNearReslMod" 1 "FLR2RadrDetnMode_RngMidReslMod" 2 "FLR2RadrDetnMode_RngLongReslMod" 3 "FLR2RadrDetnMode_DetectionUnpopulated";
VAL_ 166 FLR2RdrDetn130To134Mode3 0 "FLR2RadrDetnMode_RngNearReslMod" 1 "FLR2RadrDetnMode_RngMidReslMod" 2 "FLR2RadrDetnMode_RngLongReslMod" 3 "FLR2RadrDetnMode_DetectionUnpopulated";
VAL_ 166 FLR2RdrDetn130To134Mode4 0 "FLR2RadrDetnMode_RngNearReslMod" 1 "FLR2RadrDetnMode_RngMidReslMod" 2 "FLR2RadrDetnMode_RngLongReslMod" 3 "FLR2RadrDetnMode_DetectionUnpopulated";
VAL_ 166 FLR2RdrDetn130To134Quality0 0 "Quality_Low" 1 "Quality_Medium" 2 "Quality_High" 3 "Quality_DetectionUnpopulated";
VAL_ 166 FLR2RdrDetn130To134Quality1 0 "Quality_Low" 1 "Quality_Medium" 2 "Quality_High" 3 "Quality_DetectionUnpopulated";
VAL_ 166 FLR2RdrDetn130To134Quality2 0 "Quality_Low" 1 "Quality_Medium" 2 "Quality_High" 3 "Quality_DetectionUnpopulated";
VAL_ 166 FLR2RdrDetn130To134Quality3 0 "Quality_Low" 1 "Quality_Medium" 2 "Quality_High" 3 "Quality_DetectionUnpopulated";
VAL_ 166 FLR2RdrDetn130To134Quality4 0 "Quality_Low" 1 "Quality_Medium" 2 "Quality_High" 3 "Quality_DetectionUnpopulated";
VAL_ 169 FLR2RdrDetn135To139Mode0 0 "FLR2RadrDetnMode_RngNearReslMod" 1 "FLR2RadrDetnMode_RngMidReslMod" 2 "FLR2RadrDetnMode_RngLongReslMod" 3 "FLR2RadrDetnMode_DetectionUnpopulated";
VAL_ 169 FLR2RdrDetn135To139Mode1 0 "FLR2RadrDetnMode_RngNearReslMod" 1 "FLR2RadrDetnMode_RngMidReslMod" 2 "FLR2RadrDetnMode_RngLongReslMod" 3 "FLR2RadrDetnMode_DetectionUnpopulated";
VAL_ 169 FLR2RdrDetn135To139Mode2 0 "FLR2RadrDetnMode_RngNearReslMod" 1 "FLR2RadrDetnMode_RngMidReslMod" 2 "FLR2RadrDetnMode_RngLongReslMod" 3 "FLR2RadrDetnMode_DetectionUnpopulated";
VAL_ 169 FLR2RdrDetn135To139Mode3 0 "FLR2RadrDetnMode_RngNearReslMod" 1 "FLR2RadrDetnMode_RngMidReslMod" 2 "FLR2RadrDetnMode_RngLongReslMod" 3 "FLR2RadrDetnMode_DetectionUnpopulated";
VAL_ 169 FLR2RdrDetn135To139Mode4 0 "FLR2RadrDetnMode_RngNearReslMod" 1 "FLR2RadrDetnMode_RngMidReslMod" 2 "FLR2RadrDetnMode_RngLongReslMod" 3 "FLR2RadrDetnMode_DetectionUnpopulated";
VAL_ 169 FLR2RdrDetn135To139Quality0 0 "Quality_Low" 1 "Quality_Medium" 2 "Quality_High" 3 "Quality_DetectionUnpopulated";
VAL_ 169 FLR2RdrDetn135To139Quality1 0 "Quality_Low" 1 "Quality_Medium" 2 "Quality_High" 3 "Quality_DetectionUnpopulated";
VAL_ 169 FLR2RdrDetn135To139Quality2 0 "Quality_Low" 1 "Quality_Medium" 2 "Quality_High" 3 "Quality_DetectionUnpopulated";
VAL_ 169 FLR2RdrDetn135To139Quality3 0 "Quality_Low" 1 "Quality_Medium" 2 "Quality_High" 3 "Quality_DetectionUnpopulated";
VAL_ 169 FLR2RdrDetn135To139Quality4 0 "Quality_Low" 1 "Quality_Medium" 2 "Quality_High" 3 "Quality_DetectionUnpopulated";
VAL_ 172 FLR2RdrDetn140To144Mode0 0 "FLR2RadrDetnMode_RngNearReslMod" 1 "FLR2RadrDetnMode_RngMidReslMod" 2 "FLR2RadrDetnMode_RngLongReslMod" 3 "FLR2RadrDetnMode_DetectionUnpopulated";
VAL_ 172 FLR2RdrDetn140To144Mode1 0 "FLR2RadrDetnMode_RngNearReslMod" 1 "FLR2RadrDetnMode_RngMidReslMod" 2 "FLR2RadrDetnMode_RngLongReslMod" 3 "FLR2RadrDetnMode_DetectionUnpopulated";
VAL_ 172 FLR2RdrDetn140To144Mode2 0 "FLR2RadrDetnMode_RngNearReslMod" 1 "FLR2RadrDetnMode_RngMidReslMod" 2 "FLR2RadrDetnMode_RngLongReslMod" 3 "FLR2RadrDetnMode_DetectionUnpopulated";
VAL_ 172 FLR2RdrDetn140To144Mode3 0 "FLR2RadrDetnMode_RngNearReslMod" 1 "FLR2RadrDetnMode_RngMidReslMod" 2 "FLR2RadrDetnMode_RngLongReslMod" 3 "FLR2RadrDetnMode_DetectionUnpopulated";
VAL_ 172 FLR2RdrDetn140To144Mode4 0 "FLR2RadrDetnMode_RngNearReslMod" 1 "FLR2RadrDetnMode_RngMidReslMod" 2 "FLR2RadrDetnMode_RngLongReslMod" 3 "FLR2RadrDetnMode_DetectionUnpopulated";
VAL_ 172 FLR2RdrDetn140To144Quality0 0 "Quality_Low" 1 "Quality_Medium" 2 "Quality_High" 3 "Quality_DetectionUnpopulated";
VAL_ 172 FLR2RdrDetn140To144Quality1 0 "Quality_Low" 1 "Quality_Medium" 2 "Quality_High" 3 "Quality_DetectionUnpopulated";
VAL_ 172 FLR2RdrDetn140To144Quality2 0 "Quality_Low" 1 "Quality_Medium" 2 "Quality_High" 3 "Quality_DetectionUnpopulated";
VAL_ 172 FLR2RdrDetn140To144Quality3 0 "Quality_Low" 1 "Quality_Medium" 2 "Quality_High" 3 "Quality_DetectionUnpopulated";
VAL_ 172 FLR2RdrDetn140To144Quality4 0 "Quality_Low" 1 "Quality_Medium" 2 "Quality_High" 3 "Quality_DetectionUnpopulated";
VAL_ 176 FLR2RdrDetn145To149Mode0 0 "FLR2RadrDetnMode_RngNearReslMod" 1 "FLR2RadrDetnMode_RngMidReslMod" 2 "FLR2RadrDetnMode_RngLongReslMod" 3 "FLR2RadrDetnMode_DetectionUnpopulated";
VAL_ 176 FLR2RdrDetn145To149Mode1 0 "FLR2RadrDetnMode_RngNearReslMod" 1 "FLR2RadrDetnMode_RngMidReslMod" 2 "FLR2RadrDetnMode_RngLongReslMod" 3 "FLR2RadrDetnMode_DetectionUnpopulated";
VAL_ 176 FLR2RdrDetn145To149Mode2 0 "FLR2RadrDetnMode_RngNearReslMod" 1 "FLR2RadrDetnMode_RngMidReslMod" 2 "FLR2RadrDetnMode_RngLongReslMod" 3 "FLR2RadrDetnMode_DetectionUnpopulated";
VAL_ 176 FLR2RdrDetn145To149Mode3 0 "FLR2RadrDetnMode_RngNearReslMod" 1 "FLR2RadrDetnMode_RngMidReslMod" 2 "FLR2RadrDetnMode_RngLongReslMod" 3 "FLR2RadrDetnMode_DetectionUnpopulated";
VAL_ 176 FLR2RdrDetn145To149Mode4 0 "FLR2RadrDetnMode_RngNearReslMod" 1 "FLR2RadrDetnMode_RngMidReslMod" 2 "FLR2RadrDetnMode_RngLongReslMod" 3 "FLR2RadrDetnMode_DetectionUnpopulated";
VAL_ 176 FLR2RdrDetn145To149Quality0 0 "Quality_Low" 1 "Quality_Medium" 2 "Quality_High" 3 "Quality_DetectionUnpopulated";
VAL_ 176 FLR2RdrDetn145To149Quality1 0 "Quality_Low" 1 "Quality_Medium" 2 "Quality_High" 3 "Quality_DetectionUnpopulated";
VAL_ 176 FLR2RdrDetn145To149Quality2 0 "Quality_Low" 1 "Quality_Medium" 2 "Quality_High" 3 "Quality_DetectionUnpopulated";
VAL_ 176 FLR2RdrDetn145To149Quality3 0 "Quality_Low" 1 "Quality_Medium" 2 "Quality_High" 3 "Quality_DetectionUnpopulated";
VAL_ 176 FLR2RdrDetn145To149Quality4 0 "Quality_Low" 1 "Quality_Medium" 2 "Quality_High" 3 "Quality_DetectionUnpopulated";
VAL_ 179 FLR2RdrDetn150To154Mode0 0 "FLR2RadrDetnMode_RngNearReslMod" 1 "FLR2RadrDetnMode_RngMidReslMod" 2 "FLR2RadrDetnMode_RngLongReslMod" 3 "FLR2RadrDetnMode_DetectionUnpopulated";
VAL_ 179 FLR2RdrDetn150To154Mode1 0 "FLR2RadrDetnMode_RngNearReslMod" 1 "FLR2RadrDetnMode_RngMidReslMod" 2 "FLR2RadrDetnMode_RngLongReslMod" 3 "FLR2RadrDetnMode_DetectionUnpopulated";
VAL_ 179 FLR2RdrDetn150To154Mode2 0 "FLR2RadrDetnMode_RngNearReslMod" 1 "FLR2RadrDetnMode_RngMidReslMod" 2 "FLR2RadrDetnMode_RngLongReslMod" 3 "FLR2RadrDetnMode_DetectionUnpopulated";
VAL_ 179 FLR2RdrDetn150To154Mode3 0 "FLR2RadrDetnMode_RngNearReslMod" 1 "FLR2RadrDetnMode_RngMidReslMod" 2 "FLR2RadrDetnMode_RngLongReslMod" 3 "FLR2RadrDetnMode_DetectionUnpopulated";
VAL_ 179 FLR2RdrDetn150To154Mode4 0 "FLR2RadrDetnMode_RngNearReslMod" 1 "FLR2RadrDetnMode_RngMidReslMod" 2 "FLR2RadrDetnMode_RngLongReslMod" 3 "FLR2RadrDetnMode_DetectionUnpopulated";
VAL_ 179 FLR2RdrDetn150To154Quality0 0 "Quality_Low" 1 "Quality_Medium" 2 "Quality_High" 3 "Quality_DetectionUnpopulated";
VAL_ 179 FLR2RdrDetn150To154Quality1 0 "Quality_Low" 1 "Quality_Medium" 2 "Quality_High" 3 "Quality_DetectionUnpopulated";
VAL_ 179 FLR2RdrDetn150To154Quality2 0 "Quality_Low" 1 "Quality_Medium" 2 "Quality_High" 3 "Quality_DetectionUnpopulated";
VAL_ 179 FLR2RdrDetn150To154Quality3 0 "Quality_Low" 1 "Quality_Medium" 2 "Quality_High" 3 "Quality_DetectionUnpopulated";
VAL_ 179 FLR2RdrDetn150To154Quality4 0 "Quality_Low" 1 "Quality_Medium" 2 "Quality_High" 3 "Quality_DetectionUnpopulated";
VAL_ 182 FLR2RdrDetn155To159Mode0 0 "FLR2RadrDetnMode_RngNearReslMod" 1 "FLR2RadrDetnMode_RngMidReslMod" 2 "FLR2RadrDetnMode_RngLongReslMod" 3 "FLR2RadrDetnMode_DetectionUnpopulated";
VAL_ 182 FLR2RdrDetn155To159Mode1 0 "FLR2RadrDetnMode_RngNearReslMod" 1 "FLR2RadrDetnMode_RngMidReslMod" 2 "FLR2RadrDetnMode_RngLongReslMod" 3 "FLR2RadrDetnMode_DetectionUnpopulated";
VAL_ 182 FLR2RdrDetn155To159Mode2 0 "FLR2RadrDetnMode_RngNearReslMod" 1 "FLR2RadrDetnMode_RngMidReslMod" 2 "FLR2RadrDetnMode_RngLongReslMod" 3 "FLR2RadrDetnMode_DetectionUnpopulated";
VAL_ 182 FLR2RdrDetn155To159Mode3 0 "FLR2RadrDetnMode_RngNearReslMod" 1 "FLR2RadrDetnMode_RngMidReslMod" 2 "FLR2RadrDetnMode_RngLongReslMod" 3 "FLR2RadrDetnMode_DetectionUnpopulated";
VAL_ 182 FLR2RdrDetn155To159Mode4 0 "FLR2RadrDetnMode_RngNearReslMod" 1 "FLR2RadrDetnMode_RngMidReslMod" 2 "FLR2RadrDetnMode_RngLongReslMod" 3 "FLR2RadrDetnMode_DetectionUnpopulated";
VAL_ 182 FLR2RdrDetn155To159Quality0 0 "Quality_Low" 1 "Quality_Medium" 2 "Quality_High" 3 "Quality_DetectionUnpopulated";
VAL_ 182 FLR2RdrDetn155To159Quality1 0 "Quality_Low" 1 "Quality_Medium" 2 "Quality_High" 3 "Quality_DetectionUnpopulated";
VAL_ 182 FLR2RdrDetn155To159Quality2 0 "Quality_Low" 1 "Quality_Medium" 2 "Quality_High" 3 "Quality_DetectionUnpopulated";
VAL_ 182 FLR2RdrDetn155To159Quality3 0 "Quality_Low" 1 "Quality_Medium" 2 "Quality_High" 3 "Quality_DetectionUnpopulated";
VAL_ 182 FLR2RdrDetn155To159Quality4 0 "Quality_Low" 1 "Quality_Medium" 2 "Quality_High" 3 "Quality_DetectionUnpopulated";
VAL_ 185 FLR2RdrDetn160To164Mode0 0 "FLR2RadrDetnMode_RngNearReslMod" 1 "FLR2RadrDetnMode_RngMidReslMod" 2 "FLR2RadrDetnMode_RngLongReslMod" 3 "FLR2RadrDetnMode_DetectionUnpopulated";
VAL_ 185 FLR2RdrDetn160To164Mode1 0 "FLR2RadrDetnMode_RngNearReslMod" 1 "FLR2RadrDetnMode_RngMidReslMod" 2 "FLR2RadrDetnMode_RngLongReslMod" 3 "FLR2RadrDetnMode_DetectionUnpopulated";
VAL_ 185 FLR2RdrDetn160To164Mode2 0 "FLR2RadrDetnMode_RngNearReslMod" 1 "FLR2RadrDetnMode_RngMidReslMod" 2 "FLR2RadrDetnMode_RngLongReslMod" 3 "FLR2RadrDetnMode_DetectionUnpopulated";
VAL_ 185 FLR2RdrDetn160To164Mode3 0 "FLR2RadrDetnMode_RngNearReslMod" 1 "FLR2RadrDetnMode_RngMidReslMod" 2 "FLR2RadrDetnMode_RngLongReslMod" 3 "FLR2RadrDetnMode_DetectionUnpopulated";
VAL_ 185 FLR2RdrDetn160To164Mode4 0 "FLR2RadrDetnMode_RngNearReslMod" 1 "FLR2RadrDetnMode_RngMidReslMod" 2 "FLR2RadrDetnMode_RngLongReslMod" 3 "FLR2RadrDetnMode_DetectionUnpopulated";
VAL_ 185 FLR2RdrDetn160To164Quality0 0 "Quality_Low" 1 "Quality_Medium" 2 "Quality_High" 3 "Quality_DetectionUnpopulated";
VAL_ 185 FLR2RdrDetn160To164Quality1 0 "Quality_Low" 1 "Quality_Medium" 2 "Quality_High" 3 "Quality_DetectionUnpopulated";
VAL_ 185 FLR2RdrDetn160To164Quality2 0 "Quality_Low" 1 "Quality_Medium" 2 "Quality_High" 3 "Quality_DetectionUnpopulated";
VAL_ 185 FLR2RdrDetn160To164Quality3 0 "Quality_Low" 1 "Quality_Medium" 2 "Quality_High" 3 "Quality_DetectionUnpopulated";
VAL_ 185 FLR2RdrDetn160To164Quality4 0 "Quality_Low" 1 "Quality_Medium" 2 "Quality_High" 3 "Quality_DetectionUnpopulated";
VAL_ 188 FLR2RdrDetn165To169Mode0 0 "FLR2RadrDetnMode_RngNearReslMod" 1 "FLR2RadrDetnMode_RngMidReslMod" 2 "FLR2RadrDetnMode_RngLongReslMod" 3 "FLR2RadrDetnMode_DetectionUnpopulated";
VAL_ 188 FLR2RdrDetn165To169Mode1 0 "FLR2RadrDetnMode_RngNearReslMod" 1 "FLR2RadrDetnMode_RngMidReslMod" 2 "FLR2RadrDetnMode_RngLongReslMod" 3 "FLR2RadrDetnMode_DetectionUnpopulated";
VAL_ 188 FLR2RdrDetn165To169Mode2 0 "FLR2RadrDetnMode_RngNearReslMod" 1 "FLR2RadrDetnMode_RngMidReslMod" 2 "FLR2RadrDetnMode_RngLongReslMod" 3 "FLR2RadrDetnMode_DetectionUnpopulated";
VAL_ 188 FLR2RdrDetn165To169Mode3 0 "FLR2RadrDetnMode_RngNearReslMod" 1 "FLR2RadrDetnMode_RngMidReslMod" 2 "FLR2RadrDetnMode_RngLongReslMod" 3 "FLR2RadrDetnMode_DetectionUnpopulated";
VAL_ 188 FLR2RdrDetn165To169Mode4 0 "FLR2RadrDetnMode_RngNearReslMod" 1 "FLR2RadrDetnMode_RngMidReslMod" 2 "FLR2RadrDetnMode_RngLongReslMod" 3 "FLR2RadrDetnMode_DetectionUnpopulated";
VAL_ 188 FLR2RdrDetn165To169Quality0 0 "Quality_Low" 1 "Quality_Medium" 2 "Quality_High" 3 "Quality_DetectionUnpopulated";
VAL_ 188 FLR2RdrDetn165To169Quality1 0 "Quality_Low" 1 "Quality_Medium" 2 "Quality_High" 3 "Quality_DetectionUnpopulated";
VAL_ 188 FLR2RdrDetn165To169Quality2 0 "Quality_Low" 1 "Quality_Medium" 2 "Quality_High" 3 "Quality_DetectionUnpopulated";
VAL_ 188 FLR2RdrDetn165To169Quality3 0 "Quality_Low" 1 "Quality_Medium" 2 "Quality_High" 3 "Quality_DetectionUnpopulated";
VAL_ 188 FLR2RdrDetn165To169Quality4 0 "Quality_Low" 1 "Quality_Medium" 2 "Quality_High" 3 "Quality_DetectionUnpopulated";
VAL_ 192 FLR2RdrDetn170To174Mode0 0 "FLR2RadrDetnMode_RngNearReslMod" 1 "FLR2RadrDetnMode_RngMidReslMod" 2 "FLR2RadrDetnMode_RngLongReslMod" 3 "FLR2RadrDetnMode_DetectionUnpopulated";
VAL_ 192 FLR2RdrDetn170To174Mode1 0 "FLR2RadrDetnMode_RngNearReslMod" 1 "FLR2RadrDetnMode_RngMidReslMod" 2 "FLR2RadrDetnMode_RngLongReslMod" 3 "FLR2RadrDetnMode_DetectionUnpopulated";
VAL_ 192 FLR2RdrDetn170To174Mode2 0 "FLR2RadrDetnMode_RngNearReslMod" 1 "FLR2RadrDetnMode_RngMidReslMod" 2 "FLR2RadrDetnMode_RngLongReslMod" 3 "FLR2RadrDetnMode_DetectionUnpopulated";
VAL_ 192 FLR2RdrDetn170To174Mode3 0 "FLR2RadrDetnMode_RngNearReslMod" 1 "FLR2RadrDetnMode_RngMidReslMod" 2 "FLR2RadrDetnMode_RngLongReslMod" 3 "FLR2RadrDetnMode_DetectionUnpopulated";
VAL_ 192 FLR2RdrDetn170To174Mode4 0 "FLR2RadrDetnMode_RngNearReslMod" 1 "FLR2RadrDetnMode_RngMidReslMod" 2 "FLR2RadrDetnMode_RngLongReslMod" 3 "FLR2RadrDetnMode_DetectionUnpopulated";
VAL_ 192 FLR2RdrDetn170To174Quality0 0 "Quality_Low" 1 "Quality_Medium" 2 "Quality_High" 3 "Quality_DetectionUnpopulated";
VAL_ 192 FLR2RdrDetn170To174Quality1 0 "Quality_Low" 1 "Quality_Medium" 2 "Quality_High" 3 "Quality_DetectionUnpopulated";
VAL_ 192 FLR2RdrDetn170To174Quality2 0 "Quality_Low" 1 "Quality_Medium" 2 "Quality_High" 3 "Quality_DetectionUnpopulated";
VAL_ 192 FLR2RdrDetn170To174Quality3 0 "Quality_Low" 1 "Quality_Medium" 2 "Quality_High" 3 "Quality_DetectionUnpopulated";
VAL_ 192 FLR2RdrDetn170To174Quality4 0 "Quality_Low" 1 "Quality_Medium" 2 "Quality_High" 3 "Quality_DetectionUnpopulated";
VAL_ 195 FLR2RdrDetn175To179Mode0 0 "FLR2RadrDetnMode_RngNearReslMod" 1 "FLR2RadrDetnMode_RngMidReslMod" 2 "FLR2RadrDetnMode_RngLongReslMod" 3 "FLR2RadrDetnMode_DetectionUnpopulated";
VAL_ 195 FLR2RdrDetn175To179Mode1 0 "FLR2RadrDetnMode_RngNearReslMod" 1 "FLR2RadrDetnMode_RngMidReslMod" 2 "FLR2RadrDetnMode_RngLongReslMod" 3 "FLR2RadrDetnMode_DetectionUnpopulated";
VAL_ 195 FLR2RdrDetn175To179Mode2 0 "FLR2RadrDetnMode_RngNearReslMod" 1 "FLR2RadrDetnMode_RngMidReslMod" 2 "FLR2RadrDetnMode_RngLongReslMod" 3 "FLR2RadrDetnMode_DetectionUnpopulated";
VAL_ 195 FLR2RdrDetn175To179Mode3 0 "FLR2RadrDetnMode_RngNearReslMod" 1 "FLR2RadrDetnMode_RngMidReslMod" 2 "FLR2RadrDetnMode_RngLongReslMod" 3 "FLR2RadrDetnMode_DetectionUnpopulated";
VAL_ 195 FLR2RdrDetn175To179Mode4 0 "FLR2RadrDetnMode_RngNearReslMod" 1 "FLR2RadrDetnMode_RngMidReslMod" 2 "FLR2RadrDetnMode_RngLongReslMod" 3 "FLR2RadrDetnMode_DetectionUnpopulated";
VAL_ 195 FLR2RdrDetn175To179Quality0 0 "Quality_Low" 1 "Quality_Medium" 2 "Quality_High" 3 "Quality_DetectionUnpopulated";
VAL_ 195 FLR2RdrDetn175To179Quality1 0 "Quality_Low" 1 "Quality_Medium" 2 "Quality_High" 3 "Quality_DetectionUnpopulated";
VAL_ 195 FLR2RdrDetn175To179Quality2 0 "Quality_Low" 1 "Quality_Medium" 2 "Quality_High" 3 "Quality_DetectionUnpopulated";
VAL_ 195 FLR2RdrDetn175To179Quality3 0 "Quality_Low" 1 "Quality_Medium" 2 "Quality_High" 3 "Quality_DetectionUnpopulated";
VAL_ 195 FLR2RdrDetn175To179Quality4 0 "Quality_Low" 1 "Quality_Medium" 2 "Quality_High" 3 "Quality_DetectionUnpopulated";
VAL_ 198 FLR2RdrDetn180To184Mode0 0 "FLR2RadrDetnMode_RngNearReslMod" 1 "FLR2RadrDetnMode_RngMidReslMod" 2 "FLR2RadrDetnMode_RngLongReslMod" 3 "FLR2RadrDetnMode_DetectionUnpopulated";
VAL_ 198 FLR2RdrDetn180To184Mode1 0 "FLR2RadrDetnMode_RngNearReslMod" 1 "FLR2RadrDetnMode_RngMidReslMod" 2 "FLR2RadrDetnMode_RngLongReslMod" 3 "FLR2RadrDetnMode_DetectionUnpopulated";
VAL_ 198 FLR2RdrDetn180To184Mode2 0 "FLR2RadrDetnMode_RngNearReslMod" 1 "FLR2RadrDetnMode_RngMidReslMod" 2 "FLR2RadrDetnMode_RngLongReslMod" 3 "FLR2RadrDetnMode_DetectionUnpopulated";
VAL_ 198 FLR2RdrDetn180To184Mode3 0 "FLR2RadrDetnMode_RngNearReslMod" 1 "FLR2RadrDetnMode_RngMidReslMod" 2 "FLR2RadrDetnMode_RngLongReslMod" 3 "FLR2RadrDetnMode_DetectionUnpopulated";
VAL_ 198 FLR2RdrDetn180To184Mode4 0 "FLR2RadrDetnMode_RngNearReslMod" 1 "FLR2RadrDetnMode_RngMidReslMod" 2 "FLR2RadrDetnMode_RngLongReslMod" 3 "FLR2RadrDetnMode_DetectionUnpopulated";
VAL_ 198 FLR2RdrDetn180To184Quality0 0 "Quality_Low" 1 "Quality_Medium" 2 "Quality_High" 3 "Quality_DetectionUnpopulated";
VAL_ 198 FLR2RdrDetn180To184Quality1 0 "Quality_Low" 1 "Quality_Medium" 2 "Quality_High" 3 "Quality_DetectionUnpopulated";
VAL_ 198 FLR2RdrDetn180To184Quality2 0 "Quality_Low" 1 "Quality_Medium" 2 "Quality_High" 3 "Quality_DetectionUnpopulated";
VAL_ 198 FLR2RdrDetn180To184Quality3 0 "Quality_Low" 1 "Quality_Medium" 2 "Quality_High" 3 "Quality_DetectionUnpopulated";
VAL_ 198 FLR2RdrDetn180To184Quality4 0 "Quality_Low" 1 "Quality_Medium" 2 "Quality_High" 3 "Quality_DetectionUnpopulated";
VAL_ 201 FLR2RdrDetn185To189Mode0 0 "FLR2RadrDetnMode_RngNearReslMod" 1 "FLR2RadrDetnMode_RngMidReslMod" 2 "FLR2RadrDetnMode_RngLongReslMod" 3 "FLR2RadrDetnMode_DetectionUnpopulated";
VAL_ 201 FLR2RdrDetn185To189Mode1 0 "FLR2RadrDetnMode_RngNearReslMod" 1 "FLR2RadrDetnMode_RngMidReslMod" 2 "FLR2RadrDetnMode_RngLongReslMod" 3 "FLR2RadrDetnMode_DetectionUnpopulated";
VAL_ 201 FLR2RdrDetn185To189Mode2 0 "FLR2RadrDetnMode_RngNearReslMod" 1 "FLR2RadrDetnMode_RngMidReslMod" 2 "FLR2RadrDetnMode_RngLongReslMod" 3 "FLR2RadrDetnMode_DetectionUnpopulated";
VAL_ 201 FLR2RdrDetn185To189Mode3 0 "FLR2RadrDetnMode_RngNearReslMod" 1 "FLR2RadrDetnMode_RngMidReslMod" 2 "FLR2RadrDetnMode_RngLongReslMod" 3 "FLR2RadrDetnMode_DetectionUnpopulated";
VAL_ 201 FLR2RdrDetn185To189Mode4 0 "FLR2RadrDetnMode_RngNearReslMod" 1 "FLR2RadrDetnMode_RngMidReslMod" 2 "FLR2RadrDetnMode_RngLongReslMod" 3 "FLR2RadrDetnMode_DetectionUnpopulated";
VAL_ 201 FLR2RdrDetn185To189Quality0 0 "Quality_Low" 1 "Quality_Medium" 2 "Quality_High" 3 "Quality_DetectionUnpopulated";
VAL_ 201 FLR2RdrDetn185To189Quality1 0 "Quality_Low" 1 "Quality_Medium" 2 "Quality_High" 3 "Quality_DetectionUnpopulated";
VAL_ 201 FLR2RdrDetn185To189Quality2 0 "Quality_Low" 1 "Quality_Medium" 2 "Quality_High" 3 "Quality_DetectionUnpopulated";
VAL_ 201 FLR2RdrDetn185To189Quality3 0 "Quality_Low" 1 "Quality_Medium" 2 "Quality_High" 3 "Quality_DetectionUnpopulated";
VAL_ 201 FLR2RdrDetn185To189Quality4 0 "Quality_Low" 1 "Quality_Medium" 2 "Quality_High" 3 "Quality_DetectionUnpopulated";
VAL_ 204 FLR2RdrDetn190To194Mode0 0 "FLR2RadrDetnMode_RngNearReslMod" 1 "FLR2RadrDetnMode_RngMidReslMod" 2 "FLR2RadrDetnMode_RngLongReslMod" 3 "FLR2RadrDetnMode_DetectionUnpopulated";
VAL_ 204 FLR2RdrDetn190To194Mode1 0 "FLR2RadrDetnMode_RngNearReslMod" 1 "FLR2RadrDetnMode_RngMidReslMod" 2 "FLR2RadrDetnMode_RngLongReslMod" 3 "FLR2RadrDetnMode_DetectionUnpopulated";
VAL_ 204 FLR2RdrDetn190To194Mode2 0 "FLR2RadrDetnMode_RngNearReslMod" 1 "FLR2RadrDetnMode_RngMidReslMod" 2 "FLR2RadrDetnMode_RngLongReslMod" 3 "FLR2RadrDetnMode_DetectionUnpopulated";
VAL_ 204 FLR2RdrDetn190To194Mode3 0 "FLR2RadrDetnMode_RngNearReslMod" 1 "FLR2RadrDetnMode_RngMidReslMod" 2 "FLR2RadrDetnMode_RngLongReslMod" 3 "FLR2RadrDetnMode_DetectionUnpopulated";
VAL_ 204 FLR2RdrDetn190To194Mode4 0 "FLR2RadrDetnMode_RngNearReslMod" 1 "FLR2RadrDetnMode_RngMidReslMod" 2 "FLR2RadrDetnMode_RngLongReslMod" 3 "FLR2RadrDetnMode_DetectionUnpopulated";
VAL_ 204 FLR2RdrDetn190To194Quality0 0 "Quality_Low" 1 "Quality_Medium" 2 "Quality_High" 3 "Quality_DetectionUnpopulated";
VAL_ 204 FLR2RdrDetn190To194Quality1 0 "Quality_Low" 1 "Quality_Medium" 2 "Quality_High" 3 "Quality_DetectionUnpopulated";
VAL_ 204 FLR2RdrDetn190To194Quality2 0 "Quality_Low" 1 "Quality_Medium" 2 "Quality_High" 3 "Quality_DetectionUnpopulated";
VAL_ 204 FLR2RdrDetn190To194Quality3 0 "Quality_Low" 1 "Quality_Medium" 2 "Quality_High" 3 "Quality_DetectionUnpopulated";
VAL_ 204 FLR2RdrDetn190To194Quality4 0 "Quality_Low" 1 "Quality_Medium" 2 "Quality_High" 3 "Quality_DetectionUnpopulated";
VAL_ 208 FLR2RdrDetn195To199Mode0 0 "FLR2RadrDetnMode_RngNearReslMod" 1 "FLR2RadrDetnMode_RngMidReslMod" 2 "FLR2RadrDetnMode_RngLongReslMod" 3 "FLR2RadrDetnMode_DetectionUnpopulated";
VAL_ 208 FLR2RdrDetn195To199Mode1 0 "FLR2RadrDetnMode_RngNearReslMod" 1 "FLR2RadrDetnMode_RngMidReslMod" 2 "FLR2RadrDetnMode_RngLongReslMod" 3 "FLR2RadrDetnMode_DetectionUnpopulated";
VAL_ 208 FLR2RdrDetn195To199Mode2 0 "FLR2RadrDetnMode_RngNearReslMod" 1 "FLR2RadrDetnMode_RngMidReslMod" 2 "FLR2RadrDetnMode_RngLongReslMod" 3 "FLR2RadrDetnMode_DetectionUnpopulated";
VAL_ 208 FLR2RdrDetn195To199Mode3 0 "FLR2RadrDetnMode_RngNearReslMod" 1 "FLR2RadrDetnMode_RngMidReslMod" 2 "FLR2RadrDetnMode_RngLongReslMod" 3 "FLR2RadrDetnMode_DetectionUnpopulated";
VAL_ 208 FLR2RdrDetn195To199Mode4 0 "FLR2RadrDetnMode_RngNearReslMod" 1 "FLR2RadrDetnMode_RngMidReslMod" 2 "FLR2RadrDetnMode_RngLongReslMod" 3 "FLR2RadrDetnMode_DetectionUnpopulated";
VAL_ 208 FLR2RdrDetn195To199Quality0 0 "Quality_Low" 1 "Quality_Medium" 2 "Quality_High" 3 "Quality_DetectionUnpopulated";
VAL_ 208 FLR2RdrDetn195To199Quality1 0 "Quality_Low" 1 "Quality_Medium" 2 "Quality_High" 3 "Quality_DetectionUnpopulated";
VAL_ 208 FLR2RdrDetn195To199Quality2 0 "Quality_Low" 1 "Quality_Medium" 2 "Quality_High" 3 "Quality_DetectionUnpopulated";
VAL_ 208 FLR2RdrDetn195To199Quality3 0 "Quality_Low" 1 "Quality_Medium" 2 "Quality_High" 3 "Quality_DetectionUnpopulated";
VAL_ 208 FLR2RdrDetn195To199Quality4 0 "Quality_Low" 1 "Quality_Medium" 2 "Quality_High" 3 "Quality_DetectionUnpopulated";
SIG_GROUP_ 166 FLR2RdrDetn130To134 1 : FLR2RdrDetn130To134AziAng0 FLR2RdrDetn130To134AziAng1 FLR2RdrDetn130To134AziAng2 FLR2RdrDetn130To134AziAng3 FLR2RdrDetn130To134AziAng4 FLR2RdrDetn130To134Counter FLR2RdrDetn130To134CRC FLR2RdrDetn130To134DynPrpty0 FLR2RdrDetn130To134DynPrpty1 FLR2RdrDetn130To134DynPrpty2 FLR2RdrDetn130To134DynPrpty3 FLR2RdrDetn130To134DynPrpty4 FLR2RdrDetn130To134EleAng0 FLR2RdrDetn130To134EleAng1 FLR2RdrDetn130To134EleAng2 FLR2RdrDetn130To134EleAng3 FLR2RdrDetn130To134EleAng4 FLR2RdrDetn130To134Mode0 FLR2RdrDetn130To134Mode1 FLR2RdrDetn130To134Mode2 FLR2RdrDetn130To134Mode3 FLR2RdrDetn130To134Mode4 FLR2RdrDetn130To134Quality0 FLR2RdrDetn130To134Quality1 FLR2RdrDetn130To134Quality2 FLR2RdrDetn130To134Quality3 FLR2RdrDetn130To134Quality4 FLR2RdrDetn130To134Range0 FLR2RdrDetn130To134Range1 FLR2RdrDetn130To134Range2 FLR2RdrDetn130To134Range3 FLR2RdrDetn130To134Range4 FLR2RdrDetn130To134RCS0 FLR2RdrDetn130To134RCS1 FLR2RdrDetn130To134RCS2 FLR2RdrDetn130To134RCS3 FLR2RdrDetn130To134RCS4 FLR2RdrDetn130To134RngRt0 FLR2RdrDetn130To134RngRt1 FLR2RdrDetn130To134RngRt2 FLR2RdrDetn130To134RngRt3 FLR2RdrDetn130To134RngRt4 FLR2RdrDetn130To134ScanID FLR2RdrDetn130To134SNR0 FLR2RdrDetn130To134SNR1 FLR2RdrDetn130To134SNR2 FLR2RdrDetn130To134SNR3 FLR2RdrDetn130To134SNR4;
SIG_GROUP_ 169 FLR2RdrDetn135To139 1 : FLR2RdrDetn135To139AziAng0 FLR2RdrDetn135To139AziAng1 FLR2RdrDetn135To139AziAng2 FLR2RdrDetn135To139AziAng3 FLR2RdrDetn135To139AziAng4 FLR2RdrDetn135To139Counter FLR2RdrDetn135To139CRC FLR2RdrDetn135To139DynPrpty0 FLR2RdrDetn135To139DynPrpty1 FLR2RdrDetn135To139DynPrpty2 FLR2RdrDetn135To139DynPrpty3 FLR2RdrDetn135To139DynPrpty4 FLR2RdrDetn135To139EleAng0 FLR2RdrDetn135To139EleAng1 FLR2RdrDetn135To139EleAng2 FLR2RdrDetn135To139EleAng3 FLR2RdrDetn135To139EleAng4 FLR2RdrDetn135To139Mode0 FLR2RdrDetn135To139Mode1 FLR2RdrDetn135To139Mode2 FLR2RdrDetn135To139Mode3 FLR2RdrDetn135To139Mode4 FLR2RdrDetn135To139Quality0 FLR2RdrDetn135To139Quality1 FLR2RdrDetn135To139Quality2 FLR2RdrDetn135To139Quality3 FLR2RdrDetn135To139Quality4 FLR2RdrDetn135To139Range0 FLR2RdrDetn135To139Range1 FLR2RdrDetn135To139Range2 FLR2RdrDetn135To139Range3 FLR2RdrDetn135To139Range4 FLR2RdrDetn135To139RCS0 FLR2RdrDetn135To139RCS1 FLR2RdrDetn135To139RCS2 FLR2RdrDetn135To139RCS3 FLR2RdrDetn135To139RCS4 FLR2RdrDetn135To139RngRt0 FLR2RdrDetn135To139RngRt1 FLR2RdrDetn135To139RngRt2 FLR2RdrDetn135To139RngRt3 FLR2RdrDetn135To139RngRt4 FLR2RdrDetn135To139ScanID FLR2RdrDetn135To139SNR0 FLR2RdrDetn135To139SNR1 FLR2RdrDetn135To139SNR2 FLR2RdrDetn135To139SNR3 FLR2RdrDetn135To139SNR4;
SIG_GROUP_ 172 FLR2RdrDetn140To144 1 : FLR2RdrDetn140To144AziAng0 FLR2RdrDetn140To144AziAng1 FLR2RdrDetn140To144AziAng2 FLR2RdrDetn140To144AziAng3 FLR2RdrDetn140To144AziAng4 FLR2RdrDetn140To144Counter FLR2RdrDetn140To144CRC FLR2RdrDetn140To144DynPrpty0 FLR2RdrDetn140To144DynPrpty1 FLR2RdrDetn140To144DynPrpty2 FLR2RdrDetn140To144DynPrpty3 FLR2RdrDetn140To144DynPrpty4 FLR2RdrDetn140To144EleAng0 FLR2RdrDetn140To144EleAng1 FLR2RdrDetn140To144EleAng2 FLR2RdrDetn140To144EleAng3 FLR2RdrDetn140To144EleAng4 FLR2RdrDetn140To144Mode0 FLR2RdrDetn140To144Mode1 FLR2RdrDetn140To144Mode2 FLR2RdrDetn140To144Mode3 FLR2RdrDetn140To144Mode4 FLR2RdrDetn140To144Quality0 FLR2RdrDetn140To144Quality1 FLR2RdrDetn140To144Quality2 FLR2RdrDetn140To144Quality3 FLR2RdrDetn140To144Quality4 FLR2RdrDetn140To144Range0 FLR2RdrDetn140To144Range1 FLR2RdrDetn140To144Range2 FLR2RdrDetn140To144Range3 FLR2RdrDetn140To144Range4 FLR2RdrDetn140To144RCS0 FLR2RdrDetn140To144RCS1 FLR2RdrDetn140To144RCS2 FLR2RdrDetn140To144RCS3 FLR2RdrDetn140To144RCS4 FLR2RdrDetn140To144RngRt0 FLR2RdrDetn140To144RngRt1 FLR2RdrDetn140To144RngRt2 FLR2RdrDetn140To144RngRt3 FLR2RdrDetn140To144RngRt4 FLR2RdrDetn140To144ScanID FLR2RdrDetn140To144SNR0 FLR2RdrDetn140To144SNR1 FLR2RdrDetn140To144SNR2 FLR2RdrDetn140To144SNR3 FLR2RdrDetn140To144SNR4;
SIG_GROUP_ 176 FLR2RdrDetn145To149 1 : FLR2RdrDetn145To149AziAng0 FLR2RdrDetn145To149AziAng1 FLR2RdrDetn145To149AziAng2 FLR2RdrDetn145To149AziAng3 FLR2RdrDetn145To149AziAng4 FLR2RdrDetn145To149Counter FLR2RdrDetn145To149CRC FLR2RdrDetn145To149DynPrpty0 FLR2RdrDetn145To149DynPrpty1 FLR2RdrDetn145To149DynPrpty2 FLR2RdrDetn145To149DynPrpty3 FLR2RdrDetn145To149DynPrpty4 FLR2RdrDetn145To149EleAng0 FLR2RdrDetn145To149EleAng1 FLR2RdrDetn145To149EleAng2 FLR2RdrDetn145To149EleAng3 FLR2RdrDetn145To149EleAng4 FLR2RdrDetn145To149Mode0 FLR2RdrDetn145To149Mode1 FLR2RdrDetn145To149Mode2 FLR2RdrDetn145To149Mode3 FLR2RdrDetn145To149Mode4 FLR2RdrDetn145To149Quality0 FLR2RdrDetn145To149Quality1 FLR2RdrDetn145To149Quality2 FLR2RdrDetn145To149Quality3 FLR2RdrDetn145To149Quality4 FLR2RdrDetn145To149Range0 FLR2RdrDetn145To149Range1 FLR2RdrDetn145To149Range2 FLR2RdrDetn145To149Range3 FLR2RdrDetn145To149Range4 FLR2RdrDetn145To149RCS0 FLR2RdrDetn145To149RCS1 FLR2RdrDetn145To149RCS2 FLR2RdrDetn145To149RCS3 FLR2RdrDetn145To149RCS4 FLR2RdrDetn145To149RngRt0 FLR2RdrDetn145To149RngRt1 FLR2RdrDetn145To149RngRt2 FLR2RdrDetn145To149RngRt3 FLR2RdrDetn145To149RngRt4 FLR2RdrDetn145To149ScanID FLR2RdrDetn145To149SNR0 FLR2RdrDetn145To149SNR1 FLR2RdrDetn145To149SNR2 FLR2RdrDetn145To149SNR3 FLR2RdrDetn145To149SNR4;
SIG_GROUP_ 179 FLR2RdrDetn150To154 1 : FLR2RdrDetn150To154AziAng0 FLR2RdrDetn150To154AziAng1 FLR2RdrDetn150To154AziAng2 FLR2RdrDetn150To154AziAng3 FLR2RdrDetn150To154AziAng4 FLR2RdrDetn150To154Counter FLR2RdrDetn150To154CRC FLR2RdrDetn150To154DynPrpty0 FLR2RdrDetn150To154DynPrpty1 FLR2RdrDetn150To154DynPrpty2 FLR2RdrDetn150To154DynPrpty3 FLR2RdrDetn150To154DynPrpty4 FLR2RdrDetn150To154EleAng0 FLR2RdrDetn150To154EleAng1 FLR2RdrDetn150To154EleAng2 FLR2RdrDetn150To154EleAng3 FLR2RdrDetn150To154EleAng4 FLR2RdrDetn150To154Mode0 FLR2RdrDetn150To154Mode1 FLR2RdrDetn150To154Mode2 FLR2RdrDetn150To154Mode3 FLR2RdrDetn150To154Mode4 FLR2RdrDetn150To154Quality0 FLR2RdrDetn150To154Quality1 FLR2RdrDetn150To154Quality2 FLR2RdrDetn150To154Quality3 FLR2RdrDetn150To154Quality4 FLR2RdrDetn150To154Range0 FLR2RdrDetn150To154Range1 FLR2RdrDetn150To154Range2 FLR2RdrDetn150To154Range3 FLR2RdrDetn150To154Range4 FLR2RdrDetn150To154RCS0 FLR2RdrDetn150To154RCS1 FLR2RdrDetn150To154RCS2 FLR2RdrDetn150To154RCS3 FLR2RdrDetn150To154RCS4 FLR2RdrDetn150To154RngRt0 FLR2RdrDetn150To154RngRt1 FLR2RdrDetn150To154RngRt2 FLR2RdrDetn150To154RngRt3 FLR2RdrDetn150To154RngRt4 FLR2RdrDetn150To154ScanID FLR2RdrDetn150To154SNR0 FLR2RdrDetn150To154SNR1 FLR2RdrDetn150To154SNR2 FLR2RdrDetn150To154SNR3 FLR2RdrDetn150To154SNR4;
SIG_GROUP_ 182 FLR2RdrDetn155To159 1 : FLR2RdrDetn155To159AziAng0 FLR2RdrDetn155To159AziAng1 FLR2RdrDetn155To159AziAng2 FLR2RdrDetn155To159AziAng3 FLR2RdrDetn155To159AziAng4 FLR2RdrDetn155To159Counter FLR2RdrDetn155To159CRC FLR2RdrDetn155To159DynPrpty0 FLR2RdrDetn155To159DynPrpty1 FLR2RdrDetn155To159DynPrpty2 FLR2RdrDetn155To159DynPrpty3 FLR2RdrDetn155To159DynPrpty4 FLR2RdrDetn155To159EleAng0 FLR2RdrDetn155To159EleAng1 FLR2RdrDetn155To159EleAng2 FLR2RdrDetn155To159EleAng3 FLR2RdrDetn155To159EleAng4 FLR2RdrDetn155To159Mode0 FLR2RdrDetn155To159Mode1 FLR2RdrDetn155To159Mode2 FLR2RdrDetn155To159Mode3 FLR2RdrDetn155To159Mode4 FLR2RdrDetn155To159Quality0 FLR2RdrDetn155To159Quality1 FLR2RdrDetn155To159Quality2 FLR2RdrDetn155To159Quality3 FLR2RdrDetn155To159Quality4 FLR2RdrDetn155To159Range0 FLR2RdrDetn155To159Range1 FLR2RdrDetn155To159Range2 FLR2RdrDetn155To159Range3 FLR2RdrDetn155To159Range4 FLR2RdrDetn155To159RCS0 FLR2RdrDetn155To159RCS1 FLR2RdrDetn155To159RCS2 FLR2RdrDetn155To159RCS3 FLR2RdrDetn155To159RCS4 FLR2RdrDetn155To159RngRt0 FLR2RdrDetn155To159RngRt1 FLR2RdrDetn155To159RngRt2 FLR2RdrDetn155To159RngRt3 FLR2RdrDetn155To159RngRt4 FLR2RdrDetn155To159ScanID FLR2RdrDetn155To159SNR0 FLR2RdrDetn155To159SNR1 FLR2RdrDetn155To159SNR2 FLR2RdrDetn155To159SNR3 FLR2RdrDetn155To159SNR4;
SIG_GROUP_ 185 FLR2RdrDetn160To164 1 : FLR2RdrDetn160To164AziAng0 FLR2RdrDetn160To164AziAng1 FLR2RdrDetn160To164AziAng2 FLR2RdrDetn160To164AziAng3 FLR2RdrDetn160To164AziAng4 FLR2RdrDetn160To164Counter FLR2RdrDetn160To164CRC FLR2RdrDetn160To164DynPrpty0 FLR2RdrDetn160To164DynPrpty1 FLR2RdrDetn160To164DynPrpty2 FLR2RdrDetn160To164DynPrpty3 FLR2RdrDetn160To164DynPrpty4 FLR2RdrDetn160To164EleAng0 FLR2RdrDetn160To164EleAng1 FLR2RdrDetn160To164EleAng2 FLR2RdrDetn160To164EleAng3 FLR2RdrDetn160To164EleAng4 FLR2RdrDetn160To164Mode0 FLR2RdrDetn160To164Mode1 FLR2RdrDetn160To164Mode2 FLR2RdrDetn160To164Mode3 FLR2RdrDetn160To164Mode4 FLR2RdrDetn160To164Quality0 FLR2RdrDetn160To164Quality1 FLR2RdrDetn160To164Quality2 FLR2RdrDetn160To164Quality3 FLR2RdrDetn160To164Quality4 FLR2RdrDetn160To164Range0 FLR2RdrDetn160To164Range1 FLR2RdrDetn160To164Range2 FLR2RdrDetn160To164Range3 FLR2RdrDetn160To164Range4 FLR2RdrDetn160To164RCS0 FLR2RdrDetn160To164RCS1 FLR2RdrDetn160To164RCS2 FLR2RdrDetn160To164RCS3 FLR2RdrDetn160To164RCS4 FLR2RdrDetn160To164RngRt0 FLR2RdrDetn160To164RngRt1 FLR2RdrDetn160To164RngRt2 FLR2RdrDetn160To164RngRt3 FLR2RdrDetn160To164RngRt4 FLR2RdrDetn160To164ScanID FLR2RdrDetn160To164SNR0 FLR2RdrDetn160To164SNR1 FLR2RdrDetn160To164SNR2 FLR2RdrDetn160To164SNR3 FLR2RdrDetn160To164SNR4;
SIG_GROUP_ 188 FLR2RdrDetn165To169 1 : FLR2RdrDetn165To169AziAng0 FLR2RdrDetn165To169AziAng1 FLR2RdrDetn165To169AziAng2 FLR2RdrDetn165To169AziAng3 FLR2RdrDetn165To169AziAng4 FLR2RdrDetn165To169Counter FLR2RdrDetn165To169CRC FLR2RdrDetn165To169DynPrpty0 FLR2RdrDetn165To169DynPrpty1 FLR2RdrDetn165To169DynPrpty2 FLR2RdrDetn165To169DynPrpty3 FLR2RdrDetn165To169DynPrpty4 FLR2RdrDetn165To169EleAng0 FLR2RdrDetn165To169EleAng1 FLR2RdrDetn165To169EleAng2 FLR2RdrDetn165To169EleAng3 FLR2RdrDetn165To169EleAng4 FLR2RdrDetn165To169Mode0 FLR2RdrDetn165To169Mode1 FLR2RdrDetn165To169Mode2 FLR2RdrDetn165To169Mode3 FLR2RdrDetn165To169Mode4 FLR2RdrDetn165To169Quality0 FLR2RdrDetn165To169Quality1 FLR2RdrDetn165To169Quality2 FLR2RdrDetn165To169Quality3 FLR2RdrDetn165To169Quality4 FLR2RdrDetn165To169Range0 FLR2RdrDetn165To169Range1 FLR2RdrDetn165To169Range2 FLR2RdrDetn165To169Range3 FLR2RdrDetn165To169Range4 FLR2RdrDetn165To169RCS0 FLR2RdrDetn165To169RCS1 FLR2RdrDetn165To169RCS2 FLR2RdrDetn165To169RCS3 FLR2RdrDetn165To169RCS4 FLR2RdrDetn165To169RngRt0 FLR2RdrDetn165To169RngRt1 FLR2RdrDetn165To169RngRt2 FLR2RdrDetn165To169RngRt3 FLR2RdrDetn165To169RngRt4 FLR2RdrDetn165To169ScanID FLR2RdrDetn165To169SNR0 FLR2RdrDetn165To169SNR1 FLR2RdrDetn165To169SNR2 FLR2RdrDetn165To169SNR3 FLR2RdrDetn165To169SNR4;
SIG_GROUP_ 192 FLR2RdrDetn170To174 1 : FLR2RdrDetn170To174AziAng0 FLR2RdrDetn170To174AziAng1 FLR2RdrDetn170To174AziAng2 FLR2RdrDetn170To174AziAng3 FLR2RdrDetn170To174AziAng4 FLR2RdrDetn170To174Counter FLR2RdrDetn170To174CRC FLR2RdrDetn170To174DynPrpty0 FLR2RdrDetn170To174DynPrpty1 FLR2RdrDetn170To174DynPrpty2 FLR2RdrDetn170To174DynPrpty3 FLR2RdrDetn170To174DynPrpty4 FLR2RdrDetn170To174EleAng0 FLR2RdrDetn170To174EleAng1 FLR2RdrDetn170To174EleAng2 FLR2RdrDetn170To174EleAng3 FLR2RdrDetn170To174EleAng4 FLR2RdrDetn170To174Mode0 FLR2RdrDetn170To174Mode1 FLR2RdrDetn170To174Mode2 FLR2RdrDetn170To174Mode3 FLR2RdrDetn170To174Mode4 FLR2RdrDetn170To174Quality0 FLR2RdrDetn170To174Quality1 FLR2RdrDetn170To174Quality2 FLR2RdrDetn170To174Quality3 FLR2RdrDetn170To174Quality4 FLR2RdrDetn170To174Range0 FLR2RdrDetn170To174Range1 FLR2RdrDetn170To174Range2 FLR2RdrDetn170To174Range3 FLR2RdrDetn170To174Range4 FLR2RdrDetn170To174RCS0 FLR2RdrDetn170To174RCS1 FLR2RdrDetn170To174RCS2 FLR2RdrDetn170To174RCS3 FLR2RdrDetn170To174RCS4 FLR2RdrDetn170To174RngRt0 FLR2RdrDetn170To174RngRt1 FLR2RdrDetn170To174RngRt2 FLR2RdrDetn170To174RngRt3 FLR2RdrDetn170To174RngRt4 FLR2RdrDetn170To174ScanID FLR2RdrDetn170To174SNR0 FLR2RdrDetn170To174SNR1 FLR2RdrDetn170To174SNR2 FLR2RdrDetn170To174SNR3 FLR2RdrDetn170To174SNR4;
SIG_GROUP_ 195 FLR2RdrDetn175To179 1 : FLR2RdrDetn175To179AziAng0 FLR2RdrDetn175To179AziAng1 FLR2RdrDetn175To179AziAng2 FLR2RdrDetn175To179AziAng3 FLR2RdrDetn175To179AziAng4 FLR2RdrDetn175To179Counter FLR2RdrDetn175To179CRC FLR2RdrDetn175To179DynPrpty0 FLR2RdrDetn175To179DynPrpty1 FLR2RdrDetn175To179DynPrpty2 FLR2RdrDetn175To179DynPrpty3 FLR2RdrDetn175To179DynPrpty4 FLR2RdrDetn175To179EleAng0 FLR2RdrDetn175To179EleAng1 FLR2RdrDetn175To179EleAng2 FLR2RdrDetn175To179EleAng3 FLR2RdrDetn175To179EleAng4 FLR2RdrDetn175To179Mode0 FLR2RdrDetn175To179Mode1 FLR2RdrDetn175To179Mode2 FLR2RdrDetn175To179Mode3 FLR2RdrDetn175To179Mode4 FLR2RdrDetn175To179Quality0 FLR2RdrDetn175To179Quality1 FLR2RdrDetn175To179Quality2 FLR2RdrDetn175To179Quality3 FLR2RdrDetn175To179Quality4 FLR2RdrDetn175To179Range0 FLR2RdrDetn175To179Range1 FLR2RdrDetn175To179Range2 FLR2RdrDetn175To179Range3 FLR2RdrDetn175To179Range4 FLR2RdrDetn175To179RCS0 FLR2RdrDetn175To179RCS1 FLR2RdrDetn175To179RCS2 FLR2RdrDetn175To179RCS3 FLR2RdrDetn175To179RCS4 FLR2RdrDetn175To179RngRt0 FLR2RdrDetn175To179RngRt1 FLR2RdrDetn175To179RngRt2 FLR2RdrDetn175To179RngRt3 FLR2RdrDetn175To179RngRt4 FLR2RdrDetn175To179ScanID FLR2RdrDetn175To179SNR0 FLR2RdrDetn175To179SNR1 FLR2RdrDetn175To179SNR2 FLR2RdrDetn175To179SNR3 FLR2RdrDetn175To179SNR4;
SIG_GROUP_ 198 FLR2RdrDetn180To184 1 : FLR2RdrDetn180To184AziAng0 FLR2RdrDetn180To184AziAng1 FLR2RdrDetn180To184AziAng2 FLR2RdrDetn180To184AziAng3 FLR2RdrDetn180To184AziAng4 FLR2RdrDetn180To184Counter FLR2RdrDetn180To184CRC FLR2RdrDetn180To184DynPrpty0 FLR2RdrDetn180To184DynPrpty1 FLR2RdrDetn180To184DynPrpty2 FLR2RdrDetn180To184DynPrpty3 FLR2RdrDetn180To184DynPrpty4 FLR2RdrDetn180To184EleAng0 FLR2RdrDetn180To184EleAng1 FLR2RdrDetn180To184EleAng2 FLR2RdrDetn180To184EleAng3 FLR2RdrDetn180To184EleAng4 FLR2RdrDetn180To184Mode0 FLR2RdrDetn180To184Mode1 FLR2RdrDetn180To184Mode2 FLR2RdrDetn180To184Mode3 FLR2RdrDetn180To184Mode4 FLR2RdrDetn180To184Quality0 FLR2RdrDetn180To184Quality1 FLR2RdrDetn180To184Quality2 FLR2RdrDetn180To184Quality3 FLR2RdrDetn180To184Quality4 FLR2RdrDetn180To184Range0 FLR2RdrDetn180To184Range1 FLR2RdrDetn180To184Range2 FLR2RdrDetn180To184Range3 FLR2RdrDetn180To184Range4 FLR2RdrDetn180To184RCS0 FLR2RdrDetn180To184RCS1 FLR2RdrDetn180To184RCS2 FLR2RdrDetn180To184RCS3 FLR2RdrDetn180To184RCS4 FLR2RdrDetn180To184RngRt0 FLR2RdrDetn180To184RngRt1 FLR2RdrDetn180To184RngRt2 FLR2RdrDetn180To184RngRt3 FLR2RdrDetn180To184RngRt4 FLR2RdrDetn180To184ScanID FLR2RdrDetn180To184SNR0 FLR2RdrDetn180To184SNR1 FLR2RdrDetn180To184SNR2 FLR2RdrDetn180To184SNR3 FLR2RdrDetn180To184SNR4;
SIG_GROUP_ 201 FLR2RdrDetn185To189 1 : FLR2RdrDetn185To189AziAng0 FLR2RdrDetn185To189AziAng1 FLR2RdrDetn185To189AziAng2 FLR2RdrDetn185To189AziAng3 FLR2RdrDetn185To189AziAng4 FLR2RdrDetn185To189Counter FLR2RdrDetn185To189CRC FLR2RdrDetn185To189DynPrpty0 FLR2RdrDetn185To189DynPrpty1 FLR2RdrDetn185To189DynPrpty2 FLR2RdrDetn185To189DynPrpty3 FLR2RdrDetn185To189DynPrpty4 FLR2RdrDetn185To189EleAng0 FLR2RdrDetn185To189EleAng1 FLR2RdrDetn185To189EleAng2 FLR2RdrDetn185To189EleAng3 FLR2RdrDetn185To189EleAng4 FLR2RdrDetn185To189Mode0 FLR2RdrDetn185To189Mode1 FLR2RdrDetn185To189Mode2 FLR2RdrDetn185To189Mode3 FLR2RdrDetn185To189Mode4 FLR2RdrDetn185To189Quality0 FLR2RdrDetn185To189Quality1 FLR2RdrDetn185To189Quality2 FLR2RdrDetn185To189Quality3 FLR2RdrDetn185To189Quality4 FLR2RdrDetn185To189Range0 FLR2RdrDetn185To189Range1 FLR2RdrDetn185To189Range2 FLR2RdrDetn185To189Range3 FLR2RdrDetn185To189Range4 FLR2RdrDetn185To189RCS0 FLR2RdrDetn185To189RCS1 FLR2RdrDetn185To189RCS2 FLR2RdrDetn185To189RCS3 FLR2RdrDetn185To189RCS4 FLR2RdrDetn185To189RngRt0 FLR2RdrDetn185To189RngRt1 FLR2RdrDetn185To189RngRt2 FLR2RdrDetn185To189RngRt3 FLR2RdrDetn185To189RngRt4 FLR2RdrDetn185To189ScanID FLR2RdrDetn185To189SNR0 FLR2RdrDetn185To189SNR1 FLR2RdrDetn185To189SNR2 FLR2RdrDetn185To189SNR3 FLR2RdrDetn185To189SNR4;
SIG_GROUP_ 204 FLR2RdrDetn190To194 1 : FLR2RdrDetn190To194AziAng0 FLR2RdrDetn190To194AziAng1 FLR2RdrDetn190To194AziAng2 FLR2RdrDetn190To194AziAng3 FLR2RdrDetn190To194AziAng4 FLR2RdrDetn190To194Counter FLR2RdrDetn190To194CRC FLR2RdrDetn190To194DynPrpty0 FLR2RdrDetn190To194DynPrpty1 FLR2RdrDetn190To194DynPrpty2 FLR2RdrDetn190To194DynPrpty3 FLR2RdrDetn190To194DynPrpty4 FLR2RdrDetn190To194EleAng0 FLR2RdrDetn190To194EleAng1 FLR2RdrDetn190To194EleAng2 FLR2RdrDetn190To194EleAng3 FLR2RdrDetn190To194EleAng4 FLR2RdrDetn190To194Mode0 FLR2RdrDetn190To194Mode1 FLR2RdrDetn190To194Mode2 FLR2RdrDetn190To194Mode3 FLR2RdrDetn190To194Mode4 FLR2RdrDetn190To194Quality0 FLR2RdrDetn190To194Quality1 FLR2RdrDetn190To194Quality2 FLR2RdrDetn190To194Quality3 FLR2RdrDetn190To194Quality4 FLR2RdrDetn190To194Range0 FLR2RdrDetn190To194Range1 FLR2RdrDetn190To194Range2 FLR2RdrDetn190To194Range3 FLR2RdrDetn190To194Range4 FLR2RdrDetn190To194RCS0 FLR2RdrDetn190To194RCS1 FLR2RdrDetn190To194RCS2 FLR2RdrDetn190To194RCS3 FLR2RdrDetn190To194RCS4 FLR2RdrDetn190To194RngRt0 FLR2RdrDetn190To194RngRt1 FLR2RdrDetn190To194RngRt2 FLR2RdrDetn190To194RngRt3 FLR2RdrDetn190To194RngRt4 FLR2RdrDetn190To194ScanID FLR2RdrDetn190To194SNR0 FLR2RdrDetn190To194SNR1 FLR2RdrDetn190To194SNR2 FLR2RdrDetn190To194SNR3 FLR2RdrDetn190To194SNR4;
SIG_GROUP_ 208 FLR2RdrDetn195To199 1 : FLR2RdrDetn195To199AziAng0 FLR2RdrDetn195To199AziAng1 FLR2RdrDetn195To199AziAng2 FLR2RdrDetn195To199AziAng3 FLR2RdrDetn195To199AziAng4 FLR2RdrDetn195To199Counter FLR2RdrDetn195To199CRC FLR2RdrDetn195To199DynPrpty0 FLR2RdrDetn195To199DynPrpty1 FLR2RdrDetn195To199DynPrpty2 FLR2RdrDetn195To199DynPrpty3 FLR2RdrDetn195To199DynPrpty4 FLR2RdrDetn195To199EleAng0 FLR2RdrDetn195To199EleAng1 FLR2RdrDetn195To199EleAng2 FLR2RdrDetn195To199EleAng3 FLR2RdrDetn195To199EleAng4 FLR2RdrDetn195To199Mode0 FLR2RdrDetn195To199Mode1 FLR2RdrDetn195To199Mode2 FLR2RdrDetn195To199Mode3 FLR2RdrDetn195To199Mode4 FLR2RdrDetn195To199Quality0 FLR2RdrDetn195To199Quality1 FLR2RdrDetn195To199Quality2 FLR2RdrDetn195To199Quality3 FLR2RdrDetn195To199Quality4 FLR2RdrDetn195To199Range0 FLR2RdrDetn195To199Range1 FLR2RdrDetn195To199Range2 FLR2RdrDetn195To199Range3 FLR2RdrDetn195To199Range4 FLR2RdrDetn195To199RCS0 FLR2RdrDetn195To199RCS1 FLR2RdrDetn195To199RCS2 FLR2RdrDetn195To199RCS3 FLR2RdrDetn195To199RCS4 FLR2RdrDetn195To199RngRt0 FLR2RdrDetn195To199RngRt1 FLR2RdrDetn195To199RngRt2 FLR2RdrDetn195To199RngRt3 FLR2RdrDetn195To199RngRt4 FLR2RdrDetn195To199ScanID FLR2RdrDetn195To199SNR0 FLR2RdrDetn195To199SNR1 FLR2RdrDetn195To199SNR2 FLR2RdrDetn195To199SNR3 FLR2RdrDetn195To199SNR4;
