// *************************************************************************** *
// *                                                                           *
// * Description:         CANDB File                                           *
// * Generated at:        2023-01-05 13:51                                     *
// * System:              FLRsystem_MAIN_26                                    *
// * Network:             FLR1CAN                                              *
// *                                                                           *
// *************************************************************************** *
VERSION "FLR1CAN"

NS_ :

BS_ :

BU_ :  FLR FLRdpHPA FLRdpHPB

BO_ 278 FlrFlr1canFr69 : 64 FLR
 SG_ FLR2RdrDetn340To344_UB : 359|1@0+ (1,0) [0|1] "" FLRdpHPA,FLRdpHPB
 SG_ FLR2RdrDetn340To344AziAng0 : 32|9@1+ (0.0035,-0.87266) [-0.87266|0.91584] "rad" FLRdpHPA,FLRdpHPB
 SG_ FLR2RdrDetn340To344AziAng1 : 96|9@1+ (0.0035,-0.87266) [-0.87266|0.91584] "rad" FLRdpHPA,FLRdpHPB
 SG_ FLR2RdrDetn340To344AziAng2 : 160|9@1+ (0.0035,-0.87266) [-0.87266|0.91584] "rad" FLRdpHPA,FLRdpHPB
 SG_ FLR2RdrDetn340To344AziAng3 : 224|9@1+ (0.0035,-0.87266) [-0.87266|0.91584] "rad" FLRdpHPA,FLRdpHPB
 SG_ FLR2RdrDetn340To344AziAng4 : 288|9@1+ (0.0035,-0.87266) [-0.87266|0.91584] "rad" FLRdpHPA,FLRdpHPB
 SG_ FLR2RdrDetn340To344Counter : 16|8@1+ (1.0,0.0) [0.0|255.0] "Unitless" FLRdpHPA,FLRdpHPB
 SG_ FLR2RdrDetn340To344CRC : 0|16@1+ (1.0,0.0) [0.0|65535.0] "Unitless" FLRdpHPA,FLRdpHPB
 SG_ FLR2RdrDetn340To344DynPrpty0 : 93|1@1+ (1.0,0.0) [0.0|1.0] "Unitless" FLRdpHPA,FLRdpHPB
 SG_ FLR2RdrDetn340To344DynPrpty1 : 157|1@1+ (1.0,0.0) [0.0|1.0] "Unitless" FLRdpHPA,FLRdpHPB
 SG_ FLR2RdrDetn340To344DynPrpty2 : 221|1@1+ (1.0,0.0) [0.0|1.0] "Unitless" FLRdpHPA,FLRdpHPB
 SG_ FLR2RdrDetn340To344DynPrpty3 : 285|1@1+ (1.0,0.0) [0.0|1.0] "Unitless" FLRdpHPA,FLRdpHPB
 SG_ FLR2RdrDetn340To344DynPrpty4 : 349|1@1+ (1.0,0.0) [0.0|1.0] "Unitless" FLRdpHPA,FLRdpHPB
 SG_ FLR2RdrDetn340To344EleAng0 : 64|8@1+ (0.002,0.0) [0.0|0.5] "rad" FLRdpHPA,FLRdpHPB
 SG_ FLR2RdrDetn340To344EleAng1 : 128|8@1+ (0.002,0.0) [0.0|0.5] "rad" FLRdpHPA,FLRdpHPB
 SG_ FLR2RdrDetn340To344EleAng2 : 192|8@1+ (0.002,0.0) [0.0|0.5] "rad" FLRdpHPA,FLRdpHPB
 SG_ FLR2RdrDetn340To344EleAng3 : 256|8@1+ (0.002,0.0) [0.0|0.5] "rad" FLRdpHPA,FLRdpHPB
 SG_ FLR2RdrDetn340To344EleAng4 : 320|8@1+ (0.002,0.0) [0.0|0.5] "rad" FLRdpHPA,FLRdpHPB
 SG_ FLR2RdrDetn340To344Mode0 : 60|2@1+ (1,0) [0|3] "" FLRdpHPA,FLRdpHPB
 SG_ FLR2RdrDetn340To344Mode1 : 124|2@1+ (1,0) [0|3] "" FLRdpHPA,FLRdpHPB
 SG_ FLR2RdrDetn340To344Mode2 : 188|2@1+ (1,0) [0|3] "" FLRdpHPA,FLRdpHPB
 SG_ FLR2RdrDetn340To344Mode3 : 252|2@1+ (1,0) [0|3] "" FLRdpHPA,FLRdpHPB
 SG_ FLR2RdrDetn340To344Mode4 : 316|2@1+ (1,0) [0|3] "" FLRdpHPA,FLRdpHPB
 SG_ FLR2RdrDetn340To344Quality0 : 62|2@1+ (1,0) [0|3] "" FLRdpHPA,FLRdpHPB
 SG_ FLR2RdrDetn340To344Quality1 : 126|2@1+ (1,0) [0|3] "" FLRdpHPA,FLRdpHPB
 SG_ FLR2RdrDetn340To344Quality2 : 190|2@1+ (1,0) [0|3] "" FLRdpHPA,FLRdpHPB
 SG_ FLR2RdrDetn340To344Quality3 : 254|2@1+ (1,0) [0|3] "" FLRdpHPA,FLRdpHPB
 SG_ FLR2RdrDetn340To344Quality4 : 318|2@1+ (1,0) [0|3] "" FLRdpHPA,FLRdpHPB
 SG_ FLR2RdrDetn340To344Range0 : 48|12@1+ (0.1,0.4) [0.4|300.0] "m" FLRdpHPA,FLRdpHPB
 SG_ FLR2RdrDetn340To344Range1 : 112|12@1+ (0.1,0.4) [0.4|300.0] "m" FLRdpHPA,FLRdpHPB
 SG_ FLR2RdrDetn340To344Range2 : 176|12@1+ (0.1,0.4) [0.4|300.0] "m" FLRdpHPA,FLRdpHPB
 SG_ FLR2RdrDetn340To344Range3 : 240|12@1+ (0.1,0.4) [0.4|300.0] "m" FLRdpHPA,FLRdpHPB
 SG_ FLR2RdrDetn340To344Range4 : 304|12@1+ (0.1,0.4) [0.4|300.0] "m" FLRdpHPA,FLRdpHPB
 SG_ FLR2RdrDetn340To344RCS0 : 83|10@1+ (0.2,-100.0) [-100.0|70.0] "dBsm" FLRdpHPA,FLRdpHPB
 SG_ FLR2RdrDetn340To344RCS1 : 147|10@1+ (0.2,-100.0) [-100.0|70.0] "dBsm" FLRdpHPA,FLRdpHPB
 SG_ FLR2RdrDetn340To344RCS2 : 211|10@1+ (0.2,-100.0) [-100.0|70.0] "dBsm" FLRdpHPA,FLRdpHPB
 SG_ FLR2RdrDetn340To344RCS3 : 275|10@1+ (0.2,-100.0) [-100.0|70.0] "dBsm" FLRdpHPA,FLRdpHPB
 SG_ FLR2RdrDetn340To344RCS4 : 339|10@1+ (0.2,-100.0) [-100.0|70.0] "dBsm" FLRdpHPA,FLRdpHPB
 SG_ FLR2RdrDetn340To344RngRt0 : 72|11@1+ (0.1,-111.11) [-111.11|55.59000000000002] "m/s" FLRdpHPA,FLRdpHPB
 SG_ FLR2RdrDetn340To344RngRt1 : 136|11@1+ (0.1,-111.11) [-111.11|55.59000000000002] "m/s" FLRdpHPA,FLRdpHPB
 SG_ FLR2RdrDetn340To344RngRt2 : 200|11@1+ (0.1,-111.11) [-111.11|55.59000000000002] "m/s" FLRdpHPA,FLRdpHPB
 SG_ FLR2RdrDetn340To344RngRt3 : 264|11@1+ (0.1,-111.11) [-111.11|55.59000000000002] "m/s" FLRdpHPA,FLRdpHPB
 SG_ FLR2RdrDetn340To344RngRt4 : 328|11@1+ (0.1,-111.11) [-111.11|55.59000000000002] "m/s" FLRdpHPA,FLRdpHPB
 SG_ FLR2RdrDetn340To344ScanID : 24|8@1+ (1.0,0.0) [0.0|255.0] "Unitless" FLRdpHPA,FLRdpHPB
 SG_ FLR2RdrDetn340To344SNR0 : 41|7@1+ (0.5,0.0) [0.0|63.5] "dB" FLRdpHPA,FLRdpHPB
 SG_ FLR2RdrDetn340To344SNR1 : 105|7@1+ (0.5,0.0) [0.0|63.5] "dB" FLRdpHPA,FLRdpHPB
 SG_ FLR2RdrDetn340To344SNR2 : 169|7@1+ (0.5,0.0) [0.0|63.5] "dB" FLRdpHPA,FLRdpHPB
 SG_ FLR2RdrDetn340To344SNR3 : 233|7@1+ (0.5,0.0) [0.0|63.5] "dB" FLRdpHPA,FLRdpHPB
 SG_ FLR2RdrDetn340To344SNR4 : 297|7@1+ (0.5,0.0) [0.0|63.5] "dB" FLRdpHPA,FLRdpHPB

BO_ 280 FlrFlr1canFr70 : 64 FLR
 SG_ FLR2RdrDetn345To349_UB : 359|1@0+ (1,0) [0|1] "" FLRdpHPA,FLRdpHPB
 SG_ FLR2RdrDetn345To349AziAng0 : 32|9@1+ (0.0035,-0.87266) [-0.87266|0.91584] "rad" FLRdpHPA,FLRdpHPB
 SG_ FLR2RdrDetn345To349AziAng1 : 96|9@1+ (0.0035,-0.87266) [-0.87266|0.91584] "rad" FLRdpHPA,FLRdpHPB
 SG_ FLR2RdrDetn345To349AziAng2 : 160|9@1+ (0.0035,-0.87266) [-0.87266|0.91584] "rad" FLRdpHPA,FLRdpHPB
 SG_ FLR2RdrDetn345To349AziAng3 : 224|9@1+ (0.0035,-0.87266) [-0.87266|0.91584] "rad" FLRdpHPA,FLRdpHPB
 SG_ FLR2RdrDetn345To349AziAng4 : 288|9@1+ (0.0035,-0.87266) [-0.87266|0.91584] "rad" FLRdpHPA,FLRdpHPB
 SG_ FLR2RdrDetn345To349Counter : 16|8@1+ (1.0,0.0) [0.0|255.0] "Unitless" FLRdpHPA,FLRdpHPB
 SG_ FLR2RdrDetn345To349CRC : 0|16@1+ (1.0,0.0) [0.0|65535.0] "Unitless" FLRdpHPA,FLRdpHPB
 SG_ FLR2RdrDetn345To349DynPrpty0 : 93|1@1+ (1.0,0.0) [0.0|1.0] "Unitless" FLRdpHPA,FLRdpHPB
 SG_ FLR2RdrDetn345To349DynPrpty1 : 157|1@1+ (1.0,0.0) [0.0|1.0] "Unitless" FLRdpHPA,FLRdpHPB
 SG_ FLR2RdrDetn345To349DynPrpty2 : 221|1@1+ (1.0,0.0) [0.0|1.0] "Unitless" FLRdpHPA,FLRdpHPB
 SG_ FLR2RdrDetn345To349DynPrpty3 : 285|1@1+ (1.0,0.0) [0.0|1.0] "Unitless" FLRdpHPA,FLRdpHPB
 SG_ FLR2RdrDetn345To349DynPrpty4 : 349|1@1+ (1.0,0.0) [0.0|1.0] "Unitless" FLRdpHPA,FLRdpHPB
 SG_ FLR2RdrDetn345To349EleAng0 : 64|8@1+ (0.002,0.0) [0.0|0.5] "rad" FLRdpHPA,FLRdpHPB
 SG_ FLR2RdrDetn345To349EleAng1 : 128|8@1+ (0.002,0.0) [0.0|0.5] "rad" FLRdpHPA,FLRdpHPB
 SG_ FLR2RdrDetn345To349EleAng2 : 192|8@1+ (0.002,0.0) [0.0|0.5] "rad" FLRdpHPA,FLRdpHPB
 SG_ FLR2RdrDetn345To349EleAng3 : 256|8@1+ (0.002,0.0) [0.0|0.5] "rad" FLRdpHPA,FLRdpHPB
 SG_ FLR2RdrDetn345To349EleAng4 : 320|8@1+ (0.002,0.0) [0.0|0.5] "rad" FLRdpHPA,FLRdpHPB
 SG_ FLR2RdrDetn345To349Mode0 : 60|2@1+ (1,0) [0|3] "" FLRdpHPA,FLRdpHPB
 SG_ FLR2RdrDetn345To349Mode1 : 124|2@1+ (1,0) [0|3] "" FLRdpHPA,FLRdpHPB
 SG_ FLR2RdrDetn345To349Mode2 : 188|2@1+ (1,0) [0|3] "" FLRdpHPA,FLRdpHPB
 SG_ FLR2RdrDetn345To349Mode3 : 252|2@1+ (1,0) [0|3] "" FLRdpHPA,FLRdpHPB
 SG_ FLR2RdrDetn345To349Mode4 : 316|2@1+ (1,0) [0|3] "" FLRdpHPA,FLRdpHPB
 SG_ FLR2RdrDetn345To349Quality0 : 62|2@1+ (1,0) [0|3] "" FLRdpHPA,FLRdpHPB
 SG_ FLR2RdrDetn345To349Quality1 : 126|2@1+ (1,0) [0|3] "" FLRdpHPA,FLRdpHPB
 SG_ FLR2RdrDetn345To349Quality2 : 190|2@1+ (1,0) [0|3] "" FLRdpHPA,FLRdpHPB
 SG_ FLR2RdrDetn345To349Quality3 : 254|2@1+ (1,0) [0|3] "" FLRdpHPA,FLRdpHPB
 SG_ FLR2RdrDetn345To349Quality4 : 318|2@1+ (1,0) [0|3] "" FLRdpHPA,FLRdpHPB
 SG_ FLR2RdrDetn345To349Range0 : 48|12@1+ (0.1,0.4) [0.4|300.0] "m" FLRdpHPA,FLRdpHPB
 SG_ FLR2RdrDetn345To349Range1 : 112|12@1+ (0.1,0.4) [0.4|300.0] "m" FLRdpHPA,FLRdpHPB
 SG_ FLR2RdrDetn345To349Range2 : 176|12@1+ (0.1,0.4) [0.4|300.0] "m" FLRdpHPA,FLRdpHPB
 SG_ FLR2RdrDetn345To349Range3 : 240|12@1+ (0.1,0.4) [0.4|300.0] "m" FLRdpHPA,FLRdpHPB
 SG_ FLR2RdrDetn345To349Range4 : 304|12@1+ (0.1,0.4) [0.4|300.0] "m" FLRdpHPA,FLRdpHPB
 SG_ FLR2RdrDetn345To349RCS0 : 83|10@1+ (0.2,-100.0) [-100.0|70.0] "dBsm" FLRdpHPA,FLRdpHPB
 SG_ FLR2RdrDetn345To349RCS1 : 147|10@1+ (0.2,-100.0) [-100.0|70.0] "dBsm" FLRdpHPA,FLRdpHPB
 SG_ FLR2RdrDetn345To349RCS2 : 211|10@1+ (0.2,-100.0) [-100.0|70.0] "dBsm" FLRdpHPA,FLRdpHPB
 SG_ FLR2RdrDetn345To349RCS3 : 275|10@1+ (0.2,-100.0) [-100.0|70.0] "dBsm" FLRdpHPA,FLRdpHPB
 SG_ FLR2RdrDetn345To349RCS4 : 339|10@1+ (0.2,-100.0) [-100.0|70.0] "dBsm" FLRdpHPA,FLRdpHPB
 SG_ FLR2RdrDetn345To349RngRt0 : 72|11@1+ (0.1,-111.11) [-111.11|55.59000000000002] "m/s" FLRdpHPA,FLRdpHPB
 SG_ FLR2RdrDetn345To349RngRt1 : 136|11@1+ (0.1,-111.11) [-111.11|55.59000000000002] "m/s" FLRdpHPA,FLRdpHPB
 SG_ FLR2RdrDetn345To349RngRt2 : 200|11@1+ (0.1,-111.11) [-111.11|55.59000000000002] "m/s" FLRdpHPA,FLRdpHPB
 SG_ FLR2RdrDetn345To349RngRt3 : 264|11@1+ (0.1,-111.11) [-111.11|55.59000000000002] "m/s" FLRdpHPA,FLRdpHPB
 SG_ FLR2RdrDetn345To349RngRt4 : 328|11@1+ (0.1,-111.11) [-111.11|55.59000000000002] "m/s" FLRdpHPA,FLRdpHPB
 SG_ FLR2RdrDetn345To349ScanID : 24|8@1+ (1.0,0.0) [0.0|255.0] "Unitless" FLRdpHPA,FLRdpHPB
 SG_ FLR2RdrDetn345To349SNR0 : 41|7@1+ (0.5,0.0) [0.0|63.5] "dB" FLRdpHPA,FLRdpHPB
 SG_ FLR2RdrDetn345To349SNR1 : 105|7@1+ (0.5,0.0) [0.0|63.5] "dB" FLRdpHPA,FLRdpHPB
 SG_ FLR2RdrDetn345To349SNR2 : 169|7@1+ (0.5,0.0) [0.0|63.5] "dB" FLRdpHPA,FLRdpHPB
 SG_ FLR2RdrDetn345To349SNR3 : 233|7@1+ (0.5,0.0) [0.0|63.5] "dB" FLRdpHPA,FLRdpHPB
 SG_ FLR2RdrDetn345To349SNR4 : 297|7@1+ (0.5,0.0) [0.0|63.5] "dB" FLRdpHPA,FLRdpHPB

BO_ 282 FlrFlr1canFr71 : 64 FLR
 SG_ FLR2RdrDetn350To354_UB : 359|1@0+ (1,0) [0|1] "" FLRdpHPA,FLRdpHPB
 SG_ FLR2RdrDetn350To354AziAng0 : 32|9@1+ (0.0035,-0.87266) [-0.87266|0.91584] "rad" FLRdpHPA,FLRdpHPB
 SG_ FLR2RdrDetn350To354AziAng1 : 96|9@1+ (0.0035,-0.87266) [-0.87266|0.91584] "rad" FLRdpHPA,FLRdpHPB
 SG_ FLR2RdrDetn350To354AziAng2 : 160|9@1+ (0.0035,-0.87266) [-0.87266|0.91584] "rad" FLRdpHPA,FLRdpHPB
 SG_ FLR2RdrDetn350To354AziAng3 : 224|9@1+ (0.0035,-0.87266) [-0.87266|0.91584] "rad" FLRdpHPA,FLRdpHPB
 SG_ FLR2RdrDetn350To354AziAng4 : 288|9@1+ (0.0035,-0.87266) [-0.87266|0.91584] "rad" FLRdpHPA,FLRdpHPB
 SG_ FLR2RdrDetn350To354Counter : 16|8@1+ (1.0,0.0) [0.0|255.0] "Unitless" FLRdpHPA,FLRdpHPB
 SG_ FLR2RdrDetn350To354CRC : 0|16@1+ (1.0,0.0) [0.0|65535.0] "Unitless" FLRdpHPA,FLRdpHPB
 SG_ FLR2RdrDetn350To354DynPrpty0 : 93|1@1+ (1.0,0.0) [0.0|1.0] "Unitless" FLRdpHPA,FLRdpHPB
 SG_ FLR2RdrDetn350To354DynPrpty1 : 157|1@1+ (1.0,0.0) [0.0|1.0] "Unitless" FLRdpHPA,FLRdpHPB
 SG_ FLR2RdrDetn350To354DynPrpty2 : 221|1@1+ (1.0,0.0) [0.0|1.0] "Unitless" FLRdpHPA,FLRdpHPB
 SG_ FLR2RdrDetn350To354DynPrpty3 : 285|1@1+ (1.0,0.0) [0.0|1.0] "Unitless" FLRdpHPA,FLRdpHPB
 SG_ FLR2RdrDetn350To354DynPrpty4 : 349|1@1+ (1.0,0.0) [0.0|1.0] "Unitless" FLRdpHPA,FLRdpHPB
 SG_ FLR2RdrDetn350To354EleAng0 : 64|8@1+ (0.002,0.0) [0.0|0.5] "rad" FLRdpHPA,FLRdpHPB
 SG_ FLR2RdrDetn350To354EleAng1 : 128|8@1+ (0.002,0.0) [0.0|0.5] "rad" FLRdpHPA,FLRdpHPB
 SG_ FLR2RdrDetn350To354EleAng2 : 192|8@1+ (0.002,0.0) [0.0|0.5] "rad" FLRdpHPA,FLRdpHPB
 SG_ FLR2RdrDetn350To354EleAng3 : 256|8@1+ (0.002,0.0) [0.0|0.5] "rad" FLRdpHPA,FLRdpHPB
 SG_ FLR2RdrDetn350To354EleAng4 : 320|8@1+ (0.002,0.0) [0.0|0.5] "rad" FLRdpHPA,FLRdpHPB
 SG_ FLR2RdrDetn350To354Mode0 : 60|2@1+ (1,0) [0|3] "" FLRdpHPA,FLRdpHPB
 SG_ FLR2RdrDetn350To354Mode1 : 124|2@1+ (1,0) [0|3] "" FLRdpHPA,FLRdpHPB
 SG_ FLR2RdrDetn350To354Mode2 : 188|2@1+ (1,0) [0|3] "" FLRdpHPA,FLRdpHPB
 SG_ FLR2RdrDetn350To354Mode3 : 252|2@1+ (1,0) [0|3] "" FLRdpHPA,FLRdpHPB
 SG_ FLR2RdrDetn350To354Mode4 : 316|2@1+ (1,0) [0|3] "" FLRdpHPA,FLRdpHPB
 SG_ FLR2RdrDetn350To354Quality0 : 62|2@1+ (1,0) [0|3] "" FLRdpHPA,FLRdpHPB
 SG_ FLR2RdrDetn350To354Quality1 : 126|2@1+ (1,0) [0|3] "" FLRdpHPA,FLRdpHPB
 SG_ FLR2RdrDetn350To354Quality2 : 190|2@1+ (1,0) [0|3] "" FLRdpHPA,FLRdpHPB
 SG_ FLR2RdrDetn350To354Quality3 : 254|2@1+ (1,0) [0|3] "" FLRdpHPA,FLRdpHPB
 SG_ FLR2RdrDetn350To354Quality4 : 318|2@1+ (1,0) [0|3] "" FLRdpHPA,FLRdpHPB
 SG_ FLR2RdrDetn350To354Range0 : 48|12@1+ (0.1,0.4) [0.4|300.0] "m" FLRdpHPA,FLRdpHPB
 SG_ FLR2RdrDetn350To354Range1 : 112|12@1+ (0.1,0.4) [0.4|300.0] "m" FLRdpHPA,FLRdpHPB
 SG_ FLR2RdrDetn350To354Range2 : 176|12@1+ (0.1,0.4) [0.4|300.0] "m" FLRdpHPA,FLRdpHPB
 SG_ FLR2RdrDetn350To354Range3 : 240|12@1+ (0.1,0.4) [0.4|300.0] "m" FLRdpHPA,FLRdpHPB
 SG_ FLR2RdrDetn350To354Range4 : 304|12@1+ (0.1,0.4) [0.4|300.0] "m" FLRdpHPA,FLRdpHPB
 SG_ FLR2RdrDetn350To354RCS0 : 83|10@1+ (0.2,-100.0) [-100.0|70.0] "dBsm" FLRdpHPA,FLRdpHPB
 SG_ FLR2RdrDetn350To354RCS1 : 147|10@1+ (0.2,-100.0) [-100.0|70.0] "dBsm" FLRdpHPA,FLRdpHPB
 SG_ FLR2RdrDetn350To354RCS2 : 211|10@1+ (0.2,-100.0) [-100.0|70.0] "dBsm" FLRdpHPA,FLRdpHPB
 SG_ FLR2RdrDetn350To354RCS3 : 275|10@1+ (0.2,-100.0) [-100.0|70.0] "dBsm" FLRdpHPA,FLRdpHPB
 SG_ FLR2RdrDetn350To354RCS4 : 339|10@1+ (0.2,-100.0) [-100.0|70.0] "dBsm" FLRdpHPA,FLRdpHPB
 SG_ FLR2RdrDetn350To354RngRt0 : 72|11@1+ (0.1,-111.11) [-111.11|55.59000000000002] "m/s" FLRdpHPA,FLRdpHPB
 SG_ FLR2RdrDetn350To354RngRt1 : 136|11@1+ (0.1,-111.11) [-111.11|55.59000000000002] "m/s" FLRdpHPA,FLRdpHPB
 SG_ FLR2RdrDetn350To354RngRt2 : 200|11@1+ (0.1,-111.11) [-111.11|55.59000000000002] "m/s" FLRdpHPA,FLRdpHPB
 SG_ FLR2RdrDetn350To354RngRt3 : 264|11@1+ (0.1,-111.11) [-111.11|55.59000000000002] "m/s" FLRdpHPA,FLRdpHPB
 SG_ FLR2RdrDetn350To354RngRt4 : 328|11@1+ (0.1,-111.11) [-111.11|55.59000000000002] "m/s" FLRdpHPA,FLRdpHPB
 SG_ FLR2RdrDetn350To354ScanID : 24|8@1+ (1.0,0.0) [0.0|255.0] "Unitless" FLRdpHPA,FLRdpHPB
 SG_ FLR2RdrDetn350To354SNR0 : 41|7@1+ (0.5,0.0) [0.0|63.5] "dB" FLRdpHPA,FLRdpHPB
 SG_ FLR2RdrDetn350To354SNR1 : 105|7@1+ (0.5,0.0) [0.0|63.5] "dB" FLRdpHPA,FLRdpHPB
 SG_ FLR2RdrDetn350To354SNR2 : 169|7@1+ (0.5,0.0) [0.0|63.5] "dB" FLRdpHPA,FLRdpHPB
 SG_ FLR2RdrDetn350To354SNR3 : 233|7@1+ (0.5,0.0) [0.0|63.5] "dB" FLRdpHPA,FLRdpHPB
 SG_ FLR2RdrDetn350To354SNR4 : 297|7@1+ (0.5,0.0) [0.0|63.5] "dB" FLRdpHPA,FLRdpHPB

BO_ 284 FlrFlr1canFr72 : 64 FLR
 SG_ FLR2RdrDetn355To359_UB : 359|1@0+ (1,0) [0|1] "" FLRdpHPA,FLRdpHPB
 SG_ FLR2RdrDetn355To359AziAng0 : 32|9@1+ (0.0035,-0.87266) [-0.87266|0.91584] "rad" FLRdpHPA,FLRdpHPB
 SG_ FLR2RdrDetn355To359AziAng1 : 96|9@1+ (0.0035,-0.87266) [-0.87266|0.91584] "rad" FLRdpHPA,FLRdpHPB
 SG_ FLR2RdrDetn355To359AziAng2 : 160|9@1+ (0.0035,-0.87266) [-0.87266|0.91584] "rad" FLRdpHPA,FLRdpHPB
 SG_ FLR2RdrDetn355To359AziAng3 : 224|9@1+ (0.0035,-0.87266) [-0.87266|0.91584] "rad" FLRdpHPA,FLRdpHPB
 SG_ FLR2RdrDetn355To359AziAng4 : 288|9@1+ (0.0035,-0.87266) [-0.87266|0.91584] "rad" FLRdpHPA,FLRdpHPB
 SG_ FLR2RdrDetn355To359Counter : 16|8@1+ (1.0,0.0) [0.0|255.0] "Unitless" FLRdpHPA,FLRdpHPB
 SG_ FLR2RdrDetn355To359CRC : 0|16@1+ (1.0,0.0) [0.0|65535.0] "Unitless" FLRdpHPA,FLRdpHPB
 SG_ FLR2RdrDetn355To359DynPrpty0 : 93|1@1+ (1.0,0.0) [0.0|1.0] "Unitless" FLRdpHPA,FLRdpHPB
 SG_ FLR2RdrDetn355To359DynPrpty1 : 157|1@1+ (1.0,0.0) [0.0|1.0] "Unitless" FLRdpHPA,FLRdpHPB
 SG_ FLR2RdrDetn355To359DynPrpty2 : 221|1@1+ (1.0,0.0) [0.0|1.0] "Unitless" FLRdpHPA,FLRdpHPB
 SG_ FLR2RdrDetn355To359DynPrpty3 : 285|1@1+ (1.0,0.0) [0.0|1.0] "Unitless" FLRdpHPA,FLRdpHPB
 SG_ FLR2RdrDetn355To359DynPrpty4 : 349|1@1+ (1.0,0.0) [0.0|1.0] "Unitless" FLRdpHPA,FLRdpHPB
 SG_ FLR2RdrDetn355To359EleAng0 : 64|8@1+ (0.002,0.0) [0.0|0.5] "rad" FLRdpHPA,FLRdpHPB
 SG_ FLR2RdrDetn355To359EleAng1 : 128|8@1+ (0.002,0.0) [0.0|0.5] "rad" FLRdpHPA,FLRdpHPB
 SG_ FLR2RdrDetn355To359EleAng2 : 192|8@1+ (0.002,0.0) [0.0|0.5] "rad" FLRdpHPA,FLRdpHPB
 SG_ FLR2RdrDetn355To359EleAng3 : 256|8@1+ (0.002,0.0) [0.0|0.5] "rad" FLRdpHPA,FLRdpHPB
 SG_ FLR2RdrDetn355To359EleAng4 : 320|8@1+ (0.002,0.0) [0.0|0.5] "rad" FLRdpHPA,FLRdpHPB
 SG_ FLR2RdrDetn355To359Mode0 : 60|2@1+ (1,0) [0|3] "" FLRdpHPA,FLRdpHPB
 SG_ FLR2RdrDetn355To359Mode1 : 124|2@1+ (1,0) [0|3] "" FLRdpHPA,FLRdpHPB
 SG_ FLR2RdrDetn355To359Mode2 : 188|2@1+ (1,0) [0|3] "" FLRdpHPA,FLRdpHPB
 SG_ FLR2RdrDetn355To359Mode3 : 252|2@1+ (1,0) [0|3] "" FLRdpHPA,FLRdpHPB
 SG_ FLR2RdrDetn355To359Mode4 : 316|2@1+ (1,0) [0|3] "" FLRdpHPA,FLRdpHPB
 SG_ FLR2RdrDetn355To359Quality0 : 62|2@1+ (1,0) [0|3] "" FLRdpHPA,FLRdpHPB
 SG_ FLR2RdrDetn355To359Quality1 : 126|2@1+ (1,0) [0|3] "" FLRdpHPA,FLRdpHPB
 SG_ FLR2RdrDetn355To359Quality2 : 190|2@1+ (1,0) [0|3] "" FLRdpHPA,FLRdpHPB
 SG_ FLR2RdrDetn355To359Quality3 : 254|2@1+ (1,0) [0|3] "" FLRdpHPA,FLRdpHPB
 SG_ FLR2RdrDetn355To359Quality4 : 318|2@1+ (1,0) [0|3] "" FLRdpHPA,FLRdpHPB
 SG_ FLR2RdrDetn355To359Range0 : 48|12@1+ (0.1,0.4) [0.4|300.0] "m" FLRdpHPA,FLRdpHPB
 SG_ FLR2RdrDetn355To359Range1 : 112|12@1+ (0.1,0.4) [0.4|300.0] "m" FLRdpHPA,FLRdpHPB
 SG_ FLR2RdrDetn355To359Range2 : 176|12@1+ (0.1,0.4) [0.4|300.0] "m" FLRdpHPA,FLRdpHPB
 SG_ FLR2RdrDetn355To359Range3 : 240|12@1+ (0.1,0.4) [0.4|300.0] "m" FLRdpHPA,FLRdpHPB
 SG_ FLR2RdrDetn355To359Range4 : 304|12@1+ (0.1,0.4) [0.4|300.0] "m" FLRdpHPA,FLRdpHPB
 SG_ FLR2RdrDetn355To359RCS0 : 83|10@1+ (0.2,-100.0) [-100.0|70.0] "dBsm" FLRdpHPA,FLRdpHPB
 SG_ FLR2RdrDetn355To359RCS1 : 147|10@1+ (0.2,-100.0) [-100.0|70.0] "dBsm" FLRdpHPA,FLRdpHPB
 SG_ FLR2RdrDetn355To359RCS2 : 211|10@1+ (0.2,-100.0) [-100.0|70.0] "dBsm" FLRdpHPA,FLRdpHPB
 SG_ FLR2RdrDetn355To359RCS3 : 275|10@1+ (0.2,-100.0) [-100.0|70.0] "dBsm" FLRdpHPA,FLRdpHPB
 SG_ FLR2RdrDetn355To359RCS4 : 339|10@1+ (0.2,-100.0) [-100.0|70.0] "dBsm" FLRdpHPA,FLRdpHPB
 SG_ FLR2RdrDetn355To359RngRt0 : 72|11@1+ (0.1,-111.11) [-111.11|55.59000000000002] "m/s" FLRdpHPA,FLRdpHPB
 SG_ FLR2RdrDetn355To359RngRt1 : 136|11@1+ (0.1,-111.11) [-111.11|55.59000000000002] "m/s" FLRdpHPA,FLRdpHPB
 SG_ FLR2RdrDetn355To359RngRt2 : 200|11@1+ (0.1,-111.11) [-111.11|55.59000000000002] "m/s" FLRdpHPA,FLRdpHPB
 SG_ FLR2RdrDetn355To359RngRt3 : 264|11@1+ (0.1,-111.11) [-111.11|55.59000000000002] "m/s" FLRdpHPA,FLRdpHPB
 SG_ FLR2RdrDetn355To359RngRt4 : 328|11@1+ (0.1,-111.11) [-111.11|55.59000000000002] "m/s" FLRdpHPA,FLRdpHPB
 SG_ FLR2RdrDetn355To359ScanID : 24|8@1+ (1.0,0.0) [0.0|255.0] "Unitless" FLRdpHPA,FLRdpHPB
 SG_ FLR2RdrDetn355To359SNR0 : 41|7@1+ (0.5,0.0) [0.0|63.5] "dB" FLRdpHPA,FLRdpHPB
 SG_ FLR2RdrDetn355To359SNR1 : 105|7@1+ (0.5,0.0) [0.0|63.5] "dB" FLRdpHPA,FLRdpHPB
 SG_ FLR2RdrDetn355To359SNR2 : 169|7@1+ (0.5,0.0) [0.0|63.5] "dB" FLRdpHPA,FLRdpHPB
 SG_ FLR2RdrDetn355To359SNR3 : 233|7@1+ (0.5,0.0) [0.0|63.5] "dB" FLRdpHPA,FLRdpHPB
 SG_ FLR2RdrDetn355To359SNR4 : 297|7@1+ (0.5,0.0) [0.0|63.5] "dB" FLRdpHPA,FLRdpHPB

BO_ 286 FlrFlr1canFr73 : 64 FLR
 SG_ FLR2RdrDetn360To364_UB : 359|1@0+ (1,0) [0|1] "" FLRdpHPA,FLRdpHPB
 SG_ FLR2RdrDetn360To364AziAng0 : 32|9@1+ (0.0035,-0.87266) [-0.87266|0.91584] "rad" FLRdpHPA,FLRdpHPB
 SG_ FLR2RdrDetn360To364AziAng1 : 96|9@1+ (0.0035,-0.87266) [-0.87266|0.91584] "rad" FLRdpHPA,FLRdpHPB
 SG_ FLR2RdrDetn360To364AziAng2 : 160|9@1+ (0.0035,-0.87266) [-0.87266|0.91584] "rad" FLRdpHPA,FLRdpHPB
 SG_ FLR2RdrDetn360To364AziAng3 : 224|9@1+ (0.0035,-0.87266) [-0.87266|0.91584] "rad" FLRdpHPA,FLRdpHPB
 SG_ FLR2RdrDetn360To364AziAng4 : 288|9@1+ (0.0035,-0.87266) [-0.87266|0.91584] "rad" FLRdpHPA,FLRdpHPB
 SG_ FLR2RdrDetn360To364Counter : 16|8@1+ (1.0,0.0) [0.0|255.0] "Unitless" FLRdpHPA,FLRdpHPB
 SG_ FLR2RdrDetn360To364CRC : 0|16@1+ (1.0,0.0) [0.0|65535.0] "Unitless" FLRdpHPA,FLRdpHPB
 SG_ FLR2RdrDetn360To364DynPrpty0 : 93|1@1+ (1.0,0.0) [0.0|1.0] "Unitless" FLRdpHPA,FLRdpHPB
 SG_ FLR2RdrDetn360To364DynPrpty1 : 157|1@1+ (1.0,0.0) [0.0|1.0] "Unitless" FLRdpHPA,FLRdpHPB
 SG_ FLR2RdrDetn360To364DynPrpty2 : 221|1@1+ (1.0,0.0) [0.0|1.0] "Unitless" FLRdpHPA,FLRdpHPB
 SG_ FLR2RdrDetn360To364DynPrpty3 : 285|1@1+ (1.0,0.0) [0.0|1.0] "Unitless" FLRdpHPA,FLRdpHPB
 SG_ FLR2RdrDetn360To364DynPrpty4 : 349|1@1+ (1.0,0.0) [0.0|1.0] "Unitless" FLRdpHPA,FLRdpHPB
 SG_ FLR2RdrDetn360To364EleAng0 : 64|8@1+ (0.002,0.0) [0.0|0.5] "rad" FLRdpHPA,FLRdpHPB
 SG_ FLR2RdrDetn360To364EleAng1 : 128|8@1+ (0.002,0.0) [0.0|0.5] "rad" FLRdpHPA,FLRdpHPB
 SG_ FLR2RdrDetn360To364EleAng2 : 192|8@1+ (0.002,0.0) [0.0|0.5] "rad" FLRdpHPA,FLRdpHPB
 SG_ FLR2RdrDetn360To364EleAng3 : 256|8@1+ (0.002,0.0) [0.0|0.5] "rad" FLRdpHPA,FLRdpHPB
 SG_ FLR2RdrDetn360To364EleAng4 : 320|8@1+ (0.002,0.0) [0.0|0.5] "rad" FLRdpHPA,FLRdpHPB
 SG_ FLR2RdrDetn360To364Mode0 : 60|2@1+ (1,0) [0|3] "" FLRdpHPA,FLRdpHPB
 SG_ FLR2RdrDetn360To364Mode1 : 124|2@1+ (1,0) [0|3] "" FLRdpHPA,FLRdpHPB
 SG_ FLR2RdrDetn360To364Mode2 : 188|2@1+ (1,0) [0|3] "" FLRdpHPA,FLRdpHPB
 SG_ FLR2RdrDetn360To364Mode3 : 252|2@1+ (1,0) [0|3] "" FLRdpHPA,FLRdpHPB
 SG_ FLR2RdrDetn360To364Mode4 : 316|2@1+ (1,0) [0|3] "" FLRdpHPA,FLRdpHPB
 SG_ FLR2RdrDetn360To364Quality0 : 62|2@1+ (1,0) [0|3] "" FLRdpHPA,FLRdpHPB
 SG_ FLR2RdrDetn360To364Quality1 : 126|2@1+ (1,0) [0|3] "" FLRdpHPA,FLRdpHPB
 SG_ FLR2RdrDetn360To364Quality2 : 190|2@1+ (1,0) [0|3] "" FLRdpHPA,FLRdpHPB
 SG_ FLR2RdrDetn360To364Quality3 : 254|2@1+ (1,0) [0|3] "" FLRdpHPA,FLRdpHPB
 SG_ FLR2RdrDetn360To364Quality4 : 318|2@1+ (1,0) [0|3] "" FLRdpHPA,FLRdpHPB
 SG_ FLR2RdrDetn360To364Range0 : 48|12@1+ (0.1,0.4) [0.4|300.0] "m" FLRdpHPA,FLRdpHPB
 SG_ FLR2RdrDetn360To364Range1 : 112|12@1+ (0.1,0.4) [0.4|300.0] "m" FLRdpHPA,FLRdpHPB
 SG_ FLR2RdrDetn360To364Range2 : 176|12@1+ (0.1,0.4) [0.4|300.0] "m" FLRdpHPA,FLRdpHPB
 SG_ FLR2RdrDetn360To364Range3 : 240|12@1+ (0.1,0.4) [0.4|300.0] "m" FLRdpHPA,FLRdpHPB
 SG_ FLR2RdrDetn360To364Range4 : 304|12@1+ (0.1,0.4) [0.4|300.0] "m" FLRdpHPA,FLRdpHPB
 SG_ FLR2RdrDetn360To364RCS0 : 83|10@1+ (0.2,-100.0) [-100.0|70.0] "dBsm" FLRdpHPA,FLRdpHPB
 SG_ FLR2RdrDetn360To364RCS1 : 147|10@1+ (0.2,-100.0) [-100.0|70.0] "dBsm" FLRdpHPA,FLRdpHPB
 SG_ FLR2RdrDetn360To364RCS2 : 211|10@1+ (0.2,-100.0) [-100.0|70.0] "dBsm" FLRdpHPA,FLRdpHPB
 SG_ FLR2RdrDetn360To364RCS3 : 275|10@1+ (0.2,-100.0) [-100.0|70.0] "dBsm" FLRdpHPA,FLRdpHPB
 SG_ FLR2RdrDetn360To364RCS4 : 339|10@1+ (0.2,-100.0) [-100.0|70.0] "dBsm" FLRdpHPA,FLRdpHPB
 SG_ FLR2RdrDetn360To364RngRt0 : 72|11@1+ (0.1,-111.11) [-111.11|55.59000000000002] "m/s" FLRdpHPA,FLRdpHPB
 SG_ FLR2RdrDetn360To364RngRt1 : 136|11@1+ (0.1,-111.11) [-111.11|55.59000000000002] "m/s" FLRdpHPA,FLRdpHPB
 SG_ FLR2RdrDetn360To364RngRt2 : 200|11@1+ (0.1,-111.11) [-111.11|55.59000000000002] "m/s" FLRdpHPA,FLRdpHPB
 SG_ FLR2RdrDetn360To364RngRt3 : 264|11@1+ (0.1,-111.11) [-111.11|55.59000000000002] "m/s" FLRdpHPA,FLRdpHPB
 SG_ FLR2RdrDetn360To364RngRt4 : 328|11@1+ (0.1,-111.11) [-111.11|55.59000000000002] "m/s" FLRdpHPA,FLRdpHPB
 SG_ FLR2RdrDetn360To364ScanID : 24|8@1+ (1.0,0.0) [0.0|255.0] "Unitless" FLRdpHPA,FLRdpHPB
 SG_ FLR2RdrDetn360To364SNR0 : 41|7@1+ (0.5,0.0) [0.0|63.5] "dB" FLRdpHPA,FLRdpHPB
 SG_ FLR2RdrDetn360To364SNR1 : 105|7@1+ (0.5,0.0) [0.0|63.5] "dB" FLRdpHPA,FLRdpHPB
 SG_ FLR2RdrDetn360To364SNR2 : 169|7@1+ (0.5,0.0) [0.0|63.5] "dB" FLRdpHPA,FLRdpHPB
 SG_ FLR2RdrDetn360To364SNR3 : 233|7@1+ (0.5,0.0) [0.0|63.5] "dB" FLRdpHPA,FLRdpHPB
 SG_ FLR2RdrDetn360To364SNR4 : 297|7@1+ (0.5,0.0) [0.0|63.5] "dB" FLRdpHPA,FLRdpHPB

BO_ 288 FlrFlr1canFr74 : 64 FLR
 SG_ FLR2RdrDetn365To369_UB : 359|1@0+ (1,0) [0|1] "" FLRdpHPA,FLRdpHPB
 SG_ FLR2RdrDetn365To369AziAng0 : 32|9@1+ (0.0035,-0.87266) [-0.87266|0.91584] "rad" FLRdpHPA,FLRdpHPB
 SG_ FLR2RdrDetn365To369AziAng1 : 96|9@1+ (0.0035,-0.87266) [-0.87266|0.91584] "rad" FLRdpHPA,FLRdpHPB
 SG_ FLR2RdrDetn365To369AziAng2 : 160|9@1+ (0.0035,-0.87266) [-0.87266|0.91584] "rad" FLRdpHPA,FLRdpHPB
 SG_ FLR2RdrDetn365To369AziAng3 : 224|9@1+ (0.0035,-0.87266) [-0.87266|0.91584] "rad" FLRdpHPA,FLRdpHPB
 SG_ FLR2RdrDetn365To369AziAng4 : 288|9@1+ (0.0035,-0.87266) [-0.87266|0.91584] "rad" FLRdpHPA,FLRdpHPB
 SG_ FLR2RdrDetn365To369Counter : 16|8@1+ (1.0,0.0) [0.0|255.0] "Unitless" FLRdpHPA,FLRdpHPB
 SG_ FLR2RdrDetn365To369CRC : 0|16@1+ (1.0,0.0) [0.0|65535.0] "Unitless" FLRdpHPA,FLRdpHPB
 SG_ FLR2RdrDetn365To369DynPrpty0 : 93|1@1+ (1.0,0.0) [0.0|1.0] "Unitless" FLRdpHPA,FLRdpHPB
 SG_ FLR2RdrDetn365To369DynPrpty1 : 157|1@1+ (1.0,0.0) [0.0|1.0] "Unitless" FLRdpHPA,FLRdpHPB
 SG_ FLR2RdrDetn365To369DynPrpty2 : 221|1@1+ (1.0,0.0) [0.0|1.0] "Unitless" FLRdpHPA,FLRdpHPB
 SG_ FLR2RdrDetn365To369DynPrpty3 : 285|1@1+ (1.0,0.0) [0.0|1.0] "Unitless" FLRdpHPA,FLRdpHPB
 SG_ FLR2RdrDetn365To369DynPrpty4 : 349|1@1+ (1.0,0.0) [0.0|1.0] "Unitless" FLRdpHPA,FLRdpHPB
 SG_ FLR2RdrDetn365To369EleAng0 : 64|8@1+ (0.002,0.0) [0.0|0.5] "rad" FLRdpHPA,FLRdpHPB
 SG_ FLR2RdrDetn365To369EleAng1 : 128|8@1+ (0.002,0.0) [0.0|0.5] "rad" FLRdpHPA,FLRdpHPB
 SG_ FLR2RdrDetn365To369EleAng2 : 192|8@1+ (0.002,0.0) [0.0|0.5] "rad" FLRdpHPA,FLRdpHPB
 SG_ FLR2RdrDetn365To369EleAng3 : 256|8@1+ (0.002,0.0) [0.0|0.5] "rad" FLRdpHPA,FLRdpHPB
 SG_ FLR2RdrDetn365To369EleAng4 : 320|8@1+ (0.002,0.0) [0.0|0.5] "rad" FLRdpHPA,FLRdpHPB
 SG_ FLR2RdrDetn365To369Mode0 : 60|2@1+ (1,0) [0|3] "" FLRdpHPA,FLRdpHPB
 SG_ FLR2RdrDetn365To369Mode1 : 124|2@1+ (1,0) [0|3] "" FLRdpHPA,FLRdpHPB
 SG_ FLR2RdrDetn365To369Mode2 : 188|2@1+ (1,0) [0|3] "" FLRdpHPA,FLRdpHPB
 SG_ FLR2RdrDetn365To369Mode3 : 252|2@1+ (1,0) [0|3] "" FLRdpHPA,FLRdpHPB
 SG_ FLR2RdrDetn365To369Mode4 : 316|2@1+ (1,0) [0|3] "" FLRdpHPA,FLRdpHPB
 SG_ FLR2RdrDetn365To369Quality0 : 62|2@1+ (1,0) [0|3] "" FLRdpHPA,FLRdpHPB
 SG_ FLR2RdrDetn365To369Quality1 : 126|2@1+ (1,0) [0|3] "" FLRdpHPA,FLRdpHPB
 SG_ FLR2RdrDetn365To369Quality2 : 190|2@1+ (1,0) [0|3] "" FLRdpHPA,FLRdpHPB
 SG_ FLR2RdrDetn365To369Quality3 : 254|2@1+ (1,0) [0|3] "" FLRdpHPA,FLRdpHPB
 SG_ FLR2RdrDetn365To369Quality4 : 318|2@1+ (1,0) [0|3] "" FLRdpHPA,FLRdpHPB
 SG_ FLR2RdrDetn365To369Range0 : 48|12@1+ (0.1,0.4) [0.4|300.0] "m" FLRdpHPA,FLRdpHPB
 SG_ FLR2RdrDetn365To369Range1 : 112|12@1+ (0.1,0.4) [0.4|300.0] "m" FLRdpHPA,FLRdpHPB
 SG_ FLR2RdrDetn365To369Range2 : 176|12@1+ (0.1,0.4) [0.4|300.0] "m" FLRdpHPA,FLRdpHPB
 SG_ FLR2RdrDetn365To369Range3 : 240|12@1+ (0.1,0.4) [0.4|300.0] "m" FLRdpHPA,FLRdpHPB
 SG_ FLR2RdrDetn365To369Range4 : 304|12@1+ (0.1,0.4) [0.4|300.0] "m" FLRdpHPA,FLRdpHPB
 SG_ FLR2RdrDetn365To369RCS0 : 83|10@1+ (0.2,-100.0) [-100.0|70.0] "dBsm" FLRdpHPA,FLRdpHPB
 SG_ FLR2RdrDetn365To369RCS1 : 147|10@1+ (0.2,-100.0) [-100.0|70.0] "dBsm" FLRdpHPA,FLRdpHPB
 SG_ FLR2RdrDetn365To369RCS2 : 211|10@1+ (0.2,-100.0) [-100.0|70.0] "dBsm" FLRdpHPA,FLRdpHPB
 SG_ FLR2RdrDetn365To369RCS3 : 275|10@1+ (0.2,-100.0) [-100.0|70.0] "dBsm" FLRdpHPA,FLRdpHPB
 SG_ FLR2RdrDetn365To369RCS4 : 339|10@1+ (0.2,-100.0) [-100.0|70.0] "dBsm" FLRdpHPA,FLRdpHPB
 SG_ FLR2RdrDetn365To369RngRt0 : 72|11@1+ (0.1,-111.11) [-111.11|55.59000000000002] "m/s" FLRdpHPA,FLRdpHPB
 SG_ FLR2RdrDetn365To369RngRt1 : 136|11@1+ (0.1,-111.11) [-111.11|55.59000000000002] "m/s" FLRdpHPA,FLRdpHPB
 SG_ FLR2RdrDetn365To369RngRt2 : 200|11@1+ (0.1,-111.11) [-111.11|55.59000000000002] "m/s" FLRdpHPA,FLRdpHPB
 SG_ FLR2RdrDetn365To369RngRt3 : 264|11@1+ (0.1,-111.11) [-111.11|55.59000000000002] "m/s" FLRdpHPA,FLRdpHPB
 SG_ FLR2RdrDetn365To369RngRt4 : 328|11@1+ (0.1,-111.11) [-111.11|55.59000000000002] "m/s" FLRdpHPA,FLRdpHPB
 SG_ FLR2RdrDetn365To369ScanID : 24|8@1+ (1.0,0.0) [0.0|255.0] "Unitless" FLRdpHPA,FLRdpHPB
 SG_ FLR2RdrDetn365To369SNR0 : 41|7@1+ (0.5,0.0) [0.0|63.5] "dB" FLRdpHPA,FLRdpHPB
 SG_ FLR2RdrDetn365To369SNR1 : 105|7@1+ (0.5,0.0) [0.0|63.5] "dB" FLRdpHPA,FLRdpHPB
 SG_ FLR2RdrDetn365To369SNR2 : 169|7@1+ (0.5,0.0) [0.0|63.5] "dB" FLRdpHPA,FLRdpHPB
 SG_ FLR2RdrDetn365To369SNR3 : 233|7@1+ (0.5,0.0) [0.0|63.5] "dB" FLRdpHPA,FLRdpHPB
 SG_ FLR2RdrDetn365To369SNR4 : 297|7@1+ (0.5,0.0) [0.0|63.5] "dB" FLRdpHPA,FLRdpHPB

BO_ 290 FlrFlr1canFr75 : 64 FLR
 SG_ FLR2RdrDetn370To374_UB : 359|1@0+ (1,0) [0|1] "" FLRdpHPA,FLRdpHPB
 SG_ FLR2RdrDetn370To374AziAng0 : 32|9@1+ (0.0035,-0.87266) [-0.87266|0.91584] "rad" FLRdpHPA,FLRdpHPB
 SG_ FLR2RdrDetn370To374AziAng1 : 96|9@1+ (0.0035,-0.87266) [-0.87266|0.91584] "rad" FLRdpHPA,FLRdpHPB
 SG_ FLR2RdrDetn370To374AziAng2 : 160|9@1+ (0.0035,-0.87266) [-0.87266|0.91584] "rad" FLRdpHPA,FLRdpHPB
 SG_ FLR2RdrDetn370To374AziAng3 : 224|9@1+ (0.0035,-0.87266) [-0.87266|0.91584] "rad" FLRdpHPA,FLRdpHPB
 SG_ FLR2RdrDetn370To374AziAng4 : 288|9@1+ (0.0035,-0.87266) [-0.87266|0.91584] "rad" FLRdpHPA,FLRdpHPB
 SG_ FLR2RdrDetn370To374Counter : 16|8@1+ (1.0,0.0) [0.0|255.0] "Unitless" FLRdpHPA,FLRdpHPB
 SG_ FLR2RdrDetn370To374CRC : 0|16@1+ (1.0,0.0) [0.0|65535.0] "Unitless" FLRdpHPA,FLRdpHPB
 SG_ FLR2RdrDetn370To374DynPrpty0 : 93|1@1+ (1.0,0.0) [0.0|1.0] "Unitless" FLRdpHPA,FLRdpHPB
 SG_ FLR2RdrDetn370To374DynPrpty1 : 157|1@1+ (1.0,0.0) [0.0|1.0] "Unitless" FLRdpHPA,FLRdpHPB
 SG_ FLR2RdrDetn370To374DynPrpty2 : 221|1@1+ (1.0,0.0) [0.0|1.0] "Unitless" FLRdpHPA,FLRdpHPB
 SG_ FLR2RdrDetn370To374DynPrpty3 : 285|1@1+ (1.0,0.0) [0.0|1.0] "Unitless" FLRdpHPA,FLRdpHPB
 SG_ FLR2RdrDetn370To374DynPrpty4 : 349|1@1+ (1.0,0.0) [0.0|1.0] "Unitless" FLRdpHPA,FLRdpHPB
 SG_ FLR2RdrDetn370To374EleAng0 : 64|8@1+ (0.002,0.0) [0.0|0.5] "rad" FLRdpHPA,FLRdpHPB
 SG_ FLR2RdrDetn370To374EleAng1 : 128|8@1+ (0.002,0.0) [0.0|0.5] "rad" FLRdpHPA,FLRdpHPB
 SG_ FLR2RdrDetn370To374EleAng2 : 192|8@1+ (0.002,0.0) [0.0|0.5] "rad" FLRdpHPA,FLRdpHPB
 SG_ FLR2RdrDetn370To374EleAng3 : 256|8@1+ (0.002,0.0) [0.0|0.5] "rad" FLRdpHPA,FLRdpHPB
 SG_ FLR2RdrDetn370To374EleAng4 : 320|8@1+ (0.002,0.0) [0.0|0.5] "rad" FLRdpHPA,FLRdpHPB
 SG_ FLR2RdrDetn370To374Mode0 : 60|2@1+ (1,0) [0|3] "" FLRdpHPA,FLRdpHPB
 SG_ FLR2RdrDetn370To374Mode1 : 124|2@1+ (1,0) [0|3] "" FLRdpHPA,FLRdpHPB
 SG_ FLR2RdrDetn370To374Mode2 : 188|2@1+ (1,0) [0|3] "" FLRdpHPA,FLRdpHPB
 SG_ FLR2RdrDetn370To374Mode3 : 252|2@1+ (1,0) [0|3] "" FLRdpHPA,FLRdpHPB
 SG_ FLR2RdrDetn370To374Mode4 : 316|2@1+ (1,0) [0|3] "" FLRdpHPA,FLRdpHPB
 SG_ FLR2RdrDetn370To374Quality0 : 62|2@1+ (1,0) [0|3] "" FLRdpHPA,FLRdpHPB
 SG_ FLR2RdrDetn370To374Quality1 : 126|2@1+ (1,0) [0|3] "" FLRdpHPA,FLRdpHPB
 SG_ FLR2RdrDetn370To374Quality2 : 190|2@1+ (1,0) [0|3] "" FLRdpHPA,FLRdpHPB
 SG_ FLR2RdrDetn370To374Quality3 : 254|2@1+ (1,0) [0|3] "" FLRdpHPA,FLRdpHPB
 SG_ FLR2RdrDetn370To374Quality4 : 318|2@1+ (1,0) [0|3] "" FLRdpHPA,FLRdpHPB
 SG_ FLR2RdrDetn370To374Range0 : 48|12@1+ (0.1,0.4) [0.4|300.0] "m" FLRdpHPA,FLRdpHPB
 SG_ FLR2RdrDetn370To374Range1 : 112|12@1+ (0.1,0.4) [0.4|300.0] "m" FLRdpHPA,FLRdpHPB
 SG_ FLR2RdrDetn370To374Range2 : 176|12@1+ (0.1,0.4) [0.4|300.0] "m" FLRdpHPA,FLRdpHPB
 SG_ FLR2RdrDetn370To374Range3 : 240|12@1+ (0.1,0.4) [0.4|300.0] "m" FLRdpHPA,FLRdpHPB
 SG_ FLR2RdrDetn370To374Range4 : 304|12@1+ (0.1,0.4) [0.4|300.0] "m" FLRdpHPA,FLRdpHPB
 SG_ FLR2RdrDetn370To374RCS0 : 83|10@1+ (0.2,-100.0) [-100.0|70.0] "dBsm" FLRdpHPA,FLRdpHPB
 SG_ FLR2RdrDetn370To374RCS1 : 147|10@1+ (0.2,-100.0) [-100.0|70.0] "dBsm" FLRdpHPA,FLRdpHPB
 SG_ FLR2RdrDetn370To374RCS2 : 211|10@1+ (0.2,-100.0) [-100.0|70.0] "dBsm" FLRdpHPA,FLRdpHPB
 SG_ FLR2RdrDetn370To374RCS3 : 275|10@1+ (0.2,-100.0) [-100.0|70.0] "dBsm" FLRdpHPA,FLRdpHPB
 SG_ FLR2RdrDetn370To374RCS4 : 339|10@1+ (0.2,-100.0) [-100.0|70.0] "dBsm" FLRdpHPA,FLRdpHPB
 SG_ FLR2RdrDetn370To374RngRt0 : 72|11@1+ (0.1,-111.11) [-111.11|55.59000000000002] "m/s" FLRdpHPA,FLRdpHPB
 SG_ FLR2RdrDetn370To374RngRt1 : 136|11@1+ (0.1,-111.11) [-111.11|55.59000000000002] "m/s" FLRdpHPA,FLRdpHPB
 SG_ FLR2RdrDetn370To374RngRt2 : 200|11@1+ (0.1,-111.11) [-111.11|55.59000000000002] "m/s" FLRdpHPA,FLRdpHPB
 SG_ FLR2RdrDetn370To374RngRt3 : 264|11@1+ (0.1,-111.11) [-111.11|55.59000000000002] "m/s" FLRdpHPA,FLRdpHPB
 SG_ FLR2RdrDetn370To374RngRt4 : 328|11@1+ (0.1,-111.11) [-111.11|55.59000000000002] "m/s" FLRdpHPA,FLRdpHPB
 SG_ FLR2RdrDetn370To374ScanID : 24|8@1+ (1.0,0.0) [0.0|255.0] "Unitless" FLRdpHPA,FLRdpHPB
 SG_ FLR2RdrDetn370To374SNR0 : 41|7@1+ (0.5,0.0) [0.0|63.5] "dB" FLRdpHPA,FLRdpHPB
 SG_ FLR2RdrDetn370To374SNR1 : 105|7@1+ (0.5,0.0) [0.0|63.5] "dB" FLRdpHPA,FLRdpHPB
 SG_ FLR2RdrDetn370To374SNR2 : 169|7@1+ (0.5,0.0) [0.0|63.5] "dB" FLRdpHPA,FLRdpHPB
 SG_ FLR2RdrDetn370To374SNR3 : 233|7@1+ (0.5,0.0) [0.0|63.5] "dB" FLRdpHPA,FLRdpHPB
 SG_ FLR2RdrDetn370To374SNR4 : 297|7@1+ (0.5,0.0) [0.0|63.5] "dB" FLRdpHPA,FLRdpHPB

BO_ 292 FlrFlr1canFr76 : 64 FLR
 SG_ FLR2RdrDetn375To379_UB : 359|1@0+ (1,0) [0|1] "" FLRdpHPA,FLRdpHPB
 SG_ FLR2RdrDetn375To379AziAng0 : 32|9@1+ (0.0035,-0.87266) [-0.87266|0.91584] "rad" FLRdpHPA,FLRdpHPB
 SG_ FLR2RdrDetn375To379AziAng1 : 96|9@1+ (0.0035,-0.87266) [-0.87266|0.91584] "rad" FLRdpHPA,FLRdpHPB
 SG_ FLR2RdrDetn375To379AziAng2 : 160|9@1+ (0.0035,-0.87266) [-0.87266|0.91584] "rad" FLRdpHPA,FLRdpHPB
 SG_ FLR2RdrDetn375To379AziAng3 : 224|9@1+ (0.0035,-0.87266) [-0.87266|0.91584] "rad" FLRdpHPA,FLRdpHPB
 SG_ FLR2RdrDetn375To379AziAng4 : 288|9@1+ (0.0035,-0.87266) [-0.87266|0.91584] "rad" FLRdpHPA,FLRdpHPB
 SG_ FLR2RdrDetn375To379Counter : 16|8@1+ (1.0,0.0) [0.0|255.0] "Unitless" FLRdpHPA,FLRdpHPB
 SG_ FLR2RdrDetn375To379CRC : 0|16@1+ (1.0,0.0) [0.0|65535.0] "Unitless" FLRdpHPA,FLRdpHPB
 SG_ FLR2RdrDetn375To379DynPrpty0 : 93|1@1+ (1.0,0.0) [0.0|1.0] "Unitless" FLRdpHPA,FLRdpHPB
 SG_ FLR2RdrDetn375To379DynPrpty1 : 157|1@1+ (1.0,0.0) [0.0|1.0] "Unitless" FLRdpHPA,FLRdpHPB
 SG_ FLR2RdrDetn375To379DynPrpty2 : 221|1@1+ (1.0,0.0) [0.0|1.0] "Unitless" FLRdpHPA,FLRdpHPB
 SG_ FLR2RdrDetn375To379DynPrpty3 : 285|1@1+ (1.0,0.0) [0.0|1.0] "Unitless" FLRdpHPA,FLRdpHPB
 SG_ FLR2RdrDetn375To379DynPrpty4 : 349|1@1+ (1.0,0.0) [0.0|1.0] "Unitless" FLRdpHPA,FLRdpHPB
 SG_ FLR2RdrDetn375To379EleAng0 : 64|8@1+ (0.002,0.0) [0.0|0.5] "rad" FLRdpHPA,FLRdpHPB
 SG_ FLR2RdrDetn375To379EleAng1 : 128|8@1+ (0.002,0.0) [0.0|0.5] "rad" FLRdpHPA,FLRdpHPB
 SG_ FLR2RdrDetn375To379EleAng2 : 192|8@1+ (0.002,0.0) [0.0|0.5] "rad" FLRdpHPA,FLRdpHPB
 SG_ FLR2RdrDetn375To379EleAng3 : 256|8@1+ (0.002,0.0) [0.0|0.5] "rad" FLRdpHPA,FLRdpHPB
 SG_ FLR2RdrDetn375To379EleAng4 : 320|8@1+ (0.002,0.0) [0.0|0.5] "rad" FLRdpHPA,FLRdpHPB
 SG_ FLR2RdrDetn375To379Mode0 : 60|2@1+ (1,0) [0|3] "" FLRdpHPA,FLRdpHPB
 SG_ FLR2RdrDetn375To379Mode1 : 124|2@1+ (1,0) [0|3] "" FLRdpHPA,FLRdpHPB
 SG_ FLR2RdrDetn375To379Mode2 : 188|2@1+ (1,0) [0|3] "" FLRdpHPA,FLRdpHPB
 SG_ FLR2RdrDetn375To379Mode3 : 252|2@1+ (1,0) [0|3] "" FLRdpHPA,FLRdpHPB
 SG_ FLR2RdrDetn375To379Mode4 : 316|2@1+ (1,0) [0|3] "" FLRdpHPA,FLRdpHPB
 SG_ FLR2RdrDetn375To379Quality0 : 62|2@1+ (1,0) [0|3] "" FLRdpHPA,FLRdpHPB
 SG_ FLR2RdrDetn375To379Quality1 : 126|2@1+ (1,0) [0|3] "" FLRdpHPA,FLRdpHPB
 SG_ FLR2RdrDetn375To379Quality2 : 190|2@1+ (1,0) [0|3] "" FLRdpHPA,FLRdpHPB
 SG_ FLR2RdrDetn375To379Quality3 : 254|2@1+ (1,0) [0|3] "" FLRdpHPA,FLRdpHPB
 SG_ FLR2RdrDetn375To379Quality4 : 318|2@1+ (1,0) [0|3] "" FLRdpHPA,FLRdpHPB
 SG_ FLR2RdrDetn375To379Range0 : 48|12@1+ (0.1,0.4) [0.4|300.0] "m" FLRdpHPA,FLRdpHPB
 SG_ FLR2RdrDetn375To379Range1 : 112|12@1+ (0.1,0.4) [0.4|300.0] "m" FLRdpHPA,FLRdpHPB
 SG_ FLR2RdrDetn375To379Range2 : 176|12@1+ (0.1,0.4) [0.4|300.0] "m" FLRdpHPA,FLRdpHPB
 SG_ FLR2RdrDetn375To379Range3 : 240|12@1+ (0.1,0.4) [0.4|300.0] "m" FLRdpHPA,FLRdpHPB
 SG_ FLR2RdrDetn375To379Range4 : 304|12@1+ (0.1,0.4) [0.4|300.0] "m" FLRdpHPA,FLRdpHPB
 SG_ FLR2RdrDetn375To379RCS0 : 83|10@1+ (0.2,-100.0) [-100.0|70.0] "dBsm" FLRdpHPA,FLRdpHPB
 SG_ FLR2RdrDetn375To379RCS1 : 147|10@1+ (0.2,-100.0) [-100.0|70.0] "dBsm" FLRdpHPA,FLRdpHPB
 SG_ FLR2RdrDetn375To379RCS2 : 211|10@1+ (0.2,-100.0) [-100.0|70.0] "dBsm" FLRdpHPA,FLRdpHPB
 SG_ FLR2RdrDetn375To379RCS3 : 275|10@1+ (0.2,-100.0) [-100.0|70.0] "dBsm" FLRdpHPA,FLRdpHPB
 SG_ FLR2RdrDetn375To379RCS4 : 339|10@1+ (0.2,-100.0) [-100.0|70.0] "dBsm" FLRdpHPA,FLRdpHPB
 SG_ FLR2RdrDetn375To379RngRt0 : 72|11@1+ (0.1,-111.11) [-111.11|55.59000000000002] "m/s" FLRdpHPA,FLRdpHPB
 SG_ FLR2RdrDetn375To379RngRt1 : 136|11@1+ (0.1,-111.11) [-111.11|55.59000000000002] "m/s" FLRdpHPA,FLRdpHPB
 SG_ FLR2RdrDetn375To379RngRt2 : 200|11@1+ (0.1,-111.11) [-111.11|55.59000000000002] "m/s" FLRdpHPA,FLRdpHPB
 SG_ FLR2RdrDetn375To379RngRt3 : 264|11@1+ (0.1,-111.11) [-111.11|55.59000000000002] "m/s" FLRdpHPA,FLRdpHPB
 SG_ FLR2RdrDetn375To379RngRt4 : 328|11@1+ (0.1,-111.11) [-111.11|55.59000000000002] "m/s" FLRdpHPA,FLRdpHPB
 SG_ FLR2RdrDetn375To379ScanID : 24|8@1+ (1.0,0.0) [0.0|255.0] "Unitless" FLRdpHPA,FLRdpHPB
 SG_ FLR2RdrDetn375To379SNR0 : 41|7@1+ (0.5,0.0) [0.0|63.5] "dB" FLRdpHPA,FLRdpHPB
 SG_ FLR2RdrDetn375To379SNR1 : 105|7@1+ (0.5,0.0) [0.0|63.5] "dB" FLRdpHPA,FLRdpHPB
 SG_ FLR2RdrDetn375To379SNR2 : 169|7@1+ (0.5,0.0) [0.0|63.5] "dB" FLRdpHPA,FLRdpHPB
 SG_ FLR2RdrDetn375To379SNR3 : 233|7@1+ (0.5,0.0) [0.0|63.5] "dB" FLRdpHPA,FLRdpHPB
 SG_ FLR2RdrDetn375To379SNR4 : 297|7@1+ (0.5,0.0) [0.0|63.5] "dB" FLRdpHPA,FLRdpHPB

BO_ 294 FlrFlr1canFr77 : 64 FLR
 SG_ FLR2RdrDetn380To384_UB : 359|1@0+ (1,0) [0|1] "" FLRdpHPA,FLRdpHPB
 SG_ FLR2RdrDetn380To384AziAng0 : 32|9@1+ (0.0035,-0.87266) [-0.87266|0.91584] "rad" FLRdpHPA,FLRdpHPB
 SG_ FLR2RdrDetn380To384AziAng1 : 96|9@1+ (0.0035,-0.87266) [-0.87266|0.91584] "rad" FLRdpHPA,FLRdpHPB
 SG_ FLR2RdrDetn380To384AziAng2 : 160|9@1+ (0.0035,-0.87266) [-0.87266|0.91584] "rad" FLRdpHPA,FLRdpHPB
 SG_ FLR2RdrDetn380To384AziAng3 : 224|9@1+ (0.0035,-0.87266) [-0.87266|0.91584] "rad" FLRdpHPA,FLRdpHPB
 SG_ FLR2RdrDetn380To384AziAng4 : 288|9@1+ (0.0035,-0.87266) [-0.87266|0.91584] "rad" FLRdpHPA,FLRdpHPB
 SG_ FLR2RdrDetn380To384Counter : 16|8@1+ (1.0,0.0) [0.0|255.0] "Unitless" FLRdpHPA,FLRdpHPB
 SG_ FLR2RdrDetn380To384CRC : 0|16@1+ (1.0,0.0) [0.0|65535.0] "Unitless" FLRdpHPA,FLRdpHPB
 SG_ FLR2RdrDetn380To384DynPrpty0 : 93|1@1+ (1.0,0.0) [0.0|1.0] "Unitless" FLRdpHPA,FLRdpHPB
 SG_ FLR2RdrDetn380To384DynPrpty1 : 157|1@1+ (1.0,0.0) [0.0|1.0] "Unitless" FLRdpHPA,FLRdpHPB
 SG_ FLR2RdrDetn380To384DynPrpty2 : 221|1@1+ (1.0,0.0) [0.0|1.0] "Unitless" FLRdpHPA,FLRdpHPB
 SG_ FLR2RdrDetn380To384DynPrpty3 : 285|1@1+ (1.0,0.0) [0.0|1.0] "Unitless" FLRdpHPA,FLRdpHPB
 SG_ FLR2RdrDetn380To384DynPrpty4 : 349|1@1+ (1.0,0.0) [0.0|1.0] "Unitless" FLRdpHPA,FLRdpHPB
 SG_ FLR2RdrDetn380To384EleAng0 : 64|8@1+ (0.002,0.0) [0.0|0.5] "rad" FLRdpHPA,FLRdpHPB
 SG_ FLR2RdrDetn380To384EleAng1 : 128|8@1+ (0.002,0.0) [0.0|0.5] "rad" FLRdpHPA,FLRdpHPB
 SG_ FLR2RdrDetn380To384EleAng2 : 192|8@1+ (0.002,0.0) [0.0|0.5] "rad" FLRdpHPA,FLRdpHPB
 SG_ FLR2RdrDetn380To384EleAng3 : 256|8@1+ (0.002,0.0) [0.0|0.5] "rad" FLRdpHPA,FLRdpHPB
 SG_ FLR2RdrDetn380To384EleAng4 : 320|8@1+ (0.002,0.0) [0.0|0.5] "rad" FLRdpHPA,FLRdpHPB
 SG_ FLR2RdrDetn380To384Mode0 : 60|2@1+ (1,0) [0|3] "" FLRdpHPA,FLRdpHPB
 SG_ FLR2RdrDetn380To384Mode1 : 124|2@1+ (1,0) [0|3] "" FLRdpHPA,FLRdpHPB
 SG_ FLR2RdrDetn380To384Mode2 : 188|2@1+ (1,0) [0|3] "" FLRdpHPA,FLRdpHPB
 SG_ FLR2RdrDetn380To384Mode3 : 252|2@1+ (1,0) [0|3] "" FLRdpHPA,FLRdpHPB
 SG_ FLR2RdrDetn380To384Mode4 : 316|2@1+ (1,0) [0|3] "" FLRdpHPA,FLRdpHPB
 SG_ FLR2RdrDetn380To384Quality0 : 62|2@1+ (1,0) [0|3] "" FLRdpHPA,FLRdpHPB
 SG_ FLR2RdrDetn380To384Quality1 : 126|2@1+ (1,0) [0|3] "" FLRdpHPA,FLRdpHPB
 SG_ FLR2RdrDetn380To384Quality2 : 190|2@1+ (1,0) [0|3] "" FLRdpHPA,FLRdpHPB
 SG_ FLR2RdrDetn380To384Quality3 : 254|2@1+ (1,0) [0|3] "" FLRdpHPA,FLRdpHPB
 SG_ FLR2RdrDetn380To384Quality4 : 318|2@1+ (1,0) [0|3] "" FLRdpHPA,FLRdpHPB
 SG_ FLR2RdrDetn380To384Range0 : 48|12@1+ (0.1,0.4) [0.4|300.0] "m" FLRdpHPA,FLRdpHPB
 SG_ FLR2RdrDetn380To384Range1 : 112|12@1+ (0.1,0.4) [0.4|300.0] "m" FLRdpHPA,FLRdpHPB
 SG_ FLR2RdrDetn380To384Range2 : 176|12@1+ (0.1,0.4) [0.4|300.0] "m" FLRdpHPA,FLRdpHPB
 SG_ FLR2RdrDetn380To384Range3 : 240|12@1+ (0.1,0.4) [0.4|300.0] "m" FLRdpHPA,FLRdpHPB
 SG_ FLR2RdrDetn380To384Range4 : 304|12@1+ (0.1,0.4) [0.4|300.0] "m" FLRdpHPA,FLRdpHPB
 SG_ FLR2RdrDetn380To384RCS0 : 83|10@1+ (0.2,-100.0) [-100.0|70.0] "dBsm" FLRdpHPA,FLRdpHPB
 SG_ FLR2RdrDetn380To384RCS1 : 147|10@1+ (0.2,-100.0) [-100.0|70.0] "dBsm" FLRdpHPA,FLRdpHPB
 SG_ FLR2RdrDetn380To384RCS2 : 211|10@1+ (0.2,-100.0) [-100.0|70.0] "dBsm" FLRdpHPA,FLRdpHPB
 SG_ FLR2RdrDetn380To384RCS3 : 275|10@1+ (0.2,-100.0) [-100.0|70.0] "dBsm" FLRdpHPA,FLRdpHPB
 SG_ FLR2RdrDetn380To384RCS4 : 339|10@1+ (0.2,-100.0) [-100.0|70.0] "dBsm" FLRdpHPA,FLRdpHPB
 SG_ FLR2RdrDetn380To384RngRt0 : 72|11@1+ (0.1,-111.11) [-111.11|55.59000000000002] "m/s" FLRdpHPA,FLRdpHPB
 SG_ FLR2RdrDetn380To384RngRt1 : 136|11@1+ (0.1,-111.11) [-111.11|55.59000000000002] "m/s" FLRdpHPA,FLRdpHPB
 SG_ FLR2RdrDetn380To384RngRt2 : 200|11@1+ (0.1,-111.11) [-111.11|55.59000000000002] "m/s" FLRdpHPA,FLRdpHPB
 SG_ FLR2RdrDetn380To384RngRt3 : 264|11@1+ (0.1,-111.11) [-111.11|55.59000000000002] "m/s" FLRdpHPA,FLRdpHPB
 SG_ FLR2RdrDetn380To384RngRt4 : 328|11@1+ (0.1,-111.11) [-111.11|55.59000000000002] "m/s" FLRdpHPA,FLRdpHPB
 SG_ FLR2RdrDetn380To384ScanID : 24|8@1+ (1.0,0.0) [0.0|255.0] "Unitless" FLRdpHPA,FLRdpHPB
 SG_ FLR2RdrDetn380To384SNR0 : 41|7@1+ (0.5,0.0) [0.0|63.5] "dB" FLRdpHPA,FLRdpHPB
 SG_ FLR2RdrDetn380To384SNR1 : 105|7@1+ (0.5,0.0) [0.0|63.5] "dB" FLRdpHPA,FLRdpHPB
 SG_ FLR2RdrDetn380To384SNR2 : 169|7@1+ (0.5,0.0) [0.0|63.5] "dB" FLRdpHPA,FLRdpHPB
 SG_ FLR2RdrDetn380To384SNR3 : 233|7@1+ (0.5,0.0) [0.0|63.5] "dB" FLRdpHPA,FLRdpHPB
 SG_ FLR2RdrDetn380To384SNR4 : 297|7@1+ (0.5,0.0) [0.0|63.5] "dB" FLRdpHPA,FLRdpHPB

BO_ 296 FlrFlr1canFr78 : 64 FLR
 SG_ FLR2RdrDetn385To389_UB : 359|1@0+ (1,0) [0|1] "" FLRdpHPA,FLRdpHPB
 SG_ FLR2RdrDetn385To389AziAng0 : 32|9@1+ (0.0035,-0.87266) [-0.87266|0.91584] "rad" FLRdpHPA,FLRdpHPB
 SG_ FLR2RdrDetn385To389AziAng1 : 96|9@1+ (0.0035,-0.87266) [-0.87266|0.91584] "rad" FLRdpHPA,FLRdpHPB
 SG_ FLR2RdrDetn385To389AziAng2 : 160|9@1+ (0.0035,-0.87266) [-0.87266|0.91584] "rad" FLRdpHPA,FLRdpHPB
 SG_ FLR2RdrDetn385To389AziAng3 : 224|9@1+ (0.0035,-0.87266) [-0.87266|0.91584] "rad" FLRdpHPA,FLRdpHPB
 SG_ FLR2RdrDetn385To389AziAng4 : 288|9@1+ (0.0035,-0.87266) [-0.87266|0.91584] "rad" FLRdpHPA,FLRdpHPB
 SG_ FLR2RdrDetn385To389Counter : 16|8@1+ (1.0,0.0) [0.0|255.0] "Unitless" FLRdpHPA,FLRdpHPB
 SG_ FLR2RdrDetn385To389CRC : 0|16@1+ (1.0,0.0) [0.0|65535.0] "Unitless" FLRdpHPA,FLRdpHPB
 SG_ FLR2RdrDetn385To389DynPrpty0 : 93|1@1+ (1.0,0.0) [0.0|1.0] "Unitless" FLRdpHPA,FLRdpHPB
 SG_ FLR2RdrDetn385To389DynPrpty1 : 157|1@1+ (1.0,0.0) [0.0|1.0] "Unitless" FLRdpHPA,FLRdpHPB
 SG_ FLR2RdrDetn385To389DynPrpty2 : 221|1@1+ (1.0,0.0) [0.0|1.0] "Unitless" FLRdpHPA,FLRdpHPB
 SG_ FLR2RdrDetn385To389DynPrpty3 : 285|1@1+ (1.0,0.0) [0.0|1.0] "Unitless" FLRdpHPA,FLRdpHPB
 SG_ FLR2RdrDetn385To389DynPrpty4 : 349|1@1+ (1.0,0.0) [0.0|1.0] "Unitless" FLRdpHPA,FLRdpHPB
 SG_ FLR2RdrDetn385To389EleAng0 : 64|8@1+ (0.002,0.0) [0.0|0.5] "rad" FLRdpHPA,FLRdpHPB
 SG_ FLR2RdrDetn385To389EleAng1 : 128|8@1+ (0.002,0.0) [0.0|0.5] "rad" FLRdpHPA,FLRdpHPB
 SG_ FLR2RdrDetn385To389EleAng2 : 192|8@1+ (0.002,0.0) [0.0|0.5] "rad" FLRdpHPA,FLRdpHPB
 SG_ FLR2RdrDetn385To389EleAng3 : 256|8@1+ (0.002,0.0) [0.0|0.5] "rad" FLRdpHPA,FLRdpHPB
 SG_ FLR2RdrDetn385To389EleAng4 : 320|8@1+ (0.002,0.0) [0.0|0.5] "rad" FLRdpHPA,FLRdpHPB
 SG_ FLR2RdrDetn385To389Mode0 : 60|2@1+ (1,0) [0|3] "" FLRdpHPA,FLRdpHPB
 SG_ FLR2RdrDetn385To389Mode1 : 124|2@1+ (1,0) [0|3] "" FLRdpHPA,FLRdpHPB
 SG_ FLR2RdrDetn385To389Mode2 : 188|2@1+ (1,0) [0|3] "" FLRdpHPA,FLRdpHPB
 SG_ FLR2RdrDetn385To389Mode3 : 252|2@1+ (1,0) [0|3] "" FLRdpHPA,FLRdpHPB
 SG_ FLR2RdrDetn385To389Mode4 : 316|2@1+ (1,0) [0|3] "" FLRdpHPA,FLRdpHPB
 SG_ FLR2RdrDetn385To389Quality0 : 62|2@1+ (1,0) [0|3] "" FLRdpHPA,FLRdpHPB
 SG_ FLR2RdrDetn385To389Quality1 : 126|2@1+ (1,0) [0|3] "" FLRdpHPA,FLRdpHPB
 SG_ FLR2RdrDetn385To389Quality2 : 190|2@1+ (1,0) [0|3] "" FLRdpHPA,FLRdpHPB
 SG_ FLR2RdrDetn385To389Quality3 : 254|2@1+ (1,0) [0|3] "" FLRdpHPA,FLRdpHPB
 SG_ FLR2RdrDetn385To389Quality4 : 318|2@1+ (1,0) [0|3] "" FLRdpHPA,FLRdpHPB
 SG_ FLR2RdrDetn385To389Range0 : 48|12@1+ (0.1,0.4) [0.4|300.0] "m" FLRdpHPA,FLRdpHPB
 SG_ FLR2RdrDetn385To389Range1 : 112|12@1+ (0.1,0.4) [0.4|300.0] "m" FLRdpHPA,FLRdpHPB
 SG_ FLR2RdrDetn385To389Range2 : 176|12@1+ (0.1,0.4) [0.4|300.0] "m" FLRdpHPA,FLRdpHPB
 SG_ FLR2RdrDetn385To389Range3 : 240|12@1+ (0.1,0.4) [0.4|300.0] "m" FLRdpHPA,FLRdpHPB
 SG_ FLR2RdrDetn385To389Range4 : 304|12@1+ (0.1,0.4) [0.4|300.0] "m" FLRdpHPA,FLRdpHPB
 SG_ FLR2RdrDetn385To389RCS0 : 83|10@1+ (0.2,-100.0) [-100.0|70.0] "dBsm" FLRdpHPA,FLRdpHPB
 SG_ FLR2RdrDetn385To389RCS1 : 147|10@1+ (0.2,-100.0) [-100.0|70.0] "dBsm" FLRdpHPA,FLRdpHPB
 SG_ FLR2RdrDetn385To389RCS2 : 211|10@1+ (0.2,-100.0) [-100.0|70.0] "dBsm" FLRdpHPA,FLRdpHPB
 SG_ FLR2RdrDetn385To389RCS3 : 275|10@1+ (0.2,-100.0) [-100.0|70.0] "dBsm" FLRdpHPA,FLRdpHPB
 SG_ FLR2RdrDetn385To389RCS4 : 339|10@1+ (0.2,-100.0) [-100.0|70.0] "dBsm" FLRdpHPA,FLRdpHPB
 SG_ FLR2RdrDetn385To389RngRt0 : 72|11@1+ (0.1,-111.11) [-111.11|55.59000000000002] "m/s" FLRdpHPA,FLRdpHPB
 SG_ FLR2RdrDetn385To389RngRt1 : 136|11@1+ (0.1,-111.11) [-111.11|55.59000000000002] "m/s" FLRdpHPA,FLRdpHPB
 SG_ FLR2RdrDetn385To389RngRt2 : 200|11@1+ (0.1,-111.11) [-111.11|55.59000000000002] "m/s" FLRdpHPA,FLRdpHPB
 SG_ FLR2RdrDetn385To389RngRt3 : 264|11@1+ (0.1,-111.11) [-111.11|55.59000000000002] "m/s" FLRdpHPA,FLRdpHPB
 SG_ FLR2RdrDetn385To389RngRt4 : 328|11@1+ (0.1,-111.11) [-111.11|55.59000000000002] "m/s" FLRdpHPA,FLRdpHPB
 SG_ FLR2RdrDetn385To389ScanID : 24|8@1+ (1.0,0.0) [0.0|255.0] "Unitless" FLRdpHPA,FLRdpHPB
 SG_ FLR2RdrDetn385To389SNR0 : 41|7@1+ (0.5,0.0) [0.0|63.5] "dB" FLRdpHPA,FLRdpHPB
 SG_ FLR2RdrDetn385To389SNR1 : 105|7@1+ (0.5,0.0) [0.0|63.5] "dB" FLRdpHPA,FLRdpHPB
 SG_ FLR2RdrDetn385To389SNR2 : 169|7@1+ (0.5,0.0) [0.0|63.5] "dB" FLRdpHPA,FLRdpHPB
 SG_ FLR2RdrDetn385To389SNR3 : 233|7@1+ (0.5,0.0) [0.0|63.5] "dB" FLRdpHPA,FLRdpHPB
 SG_ FLR2RdrDetn385To389SNR4 : 297|7@1+ (0.5,0.0) [0.0|63.5] "dB" FLRdpHPA,FLRdpHPB

BO_ 298 FlrFlr1canFr79 : 64 FLR
 SG_ FLR2RdrDetn390To394_UB : 359|1@0+ (1,0) [0|1] "" FLRdpHPA,FLRdpHPB
 SG_ FLR2RdrDetn390To394AziAng0 : 32|9@1+ (0.0035,-0.87266) [-0.87266|0.91584] "rad" FLRdpHPA,FLRdpHPB
 SG_ FLR2RdrDetn390To394AziAng1 : 96|9@1+ (0.0035,-0.87266) [-0.87266|0.91584] "rad" FLRdpHPA,FLRdpHPB
 SG_ FLR2RdrDetn390To394AziAng2 : 160|9@1+ (0.0035,-0.87266) [-0.87266|0.91584] "rad" FLRdpHPA,FLRdpHPB
 SG_ FLR2RdrDetn390To394AziAng3 : 224|9@1+ (0.0035,-0.87266) [-0.87266|0.91584] "rad" FLRdpHPA,FLRdpHPB
 SG_ FLR2RdrDetn390To394AziAng4 : 288|9@1+ (0.0035,-0.87266) [-0.87266|0.91584] "rad" FLRdpHPA,FLRdpHPB
 SG_ FLR2RdrDetn390To394Counter : 16|8@1+ (1.0,0.0) [0.0|255.0] "Unitless" FLRdpHPA,FLRdpHPB
 SG_ FLR2RdrDetn390To394CRC : 0|16@1+ (1.0,0.0) [0.0|65535.0] "Unitless" FLRdpHPA,FLRdpHPB
 SG_ FLR2RdrDetn390To394DynPrpty0 : 93|1@1+ (1.0,0.0) [0.0|1.0] "Unitless" FLRdpHPA,FLRdpHPB
 SG_ FLR2RdrDetn390To394DynPrpty1 : 157|1@1+ (1.0,0.0) [0.0|1.0] "Unitless" FLRdpHPA,FLRdpHPB
 SG_ FLR2RdrDetn390To394DynPrpty2 : 221|1@1+ (1.0,0.0) [0.0|1.0] "Unitless" FLRdpHPA,FLRdpHPB
 SG_ FLR2RdrDetn390To394DynPrpty3 : 285|1@1+ (1.0,0.0) [0.0|1.0] "Unitless" FLRdpHPA,FLRdpHPB
 SG_ FLR2RdrDetn390To394DynPrpty4 : 349|1@1+ (1.0,0.0) [0.0|1.0] "Unitless" FLRdpHPA,FLRdpHPB
 SG_ FLR2RdrDetn390To394EleAng0 : 64|8@1+ (0.002,0.0) [0.0|0.5] "rad" FLRdpHPA,FLRdpHPB
 SG_ FLR2RdrDetn390To394EleAng1 : 128|8@1+ (0.002,0.0) [0.0|0.5] "rad" FLRdpHPA,FLRdpHPB
 SG_ FLR2RdrDetn390To394EleAng2 : 192|8@1+ (0.002,0.0) [0.0|0.5] "rad" FLRdpHPA,FLRdpHPB
 SG_ FLR2RdrDetn390To394EleAng3 : 256|8@1+ (0.002,0.0) [0.0|0.5] "rad" FLRdpHPA,FLRdpHPB
 SG_ FLR2RdrDetn390To394EleAng4 : 320|8@1+ (0.002,0.0) [0.0|0.5] "rad" FLRdpHPA,FLRdpHPB
 SG_ FLR2RdrDetn390To394Mode0 : 60|2@1+ (1,0) [0|3] "" FLRdpHPA,FLRdpHPB
 SG_ FLR2RdrDetn390To394Mode1 : 124|2@1+ (1,0) [0|3] "" FLRdpHPA,FLRdpHPB
 SG_ FLR2RdrDetn390To394Mode2 : 188|2@1+ (1,0) [0|3] "" FLRdpHPA,FLRdpHPB
 SG_ FLR2RdrDetn390To394Mode3 : 252|2@1+ (1,0) [0|3] "" FLRdpHPA,FLRdpHPB
 SG_ FLR2RdrDetn390To394Mode4 : 316|2@1+ (1,0) [0|3] "" FLRdpHPA,FLRdpHPB
 SG_ FLR2RdrDetn390To394Quality0 : 62|2@1+ (1,0) [0|3] "" FLRdpHPA,FLRdpHPB
 SG_ FLR2RdrDetn390To394Quality1 : 126|2@1+ (1,0) [0|3] "" FLRdpHPA,FLRdpHPB
 SG_ FLR2RdrDetn390To394Quality2 : 190|2@1+ (1,0) [0|3] "" FLRdpHPA,FLRdpHPB
 SG_ FLR2RdrDetn390To394Quality3 : 254|2@1+ (1,0) [0|3] "" FLRdpHPA,FLRdpHPB
 SG_ FLR2RdrDetn390To394Quality4 : 318|2@1+ (1,0) [0|3] "" FLRdpHPA,FLRdpHPB
 SG_ FLR2RdrDetn390To394Range0 : 48|12@1+ (0.1,0.4) [0.4|300.0] "m" FLRdpHPA,FLRdpHPB
 SG_ FLR2RdrDetn390To394Range1 : 112|12@1+ (0.1,0.4) [0.4|300.0] "m" FLRdpHPA,FLRdpHPB
 SG_ FLR2RdrDetn390To394Range2 : 176|12@1+ (0.1,0.4) [0.4|300.0] "m" FLRdpHPA,FLRdpHPB
 SG_ FLR2RdrDetn390To394Range3 : 240|12@1+ (0.1,0.4) [0.4|300.0] "m" FLRdpHPA,FLRdpHPB
 SG_ FLR2RdrDetn390To394Range4 : 304|12@1+ (0.1,0.4) [0.4|300.0] "m" FLRdpHPA,FLRdpHPB
 SG_ FLR2RdrDetn390To394RCS0 : 83|10@1+ (0.2,-100.0) [-100.0|70.0] "dBsm" FLRdpHPA,FLRdpHPB
 SG_ FLR2RdrDetn390To394RCS1 : 147|10@1+ (0.2,-100.0) [-100.0|70.0] "dBsm" FLRdpHPA,FLRdpHPB
 SG_ FLR2RdrDetn390To394RCS2 : 211|10@1+ (0.2,-100.0) [-100.0|70.0] "dBsm" FLRdpHPA,FLRdpHPB
 SG_ FLR2RdrDetn390To394RCS3 : 275|10@1+ (0.2,-100.0) [-100.0|70.0] "dBsm" FLRdpHPA,FLRdpHPB
 SG_ FLR2RdrDetn390To394RCS4 : 339|10@1+ (0.2,-100.0) [-100.0|70.0] "dBsm" FLRdpHPA,FLRdpHPB
 SG_ FLR2RdrDetn390To394RngRt0 : 72|11@1+ (0.1,-111.11) [-111.11|55.59000000000002] "m/s" FLRdpHPA,FLRdpHPB
 SG_ FLR2RdrDetn390To394RngRt1 : 136|11@1+ (0.1,-111.11) [-111.11|55.59000000000002] "m/s" FLRdpHPA,FLRdpHPB
 SG_ FLR2RdrDetn390To394RngRt2 : 200|11@1+ (0.1,-111.11) [-111.11|55.59000000000002] "m/s" FLRdpHPA,FLRdpHPB
 SG_ FLR2RdrDetn390To394RngRt3 : 264|11@1+ (0.1,-111.11) [-111.11|55.59000000000002] "m/s" FLRdpHPA,FLRdpHPB
 SG_ FLR2RdrDetn390To394RngRt4 : 328|11@1+ (0.1,-111.11) [-111.11|55.59000000000002] "m/s" FLRdpHPA,FLRdpHPB
 SG_ FLR2RdrDetn390To394ScanID : 24|8@1+ (1.0,0.0) [0.0|255.0] "Unitless" FLRdpHPA,FLRdpHPB
 SG_ FLR2RdrDetn390To394SNR0 : 41|7@1+ (0.5,0.0) [0.0|63.5] "dB" FLRdpHPA,FLRdpHPB
 SG_ FLR2RdrDetn390To394SNR1 : 105|7@1+ (0.5,0.0) [0.0|63.5] "dB" FLRdpHPA,FLRdpHPB
 SG_ FLR2RdrDetn390To394SNR2 : 169|7@1+ (0.5,0.0) [0.0|63.5] "dB" FLRdpHPA,FLRdpHPB
 SG_ FLR2RdrDetn390To394SNR3 : 233|7@1+ (0.5,0.0) [0.0|63.5] "dB" FLRdpHPA,FLRdpHPB
 SG_ FLR2RdrDetn390To394SNR4 : 297|7@1+ (0.5,0.0) [0.0|63.5] "dB" FLRdpHPA,FLRdpHPB

BO_ 300 FlrFlr1canFr80 : 64 FLR
 SG_ FLR2RdrDetn395To399_UB : 359|1@0+ (1,0) [0|1] "" FLRdpHPA,FLRdpHPB
 SG_ FLR2RdrDetn395To399AziAng0 : 32|9@1+ (0.0035,-0.87266) [-0.87266|0.91584] "rad" FLRdpHPA,FLRdpHPB
 SG_ FLR2RdrDetn395To399AziAng1 : 96|9@1+ (0.0035,-0.87266) [-0.87266|0.91584] "rad" FLRdpHPA,FLRdpHPB
 SG_ FLR2RdrDetn395To399AziAng2 : 160|9@1+ (0.0035,-0.87266) [-0.87266|0.91584] "rad" FLRdpHPA,FLRdpHPB
 SG_ FLR2RdrDetn395To399AziAng3 : 224|9@1+ (0.0035,-0.87266) [-0.87266|0.91584] "rad" FLRdpHPA,FLRdpHPB
 SG_ FLR2RdrDetn395To399AziAng4 : 288|9@1+ (0.0035,-0.87266) [-0.87266|0.91584] "rad" FLRdpHPA,FLRdpHPB
 SG_ FLR2RdrDetn395To399Counter : 16|8@1+ (1.0,0.0) [0.0|255.0] "Unitless" FLRdpHPA,FLRdpHPB
 SG_ FLR2RdrDetn395To399CRC : 0|16@1+ (1.0,0.0) [0.0|65535.0] "Unitless" FLRdpHPA,FLRdpHPB
 SG_ FLR2RdrDetn395To399DynPrpty0 : 93|1@1+ (1.0,0.0) [0.0|1.0] "Unitless" FLRdpHPA,FLRdpHPB
 SG_ FLR2RdrDetn395To399DynPrpty1 : 157|1@1+ (1.0,0.0) [0.0|1.0] "Unitless" FLRdpHPA,FLRdpHPB
 SG_ FLR2RdrDetn395To399DynPrpty2 : 221|1@1+ (1.0,0.0) [0.0|1.0] "Unitless" FLRdpHPA,FLRdpHPB
 SG_ FLR2RdrDetn395To399DynPrpty3 : 285|1@1+ (1.0,0.0) [0.0|1.0] "Unitless" FLRdpHPA,FLRdpHPB
 SG_ FLR2RdrDetn395To399DynPrpty4 : 349|1@1+ (1.0,0.0) [0.0|1.0] "Unitless" FLRdpHPA,FLRdpHPB
 SG_ FLR2RdrDetn395To399EleAng0 : 64|8@1+ (0.002,0.0) [0.0|0.5] "rad" FLRdpHPA,FLRdpHPB
 SG_ FLR2RdrDetn395To399EleAng1 : 128|8@1+ (0.002,0.0) [0.0|0.5] "rad" FLRdpHPA,FLRdpHPB
 SG_ FLR2RdrDetn395To399EleAng2 : 192|8@1+ (0.002,0.0) [0.0|0.5] "rad" FLRdpHPA,FLRdpHPB
 SG_ FLR2RdrDetn395To399EleAng3 : 256|8@1+ (0.002,0.0) [0.0|0.5] "rad" FLRdpHPA,FLRdpHPB
 SG_ FLR2RdrDetn395To399EleAng4 : 320|8@1+ (0.002,0.0) [0.0|0.5] "rad" FLRdpHPA,FLRdpHPB
 SG_ FLR2RdrDetn395To399Mode0 : 60|2@1+ (1,0) [0|3] "" FLRdpHPA,FLRdpHPB
 SG_ FLR2RdrDetn395To399Mode1 : 124|2@1+ (1,0) [0|3] "" FLRdpHPA,FLRdpHPB
 SG_ FLR2RdrDetn395To399Mode2 : 188|2@1+ (1,0) [0|3] "" FLRdpHPA,FLRdpHPB
 SG_ FLR2RdrDetn395To399Mode3 : 252|2@1+ (1,0) [0|3] "" FLRdpHPA,FLRdpHPB
 SG_ FLR2RdrDetn395To399Mode4 : 316|2@1+ (1,0) [0|3] "" FLRdpHPA,FLRdpHPB
 SG_ FLR2RdrDetn395To399Quality0 : 62|2@1+ (1,0) [0|3] "" FLRdpHPA,FLRdpHPB
 SG_ FLR2RdrDetn395To399Quality1 : 126|2@1+ (1,0) [0|3] "" FLRdpHPA,FLRdpHPB
 SG_ FLR2RdrDetn395To399Quality2 : 190|2@1+ (1,0) [0|3] "" FLRdpHPA,FLRdpHPB
 SG_ FLR2RdrDetn395To399Quality3 : 254|2@1+ (1,0) [0|3] "" FLRdpHPA,FLRdpHPB
 SG_ FLR2RdrDetn395To399Quality4 : 318|2@1+ (1,0) [0|3] "" FLRdpHPA,FLRdpHPB
 SG_ FLR2RdrDetn395To399Range0 : 48|12@1+ (0.1,0.4) [0.4|300.0] "m" FLRdpHPA,FLRdpHPB
 SG_ FLR2RdrDetn395To399Range1 : 112|12@1+ (0.1,0.4) [0.4|300.0] "m" FLRdpHPA,FLRdpHPB
 SG_ FLR2RdrDetn395To399Range2 : 176|12@1+ (0.1,0.4) [0.4|300.0] "m" FLRdpHPA,FLRdpHPB
 SG_ FLR2RdrDetn395To399Range3 : 240|12@1+ (0.1,0.4) [0.4|300.0] "m" FLRdpHPA,FLRdpHPB
 SG_ FLR2RdrDetn395To399Range4 : 304|12@1+ (0.1,0.4) [0.4|300.0] "m" FLRdpHPA,FLRdpHPB
 SG_ FLR2RdrDetn395To399RCS0 : 83|10@1+ (0.2,-100.0) [-100.0|70.0] "dBsm" FLRdpHPA,FLRdpHPB
 SG_ FLR2RdrDetn395To399RCS1 : 147|10@1+ (0.2,-100.0) [-100.0|70.0] "dBsm" FLRdpHPA,FLRdpHPB
 SG_ FLR2RdrDetn395To399RCS2 : 211|10@1+ (0.2,-100.0) [-100.0|70.0] "dBsm" FLRdpHPA,FLRdpHPB
 SG_ FLR2RdrDetn395To399RCS3 : 275|10@1+ (0.2,-100.0) [-100.0|70.0] "dBsm" FLRdpHPA,FLRdpHPB
 SG_ FLR2RdrDetn395To399RCS4 : 339|10@1+ (0.2,-100.0) [-100.0|70.0] "dBsm" FLRdpHPA,FLRdpHPB
 SG_ FLR2RdrDetn395To399RngRt0 : 72|11@1+ (0.1,-111.11) [-111.11|55.59000000000002] "m/s" FLRdpHPA,FLRdpHPB
 SG_ FLR2RdrDetn395To399RngRt1 : 136|11@1+ (0.1,-111.11) [-111.11|55.59000000000002] "m/s" FLRdpHPA,FLRdpHPB
 SG_ FLR2RdrDetn395To399RngRt2 : 200|11@1+ (0.1,-111.11) [-111.11|55.59000000000002] "m/s" FLRdpHPA,FLRdpHPB
 SG_ FLR2RdrDetn395To399RngRt3 : 264|11@1+ (0.1,-111.11) [-111.11|55.59000000000002] "m/s" FLRdpHPA,FLRdpHPB
 SG_ FLR2RdrDetn395To399RngRt4 : 328|11@1+ (0.1,-111.11) [-111.11|55.59000000000002] "m/s" FLRdpHPA,FLRdpHPB
 SG_ FLR2RdrDetn395To399ScanID : 24|8@1+ (1.0,0.0) [0.0|255.0] "Unitless" FLRdpHPA,FLRdpHPB
 SG_ FLR2RdrDetn395To399SNR0 : 41|7@1+ (0.5,0.0) [0.0|63.5] "dB" FLRdpHPA,FLRdpHPB
 SG_ FLR2RdrDetn395To399SNR1 : 105|7@1+ (0.5,0.0) [0.0|63.5] "dB" FLRdpHPA,FLRdpHPB
 SG_ FLR2RdrDetn395To399SNR2 : 169|7@1+ (0.5,0.0) [0.0|63.5] "dB" FLRdpHPA,FLRdpHPB
 SG_ FLR2RdrDetn395To399SNR3 : 233|7@1+ (0.5,0.0) [0.0|63.5] "dB" FLRdpHPA,FLRdpHPB
 SG_ FLR2RdrDetn395To399SNR4 : 297|7@1+ (0.5,0.0) [0.0|63.5] "dB" FLRdpHPA,FLRdpHPB

BO_ 320 FlrFlr1canFr81 : 64 FLR
 SG_ FLR2RdrObject0To1_UB : 367|1@0+ (1,0) [0|1] "" FLRdpHPA,FLRdpHPB
 SG_ FLR2RdrObject0To1Class0 : 36|2@1+ (1,0) [0|3] "" FLRdpHPA,FLRdpHPB
 SG_ FLR2RdrObject0To1Class1 : 195|2@1+ (1,0) [0|3] "" FLRdpHPA,FLRdpHPB
 SG_ FLR2RdrObject0To1Counter : 16|8@1+ (1.0,0.0) [0.0|255.0] "Unitless" FLRdpHPA,FLRdpHPB
 SG_ FLR2RdrObject0To1CRC : 0|16@1+ (1.0,0.0) [0.0|65535.0] "Unitless" FLRdpHPA,FLRdpHPB
 SG_ FLR2RdrObject0To1DataCoastCntr0 : 38|3@1+ (1,0) [0|7] "" FLRdpHPA,FLRdpHPB
 SG_ FLR2RdrObject0To1DataCoastCntr1 : 197|3@1+ (1,0) [0|7] "" FLRdpHPA,FLRdpHPB
 SG_ FLR2RdrObject0To1DataConf0 : 41|7@1+ (1.0,0.0) [0.0|100.0] "%" FLRdpHPA,FLRdpHPB
 SG_ FLR2RdrObject0To1DataConf1 : 200|7@1+ (1.0,0.0) [0.0|100.0] "%" FLRdpHPA,FLRdpHPB
 SG_ FLR2RdrObject0To1DataLen0 : 48|8@1+ (0.2,0.0) [0.0|30.0] "m" FLRdpHPA,FLRdpHPB
 SG_ FLR2RdrObject0To1DataLen1 : 207|8@1+ (0.2,0.0) [0.0|30.0] "m" FLRdpHPA,FLRdpHPB
 SG_ FLR2RdrObject0To1DataStDLatAcc0 : 56|5@1+ (0.35,0.0) [0.0|10.85] "m/s^2" FLRdpHPA,FLRdpHPB
 SG_ FLR2RdrObject0To1DataStDLatAcc1 : 215|5@1+ (0.35,0.0) [0.0|10.85] "m/s^2" FLRdpHPA,FLRdpHPB
 SG_ FLR2RdrObject0To1DataStDLatPos0 : 61|8@1+ (0.1,0.0) [0.0|25.5] "m" FLRdpHPA,FLRdpHPB
 SG_ FLR2RdrObject0To1DataStDLatPos1 : 220|8@1+ (0.1,0.0) [0.0|25.5] "m" FLRdpHPA,FLRdpHPB
 SG_ FLR2RdrObject0To1DataStDLatVelo0 : 69|6@1+ (0.2,0.0) [0.0|12.600000000000001] "m/s" FLRdpHPA,FLRdpHPB
 SG_ FLR2RdrObject0To1DataStDLatVelo1 : 228|6@1+ (0.2,0.0) [0.0|12.600000000000001] "m/s" FLRdpHPA,FLRdpHPB
 SG_ FLR2RdrObject0To1DataStDLgtAcc0 : 75|5@1+ (0.35,0.0) [0.0|10.85] "m/s^2" FLRdpHPA,FLRdpHPB
 SG_ FLR2RdrObject0To1DataStDLgtAcc1 : 234|5@1+ (0.35,0.0) [0.0|10.85] "m/s^2" FLRdpHPA,FLRdpHPB
 SG_ FLR2RdrObject0To1DataStDLgtPos0 : 80|8@1+ (0.05,0.0) [0.0|12.75] "m" FLRdpHPA,FLRdpHPB
 SG_ FLR2RdrObject0To1DataStDLgtPos1 : 239|8@1+ (0.05,0.0) [0.0|12.75] "m" FLRdpHPA,FLRdpHPB
 SG_ FLR2RdrObject0To1DataStDLgtVelo0 : 88|6@1+ (0.2,0.0) [0.0|12.600000000000001] "m/s" FLRdpHPA,FLRdpHPB
 SG_ FLR2RdrObject0To1DataStDLgtVelo1 : 247|6@1+ (0.2,0.0) [0.0|12.600000000000001] "m/s" FLRdpHPA,FLRdpHPB
 SG_ FLR2RdrObject0To1DataWidth0 : 94|7@1+ (0.2,0.0) [0.0|15.0] "m" FLRdpHPA,FLRdpHPB
 SG_ FLR2RdrObject0To1DataWidth1 : 253|7@1+ (0.2,0.0) [0.0|15.0] "m" FLRdpHPA,FLRdpHPB
 SG_ FLR2RdrObject0To1HeadingAng0 : 101|10@1+ (0.01,-3.15) [-3.15|3.15] "rad" FLRdpHPA,FLRdpHPB
 SG_ FLR2RdrObject0To1HeadingAng1 : 260|10@1+ (0.01,-3.15) [-3.15|3.15] "rad" FLRdpHPA,FLRdpHPB
 SG_ FLR2RdrObject0To1LatAcc0 : 111|10@1+ (0.125,-44.5) [-44.5|44.5] "m/s^2" FLRdpHPA,FLRdpHPB
 SG_ FLR2RdrObject0To1LatAcc1 : 270|10@1+ (0.125,-44.5) [-44.5|44.5] "m/s^2" FLRdpHPA,FLRdpHPB
 SG_ FLR2RdrObject0To1LatPos0 : 121|13@1+ (0.0625,-255.9375) [-255.9375|255.9375] "Unitless" FLRdpHPA,FLRdpHPB
 SG_ FLR2RdrObject0To1LatPos1 : 280|13@1+ (0.0625,-255.9375) [-255.9375|255.9375] "Unitless" FLRdpHPA,FLRdpHPB
 SG_ FLR2RdrObject0To1LatVelo0 : 134|11@1+ (0.125,-128.0) [-128.0|127.875] "m/s" FLRdpHPA,FLRdpHPB
 SG_ FLR2RdrObject0To1LatVelo1 : 293|11@1+ (0.125,-128.0) [-128.0|127.875] "m/s" FLRdpHPA,FLRdpHPB
 SG_ FLR2RdrObject0To1LgtAcc0 : 145|10@1+ (0.125,-44.5) [-44.5|44.5] "m/s^2" FLRdpHPA,FLRdpHPB
 SG_ FLR2RdrObject0To1LgtAcc1 : 304|10@1+ (0.125,-44.5) [-44.5|44.5] "m/s^2" FLRdpHPA,FLRdpHPB
 SG_ FLR2RdrObject0To1LgtPos0 : 155|13@1+ (0.0625,-255.9375) [-255.9375|255.9375] "Unitless" FLRdpHPA,FLRdpHPB
 SG_ FLR2RdrObject0To1LgtPos1 : 314|13@1+ (0.0625,-255.9375) [-255.9375|255.9375] "Unitless" FLRdpHPA,FLRdpHPB
 SG_ FLR2RdrObject0To1LgtVelo0 : 168|11@1+ (0.125,-128.0) [-128.0|127.875] "m/s" FLRdpHPA,FLRdpHPB
 SG_ FLR2RdrObject0To1LgtVelo1 : 327|11@1+ (0.125,-128.0) [-128.0|127.875] "m/s" FLRdpHPA,FLRdpHPB
 SG_ FLR2RdrObject0To1ModeInfo0 : 179|2@1+ (1,0) [0|3] "" FLRdpHPA,FLRdpHPB
 SG_ FLR2RdrObject0To1ModeInfo1 : 338|2@1+ (1,0) [0|3] "" FLRdpHPA,FLRdpHPB
 SG_ FLR2RdrObject0To1MsgCntr : 32|4@1+ (1.0,0.0) [0.0|15.0] "Unitless" FLRdpHPA,FLRdpHPB
 SG_ FLR2RdrObject0To1MtnModel0 : 181|2@1+ (1.0,0.0) [0.0|3.0] "Unitless" FLRdpHPA,FLRdpHPB
 SG_ FLR2RdrObject0To1MtnModel1 : 340|2@1+ (1.0,0.0) [0.0|3.0] "Unitless" FLRdpHPA,FLRdpHPB
 SG_ FLR2RdrObject0To1MtnPattern0 : 183|4@1+ (1,0) [0|15] "" FLRdpHPA,FLRdpHPB
 SG_ FLR2RdrObject0To1MtnPattern1 : 342|4@1+ (1,0) [0|15] "" FLRdpHPA,FLRdpHPB
 SG_ FLR2RdrObject0To1PedMicroDoppler0 : 187|1@1+ (1.0,0.0) [0.0|1.0] "Unitless" FLRdpHPA,FLRdpHPB
 SG_ FLR2RdrObject0To1PedMicroDoppler1 : 346|1@1+ (1.0,0.0) [0.0|1.0] "Unitless" FLRdpHPA,FLRdpHPB
 SG_ FLR2RdrObject0To1Qly0 : 188|7@1+ (1.0,0.0) [0.0|100.0] "Unitless" FLRdpHPA,FLRdpHPB
 SG_ FLR2RdrObject0To1Qly1 : 347|7@1+ (1.0,0.0) [0.0|100.0] "Unitless" FLRdpHPA,FLRdpHPB
 SG_ FLR2RdrObject0To1ScanID : 24|8@1+ (1.0,0.0) [0.0|255.0] "Unitless" FLRdpHPA,FLRdpHPB

BO_ 322 FlrFlr1canFr82 : 64 FLR
 SG_ FLR2RdrObject2To3_UB : 367|1@0+ (1,0) [0|1] "" FLRdpHPA,FLRdpHPB
 SG_ FLR2RdrObject2To3Class0 : 36|2@1+ (1,0) [0|3] "" FLRdpHPA,FLRdpHPB
 SG_ FLR2RdrObject2To3Class1 : 195|2@1+ (1,0) [0|3] "" FLRdpHPA,FLRdpHPB
 SG_ FLR2RdrObject2To3Counter : 16|8@1+ (1.0,0.0) [0.0|255.0] "Unitless" FLRdpHPA,FLRdpHPB
 SG_ FLR2RdrObject2To3CRC : 0|16@1+ (1.0,0.0) [0.0|65535.0] "Unitless" FLRdpHPA,FLRdpHPB
 SG_ FLR2RdrObject2To3DataCoastCntr0 : 38|3@1+ (1,0) [0|7] "" FLRdpHPA,FLRdpHPB
 SG_ FLR2RdrObject2To3DataCoastCntr1 : 197|3@1+ (1,0) [0|7] "" FLRdpHPA,FLRdpHPB
 SG_ FLR2RdrObject2To3DataConf0 : 41|7@1+ (1.0,0.0) [0.0|100.0] "%" FLRdpHPA,FLRdpHPB
 SG_ FLR2RdrObject2To3DataConf1 : 200|7@1+ (1.0,0.0) [0.0|100.0] "%" FLRdpHPA,FLRdpHPB
 SG_ FLR2RdrObject2To3DataLen0 : 48|8@1+ (0.2,0.0) [0.0|30.0] "m" FLRdpHPA,FLRdpHPB
 SG_ FLR2RdrObject2To3DataLen1 : 207|8@1+ (0.2,0.0) [0.0|30.0] "m" FLRdpHPA,FLRdpHPB
 SG_ FLR2RdrObject2To3DataStDLatAcc0 : 56|5@1+ (0.35,0.0) [0.0|10.85] "m/s^2" FLRdpHPA,FLRdpHPB
 SG_ FLR2RdrObject2To3DataStDLatAcc1 : 215|5@1+ (0.35,0.0) [0.0|10.85] "m/s^2" FLRdpHPA,FLRdpHPB
 SG_ FLR2RdrObject2To3DataStDLatPos0 : 61|8@1+ (0.1,0.0) [0.0|25.5] "m" FLRdpHPA,FLRdpHPB
 SG_ FLR2RdrObject2To3DataStDLatPos1 : 220|8@1+ (0.1,0.0) [0.0|25.5] "m" FLRdpHPA,FLRdpHPB
 SG_ FLR2RdrObject2To3DataStDLatVelo0 : 69|6@1+ (0.2,0.0) [0.0|12.600000000000001] "m/s" FLRdpHPA,FLRdpHPB
 SG_ FLR2RdrObject2To3DataStDLatVelo1 : 228|6@1+ (0.2,0.0) [0.0|12.600000000000001] "m/s" FLRdpHPA,FLRdpHPB
 SG_ FLR2RdrObject2To3DataStDLgtAcc0 : 75|5@1+ (0.35,0.0) [0.0|10.85] "m/s^2" FLRdpHPA,FLRdpHPB
 SG_ FLR2RdrObject2To3DataStDLgtAcc1 : 234|5@1+ (0.35,0.0) [0.0|10.85] "m/s^2" FLRdpHPA,FLRdpHPB
 SG_ FLR2RdrObject2To3DataStDLgtPos0 : 80|8@1+ (0.05,0.0) [0.0|12.75] "m" FLRdpHPA,FLRdpHPB
 SG_ FLR2RdrObject2To3DataStDLgtPos1 : 239|8@1+ (0.05,0.0) [0.0|12.75] "m" FLRdpHPA,FLRdpHPB
 SG_ FLR2RdrObject2To3DataStDLgtVelo0 : 88|6@1+ (0.2,0.0) [0.0|12.600000000000001] "m/s" FLRdpHPA,FLRdpHPB
 SG_ FLR2RdrObject2To3DataStDLgtVelo1 : 247|6@1+ (0.2,0.0) [0.0|12.600000000000001] "m/s" FLRdpHPA,FLRdpHPB
 SG_ FLR2RdrObject2To3DataWidth0 : 94|7@1+ (0.2,0.0) [0.0|15.0] "m" FLRdpHPA,FLRdpHPB
 SG_ FLR2RdrObject2To3DataWidth1 : 253|7@1+ (0.2,0.0) [0.0|15.0] "m" FLRdpHPA,FLRdpHPB
 SG_ FLR2RdrObject2To3HeadingAng0 : 101|10@1+ (0.01,-3.15) [-3.15|3.15] "rad" FLRdpHPA,FLRdpHPB
 SG_ FLR2RdrObject2To3HeadingAng1 : 260|10@1+ (0.01,-3.15) [-3.15|3.15] "rad" FLRdpHPA,FLRdpHPB
 SG_ FLR2RdrObject2To3LatAcc0 : 111|10@1+ (0.125,-44.5) [-44.5|44.5] "m/s^2" FLRdpHPA,FLRdpHPB
 SG_ FLR2RdrObject2To3LatAcc1 : 270|10@1+ (0.125,-44.5) [-44.5|44.5] "m/s^2" FLRdpHPA,FLRdpHPB
 SG_ FLR2RdrObject2To3LatPos0 : 121|13@1+ (0.0625,-255.9375) [-255.9375|255.9375] "Unitless" FLRdpHPA,FLRdpHPB
 SG_ FLR2RdrObject2To3LatPos1 : 280|13@1+ (0.0625,-255.9375) [-255.9375|255.9375] "Unitless" FLRdpHPA,FLRdpHPB
 SG_ FLR2RdrObject2To3LatVelo0 : 134|11@1+ (0.125,-128.0) [-128.0|127.875] "m/s" FLRdpHPA,FLRdpHPB
 SG_ FLR2RdrObject2To3LatVelo1 : 293|11@1+ (0.125,-128.0) [-128.0|127.875] "m/s" FLRdpHPA,FLRdpHPB
 SG_ FLR2RdrObject2To3LgtAcc0 : 145|10@1+ (0.125,-44.5) [-44.5|44.5] "m/s^2" FLRdpHPA,FLRdpHPB
 SG_ FLR2RdrObject2To3LgtAcc1 : 304|10@1+ (0.125,-44.5) [-44.5|44.5] "m/s^2" FLRdpHPA,FLRdpHPB
 SG_ FLR2RdrObject2To3LgtPos0 : 155|13@1+ (0.0625,-255.9375) [-255.9375|255.9375] "Unitless" FLRdpHPA,FLRdpHPB
 SG_ FLR2RdrObject2To3LgtPos1 : 314|13@1+ (0.0625,-255.9375) [-255.9375|255.9375] "Unitless" FLRdpHPA,FLRdpHPB
 SG_ FLR2RdrObject2To3LgtVelo0 : 168|11@1+ (0.125,-128.0) [-128.0|127.875] "m/s" FLRdpHPA,FLRdpHPB
 SG_ FLR2RdrObject2To3LgtVelo1 : 327|11@1+ (0.125,-128.0) [-128.0|127.875] "m/s" FLRdpHPA,FLRdpHPB
 SG_ FLR2RdrObject2To3ModeInfo0 : 179|2@1+ (1,0) [0|3] "" FLRdpHPA,FLRdpHPB
 SG_ FLR2RdrObject2To3ModeInfo1 : 338|2@1+ (1,0) [0|3] "" FLRdpHPA,FLRdpHPB
 SG_ FLR2RdrObject2To3MsgCntr : 32|4@1+ (1.0,0.0) [0.0|15.0] "Unitless" FLRdpHPA,FLRdpHPB
 SG_ FLR2RdrObject2To3MtnModel0 : 181|2@1+ (1.0,0.0) [0.0|3.0] "Unitless" FLRdpHPA,FLRdpHPB
 SG_ FLR2RdrObject2To3MtnModel1 : 340|2@1+ (1.0,0.0) [0.0|3.0] "Unitless" FLRdpHPA,FLRdpHPB
 SG_ FLR2RdrObject2To3MtnPattern0 : 183|4@1+ (1,0) [0|15] "" FLRdpHPA,FLRdpHPB
 SG_ FLR2RdrObject2To3MtnPattern1 : 342|4@1+ (1,0) [0|15] "" FLRdpHPA,FLRdpHPB
 SG_ FLR2RdrObject2To3PedMicroDoppler0 : 187|1@1+ (1.0,0.0) [0.0|1.0] "Unitless" FLRdpHPA,FLRdpHPB
 SG_ FLR2RdrObject2To3PedMicroDoppler1 : 346|1@1+ (1.0,0.0) [0.0|1.0] "Unitless" FLRdpHPA,FLRdpHPB
 SG_ FLR2RdrObject2To3Qly0 : 188|7@1+ (1.0,0.0) [0.0|100.0] "Unitless" FLRdpHPA,FLRdpHPB
 SG_ FLR2RdrObject2To3Qly1 : 347|7@1+ (1.0,0.0) [0.0|100.0] "Unitless" FLRdpHPA,FLRdpHPB
 SG_ FLR2RdrObject2To3ScanID : 24|8@1+ (1.0,0.0) [0.0|255.0] "Unitless" FLRdpHPA,FLRdpHPB

CM_ SG_ 278 FLR2RdrDetn340To344AziAng0 "Azimuth Angle";
CM_ SG_ 278 FLR2RdrDetn340To344AziAng1 "Azimuth Angle";
CM_ SG_ 278 FLR2RdrDetn340To344AziAng2 "Azimuth Angle";
CM_ SG_ 278 FLR2RdrDetn340To344AziAng3 "Azimuth Angle";
CM_ SG_ 278 FLR2RdrDetn340To344AziAng4 "Azimuth Angle";
CM_ SG_ 278 FLR2RdrDetn340To344DynPrpty0 "Moving/Stationary";
CM_ SG_ 278 FLR2RdrDetn340To344DynPrpty1 "Moving/Stationary";
CM_ SG_ 278 FLR2RdrDetn340To344DynPrpty2 "Moving/Stationary";
CM_ SG_ 278 FLR2RdrDetn340To344DynPrpty3 "Moving/Stationary";
CM_ SG_ 278 FLR2RdrDetn340To344DynPrpty4 "Moving/Stationary";
CM_ SG_ 278 FLR2RdrDetn340To344EleAng0 "Elevation angle";
CM_ SG_ 278 FLR2RdrDetn340To344EleAng1 "Elevation angle";
CM_ SG_ 278 FLR2RdrDetn340To344EleAng2 "Elevation angle";
CM_ SG_ 278 FLR2RdrDetn340To344EleAng3 "Elevation angle";
CM_ SG_ 278 FLR2RdrDetn340To344EleAng4 "Elevation angle";
CM_ SG_ 278 FLR2RdrDetn340To344Mode0 "What chirp mode the detection is from";
CM_ SG_ 278 FLR2RdrDetn340To344Mode1 "What chirp mode the detection is from";
CM_ SG_ 278 FLR2RdrDetn340To344Mode2 "What chirp mode the detection is from";
CM_ SG_ 278 FLR2RdrDetn340To344Mode3 "What chirp mode the detection is from";
CM_ SG_ 278 FLR2RdrDetn340To344Mode4 "What chirp mode the detection is from";
CM_ SG_ 278 FLR2RdrDetn340To344Quality0 "Quality";
CM_ SG_ 278 FLR2RdrDetn340To344Quality1 "Quality";
CM_ SG_ 278 FLR2RdrDetn340To344Quality2 "Quality";
CM_ SG_ 278 FLR2RdrDetn340To344Quality3 "Quality";
CM_ SG_ 278 FLR2RdrDetn340To344Quality4 "Quality";
CM_ SG_ 278 FLR2RdrDetn340To344Range0 "Range from sensor to object";
CM_ SG_ 278 FLR2RdrDetn340To344Range1 "Range from sensor to object";
CM_ SG_ 278 FLR2RdrDetn340To344Range2 "Range from sensor to object";
CM_ SG_ 278 FLR2RdrDetn340To344Range3 "Range from sensor to object";
CM_ SG_ 278 FLR2RdrDetn340To344Range4 "Range from sensor to object";
CM_ SG_ 278 FLR2RdrDetn340To344RCS0 "RCS";
CM_ SG_ 278 FLR2RdrDetn340To344RCS1 "RCS";
CM_ SG_ 278 FLR2RdrDetn340To344RCS2 "RCS";
CM_ SG_ 278 FLR2RdrDetn340To344RCS3 "RCS";
CM_ SG_ 278 FLR2RdrDetn340To344RCS4 "RCS";
CM_ SG_ 278 FLR2RdrDetn340To344RngRt0 "Speed towards/away from the sensor";
CM_ SG_ 278 FLR2RdrDetn340To344RngRt1 "Speed towards/away from the sensor";
CM_ SG_ 278 FLR2RdrDetn340To344RngRt2 "Speed towards/away from the sensor";
CM_ SG_ 278 FLR2RdrDetn340To344RngRt3 "Speed towards/away from the sensor";
CM_ SG_ 278 FLR2RdrDetn340To344RngRt4 "Speed towards/away from the sensor";
CM_ SG_ 278 FLR2RdrDetn340To344ScanID "Value to tie status, detection data and object data frames together";
CM_ SG_ 278 FLR2RdrDetn340To344SNR0 "Signal to Noise Ratio";
CM_ SG_ 278 FLR2RdrDetn340To344SNR1 "Signal to Noise Ration";
CM_ SG_ 278 FLR2RdrDetn340To344SNR2 "Signal to Noise Ration";
CM_ SG_ 278 FLR2RdrDetn340To344SNR3 "Signal to Noise Ration";
CM_ SG_ 278 FLR2RdrDetn340To344SNR4 "Signal to Noise Ration";
CM_ SG_ 280 FLR2RdrDetn345To349AziAng0 "Azimuth Angle";
CM_ SG_ 280 FLR2RdrDetn345To349AziAng1 "Azimuth Angle";
CM_ SG_ 280 FLR2RdrDetn345To349AziAng2 "Azimuth Angle";
CM_ SG_ 280 FLR2RdrDetn345To349AziAng3 "Azimuth Angle";
CM_ SG_ 280 FLR2RdrDetn345To349AziAng4 "Azimuth Angle";
CM_ SG_ 280 FLR2RdrDetn345To349DynPrpty0 "Moving/Stationary";
CM_ SG_ 280 FLR2RdrDetn345To349DynPrpty1 "Moving/Stationary";
CM_ SG_ 280 FLR2RdrDetn345To349DynPrpty2 "Moving/Stationary";
CM_ SG_ 280 FLR2RdrDetn345To349DynPrpty3 "Moving/Stationary";
CM_ SG_ 280 FLR2RdrDetn345To349DynPrpty4 "Moving/Stationary";
CM_ SG_ 280 FLR2RdrDetn345To349EleAng0 "Elevation angle";
CM_ SG_ 280 FLR2RdrDetn345To349EleAng1 "Elevation angle";
CM_ SG_ 280 FLR2RdrDetn345To349EleAng2 "Elevation angle";
CM_ SG_ 280 FLR2RdrDetn345To349EleAng3 "Elevation angle";
CM_ SG_ 280 FLR2RdrDetn345To349EleAng4 "Elevation angle";
CM_ SG_ 280 FLR2RdrDetn345To349Mode0 "What chirp mode the detection is from";
CM_ SG_ 280 FLR2RdrDetn345To349Mode1 "What chirp mode the detection is from";
CM_ SG_ 280 FLR2RdrDetn345To349Mode2 "What chirp mode the detection is from";
CM_ SG_ 280 FLR2RdrDetn345To349Mode3 "What chirp mode the detection is from";
CM_ SG_ 280 FLR2RdrDetn345To349Mode4 "What chirp mode the detection is from";
CM_ SG_ 280 FLR2RdrDetn345To349Quality0 "Quality";
CM_ SG_ 280 FLR2RdrDetn345To349Quality1 "Quality";
CM_ SG_ 280 FLR2RdrDetn345To349Quality2 "Quality";
CM_ SG_ 280 FLR2RdrDetn345To349Quality3 "Quality";
CM_ SG_ 280 FLR2RdrDetn345To349Quality4 "Quality";
CM_ SG_ 280 FLR2RdrDetn345To349Range0 "Range from sensor to object";
CM_ SG_ 280 FLR2RdrDetn345To349Range1 "Range from sensor to object";
CM_ SG_ 280 FLR2RdrDetn345To349Range2 "Range from sensor to object";
CM_ SG_ 280 FLR2RdrDetn345To349Range3 "Range from sensor to object";
CM_ SG_ 280 FLR2RdrDetn345To349Range4 "Range from sensor to object";
CM_ SG_ 280 FLR2RdrDetn345To349RCS0 "RCS";
CM_ SG_ 280 FLR2RdrDetn345To349RCS1 "RCS";
CM_ SG_ 280 FLR2RdrDetn345To349RCS2 "RCS";
CM_ SG_ 280 FLR2RdrDetn345To349RCS3 "RCS";
CM_ SG_ 280 FLR2RdrDetn345To349RCS4 "RCS";
CM_ SG_ 280 FLR2RdrDetn345To349RngRt0 "Speed towards/away from the sensor";
CM_ SG_ 280 FLR2RdrDetn345To349RngRt1 "Speed towards/away from the sensor";
CM_ SG_ 280 FLR2RdrDetn345To349RngRt2 "Speed towards/away from the sensor";
CM_ SG_ 280 FLR2RdrDetn345To349RngRt3 "Speed towards/away from the sensor";
CM_ SG_ 280 FLR2RdrDetn345To349RngRt4 "Speed towards/away from the sensor";
CM_ SG_ 280 FLR2RdrDetn345To349ScanID "Value to tie status, detection data and object data frames together";
CM_ SG_ 280 FLR2RdrDetn345To349SNR0 "Signal to Noise Ratio";
CM_ SG_ 280 FLR2RdrDetn345To349SNR1 "Signal to Noise Ration";
CM_ SG_ 280 FLR2RdrDetn345To349SNR2 "Signal to Noise Ration";
CM_ SG_ 280 FLR2RdrDetn345To349SNR3 "Signal to Noise Ration";
CM_ SG_ 280 FLR2RdrDetn345To349SNR4 "Signal to Noise Ration";
CM_ SG_ 282 FLR2RdrDetn350To354AziAng0 "Azimuth Angle";
CM_ SG_ 282 FLR2RdrDetn350To354AziAng1 "Azimuth Angle";
CM_ SG_ 282 FLR2RdrDetn350To354AziAng2 "Azimuth Angle";
CM_ SG_ 282 FLR2RdrDetn350To354AziAng3 "Azimuth Angle";
CM_ SG_ 282 FLR2RdrDetn350To354AziAng4 "Azimuth Angle";
CM_ SG_ 282 FLR2RdrDetn350To354DynPrpty0 "Moving/Stationary";
CM_ SG_ 282 FLR2RdrDetn350To354DynPrpty1 "Moving/Stationary";
CM_ SG_ 282 FLR2RdrDetn350To354DynPrpty2 "Moving/Stationary";
CM_ SG_ 282 FLR2RdrDetn350To354DynPrpty3 "Moving/Stationary";
CM_ SG_ 282 FLR2RdrDetn350To354DynPrpty4 "Moving/Stationary";
CM_ SG_ 282 FLR2RdrDetn350To354EleAng0 "Elevation angle";
CM_ SG_ 282 FLR2RdrDetn350To354EleAng1 "Elevation angle";
CM_ SG_ 282 FLR2RdrDetn350To354EleAng2 "Elevation angle";
CM_ SG_ 282 FLR2RdrDetn350To354EleAng3 "Elevation angle";
CM_ SG_ 282 FLR2RdrDetn350To354EleAng4 "Elevation angle";
CM_ SG_ 282 FLR2RdrDetn350To354Mode0 "What chirp mode the detection is from";
CM_ SG_ 282 FLR2RdrDetn350To354Mode1 "What chirp mode the detection is from";
CM_ SG_ 282 FLR2RdrDetn350To354Mode2 "What chirp mode the detection is from";
CM_ SG_ 282 FLR2RdrDetn350To354Mode3 "What chirp mode the detection is from";
CM_ SG_ 282 FLR2RdrDetn350To354Mode4 "What chirp mode the detection is from";
CM_ SG_ 282 FLR2RdrDetn350To354Quality0 "Quality";
CM_ SG_ 282 FLR2RdrDetn350To354Quality1 "Quality";
CM_ SG_ 282 FLR2RdrDetn350To354Quality2 "Quality";
CM_ SG_ 282 FLR2RdrDetn350To354Quality3 "Quality";
CM_ SG_ 282 FLR2RdrDetn350To354Quality4 "Quality";
CM_ SG_ 282 FLR2RdrDetn350To354Range0 "Range from sensor to object";
CM_ SG_ 282 FLR2RdrDetn350To354Range1 "Range from sensor to object";
CM_ SG_ 282 FLR2RdrDetn350To354Range2 "Range from sensor to object";
CM_ SG_ 282 FLR2RdrDetn350To354Range3 "Range from sensor to object";
CM_ SG_ 282 FLR2RdrDetn350To354Range4 "Range from sensor to object";
CM_ SG_ 282 FLR2RdrDetn350To354RCS0 "RCS";
CM_ SG_ 282 FLR2RdrDetn350To354RCS1 "RCS";
CM_ SG_ 282 FLR2RdrDetn350To354RCS2 "RCS";
CM_ SG_ 282 FLR2RdrDetn350To354RCS3 "RCS";
CM_ SG_ 282 FLR2RdrDetn350To354RCS4 "RCS";
CM_ SG_ 282 FLR2RdrDetn350To354RngRt0 "Speed towards/away from the sensor";
CM_ SG_ 282 FLR2RdrDetn350To354RngRt1 "Speed towards/away from the sensor";
CM_ SG_ 282 FLR2RdrDetn350To354RngRt2 "Speed towards/away from the sensor";
CM_ SG_ 282 FLR2RdrDetn350To354RngRt3 "Speed towards/away from the sensor";
CM_ SG_ 282 FLR2RdrDetn350To354RngRt4 "Speed towards/away from the sensor";
CM_ SG_ 282 FLR2RdrDetn350To354ScanID "Value to tie status, detection data and object data frames together";
CM_ SG_ 282 FLR2RdrDetn350To354SNR0 "Signal to Noise Ratio";
CM_ SG_ 282 FLR2RdrDetn350To354SNR1 "Signal to Noise Ration";
CM_ SG_ 282 FLR2RdrDetn350To354SNR2 "Signal to Noise Ration";
CM_ SG_ 282 FLR2RdrDetn350To354SNR3 "Signal to Noise Ration";
CM_ SG_ 282 FLR2RdrDetn350To354SNR4 "Signal to Noise Ration";
CM_ SG_ 284 FLR2RdrDetn355To359AziAng0 "Azimuth Angle";
CM_ SG_ 284 FLR2RdrDetn355To359AziAng1 "Azimuth Angle";
CM_ SG_ 284 FLR2RdrDetn355To359AziAng2 "Azimuth Angle";
CM_ SG_ 284 FLR2RdrDetn355To359AziAng3 "Azimuth Angle";
CM_ SG_ 284 FLR2RdrDetn355To359AziAng4 "Azimuth Angle";
CM_ SG_ 284 FLR2RdrDetn355To359DynPrpty0 "Moving/Stationary";
CM_ SG_ 284 FLR2RdrDetn355To359DynPrpty1 "Moving/Stationary";
CM_ SG_ 284 FLR2RdrDetn355To359DynPrpty2 "Moving/Stationary";
CM_ SG_ 284 FLR2RdrDetn355To359DynPrpty3 "Moving/Stationary";
CM_ SG_ 284 FLR2RdrDetn355To359DynPrpty4 "Moving/Stationary";
CM_ SG_ 284 FLR2RdrDetn355To359EleAng0 "Elevation angle";
CM_ SG_ 284 FLR2RdrDetn355To359EleAng1 "Elevation angle";
CM_ SG_ 284 FLR2RdrDetn355To359EleAng2 "Elevation angle";
CM_ SG_ 284 FLR2RdrDetn355To359EleAng3 "Elevation angle";
CM_ SG_ 284 FLR2RdrDetn355To359EleAng4 "Elevation angle";
CM_ SG_ 284 FLR2RdrDetn355To359Mode0 "What chirp mode the detection is from";
CM_ SG_ 284 FLR2RdrDetn355To359Mode1 "What chirp mode the detection is from";
CM_ SG_ 284 FLR2RdrDetn355To359Mode2 "What chirp mode the detection is from";
CM_ SG_ 284 FLR2RdrDetn355To359Mode3 "What chirp mode the detection is from";
CM_ SG_ 284 FLR2RdrDetn355To359Mode4 "What chirp mode the detection is from";
CM_ SG_ 284 FLR2RdrDetn355To359Quality0 "Quality";
CM_ SG_ 284 FLR2RdrDetn355To359Quality1 "Quality";
CM_ SG_ 284 FLR2RdrDetn355To359Quality2 "Quality";
CM_ SG_ 284 FLR2RdrDetn355To359Quality3 "Quality";
CM_ SG_ 284 FLR2RdrDetn355To359Quality4 "Quality";
CM_ SG_ 284 FLR2RdrDetn355To359Range0 "Range from sensor to object";
CM_ SG_ 284 FLR2RdrDetn355To359Range1 "Range from sensor to object";
CM_ SG_ 284 FLR2RdrDetn355To359Range2 "Range from sensor to object";
CM_ SG_ 284 FLR2RdrDetn355To359Range3 "Range from sensor to object";
CM_ SG_ 284 FLR2RdrDetn355To359Range4 "Range from sensor to object";
CM_ SG_ 284 FLR2RdrDetn355To359RCS0 "RCS";
CM_ SG_ 284 FLR2RdrDetn355To359RCS1 "RCS";
CM_ SG_ 284 FLR2RdrDetn355To359RCS2 "RCS";
CM_ SG_ 284 FLR2RdrDetn355To359RCS3 "RCS";
CM_ SG_ 284 FLR2RdrDetn355To359RCS4 "RCS";
CM_ SG_ 284 FLR2RdrDetn355To359RngRt0 "Speed towards/away from the sensor";
CM_ SG_ 284 FLR2RdrDetn355To359RngRt1 "Speed towards/away from the sensor";
CM_ SG_ 284 FLR2RdrDetn355To359RngRt2 "Speed towards/away from the sensor";
CM_ SG_ 284 FLR2RdrDetn355To359RngRt3 "Speed towards/away from the sensor";
CM_ SG_ 284 FLR2RdrDetn355To359RngRt4 "Speed towards/away from the sensor";
CM_ SG_ 284 FLR2RdrDetn355To359ScanID "Value to tie status, detection data and object data frames together";
CM_ SG_ 284 FLR2RdrDetn355To359SNR0 "Signal to Noise Ratio";
CM_ SG_ 284 FLR2RdrDetn355To359SNR1 "Signal to Noise Ration";
CM_ SG_ 284 FLR2RdrDetn355To359SNR2 "Signal to Noise Ration";
CM_ SG_ 284 FLR2RdrDetn355To359SNR3 "Signal to Noise Ration";
CM_ SG_ 284 FLR2RdrDetn355To359SNR4 "Signal to Noise Ration";
CM_ SG_ 286 FLR2RdrDetn360To364AziAng0 "Azimuth Angle";
CM_ SG_ 286 FLR2RdrDetn360To364AziAng1 "Azimuth Angle";
CM_ SG_ 286 FLR2RdrDetn360To364AziAng2 "Azimuth Angle";
CM_ SG_ 286 FLR2RdrDetn360To364AziAng3 "Azimuth Angle";
CM_ SG_ 286 FLR2RdrDetn360To364AziAng4 "Azimuth Angle";
CM_ SG_ 286 FLR2RdrDetn360To364DynPrpty0 "Moving/Stationary";
CM_ SG_ 286 FLR2RdrDetn360To364DynPrpty1 "Moving/Stationary";
CM_ SG_ 286 FLR2RdrDetn360To364DynPrpty2 "Moving/Stationary";
CM_ SG_ 286 FLR2RdrDetn360To364DynPrpty3 "Moving/Stationary";
CM_ SG_ 286 FLR2RdrDetn360To364DynPrpty4 "Moving/Stationary";
CM_ SG_ 286 FLR2RdrDetn360To364EleAng0 "Elevation angle";
CM_ SG_ 286 FLR2RdrDetn360To364EleAng1 "Elevation angle";
CM_ SG_ 286 FLR2RdrDetn360To364EleAng2 "Elevation angle";
CM_ SG_ 286 FLR2RdrDetn360To364EleAng3 "Elevation angle";
CM_ SG_ 286 FLR2RdrDetn360To364EleAng4 "Elevation angle";
CM_ SG_ 286 FLR2RdrDetn360To364Mode0 "What chirp mode the detection is from";
CM_ SG_ 286 FLR2RdrDetn360To364Mode1 "What chirp mode the detection is from";
CM_ SG_ 286 FLR2RdrDetn360To364Mode2 "What chirp mode the detection is from";
CM_ SG_ 286 FLR2RdrDetn360To364Mode3 "What chirp mode the detection is from";
CM_ SG_ 286 FLR2RdrDetn360To364Mode4 "What chirp mode the detection is from";
CM_ SG_ 286 FLR2RdrDetn360To364Quality0 "Quality";
CM_ SG_ 286 FLR2RdrDetn360To364Quality1 "Quality";
CM_ SG_ 286 FLR2RdrDetn360To364Quality2 "Quality";
CM_ SG_ 286 FLR2RdrDetn360To364Quality3 "Quality";
CM_ SG_ 286 FLR2RdrDetn360To364Quality4 "Quality";
CM_ SG_ 286 FLR2RdrDetn360To364Range0 "Range from sensor to object";
CM_ SG_ 286 FLR2RdrDetn360To364Range1 "Range from sensor to object";
CM_ SG_ 286 FLR2RdrDetn360To364Range2 "Range from sensor to object";
CM_ SG_ 286 FLR2RdrDetn360To364Range3 "Range from sensor to object";
CM_ SG_ 286 FLR2RdrDetn360To364Range4 "Range from sensor to object";
CM_ SG_ 286 FLR2RdrDetn360To364RCS0 "RCS";
CM_ SG_ 286 FLR2RdrDetn360To364RCS1 "RCS";
CM_ SG_ 286 FLR2RdrDetn360To364RCS2 "RCS";
CM_ SG_ 286 FLR2RdrDetn360To364RCS3 "RCS";
CM_ SG_ 286 FLR2RdrDetn360To364RCS4 "RCS";
CM_ SG_ 286 FLR2RdrDetn360To364RngRt0 "Speed towards/away from the sensor";
CM_ SG_ 286 FLR2RdrDetn360To364RngRt1 "Speed towards/away from the sensor";
CM_ SG_ 286 FLR2RdrDetn360To364RngRt2 "Speed towards/away from the sensor";
CM_ SG_ 286 FLR2RdrDetn360To364RngRt3 "Speed towards/away from the sensor";
CM_ SG_ 286 FLR2RdrDetn360To364RngRt4 "Speed towards/away from the sensor";
CM_ SG_ 286 FLR2RdrDetn360To364ScanID "Value to tie status, detection data and object data frames together";
CM_ SG_ 286 FLR2RdrDetn360To364SNR0 "Signal to Noise Ratio";
CM_ SG_ 286 FLR2RdrDetn360To364SNR1 "Signal to Noise Ration";
CM_ SG_ 286 FLR2RdrDetn360To364SNR2 "Signal to Noise Ration";
CM_ SG_ 286 FLR2RdrDetn360To364SNR3 "Signal to Noise Ration";
CM_ SG_ 286 FLR2RdrDetn360To364SNR4 "Signal to Noise Ration";
CM_ SG_ 288 FLR2RdrDetn365To369AziAng0 "Azimuth Angle";
CM_ SG_ 288 FLR2RdrDetn365To369AziAng1 "Azimuth Angle";
CM_ SG_ 288 FLR2RdrDetn365To369AziAng2 "Azimuth Angle";
CM_ SG_ 288 FLR2RdrDetn365To369AziAng3 "Azimuth Angle";
CM_ SG_ 288 FLR2RdrDetn365To369AziAng4 "Azimuth Angle";
CM_ SG_ 288 FLR2RdrDetn365To369DynPrpty0 "Moving/Stationary";
CM_ SG_ 288 FLR2RdrDetn365To369DynPrpty1 "Moving/Stationary";
CM_ SG_ 288 FLR2RdrDetn365To369DynPrpty2 "Moving/Stationary";
CM_ SG_ 288 FLR2RdrDetn365To369DynPrpty3 "Moving/Stationary";
CM_ SG_ 288 FLR2RdrDetn365To369DynPrpty4 "Moving/Stationary";
CM_ SG_ 288 FLR2RdrDetn365To369EleAng0 "Elevation angle";
CM_ SG_ 288 FLR2RdrDetn365To369EleAng1 "Elevation angle";
CM_ SG_ 288 FLR2RdrDetn365To369EleAng2 "Elevation angle";
CM_ SG_ 288 FLR2RdrDetn365To369EleAng3 "Elevation angle";
CM_ SG_ 288 FLR2RdrDetn365To369EleAng4 "Elevation angle";
CM_ SG_ 288 FLR2RdrDetn365To369Mode0 "What chirp mode the detection is from";
CM_ SG_ 288 FLR2RdrDetn365To369Mode1 "What chirp mode the detection is from";
CM_ SG_ 288 FLR2RdrDetn365To369Mode2 "What chirp mode the detection is from";
CM_ SG_ 288 FLR2RdrDetn365To369Mode3 "What chirp mode the detection is from";
CM_ SG_ 288 FLR2RdrDetn365To369Mode4 "What chirp mode the detection is from";
CM_ SG_ 288 FLR2RdrDetn365To369Quality0 "Quality";
CM_ SG_ 288 FLR2RdrDetn365To369Quality1 "Quality";
CM_ SG_ 288 FLR2RdrDetn365To369Quality2 "Quality";
CM_ SG_ 288 FLR2RdrDetn365To369Quality3 "Quality";
CM_ SG_ 288 FLR2RdrDetn365To369Quality4 "Quality";
CM_ SG_ 288 FLR2RdrDetn365To369Range0 "Range from sensor to object";
CM_ SG_ 288 FLR2RdrDetn365To369Range1 "Range from sensor to object";
CM_ SG_ 288 FLR2RdrDetn365To369Range2 "Range from sensor to object";
CM_ SG_ 288 FLR2RdrDetn365To369Range3 "Range from sensor to object";
CM_ SG_ 288 FLR2RdrDetn365To369Range4 "Range from sensor to object";
CM_ SG_ 288 FLR2RdrDetn365To369RCS0 "RCS";
CM_ SG_ 288 FLR2RdrDetn365To369RCS1 "RCS";
CM_ SG_ 288 FLR2RdrDetn365To369RCS2 "RCS";
CM_ SG_ 288 FLR2RdrDetn365To369RCS3 "RCS";
CM_ SG_ 288 FLR2RdrDetn365To369RCS4 "RCS";
CM_ SG_ 288 FLR2RdrDetn365To369RngRt0 "Speed towards/away from the sensor";
CM_ SG_ 288 FLR2RdrDetn365To369RngRt1 "Speed towards/away from the sensor";
CM_ SG_ 288 FLR2RdrDetn365To369RngRt2 "Speed towards/away from the sensor";
CM_ SG_ 288 FLR2RdrDetn365To369RngRt3 "Speed towards/away from the sensor";
CM_ SG_ 288 FLR2RdrDetn365To369RngRt4 "Speed towards/away from the sensor";
CM_ SG_ 288 FLR2RdrDetn365To369ScanID "Value to tie status, detection data and object data frames together";
CM_ SG_ 288 FLR2RdrDetn365To369SNR0 "Signal to Noise Ratio";
CM_ SG_ 288 FLR2RdrDetn365To369SNR1 "Signal to Noise Ration";
CM_ SG_ 288 FLR2RdrDetn365To369SNR2 "Signal to Noise Ration";
CM_ SG_ 288 FLR2RdrDetn365To369SNR3 "Signal to Noise Ration";
CM_ SG_ 288 FLR2RdrDetn365To369SNR4 "Signal to Noise Ration";
CM_ SG_ 290 FLR2RdrDetn370To374AziAng0 "Azimuth Angle";
CM_ SG_ 290 FLR2RdrDetn370To374AziAng1 "Azimuth Angle";
CM_ SG_ 290 FLR2RdrDetn370To374AziAng2 "Azimuth Angle";
CM_ SG_ 290 FLR2RdrDetn370To374AziAng3 "Azimuth Angle";
CM_ SG_ 290 FLR2RdrDetn370To374AziAng4 "Azimuth Angle";
CM_ SG_ 290 FLR2RdrDetn370To374DynPrpty0 "Moving/Stationary";
CM_ SG_ 290 FLR2RdrDetn370To374DynPrpty1 "Moving/Stationary";
CM_ SG_ 290 FLR2RdrDetn370To374DynPrpty2 "Moving/Stationary";
CM_ SG_ 290 FLR2RdrDetn370To374DynPrpty3 "Moving/Stationary";
CM_ SG_ 290 FLR2RdrDetn370To374DynPrpty4 "Moving/Stationary";
CM_ SG_ 290 FLR2RdrDetn370To374EleAng0 "Elevation angle";
CM_ SG_ 290 FLR2RdrDetn370To374EleAng1 "Elevation angle";
CM_ SG_ 290 FLR2RdrDetn370To374EleAng2 "Elevation angle";
CM_ SG_ 290 FLR2RdrDetn370To374EleAng3 "Elevation angle";
CM_ SG_ 290 FLR2RdrDetn370To374EleAng4 "Elevation angle";
CM_ SG_ 290 FLR2RdrDetn370To374Mode0 "What chirp mode the detection is from";
CM_ SG_ 290 FLR2RdrDetn370To374Mode1 "What chirp mode the detection is from";
CM_ SG_ 290 FLR2RdrDetn370To374Mode2 "What chirp mode the detection is from";
CM_ SG_ 290 FLR2RdrDetn370To374Mode3 "What chirp mode the detection is from";
CM_ SG_ 290 FLR2RdrDetn370To374Mode4 "What chirp mode the detection is from";
CM_ SG_ 290 FLR2RdrDetn370To374Quality0 "Quality";
CM_ SG_ 290 FLR2RdrDetn370To374Quality1 "Quality";
CM_ SG_ 290 FLR2RdrDetn370To374Quality2 "Quality";
CM_ SG_ 290 FLR2RdrDetn370To374Quality3 "Quality";
CM_ SG_ 290 FLR2RdrDetn370To374Quality4 "Quality";
CM_ SG_ 290 FLR2RdrDetn370To374Range0 "Range from sensor to object";
CM_ SG_ 290 FLR2RdrDetn370To374Range1 "Range from sensor to object";
CM_ SG_ 290 FLR2RdrDetn370To374Range2 "Range from sensor to object";
CM_ SG_ 290 FLR2RdrDetn370To374Range3 "Range from sensor to object";
CM_ SG_ 290 FLR2RdrDetn370To374Range4 "Range from sensor to object";
CM_ SG_ 290 FLR2RdrDetn370To374RCS0 "RCS";
CM_ SG_ 290 FLR2RdrDetn370To374RCS1 "RCS";
CM_ SG_ 290 FLR2RdrDetn370To374RCS2 "RCS";
CM_ SG_ 290 FLR2RdrDetn370To374RCS3 "RCS";
CM_ SG_ 290 FLR2RdrDetn370To374RCS4 "RCS";
CM_ SG_ 290 FLR2RdrDetn370To374RngRt0 "Speed towards/away from the sensor";
CM_ SG_ 290 FLR2RdrDetn370To374RngRt1 "Speed towards/away from the sensor";
CM_ SG_ 290 FLR2RdrDetn370To374RngRt2 "Speed towards/away from the sensor";
CM_ SG_ 290 FLR2RdrDetn370To374RngRt3 "Speed towards/away from the sensor";
CM_ SG_ 290 FLR2RdrDetn370To374RngRt4 "Speed towards/away from the sensor";
CM_ SG_ 290 FLR2RdrDetn370To374ScanID "Value to tie status, detection data and object data frames together";
CM_ SG_ 290 FLR2RdrDetn370To374SNR0 "Signal to Noise Ratio";
CM_ SG_ 290 FLR2RdrDetn370To374SNR1 "Signal to Noise Ration";
CM_ SG_ 290 FLR2RdrDetn370To374SNR2 "Signal to Noise Ration";
CM_ SG_ 290 FLR2RdrDetn370To374SNR3 "Signal to Noise Ration";
CM_ SG_ 290 FLR2RdrDetn370To374SNR4 "Signal to Noise Ration";
CM_ SG_ 292 FLR2RdrDetn375To379AziAng0 "Azimuth Angle";
CM_ SG_ 292 FLR2RdrDetn375To379AziAng1 "Azimuth Angle";
CM_ SG_ 292 FLR2RdrDetn375To379AziAng2 "Azimuth Angle";
CM_ SG_ 292 FLR2RdrDetn375To379AziAng3 "Azimuth Angle";
CM_ SG_ 292 FLR2RdrDetn375To379AziAng4 "Azimuth Angle";
CM_ SG_ 292 FLR2RdrDetn375To379DynPrpty0 "Moving/Stationary";
CM_ SG_ 292 FLR2RdrDetn375To379DynPrpty1 "Moving/Stationary";
CM_ SG_ 292 FLR2RdrDetn375To379DynPrpty2 "Moving/Stationary";
CM_ SG_ 292 FLR2RdrDetn375To379DynPrpty3 "Moving/Stationary";
CM_ SG_ 292 FLR2RdrDetn375To379DynPrpty4 "Moving/Stationary";
CM_ SG_ 292 FLR2RdrDetn375To379EleAng0 "Elevation angle";
CM_ SG_ 292 FLR2RdrDetn375To379EleAng1 "Elevation angle";
CM_ SG_ 292 FLR2RdrDetn375To379EleAng2 "Elevation angle";
CM_ SG_ 292 FLR2RdrDetn375To379EleAng3 "Elevation angle";
CM_ SG_ 292 FLR2RdrDetn375To379EleAng4 "Elevation angle";
CM_ SG_ 292 FLR2RdrDetn375To379Mode0 "What chirp mode the detection is from";
CM_ SG_ 292 FLR2RdrDetn375To379Mode1 "What chirp mode the detection is from";
CM_ SG_ 292 FLR2RdrDetn375To379Mode2 "What chirp mode the detection is from";
CM_ SG_ 292 FLR2RdrDetn375To379Mode3 "What chirp mode the detection is from";
CM_ SG_ 292 FLR2RdrDetn375To379Mode4 "What chirp mode the detection is from";
CM_ SG_ 292 FLR2RdrDetn375To379Quality0 "Quality";
CM_ SG_ 292 FLR2RdrDetn375To379Quality1 "Quality";
CM_ SG_ 292 FLR2RdrDetn375To379Quality2 "Quality";
CM_ SG_ 292 FLR2RdrDetn375To379Quality3 "Quality";
CM_ SG_ 292 FLR2RdrDetn375To379Quality4 "Quality";
CM_ SG_ 292 FLR2RdrDetn375To379Range0 "Range from sensor to object";
CM_ SG_ 292 FLR2RdrDetn375To379Range1 "Range from sensor to object";
CM_ SG_ 292 FLR2RdrDetn375To379Range2 "Range from sensor to object";
CM_ SG_ 292 FLR2RdrDetn375To379Range3 "Range from sensor to object";
CM_ SG_ 292 FLR2RdrDetn375To379Range4 "Range from sensor to object";
CM_ SG_ 292 FLR2RdrDetn375To379RCS0 "RCS";
CM_ SG_ 292 FLR2RdrDetn375To379RCS1 "RCS";
CM_ SG_ 292 FLR2RdrDetn375To379RCS2 "RCS";
CM_ SG_ 292 FLR2RdrDetn375To379RCS3 "RCS";
CM_ SG_ 292 FLR2RdrDetn375To379RCS4 "RCS";
CM_ SG_ 292 FLR2RdrDetn375To379RngRt0 "Speed towards/away from the sensor";
CM_ SG_ 292 FLR2RdrDetn375To379RngRt1 "Speed towards/away from the sensor";
CM_ SG_ 292 FLR2RdrDetn375To379RngRt2 "Speed towards/away from the sensor";
CM_ SG_ 292 FLR2RdrDetn375To379RngRt3 "Speed towards/away from the sensor";
CM_ SG_ 292 FLR2RdrDetn375To379RngRt4 "Speed towards/away from the sensor";
CM_ SG_ 292 FLR2RdrDetn375To379ScanID "Value to tie status, detection data and object data frames together";
CM_ SG_ 292 FLR2RdrDetn375To379SNR0 "Signal to Noise Ratio";
CM_ SG_ 292 FLR2RdrDetn375To379SNR1 "Signal to Noise Ration";
CM_ SG_ 292 FLR2RdrDetn375To379SNR2 "Signal to Noise Ration";
CM_ SG_ 292 FLR2RdrDetn375To379SNR3 "Signal to Noise Ration";
CM_ SG_ 292 FLR2RdrDetn375To379SNR4 "Signal to Noise Ration";
CM_ SG_ 294 FLR2RdrDetn380To384AziAng0 "Azimuth Angle";
CM_ SG_ 294 FLR2RdrDetn380To384AziAng1 "Azimuth Angle";
CM_ SG_ 294 FLR2RdrDetn380To384AziAng2 "Azimuth Angle";
CM_ SG_ 294 FLR2RdrDetn380To384AziAng3 "Azimuth Angle";
CM_ SG_ 294 FLR2RdrDetn380To384AziAng4 "Azimuth Angle";
CM_ SG_ 294 FLR2RdrDetn380To384DynPrpty0 "Moving/Stationary";
CM_ SG_ 294 FLR2RdrDetn380To384DynPrpty1 "Moving/Stationary";
CM_ SG_ 294 FLR2RdrDetn380To384DynPrpty2 "Moving/Stationary";
CM_ SG_ 294 FLR2RdrDetn380To384DynPrpty3 "Moving/Stationary";
CM_ SG_ 294 FLR2RdrDetn380To384DynPrpty4 "Moving/Stationary";
CM_ SG_ 294 FLR2RdrDetn380To384EleAng0 "Elevation angle";
CM_ SG_ 294 FLR2RdrDetn380To384EleAng1 "Elevation angle";
CM_ SG_ 294 FLR2RdrDetn380To384EleAng2 "Elevation angle";
CM_ SG_ 294 FLR2RdrDetn380To384EleAng3 "Elevation angle";
CM_ SG_ 294 FLR2RdrDetn380To384EleAng4 "Elevation angle";
CM_ SG_ 294 FLR2RdrDetn380To384Mode0 "What chirp mode the detection is from";
CM_ SG_ 294 FLR2RdrDetn380To384Mode1 "What chirp mode the detection is from";
CM_ SG_ 294 FLR2RdrDetn380To384Mode2 "What chirp mode the detection is from";
CM_ SG_ 294 FLR2RdrDetn380To384Mode3 "What chirp mode the detection is from";
CM_ SG_ 294 FLR2RdrDetn380To384Mode4 "What chirp mode the detection is from";
CM_ SG_ 294 FLR2RdrDetn380To384Quality0 "Quality";
CM_ SG_ 294 FLR2RdrDetn380To384Quality1 "Quality";
CM_ SG_ 294 FLR2RdrDetn380To384Quality2 "Quality";
CM_ SG_ 294 FLR2RdrDetn380To384Quality3 "Quality";
CM_ SG_ 294 FLR2RdrDetn380To384Quality4 "Quality";
CM_ SG_ 294 FLR2RdrDetn380To384Range0 "Range from sensor to object";
CM_ SG_ 294 FLR2RdrDetn380To384Range1 "Range from sensor to object";
CM_ SG_ 294 FLR2RdrDetn380To384Range2 "Range from sensor to object";
CM_ SG_ 294 FLR2RdrDetn380To384Range3 "Range from sensor to object";
CM_ SG_ 294 FLR2RdrDetn380To384Range4 "Range from sensor to object";
CM_ SG_ 294 FLR2RdrDetn380To384RCS0 "RCS";
CM_ SG_ 294 FLR2RdrDetn380To384RCS1 "RCS";
CM_ SG_ 294 FLR2RdrDetn380To384RCS2 "RCS";
CM_ SG_ 294 FLR2RdrDetn380To384RCS3 "RCS";
CM_ SG_ 294 FLR2RdrDetn380To384RCS4 "RCS";
CM_ SG_ 294 FLR2RdrDetn380To384RngRt0 "Speed towards/away from the sensor";
CM_ SG_ 294 FLR2RdrDetn380To384RngRt1 "Speed towards/away from the sensor";
CM_ SG_ 294 FLR2RdrDetn380To384RngRt2 "Speed towards/away from the sensor";
CM_ SG_ 294 FLR2RdrDetn380To384RngRt3 "Speed towards/away from the sensor";
CM_ SG_ 294 FLR2RdrDetn380To384RngRt4 "Speed towards/away from the sensor";
CM_ SG_ 294 FLR2RdrDetn380To384ScanID "Value to tie status, detection data and object data frames together";
CM_ SG_ 294 FLR2RdrDetn380To384SNR0 "Signal to Noise Ratio";
CM_ SG_ 294 FLR2RdrDetn380To384SNR1 "Signal to Noise Ration";
CM_ SG_ 294 FLR2RdrDetn380To384SNR2 "Signal to Noise Ration";
CM_ SG_ 294 FLR2RdrDetn380To384SNR3 "Signal to Noise Ration";
CM_ SG_ 294 FLR2RdrDetn380To384SNR4 "Signal to Noise Ration";
CM_ SG_ 296 FLR2RdrDetn385To389AziAng0 "Azimuth Angle";
CM_ SG_ 296 FLR2RdrDetn385To389AziAng1 "Azimuth Angle";
CM_ SG_ 296 FLR2RdrDetn385To389AziAng2 "Azimuth Angle";
CM_ SG_ 296 FLR2RdrDetn385To389AziAng3 "Azimuth Angle";
CM_ SG_ 296 FLR2RdrDetn385To389AziAng4 "Azimuth Angle";
CM_ SG_ 296 FLR2RdrDetn385To389DynPrpty0 "Moving/Stationary";
CM_ SG_ 296 FLR2RdrDetn385To389DynPrpty1 "Moving/Stationary";
CM_ SG_ 296 FLR2RdrDetn385To389DynPrpty2 "Moving/Stationary";
CM_ SG_ 296 FLR2RdrDetn385To389DynPrpty3 "Moving/Stationary";
CM_ SG_ 296 FLR2RdrDetn385To389DynPrpty4 "Moving/Stationary";
CM_ SG_ 296 FLR2RdrDetn385To389EleAng0 "Elevation angle";
CM_ SG_ 296 FLR2RdrDetn385To389EleAng1 "Elevation angle";
CM_ SG_ 296 FLR2RdrDetn385To389EleAng2 "Elevation angle";
CM_ SG_ 296 FLR2RdrDetn385To389EleAng3 "Elevation angle";
CM_ SG_ 296 FLR2RdrDetn385To389EleAng4 "Elevation angle";
CM_ SG_ 296 FLR2RdrDetn385To389Mode0 "What chirp mode the detection is from";
CM_ SG_ 296 FLR2RdrDetn385To389Mode1 "What chirp mode the detection is from";
CM_ SG_ 296 FLR2RdrDetn385To389Mode2 "What chirp mode the detection is from";
CM_ SG_ 296 FLR2RdrDetn385To389Mode3 "What chirp mode the detection is from";
CM_ SG_ 296 FLR2RdrDetn385To389Mode4 "What chirp mode the detection is from";
CM_ SG_ 296 FLR2RdrDetn385To389Quality0 "Quality";
CM_ SG_ 296 FLR2RdrDetn385To389Quality1 "Quality";
CM_ SG_ 296 FLR2RdrDetn385To389Quality2 "Quality";
CM_ SG_ 296 FLR2RdrDetn385To389Quality3 "Quality";
CM_ SG_ 296 FLR2RdrDetn385To389Quality4 "Quality";
CM_ SG_ 296 FLR2RdrDetn385To389Range0 "Range from sensor to object";
CM_ SG_ 296 FLR2RdrDetn385To389Range1 "Range from sensor to object";
CM_ SG_ 296 FLR2RdrDetn385To389Range2 "Range from sensor to object";
CM_ SG_ 296 FLR2RdrDetn385To389Range3 "Range from sensor to object";
CM_ SG_ 296 FLR2RdrDetn385To389Range4 "Range from sensor to object";
CM_ SG_ 296 FLR2RdrDetn385To389RCS0 "RCS";
CM_ SG_ 296 FLR2RdrDetn385To389RCS1 "RCS";
CM_ SG_ 296 FLR2RdrDetn385To389RCS2 "RCS";
CM_ SG_ 296 FLR2RdrDetn385To389RCS3 "RCS";
CM_ SG_ 296 FLR2RdrDetn385To389RCS4 "RCS";
CM_ SG_ 296 FLR2RdrDetn385To389RngRt0 "Speed towards/away from the sensor";
CM_ SG_ 296 FLR2RdrDetn385To389RngRt1 "Speed towards/away from the sensor";
CM_ SG_ 296 FLR2RdrDetn385To389RngRt2 "Speed towards/away from the sensor";
CM_ SG_ 296 FLR2RdrDetn385To389RngRt3 "Speed towards/away from the sensor";
CM_ SG_ 296 FLR2RdrDetn385To389RngRt4 "Speed towards/away from the sensor";
CM_ SG_ 296 FLR2RdrDetn385To389ScanID "Value to tie status, detection data and object data frames together";
CM_ SG_ 296 FLR2RdrDetn385To389SNR0 "Signal to Noise Ratio";
CM_ SG_ 296 FLR2RdrDetn385To389SNR1 "Signal to Noise Ration";
CM_ SG_ 296 FLR2RdrDetn385To389SNR2 "Signal to Noise Ration";
CM_ SG_ 296 FLR2RdrDetn385To389SNR3 "Signal to Noise Ration";
CM_ SG_ 296 FLR2RdrDetn385To389SNR4 "Signal to Noise Ration";
CM_ SG_ 298 FLR2RdrDetn390To394AziAng0 "Azimuth Angle";
CM_ SG_ 298 FLR2RdrDetn390To394AziAng1 "Azimuth Angle";
CM_ SG_ 298 FLR2RdrDetn390To394AziAng2 "Azimuth Angle";
CM_ SG_ 298 FLR2RdrDetn390To394AziAng3 "Azimuth Angle";
CM_ SG_ 298 FLR2RdrDetn390To394AziAng4 "Azimuth Angle";
CM_ SG_ 298 FLR2RdrDetn390To394DynPrpty0 "Moving/Stationary";
CM_ SG_ 298 FLR2RdrDetn390To394DynPrpty1 "Moving/Stationary";
CM_ SG_ 298 FLR2RdrDetn390To394DynPrpty2 "Moving/Stationary";
CM_ SG_ 298 FLR2RdrDetn390To394DynPrpty3 "Moving/Stationary";
CM_ SG_ 298 FLR2RdrDetn390To394DynPrpty4 "Moving/Stationary";
CM_ SG_ 298 FLR2RdrDetn390To394EleAng0 "Elevation angle";
CM_ SG_ 298 FLR2RdrDetn390To394EleAng1 "Elevation angle";
CM_ SG_ 298 FLR2RdrDetn390To394EleAng2 "Elevation angle";
CM_ SG_ 298 FLR2RdrDetn390To394EleAng3 "Elevation angle";
CM_ SG_ 298 FLR2RdrDetn390To394EleAng4 "Elevation angle";
CM_ SG_ 298 FLR2RdrDetn390To394Mode0 "What chirp mode the detection is from";
CM_ SG_ 298 FLR2RdrDetn390To394Mode1 "What chirp mode the detection is from";
CM_ SG_ 298 FLR2RdrDetn390To394Mode2 "What chirp mode the detection is from";
CM_ SG_ 298 FLR2RdrDetn390To394Mode3 "What chirp mode the detection is from";
CM_ SG_ 298 FLR2RdrDetn390To394Mode4 "What chirp mode the detection is from";
CM_ SG_ 298 FLR2RdrDetn390To394Quality0 "Quality";
CM_ SG_ 298 FLR2RdrDetn390To394Quality1 "Quality";
CM_ SG_ 298 FLR2RdrDetn390To394Quality2 "Quality";
CM_ SG_ 298 FLR2RdrDetn390To394Quality3 "Quality";
CM_ SG_ 298 FLR2RdrDetn390To394Quality4 "Quality";
CM_ SG_ 298 FLR2RdrDetn390To394Range0 "Range from sensor to object";
CM_ SG_ 298 FLR2RdrDetn390To394Range1 "Range from sensor to object";
CM_ SG_ 298 FLR2RdrDetn390To394Range2 "Range from sensor to object";
CM_ SG_ 298 FLR2RdrDetn390To394Range3 "Range from sensor to object";
CM_ SG_ 298 FLR2RdrDetn390To394Range4 "Range from sensor to object";
CM_ SG_ 298 FLR2RdrDetn390To394RCS0 "RCS";
CM_ SG_ 298 FLR2RdrDetn390To394RCS1 "RCS";
CM_ SG_ 298 FLR2RdrDetn390To394RCS2 "RCS";
CM_ SG_ 298 FLR2RdrDetn390To394RCS3 "RCS";
CM_ SG_ 298 FLR2RdrDetn390To394RCS4 "RCS";
CM_ SG_ 298 FLR2RdrDetn390To394RngRt0 "Speed towards/away from the sensor";
CM_ SG_ 298 FLR2RdrDetn390To394RngRt1 "Speed towards/away from the sensor";
CM_ SG_ 298 FLR2RdrDetn390To394RngRt2 "Speed towards/away from the sensor";
CM_ SG_ 298 FLR2RdrDetn390To394RngRt3 "Speed towards/away from the sensor";
CM_ SG_ 298 FLR2RdrDetn390To394RngRt4 "Speed towards/away from the sensor";
CM_ SG_ 298 FLR2RdrDetn390To394ScanID "Value to tie status, detection data and object data frames together";
CM_ SG_ 298 FLR2RdrDetn390To394SNR0 "Signal to Noise Ratio";
CM_ SG_ 298 FLR2RdrDetn390To394SNR1 "Signal to Noise Ration";
CM_ SG_ 298 FLR2RdrDetn390To394SNR2 "Signal to Noise Ration";
CM_ SG_ 298 FLR2RdrDetn390To394SNR3 "Signal to Noise Ration";
CM_ SG_ 298 FLR2RdrDetn390To394SNR4 "Signal to Noise Ration";
CM_ SG_ 300 FLR2RdrDetn395To399AziAng0 "Azimuth Angle";
CM_ SG_ 300 FLR2RdrDetn395To399AziAng1 "Azimuth Angle";
CM_ SG_ 300 FLR2RdrDetn395To399AziAng2 "Azimuth Angle";
CM_ SG_ 300 FLR2RdrDetn395To399AziAng3 "Azimuth Angle";
CM_ SG_ 300 FLR2RdrDetn395To399AziAng4 "Azimuth Angle";
CM_ SG_ 300 FLR2RdrDetn395To399DynPrpty0 "Moving/Stationary";
CM_ SG_ 300 FLR2RdrDetn395To399DynPrpty1 "Moving/Stationary";
CM_ SG_ 300 FLR2RdrDetn395To399DynPrpty2 "Moving/Stationary";
CM_ SG_ 300 FLR2RdrDetn395To399DynPrpty3 "Moving/Stationary";
CM_ SG_ 300 FLR2RdrDetn395To399DynPrpty4 "Moving/Stationary";
CM_ SG_ 300 FLR2RdrDetn395To399EleAng0 "Elevation angle";
CM_ SG_ 300 FLR2RdrDetn395To399EleAng1 "Elevation angle";
CM_ SG_ 300 FLR2RdrDetn395To399EleAng2 "Elevation angle";
CM_ SG_ 300 FLR2RdrDetn395To399EleAng3 "Elevation angle";
CM_ SG_ 300 FLR2RdrDetn395To399EleAng4 "Elevation angle";
CM_ SG_ 300 FLR2RdrDetn395To399Mode0 "What chirp mode the detection is from";
CM_ SG_ 300 FLR2RdrDetn395To399Mode1 "What chirp mode the detection is from";
CM_ SG_ 300 FLR2RdrDetn395To399Mode2 "What chirp mode the detection is from";
CM_ SG_ 300 FLR2RdrDetn395To399Mode3 "What chirp mode the detection is from";
CM_ SG_ 300 FLR2RdrDetn395To399Mode4 "What chirp mode the detection is from";
CM_ SG_ 300 FLR2RdrDetn395To399Quality0 "Quality";
CM_ SG_ 300 FLR2RdrDetn395To399Quality1 "Quality";
CM_ SG_ 300 FLR2RdrDetn395To399Quality2 "Quality";
CM_ SG_ 300 FLR2RdrDetn395To399Quality3 "Quality";
CM_ SG_ 300 FLR2RdrDetn395To399Quality4 "Quality";
CM_ SG_ 300 FLR2RdrDetn395To399Range0 "Range from sensor to object";
CM_ SG_ 300 FLR2RdrDetn395To399Range1 "Range from sensor to object";
CM_ SG_ 300 FLR2RdrDetn395To399Range2 "Range from sensor to object";
CM_ SG_ 300 FLR2RdrDetn395To399Range3 "Range from sensor to object";
CM_ SG_ 300 FLR2RdrDetn395To399Range4 "Range from sensor to object";
CM_ SG_ 300 FLR2RdrDetn395To399RCS0 "RCS";
CM_ SG_ 300 FLR2RdrDetn395To399RCS1 "RCS";
CM_ SG_ 300 FLR2RdrDetn395To399RCS2 "RCS";
CM_ SG_ 300 FLR2RdrDetn395To399RCS3 "RCS";
CM_ SG_ 300 FLR2RdrDetn395To399RCS4 "RCS";
CM_ SG_ 300 FLR2RdrDetn395To399RngRt0 "Speed towards/away from the sensor";
CM_ SG_ 300 FLR2RdrDetn395To399RngRt1 "Speed towards/away from the sensor";
CM_ SG_ 300 FLR2RdrDetn395To399RngRt2 "Speed towards/away from the sensor";
CM_ SG_ 300 FLR2RdrDetn395To399RngRt3 "Speed towards/away from the sensor";
CM_ SG_ 300 FLR2RdrDetn395To399RngRt4 "Speed towards/away from the sensor";
CM_ SG_ 300 FLR2RdrDetn395To399ScanID "Value to tie status, detection data and object data frames together";
CM_ SG_ 300 FLR2RdrDetn395To399SNR0 "Signal to Noise Ratio";
CM_ SG_ 300 FLR2RdrDetn395To399SNR1 "Signal to Noise Ration";
CM_ SG_ 300 FLR2RdrDetn395To399SNR2 "Signal to Noise Ration";
CM_ SG_ 300 FLR2RdrDetn395To399SNR3 "Signal to Noise Ration";
CM_ SG_ 300 FLR2RdrDetn395To399SNR4 "Signal to Noise Ration";
BA_DEF_ BO_ "CANFD_BRS" ENUM "0","1";
BA_DEF_ BO_ "GenMsgCycleTime" INT 0 65536; // [ms]
BA_DEF_ BO_ "GenMsgDelayTime" INT 0 65536; // [ms]
BA_DEF_ BO_ "GenMsgSendType" ENUM "cyclic", "spontaneous", "not-used", "not-used", "not-used", "cyclicAndSpontaneous", "not-used", "cyclicIfActive", "NoMsgSendType"; // [us]
BA_DEF_ BO_ "GenMsgStartDelayTime" INT 0 65536; // [ms]
BA_DEF_ BO_ "VFrameFormat" ENUM "StandardCAN","ExtendedCAN","reserved","J1939PG","reserved","reserved","reserved","reserved","reserved","reserved","reserved","reserved","reserved","reserved","StandardCAN_FD","ExtendedCAN_FD";
BA_DEF_ SG_ "GenSigSendType" ENUM "Cyclic","OnWrite","OnWriteWithRepetition","OnChange","OnChangeWithRepetition","IfActive","IfActiveWithRepetition","NoSigSendType";
BA_DEF_ SG_ "GenSigStartValue" HEX 0 80000000;
BA_DEF_ BO_ "GenMsgILSupport" ENUM "No","Yes";
BA_DEF_ BO_ "NmAsrMessage" ENUM "No","Yes";
BA_DEF_ SG_ "GenSigFuncType" ENUM "NoFunction","n/a","n/a","n/a","n/a","n/a","n/a","n/a","n/a","n/a","n/a","n/a","n/a","n/a","n/a","CHK","CNTR","n/a","n/a","n/a","CNTR_AR_01","CRC_AR_01_BOTH","CRC_AR_01_ALT","CRC_AR_01_LOW","CRC_AR_01_NIBBLE","CNTR_AR_04","CRC_AR_04A","CNTR_AR_05","CRC_AR_05";
BA_DEF_ SG_ "GenSigDataID" STRING;
BA_DEF_DEF_ "CANFD_BRS" "1";
BA_DEF_DEF_ "GenSigStartValue" 0;
BA_DEF_DEF_ "VFrameFormat" "J1939PG";
BA_DEF_DEF_ "GenSigSendType" "NoSigSendType";
BA_DEF_DEF_ "GenMsgCycleTime" 0;
BA_DEF_DEF_ "GenMsgDelayTime" 0;
BA_DEF_DEF_ "GenMsgStartDelayTime" 0;
BA_DEF_DEF_ "GenMsgSendType" "NoMsgSendType";
BA_DEF_DEF_ "GenMsgILSupport" "Yes";
BA_DEF_DEF_ "NmAsrMessage" "No";
BA_DEF_DEF_ "GenSigFuncType" "NoFunction";
BA_DEF_DEF_ "GenSigDataID" "";
// Frame: FlrFlr1canFr69
BA_ "GenMsgDelayTime" BO_ 278 40.000;
BA_ "GenMsgSendType" BO_ 278 1;
BA_ "VFrameFormat" BO_ 278 14;
// Frame: FlrFlr1canFr70
BA_ "GenMsgDelayTime" BO_ 280 40.000;
BA_ "GenMsgSendType" BO_ 280 1;
BA_ "VFrameFormat" BO_ 280 14;
// Frame: FlrFlr1canFr71
BA_ "GenMsgDelayTime" BO_ 282 40.000;
BA_ "GenMsgSendType" BO_ 282 1;
BA_ "VFrameFormat" BO_ 282 14;
// Frame: FlrFlr1canFr72
BA_ "GenMsgDelayTime" BO_ 284 40.000;
BA_ "GenMsgSendType" BO_ 284 1;
BA_ "VFrameFormat" BO_ 284 14;
// Frame: FlrFlr1canFr73
BA_ "GenMsgDelayTime" BO_ 286 40.000;
BA_ "GenMsgSendType" BO_ 286 1;
BA_ "VFrameFormat" BO_ 286 14;
// Frame: FlrFlr1canFr74
BA_ "GenMsgDelayTime" BO_ 288 40.000;
BA_ "GenMsgSendType" BO_ 288 1;
BA_ "VFrameFormat" BO_ 288 14;
// Frame: FlrFlr1canFr75
BA_ "GenMsgDelayTime" BO_ 290 40.000;
BA_ "GenMsgSendType" BO_ 290 1;
BA_ "VFrameFormat" BO_ 290 14;
// Frame: FlrFlr1canFr76
BA_ "GenMsgDelayTime" BO_ 292 40.000;
BA_ "GenMsgSendType" BO_ 292 1;
BA_ "VFrameFormat" BO_ 292 14;
// Frame: FlrFlr1canFr77
BA_ "GenMsgDelayTime" BO_ 294 40.000;
BA_ "GenMsgSendType" BO_ 294 1;
BA_ "VFrameFormat" BO_ 294 14;
// Frame: FlrFlr1canFr78
BA_ "GenMsgDelayTime" BO_ 296 40.000;
BA_ "GenMsgSendType" BO_ 296 1;
BA_ "VFrameFormat" BO_ 296 14;
// Frame: FlrFlr1canFr79
BA_ "GenMsgDelayTime" BO_ 298 40.000;
BA_ "GenMsgSendType" BO_ 298 1;
BA_ "VFrameFormat" BO_ 298 14;
// Frame: FlrFlr1canFr80
BA_ "GenMsgDelayTime" BO_ 300 40.000;
BA_ "GenMsgSendType" BO_ 300 1;
BA_ "VFrameFormat" BO_ 300 14;
// Frame: FlrFlr1canFr81
BA_ "GenMsgDelayTime" BO_ 320 40.000;
BA_ "GenMsgSendType" BO_ 320 1;
BA_ "VFrameFormat" BO_ 320 14;
// Frame: FlrFlr1canFr82
BA_ "GenMsgDelayTime" BO_ 322 40.000;
BA_ "GenMsgSendType" BO_ 322 1;
BA_ "VFrameFormat" BO_ 322 14;
BA_ "GenSigSendType" SG_ 278 FLR2RdrDetn340To344AziAng0 1;
BA_ "GenSigSendType" SG_ 278 FLR2RdrDetn340To344AziAng1 1;
BA_ "GenSigSendType" SG_ 278 FLR2RdrDetn340To344AziAng2 1;
BA_ "GenSigSendType" SG_ 278 FLR2RdrDetn340To344AziAng3 1;
BA_ "GenSigSendType" SG_ 278 FLR2RdrDetn340To344AziAng4 1;
BA_ "GenSigDataID" SG_ 278 FLR2RdrDetn340To344CRC "0xAFD";
BA_ "GenSigFuncType" SG_ 278 FLR2RdrDetn340To344CRC 28;
BA_ "GenSigSendType" SG_ 278 FLR2RdrDetn340To344CRC 1;
BA_ "GenSigFuncType" SG_ 278 FLR2RdrDetn340To344Counter 27;
BA_ "GenSigSendType" SG_ 278 FLR2RdrDetn340To344Counter 1;
BA_ "GenSigSendType" SG_ 278 FLR2RdrDetn340To344DynPrpty0 1;
BA_ "GenSigSendType" SG_ 278 FLR2RdrDetn340To344DynPrpty1 1;
BA_ "GenSigSendType" SG_ 278 FLR2RdrDetn340To344DynPrpty2 1;
BA_ "GenSigSendType" SG_ 278 FLR2RdrDetn340To344DynPrpty3 1;
BA_ "GenSigSendType" SG_ 278 FLR2RdrDetn340To344DynPrpty4 1;
BA_ "GenSigSendType" SG_ 278 FLR2RdrDetn340To344EleAng0 1;
BA_ "GenSigSendType" SG_ 278 FLR2RdrDetn340To344EleAng1 1;
BA_ "GenSigSendType" SG_ 278 FLR2RdrDetn340To344EleAng2 1;
BA_ "GenSigSendType" SG_ 278 FLR2RdrDetn340To344EleAng3 1;
BA_ "GenSigSendType" SG_ 278 FLR2RdrDetn340To344EleAng4 1;
BA_ "GenSigSendType" SG_ 278 FLR2RdrDetn340To344Mode0 1;
BA_ "GenSigSendType" SG_ 278 FLR2RdrDetn340To344Mode1 1;
BA_ "GenSigSendType" SG_ 278 FLR2RdrDetn340To344Mode2 1;
BA_ "GenSigSendType" SG_ 278 FLR2RdrDetn340To344Mode3 1;
BA_ "GenSigSendType" SG_ 278 FLR2RdrDetn340To344Mode4 1;
BA_ "GenSigSendType" SG_ 278 FLR2RdrDetn340To344Quality0 1;
BA_ "GenSigSendType" SG_ 278 FLR2RdrDetn340To344Quality1 1;
BA_ "GenSigSendType" SG_ 278 FLR2RdrDetn340To344Quality2 1;
BA_ "GenSigSendType" SG_ 278 FLR2RdrDetn340To344Quality3 1;
BA_ "GenSigSendType" SG_ 278 FLR2RdrDetn340To344Quality4 1;
BA_ "GenSigSendType" SG_ 278 FLR2RdrDetn340To344RCS0 1;
BA_ "GenSigStartValue" SG_ 278 FLR2RdrDetn340To344RCS0 500;
BA_ "GenSigSendType" SG_ 278 FLR2RdrDetn340To344RCS1 1;
BA_ "GenSigStartValue" SG_ 278 FLR2RdrDetn340To344RCS1 500;
BA_ "GenSigSendType" SG_ 278 FLR2RdrDetn340To344RCS2 1;
BA_ "GenSigStartValue" SG_ 278 FLR2RdrDetn340To344RCS2 500;
BA_ "GenSigSendType" SG_ 278 FLR2RdrDetn340To344RCS3 1;
BA_ "GenSigStartValue" SG_ 278 FLR2RdrDetn340To344RCS3 500;
BA_ "GenSigSendType" SG_ 278 FLR2RdrDetn340To344RCS4 1;
BA_ "GenSigStartValue" SG_ 278 FLR2RdrDetn340To344RCS4 500;
BA_ "GenSigSendType" SG_ 278 FLR2RdrDetn340To344Range0 1;
BA_ "GenSigSendType" SG_ 278 FLR2RdrDetn340To344Range1 1;
BA_ "GenSigSendType" SG_ 278 FLR2RdrDetn340To344Range2 1;
BA_ "GenSigSendType" SG_ 278 FLR2RdrDetn340To344Range3 1;
BA_ "GenSigSendType" SG_ 278 FLR2RdrDetn340To344Range4 1;
BA_ "GenSigSendType" SG_ 278 FLR2RdrDetn340To344RngRt0 1;
BA_ "GenSigStartValue" SG_ 278 FLR2RdrDetn340To344RngRt0 1111;
BA_ "GenSigSendType" SG_ 278 FLR2RdrDetn340To344RngRt1 1;
BA_ "GenSigStartValue" SG_ 278 FLR2RdrDetn340To344RngRt1 1111;
BA_ "GenSigSendType" SG_ 278 FLR2RdrDetn340To344RngRt2 1;
BA_ "GenSigStartValue" SG_ 278 FLR2RdrDetn340To344RngRt2 1111;
BA_ "GenSigSendType" SG_ 278 FLR2RdrDetn340To344RngRt3 1;
BA_ "GenSigStartValue" SG_ 278 FLR2RdrDetn340To344RngRt3 1111;
BA_ "GenSigSendType" SG_ 278 FLR2RdrDetn340To344RngRt4 1;
BA_ "GenSigStartValue" SG_ 278 FLR2RdrDetn340To344RngRt4 1111;
BA_ "GenSigSendType" SG_ 278 FLR2RdrDetn340To344SNR0 1;
BA_ "GenSigSendType" SG_ 278 FLR2RdrDetn340To344SNR1 1;
BA_ "GenSigSendType" SG_ 278 FLR2RdrDetn340To344SNR2 1;
BA_ "GenSigSendType" SG_ 278 FLR2RdrDetn340To344SNR3 1;
BA_ "GenSigSendType" SG_ 278 FLR2RdrDetn340To344SNR4 1;
BA_ "GenSigSendType" SG_ 278 FLR2RdrDetn340To344ScanID 1;
BA_ "GenSigSendType" SG_ 280 FLR2RdrDetn345To349AziAng0 1;
BA_ "GenSigSendType" SG_ 280 FLR2RdrDetn345To349AziAng1 1;
BA_ "GenSigSendType" SG_ 280 FLR2RdrDetn345To349AziAng2 1;
BA_ "GenSigSendType" SG_ 280 FLR2RdrDetn345To349AziAng3 1;
BA_ "GenSigSendType" SG_ 280 FLR2RdrDetn345To349AziAng4 1;
BA_ "GenSigDataID" SG_ 280 FLR2RdrDetn345To349CRC "0xAFE";
BA_ "GenSigFuncType" SG_ 280 FLR2RdrDetn345To349CRC 28;
BA_ "GenSigSendType" SG_ 280 FLR2RdrDetn345To349CRC 1;
BA_ "GenSigFuncType" SG_ 280 FLR2RdrDetn345To349Counter 27;
BA_ "GenSigSendType" SG_ 280 FLR2RdrDetn345To349Counter 1;
BA_ "GenSigSendType" SG_ 280 FLR2RdrDetn345To349DynPrpty0 1;
BA_ "GenSigSendType" SG_ 280 FLR2RdrDetn345To349DynPrpty1 1;
BA_ "GenSigSendType" SG_ 280 FLR2RdrDetn345To349DynPrpty2 1;
BA_ "GenSigSendType" SG_ 280 FLR2RdrDetn345To349DynPrpty3 1;
BA_ "GenSigSendType" SG_ 280 FLR2RdrDetn345To349DynPrpty4 1;
BA_ "GenSigSendType" SG_ 280 FLR2RdrDetn345To349EleAng0 1;
BA_ "GenSigSendType" SG_ 280 FLR2RdrDetn345To349EleAng1 1;
BA_ "GenSigSendType" SG_ 280 FLR2RdrDetn345To349EleAng2 1;
BA_ "GenSigSendType" SG_ 280 FLR2RdrDetn345To349EleAng3 1;
BA_ "GenSigSendType" SG_ 280 FLR2RdrDetn345To349EleAng4 1;
BA_ "GenSigSendType" SG_ 280 FLR2RdrDetn345To349Mode0 1;
BA_ "GenSigSendType" SG_ 280 FLR2RdrDetn345To349Mode1 1;
BA_ "GenSigSendType" SG_ 280 FLR2RdrDetn345To349Mode2 1;
BA_ "GenSigSendType" SG_ 280 FLR2RdrDetn345To349Mode3 1;
BA_ "GenSigSendType" SG_ 280 FLR2RdrDetn345To349Mode4 1;
BA_ "GenSigSendType" SG_ 280 FLR2RdrDetn345To349Quality0 1;
BA_ "GenSigSendType" SG_ 280 FLR2RdrDetn345To349Quality1 1;
BA_ "GenSigSendType" SG_ 280 FLR2RdrDetn345To349Quality2 1;
BA_ "GenSigSendType" SG_ 280 FLR2RdrDetn345To349Quality3 1;
BA_ "GenSigSendType" SG_ 280 FLR2RdrDetn345To349Quality4 1;
BA_ "GenSigSendType" SG_ 280 FLR2RdrDetn345To349RCS0 1;
BA_ "GenSigStartValue" SG_ 280 FLR2RdrDetn345To349RCS0 500;
BA_ "GenSigSendType" SG_ 280 FLR2RdrDetn345To349RCS1 1;
BA_ "GenSigStartValue" SG_ 280 FLR2RdrDetn345To349RCS1 500;
BA_ "GenSigSendType" SG_ 280 FLR2RdrDetn345To349RCS2 1;
BA_ "GenSigStartValue" SG_ 280 FLR2RdrDetn345To349RCS2 500;
BA_ "GenSigSendType" SG_ 280 FLR2RdrDetn345To349RCS3 1;
BA_ "GenSigStartValue" SG_ 280 FLR2RdrDetn345To349RCS3 500;
BA_ "GenSigSendType" SG_ 280 FLR2RdrDetn345To349RCS4 1;
BA_ "GenSigStartValue" SG_ 280 FLR2RdrDetn345To349RCS4 500;
BA_ "GenSigSendType" SG_ 280 FLR2RdrDetn345To349Range0 1;
BA_ "GenSigSendType" SG_ 280 FLR2RdrDetn345To349Range1 1;
BA_ "GenSigSendType" SG_ 280 FLR2RdrDetn345To349Range2 1;
BA_ "GenSigSendType" SG_ 280 FLR2RdrDetn345To349Range3 1;
BA_ "GenSigSendType" SG_ 280 FLR2RdrDetn345To349Range4 1;
BA_ "GenSigSendType" SG_ 280 FLR2RdrDetn345To349RngRt0 1;
BA_ "GenSigStartValue" SG_ 280 FLR2RdrDetn345To349RngRt0 1111;
BA_ "GenSigSendType" SG_ 280 FLR2RdrDetn345To349RngRt1 1;
BA_ "GenSigStartValue" SG_ 280 FLR2RdrDetn345To349RngRt1 1111;
BA_ "GenSigSendType" SG_ 280 FLR2RdrDetn345To349RngRt2 1;
BA_ "GenSigStartValue" SG_ 280 FLR2RdrDetn345To349RngRt2 1111;
BA_ "GenSigSendType" SG_ 280 FLR2RdrDetn345To349RngRt3 1;
BA_ "GenSigStartValue" SG_ 280 FLR2RdrDetn345To349RngRt3 1111;
BA_ "GenSigSendType" SG_ 280 FLR2RdrDetn345To349RngRt4 1;
BA_ "GenSigStartValue" SG_ 280 FLR2RdrDetn345To349RngRt4 1111;
BA_ "GenSigSendType" SG_ 280 FLR2RdrDetn345To349SNR0 1;
BA_ "GenSigSendType" SG_ 280 FLR2RdrDetn345To349SNR1 1;
BA_ "GenSigSendType" SG_ 280 FLR2RdrDetn345To349SNR2 1;
BA_ "GenSigSendType" SG_ 280 FLR2RdrDetn345To349SNR3 1;
BA_ "GenSigSendType" SG_ 280 FLR2RdrDetn345To349SNR4 1;
BA_ "GenSigSendType" SG_ 280 FLR2RdrDetn345To349ScanID 1;
BA_ "GenSigSendType" SG_ 282 FLR2RdrDetn350To354AziAng0 1;
BA_ "GenSigSendType" SG_ 282 FLR2RdrDetn350To354AziAng1 1;
BA_ "GenSigSendType" SG_ 282 FLR2RdrDetn350To354AziAng2 1;
BA_ "GenSigSendType" SG_ 282 FLR2RdrDetn350To354AziAng3 1;
BA_ "GenSigSendType" SG_ 282 FLR2RdrDetn350To354AziAng4 1;
BA_ "GenSigDataID" SG_ 282 FLR2RdrDetn350To354CRC "0xAFF";
BA_ "GenSigFuncType" SG_ 282 FLR2RdrDetn350To354CRC 28;
BA_ "GenSigSendType" SG_ 282 FLR2RdrDetn350To354CRC 1;
BA_ "GenSigFuncType" SG_ 282 FLR2RdrDetn350To354Counter 27;
BA_ "GenSigSendType" SG_ 282 FLR2RdrDetn350To354Counter 1;
BA_ "GenSigSendType" SG_ 282 FLR2RdrDetn350To354DynPrpty0 1;
BA_ "GenSigSendType" SG_ 282 FLR2RdrDetn350To354DynPrpty1 1;
BA_ "GenSigSendType" SG_ 282 FLR2RdrDetn350To354DynPrpty2 1;
BA_ "GenSigSendType" SG_ 282 FLR2RdrDetn350To354DynPrpty3 1;
BA_ "GenSigSendType" SG_ 282 FLR2RdrDetn350To354DynPrpty4 1;
BA_ "GenSigSendType" SG_ 282 FLR2RdrDetn350To354EleAng0 1;
BA_ "GenSigSendType" SG_ 282 FLR2RdrDetn350To354EleAng1 1;
BA_ "GenSigSendType" SG_ 282 FLR2RdrDetn350To354EleAng2 1;
BA_ "GenSigSendType" SG_ 282 FLR2RdrDetn350To354EleAng3 1;
BA_ "GenSigSendType" SG_ 282 FLR2RdrDetn350To354EleAng4 1;
BA_ "GenSigSendType" SG_ 282 FLR2RdrDetn350To354Mode0 1;
BA_ "GenSigSendType" SG_ 282 FLR2RdrDetn350To354Mode1 1;
BA_ "GenSigSendType" SG_ 282 FLR2RdrDetn350To354Mode2 1;
BA_ "GenSigSendType" SG_ 282 FLR2RdrDetn350To354Mode3 1;
BA_ "GenSigSendType" SG_ 282 FLR2RdrDetn350To354Mode4 1;
BA_ "GenSigSendType" SG_ 282 FLR2RdrDetn350To354Quality0 1;
BA_ "GenSigSendType" SG_ 282 FLR2RdrDetn350To354Quality1 1;
BA_ "GenSigSendType" SG_ 282 FLR2RdrDetn350To354Quality2 1;
BA_ "GenSigSendType" SG_ 282 FLR2RdrDetn350To354Quality3 1;
BA_ "GenSigSendType" SG_ 282 FLR2RdrDetn350To354Quality4 1;
BA_ "GenSigSendType" SG_ 282 FLR2RdrDetn350To354RCS0 1;
BA_ "GenSigStartValue" SG_ 282 FLR2RdrDetn350To354RCS0 500;
BA_ "GenSigSendType" SG_ 282 FLR2RdrDetn350To354RCS1 1;
BA_ "GenSigStartValue" SG_ 282 FLR2RdrDetn350To354RCS1 500;
BA_ "GenSigSendType" SG_ 282 FLR2RdrDetn350To354RCS2 1;
BA_ "GenSigStartValue" SG_ 282 FLR2RdrDetn350To354RCS2 500;
BA_ "GenSigSendType" SG_ 282 FLR2RdrDetn350To354RCS3 1;
BA_ "GenSigStartValue" SG_ 282 FLR2RdrDetn350To354RCS3 500;
BA_ "GenSigSendType" SG_ 282 FLR2RdrDetn350To354RCS4 1;
BA_ "GenSigStartValue" SG_ 282 FLR2RdrDetn350To354RCS4 500;
BA_ "GenSigSendType" SG_ 282 FLR2RdrDetn350To354Range0 1;
BA_ "GenSigSendType" SG_ 282 FLR2RdrDetn350To354Range1 1;
BA_ "GenSigSendType" SG_ 282 FLR2RdrDetn350To354Range2 1;
BA_ "GenSigSendType" SG_ 282 FLR2RdrDetn350To354Range3 1;
BA_ "GenSigSendType" SG_ 282 FLR2RdrDetn350To354Range4 1;
BA_ "GenSigSendType" SG_ 282 FLR2RdrDetn350To354RngRt0 1;
BA_ "GenSigStartValue" SG_ 282 FLR2RdrDetn350To354RngRt0 1111;
BA_ "GenSigSendType" SG_ 282 FLR2RdrDetn350To354RngRt1 1;
BA_ "GenSigStartValue" SG_ 282 FLR2RdrDetn350To354RngRt1 1111;
BA_ "GenSigSendType" SG_ 282 FLR2RdrDetn350To354RngRt2 1;
BA_ "GenSigStartValue" SG_ 282 FLR2RdrDetn350To354RngRt2 1111;
BA_ "GenSigSendType" SG_ 282 FLR2RdrDetn350To354RngRt3 1;
BA_ "GenSigStartValue" SG_ 282 FLR2RdrDetn350To354RngRt3 1111;
BA_ "GenSigSendType" SG_ 282 FLR2RdrDetn350To354RngRt4 1;
BA_ "GenSigStartValue" SG_ 282 FLR2RdrDetn350To354RngRt4 1111;
BA_ "GenSigSendType" SG_ 282 FLR2RdrDetn350To354SNR0 1;
BA_ "GenSigSendType" SG_ 282 FLR2RdrDetn350To354SNR1 1;
BA_ "GenSigSendType" SG_ 282 FLR2RdrDetn350To354SNR2 1;
BA_ "GenSigSendType" SG_ 282 FLR2RdrDetn350To354SNR3 1;
BA_ "GenSigSendType" SG_ 282 FLR2RdrDetn350To354SNR4 1;
BA_ "GenSigSendType" SG_ 282 FLR2RdrDetn350To354ScanID 1;
BA_ "GenSigSendType" SG_ 284 FLR2RdrDetn355To359AziAng0 1;
BA_ "GenSigSendType" SG_ 284 FLR2RdrDetn355To359AziAng1 1;
BA_ "GenSigSendType" SG_ 284 FLR2RdrDetn355To359AziAng2 1;
BA_ "GenSigSendType" SG_ 284 FLR2RdrDetn355To359AziAng3 1;
BA_ "GenSigSendType" SG_ 284 FLR2RdrDetn355To359AziAng4 1;
BA_ "GenSigDataID" SG_ 284 FLR2RdrDetn355To359CRC "0xB00";
BA_ "GenSigFuncType" SG_ 284 FLR2RdrDetn355To359CRC 28;
BA_ "GenSigSendType" SG_ 284 FLR2RdrDetn355To359CRC 1;
BA_ "GenSigFuncType" SG_ 284 FLR2RdrDetn355To359Counter 27;
BA_ "GenSigSendType" SG_ 284 FLR2RdrDetn355To359Counter 1;
BA_ "GenSigSendType" SG_ 284 FLR2RdrDetn355To359DynPrpty0 1;
BA_ "GenSigSendType" SG_ 284 FLR2RdrDetn355To359DynPrpty1 1;
BA_ "GenSigSendType" SG_ 284 FLR2RdrDetn355To359DynPrpty2 1;
BA_ "GenSigSendType" SG_ 284 FLR2RdrDetn355To359DynPrpty3 1;
BA_ "GenSigSendType" SG_ 284 FLR2RdrDetn355To359DynPrpty4 1;
BA_ "GenSigSendType" SG_ 284 FLR2RdrDetn355To359EleAng0 1;
BA_ "GenSigSendType" SG_ 284 FLR2RdrDetn355To359EleAng1 1;
BA_ "GenSigSendType" SG_ 284 FLR2RdrDetn355To359EleAng2 1;
BA_ "GenSigSendType" SG_ 284 FLR2RdrDetn355To359EleAng3 1;
BA_ "GenSigSendType" SG_ 284 FLR2RdrDetn355To359EleAng4 1;
BA_ "GenSigSendType" SG_ 284 FLR2RdrDetn355To359Mode0 1;
BA_ "GenSigSendType" SG_ 284 FLR2RdrDetn355To359Mode1 1;
BA_ "GenSigSendType" SG_ 284 FLR2RdrDetn355To359Mode2 1;
BA_ "GenSigSendType" SG_ 284 FLR2RdrDetn355To359Mode3 1;
BA_ "GenSigSendType" SG_ 284 FLR2RdrDetn355To359Mode4 1;
BA_ "GenSigSendType" SG_ 284 FLR2RdrDetn355To359Quality0 1;
BA_ "GenSigSendType" SG_ 284 FLR2RdrDetn355To359Quality1 1;
BA_ "GenSigSendType" SG_ 284 FLR2RdrDetn355To359Quality2 1;
BA_ "GenSigSendType" SG_ 284 FLR2RdrDetn355To359Quality3 1;
BA_ "GenSigSendType" SG_ 284 FLR2RdrDetn355To359Quality4 1;
BA_ "GenSigSendType" SG_ 284 FLR2RdrDetn355To359RCS0 1;
BA_ "GenSigStartValue" SG_ 284 FLR2RdrDetn355To359RCS0 500;
BA_ "GenSigSendType" SG_ 284 FLR2RdrDetn355To359RCS1 1;
BA_ "GenSigStartValue" SG_ 284 FLR2RdrDetn355To359RCS1 500;
BA_ "GenSigSendType" SG_ 284 FLR2RdrDetn355To359RCS2 1;
BA_ "GenSigStartValue" SG_ 284 FLR2RdrDetn355To359RCS2 500;
BA_ "GenSigSendType" SG_ 284 FLR2RdrDetn355To359RCS3 1;
BA_ "GenSigStartValue" SG_ 284 FLR2RdrDetn355To359RCS3 500;
BA_ "GenSigSendType" SG_ 284 FLR2RdrDetn355To359RCS4 1;
BA_ "GenSigStartValue" SG_ 284 FLR2RdrDetn355To359RCS4 500;
BA_ "GenSigSendType" SG_ 284 FLR2RdrDetn355To359Range0 1;
BA_ "GenSigSendType" SG_ 284 FLR2RdrDetn355To359Range1 1;
BA_ "GenSigSendType" SG_ 284 FLR2RdrDetn355To359Range2 1;
BA_ "GenSigSendType" SG_ 284 FLR2RdrDetn355To359Range3 1;
BA_ "GenSigSendType" SG_ 284 FLR2RdrDetn355To359Range4 1;
BA_ "GenSigSendType" SG_ 284 FLR2RdrDetn355To359RngRt0 1;
BA_ "GenSigStartValue" SG_ 284 FLR2RdrDetn355To359RngRt0 1111;
BA_ "GenSigSendType" SG_ 284 FLR2RdrDetn355To359RngRt1 1;
BA_ "GenSigStartValue" SG_ 284 FLR2RdrDetn355To359RngRt1 1111;
BA_ "GenSigSendType" SG_ 284 FLR2RdrDetn355To359RngRt2 1;
BA_ "GenSigStartValue" SG_ 284 FLR2RdrDetn355To359RngRt2 1111;
BA_ "GenSigSendType" SG_ 284 FLR2RdrDetn355To359RngRt3 1;
BA_ "GenSigStartValue" SG_ 284 FLR2RdrDetn355To359RngRt3 1111;
BA_ "GenSigSendType" SG_ 284 FLR2RdrDetn355To359RngRt4 1;
BA_ "GenSigStartValue" SG_ 284 FLR2RdrDetn355To359RngRt4 1111;
BA_ "GenSigSendType" SG_ 284 FLR2RdrDetn355To359SNR0 1;
BA_ "GenSigSendType" SG_ 284 FLR2RdrDetn355To359SNR1 1;
BA_ "GenSigSendType" SG_ 284 FLR2RdrDetn355To359SNR2 1;
BA_ "GenSigSendType" SG_ 284 FLR2RdrDetn355To359SNR3 1;
BA_ "GenSigSendType" SG_ 284 FLR2RdrDetn355To359SNR4 1;
BA_ "GenSigSendType" SG_ 284 FLR2RdrDetn355To359ScanID 1;
BA_ "GenSigSendType" SG_ 286 FLR2RdrDetn360To364AziAng0 1;
BA_ "GenSigSendType" SG_ 286 FLR2RdrDetn360To364AziAng1 1;
BA_ "GenSigSendType" SG_ 286 FLR2RdrDetn360To364AziAng2 1;
BA_ "GenSigSendType" SG_ 286 FLR2RdrDetn360To364AziAng3 1;
BA_ "GenSigSendType" SG_ 286 FLR2RdrDetn360To364AziAng4 1;
BA_ "GenSigDataID" SG_ 286 FLR2RdrDetn360To364CRC "0xB01";
BA_ "GenSigFuncType" SG_ 286 FLR2RdrDetn360To364CRC 28;
BA_ "GenSigSendType" SG_ 286 FLR2RdrDetn360To364CRC 1;
BA_ "GenSigFuncType" SG_ 286 FLR2RdrDetn360To364Counter 27;
BA_ "GenSigSendType" SG_ 286 FLR2RdrDetn360To364Counter 1;
BA_ "GenSigSendType" SG_ 286 FLR2RdrDetn360To364DynPrpty0 1;
BA_ "GenSigSendType" SG_ 286 FLR2RdrDetn360To364DynPrpty1 1;
BA_ "GenSigSendType" SG_ 286 FLR2RdrDetn360To364DynPrpty2 1;
BA_ "GenSigSendType" SG_ 286 FLR2RdrDetn360To364DynPrpty3 1;
BA_ "GenSigSendType" SG_ 286 FLR2RdrDetn360To364DynPrpty4 1;
BA_ "GenSigSendType" SG_ 286 FLR2RdrDetn360To364EleAng0 1;
BA_ "GenSigSendType" SG_ 286 FLR2RdrDetn360To364EleAng1 1;
BA_ "GenSigSendType" SG_ 286 FLR2RdrDetn360To364EleAng2 1;
BA_ "GenSigSendType" SG_ 286 FLR2RdrDetn360To364EleAng3 1;
BA_ "GenSigSendType" SG_ 286 FLR2RdrDetn360To364EleAng4 1;
BA_ "GenSigSendType" SG_ 286 FLR2RdrDetn360To364Mode0 1;
BA_ "GenSigSendType" SG_ 286 FLR2RdrDetn360To364Mode1 1;
BA_ "GenSigSendType" SG_ 286 FLR2RdrDetn360To364Mode2 1;
BA_ "GenSigSendType" SG_ 286 FLR2RdrDetn360To364Mode3 1;
BA_ "GenSigSendType" SG_ 286 FLR2RdrDetn360To364Mode4 1;
BA_ "GenSigSendType" SG_ 286 FLR2RdrDetn360To364Quality0 1;
BA_ "GenSigSendType" SG_ 286 FLR2RdrDetn360To364Quality1 1;
BA_ "GenSigSendType" SG_ 286 FLR2RdrDetn360To364Quality2 1;
BA_ "GenSigSendType" SG_ 286 FLR2RdrDetn360To364Quality3 1;
BA_ "GenSigSendType" SG_ 286 FLR2RdrDetn360To364Quality4 1;
BA_ "GenSigSendType" SG_ 286 FLR2RdrDetn360To364RCS0 1;
BA_ "GenSigStartValue" SG_ 286 FLR2RdrDetn360To364RCS0 500;
BA_ "GenSigSendType" SG_ 286 FLR2RdrDetn360To364RCS1 1;
BA_ "GenSigStartValue" SG_ 286 FLR2RdrDetn360To364RCS1 500;
BA_ "GenSigSendType" SG_ 286 FLR2RdrDetn360To364RCS2 1;
BA_ "GenSigStartValue" SG_ 286 FLR2RdrDetn360To364RCS2 500;
BA_ "GenSigSendType" SG_ 286 FLR2RdrDetn360To364RCS3 1;
BA_ "GenSigStartValue" SG_ 286 FLR2RdrDetn360To364RCS3 500;
BA_ "GenSigSendType" SG_ 286 FLR2RdrDetn360To364RCS4 1;
BA_ "GenSigStartValue" SG_ 286 FLR2RdrDetn360To364RCS4 500;
BA_ "GenSigSendType" SG_ 286 FLR2RdrDetn360To364Range0 1;
BA_ "GenSigSendType" SG_ 286 FLR2RdrDetn360To364Range1 1;
BA_ "GenSigSendType" SG_ 286 FLR2RdrDetn360To364Range2 1;
BA_ "GenSigSendType" SG_ 286 FLR2RdrDetn360To364Range3 1;
BA_ "GenSigSendType" SG_ 286 FLR2RdrDetn360To364Range4 1;
BA_ "GenSigSendType" SG_ 286 FLR2RdrDetn360To364RngRt0 1;
BA_ "GenSigStartValue" SG_ 286 FLR2RdrDetn360To364RngRt0 1111;
BA_ "GenSigSendType" SG_ 286 FLR2RdrDetn360To364RngRt1 1;
BA_ "GenSigStartValue" SG_ 286 FLR2RdrDetn360To364RngRt1 1111;
BA_ "GenSigSendType" SG_ 286 FLR2RdrDetn360To364RngRt2 1;
BA_ "GenSigStartValue" SG_ 286 FLR2RdrDetn360To364RngRt2 1111;
BA_ "GenSigSendType" SG_ 286 FLR2RdrDetn360To364RngRt3 1;
BA_ "GenSigStartValue" SG_ 286 FLR2RdrDetn360To364RngRt3 1111;
BA_ "GenSigSendType" SG_ 286 FLR2RdrDetn360To364RngRt4 1;
BA_ "GenSigStartValue" SG_ 286 FLR2RdrDetn360To364RngRt4 1111;
BA_ "GenSigSendType" SG_ 286 FLR2RdrDetn360To364SNR0 1;
BA_ "GenSigSendType" SG_ 286 FLR2RdrDetn360To364SNR1 1;
BA_ "GenSigSendType" SG_ 286 FLR2RdrDetn360To364SNR2 1;
BA_ "GenSigSendType" SG_ 286 FLR2RdrDetn360To364SNR3 1;
BA_ "GenSigSendType" SG_ 286 FLR2RdrDetn360To364SNR4 1;
BA_ "GenSigSendType" SG_ 286 FLR2RdrDetn360To364ScanID 1;
BA_ "GenSigSendType" SG_ 288 FLR2RdrDetn365To369AziAng0 1;
BA_ "GenSigSendType" SG_ 288 FLR2RdrDetn365To369AziAng1 1;
BA_ "GenSigSendType" SG_ 288 FLR2RdrDetn365To369AziAng2 1;
BA_ "GenSigSendType" SG_ 288 FLR2RdrDetn365To369AziAng3 1;
BA_ "GenSigSendType" SG_ 288 FLR2RdrDetn365To369AziAng4 1;
BA_ "GenSigDataID" SG_ 288 FLR2RdrDetn365To369CRC "0xB02";
BA_ "GenSigFuncType" SG_ 288 FLR2RdrDetn365To369CRC 28;
BA_ "GenSigSendType" SG_ 288 FLR2RdrDetn365To369CRC 1;
BA_ "GenSigFuncType" SG_ 288 FLR2RdrDetn365To369Counter 27;
BA_ "GenSigSendType" SG_ 288 FLR2RdrDetn365To369Counter 1;
BA_ "GenSigSendType" SG_ 288 FLR2RdrDetn365To369DynPrpty0 1;
BA_ "GenSigSendType" SG_ 288 FLR2RdrDetn365To369DynPrpty1 1;
BA_ "GenSigSendType" SG_ 288 FLR2RdrDetn365To369DynPrpty2 1;
BA_ "GenSigSendType" SG_ 288 FLR2RdrDetn365To369DynPrpty3 1;
BA_ "GenSigSendType" SG_ 288 FLR2RdrDetn365To369DynPrpty4 1;
BA_ "GenSigSendType" SG_ 288 FLR2RdrDetn365To369EleAng0 1;
BA_ "GenSigSendType" SG_ 288 FLR2RdrDetn365To369EleAng1 1;
BA_ "GenSigSendType" SG_ 288 FLR2RdrDetn365To369EleAng2 1;
BA_ "GenSigSendType" SG_ 288 FLR2RdrDetn365To369EleAng3 1;
BA_ "GenSigSendType" SG_ 288 FLR2RdrDetn365To369EleAng4 1;
BA_ "GenSigSendType" SG_ 288 FLR2RdrDetn365To369Mode0 1;
BA_ "GenSigSendType" SG_ 288 FLR2RdrDetn365To369Mode1 1;
BA_ "GenSigSendType" SG_ 288 FLR2RdrDetn365To369Mode2 1;
BA_ "GenSigSendType" SG_ 288 FLR2RdrDetn365To369Mode3 1;
BA_ "GenSigSendType" SG_ 288 FLR2RdrDetn365To369Mode4 1;
BA_ "GenSigSendType" SG_ 288 FLR2RdrDetn365To369Quality0 1;
BA_ "GenSigSendType" SG_ 288 FLR2RdrDetn365To369Quality1 1;
BA_ "GenSigSendType" SG_ 288 FLR2RdrDetn365To369Quality2 1;
BA_ "GenSigSendType" SG_ 288 FLR2RdrDetn365To369Quality3 1;
BA_ "GenSigSendType" SG_ 288 FLR2RdrDetn365To369Quality4 1;
BA_ "GenSigSendType" SG_ 288 FLR2RdrDetn365To369RCS0 1;
BA_ "GenSigStartValue" SG_ 288 FLR2RdrDetn365To369RCS0 500;
BA_ "GenSigSendType" SG_ 288 FLR2RdrDetn365To369RCS1 1;
BA_ "GenSigStartValue" SG_ 288 FLR2RdrDetn365To369RCS1 500;
BA_ "GenSigSendType" SG_ 288 FLR2RdrDetn365To369RCS2 1;
BA_ "GenSigStartValue" SG_ 288 FLR2RdrDetn365To369RCS2 500;
BA_ "GenSigSendType" SG_ 288 FLR2RdrDetn365To369RCS3 1;
BA_ "GenSigStartValue" SG_ 288 FLR2RdrDetn365To369RCS3 500;
BA_ "GenSigSendType" SG_ 288 FLR2RdrDetn365To369RCS4 1;
BA_ "GenSigStartValue" SG_ 288 FLR2RdrDetn365To369RCS4 500;
BA_ "GenSigSendType" SG_ 288 FLR2RdrDetn365To369Range0 1;
BA_ "GenSigSendType" SG_ 288 FLR2RdrDetn365To369Range1 1;
BA_ "GenSigSendType" SG_ 288 FLR2RdrDetn365To369Range2 1;
BA_ "GenSigSendType" SG_ 288 FLR2RdrDetn365To369Range3 1;
BA_ "GenSigSendType" SG_ 288 FLR2RdrDetn365To369Range4 1;
BA_ "GenSigSendType" SG_ 288 FLR2RdrDetn365To369RngRt0 1;
BA_ "GenSigStartValue" SG_ 288 FLR2RdrDetn365To369RngRt0 1111;
BA_ "GenSigSendType" SG_ 288 FLR2RdrDetn365To369RngRt1 1;
BA_ "GenSigStartValue" SG_ 288 FLR2RdrDetn365To369RngRt1 1111;
BA_ "GenSigSendType" SG_ 288 FLR2RdrDetn365To369RngRt2 1;
BA_ "GenSigStartValue" SG_ 288 FLR2RdrDetn365To369RngRt2 1111;
BA_ "GenSigSendType" SG_ 288 FLR2RdrDetn365To369RngRt3 1;
BA_ "GenSigStartValue" SG_ 288 FLR2RdrDetn365To369RngRt3 1111;
BA_ "GenSigSendType" SG_ 288 FLR2RdrDetn365To369RngRt4 1;
BA_ "GenSigStartValue" SG_ 288 FLR2RdrDetn365To369RngRt4 1111;
BA_ "GenSigSendType" SG_ 288 FLR2RdrDetn365To369SNR0 1;
BA_ "GenSigSendType" SG_ 288 FLR2RdrDetn365To369SNR1 1;
BA_ "GenSigSendType" SG_ 288 FLR2RdrDetn365To369SNR2 1;
BA_ "GenSigSendType" SG_ 288 FLR2RdrDetn365To369SNR3 1;
BA_ "GenSigSendType" SG_ 288 FLR2RdrDetn365To369SNR4 1;
BA_ "GenSigSendType" SG_ 288 FLR2RdrDetn365To369ScanID 1;
BA_ "GenSigSendType" SG_ 290 FLR2RdrDetn370To374AziAng0 1;
BA_ "GenSigSendType" SG_ 290 FLR2RdrDetn370To374AziAng1 1;
BA_ "GenSigSendType" SG_ 290 FLR2RdrDetn370To374AziAng2 1;
BA_ "GenSigSendType" SG_ 290 FLR2RdrDetn370To374AziAng3 1;
BA_ "GenSigSendType" SG_ 290 FLR2RdrDetn370To374AziAng4 1;
BA_ "GenSigDataID" SG_ 290 FLR2RdrDetn370To374CRC "0xB03";
BA_ "GenSigFuncType" SG_ 290 FLR2RdrDetn370To374CRC 28;
BA_ "GenSigSendType" SG_ 290 FLR2RdrDetn370To374CRC 1;
BA_ "GenSigFuncType" SG_ 290 FLR2RdrDetn370To374Counter 27;
BA_ "GenSigSendType" SG_ 290 FLR2RdrDetn370To374Counter 1;
BA_ "GenSigSendType" SG_ 290 FLR2RdrDetn370To374DynPrpty0 1;
BA_ "GenSigSendType" SG_ 290 FLR2RdrDetn370To374DynPrpty1 1;
BA_ "GenSigSendType" SG_ 290 FLR2RdrDetn370To374DynPrpty2 1;
BA_ "GenSigSendType" SG_ 290 FLR2RdrDetn370To374DynPrpty3 1;
BA_ "GenSigSendType" SG_ 290 FLR2RdrDetn370To374DynPrpty4 1;
BA_ "GenSigSendType" SG_ 290 FLR2RdrDetn370To374EleAng0 1;
BA_ "GenSigSendType" SG_ 290 FLR2RdrDetn370To374EleAng1 1;
BA_ "GenSigSendType" SG_ 290 FLR2RdrDetn370To374EleAng2 1;
BA_ "GenSigSendType" SG_ 290 FLR2RdrDetn370To374EleAng3 1;
BA_ "GenSigSendType" SG_ 290 FLR2RdrDetn370To374EleAng4 1;
BA_ "GenSigSendType" SG_ 290 FLR2RdrDetn370To374Mode0 1;
BA_ "GenSigSendType" SG_ 290 FLR2RdrDetn370To374Mode1 1;
BA_ "GenSigSendType" SG_ 290 FLR2RdrDetn370To374Mode2 1;
BA_ "GenSigSendType" SG_ 290 FLR2RdrDetn370To374Mode3 1;
BA_ "GenSigSendType" SG_ 290 FLR2RdrDetn370To374Mode4 1;
BA_ "GenSigSendType" SG_ 290 FLR2RdrDetn370To374Quality0 1;
BA_ "GenSigSendType" SG_ 290 FLR2RdrDetn370To374Quality1 1;
BA_ "GenSigSendType" SG_ 290 FLR2RdrDetn370To374Quality2 1;
BA_ "GenSigSendType" SG_ 290 FLR2RdrDetn370To374Quality3 1;
BA_ "GenSigSendType" SG_ 290 FLR2RdrDetn370To374Quality4 1;
BA_ "GenSigSendType" SG_ 290 FLR2RdrDetn370To374RCS0 1;
BA_ "GenSigStartValue" SG_ 290 FLR2RdrDetn370To374RCS0 500;
BA_ "GenSigSendType" SG_ 290 FLR2RdrDetn370To374RCS1 1;
BA_ "GenSigStartValue" SG_ 290 FLR2RdrDetn370To374RCS1 500;
BA_ "GenSigSendType" SG_ 290 FLR2RdrDetn370To374RCS2 1;
BA_ "GenSigStartValue" SG_ 290 FLR2RdrDetn370To374RCS2 500;
BA_ "GenSigSendType" SG_ 290 FLR2RdrDetn370To374RCS3 1;
BA_ "GenSigStartValue" SG_ 290 FLR2RdrDetn370To374RCS3 500;
BA_ "GenSigSendType" SG_ 290 FLR2RdrDetn370To374RCS4 1;
BA_ "GenSigStartValue" SG_ 290 FLR2RdrDetn370To374RCS4 500;
BA_ "GenSigSendType" SG_ 290 FLR2RdrDetn370To374Range0 1;
BA_ "GenSigSendType" SG_ 290 FLR2RdrDetn370To374Range1 1;
BA_ "GenSigSendType" SG_ 290 FLR2RdrDetn370To374Range2 1;
BA_ "GenSigSendType" SG_ 290 FLR2RdrDetn370To374Range3 1;
BA_ "GenSigSendType" SG_ 290 FLR2RdrDetn370To374Range4 1;
BA_ "GenSigSendType" SG_ 290 FLR2RdrDetn370To374RngRt0 1;
BA_ "GenSigStartValue" SG_ 290 FLR2RdrDetn370To374RngRt0 1111;
BA_ "GenSigSendType" SG_ 290 FLR2RdrDetn370To374RngRt1 1;
BA_ "GenSigStartValue" SG_ 290 FLR2RdrDetn370To374RngRt1 1111;
BA_ "GenSigSendType" SG_ 290 FLR2RdrDetn370To374RngRt2 1;
BA_ "GenSigStartValue" SG_ 290 FLR2RdrDetn370To374RngRt2 1111;
BA_ "GenSigSendType" SG_ 290 FLR2RdrDetn370To374RngRt3 1;
BA_ "GenSigStartValue" SG_ 290 FLR2RdrDetn370To374RngRt3 1111;
BA_ "GenSigSendType" SG_ 290 FLR2RdrDetn370To374RngRt4 1;
BA_ "GenSigStartValue" SG_ 290 FLR2RdrDetn370To374RngRt4 1111;
BA_ "GenSigSendType" SG_ 290 FLR2RdrDetn370To374SNR0 1;
BA_ "GenSigSendType" SG_ 290 FLR2RdrDetn370To374SNR1 1;
BA_ "GenSigSendType" SG_ 290 FLR2RdrDetn370To374SNR2 1;
BA_ "GenSigSendType" SG_ 290 FLR2RdrDetn370To374SNR3 1;
BA_ "GenSigSendType" SG_ 290 FLR2RdrDetn370To374SNR4 1;
BA_ "GenSigSendType" SG_ 290 FLR2RdrDetn370To374ScanID 1;
BA_ "GenSigSendType" SG_ 292 FLR2RdrDetn375To379AziAng0 1;
BA_ "GenSigSendType" SG_ 292 FLR2RdrDetn375To379AziAng1 1;
BA_ "GenSigSendType" SG_ 292 FLR2RdrDetn375To379AziAng2 1;
BA_ "GenSigSendType" SG_ 292 FLR2RdrDetn375To379AziAng3 1;
BA_ "GenSigSendType" SG_ 292 FLR2RdrDetn375To379AziAng4 1;
BA_ "GenSigDataID" SG_ 292 FLR2RdrDetn375To379CRC "0xB04";
BA_ "GenSigFuncType" SG_ 292 FLR2RdrDetn375To379CRC 28;
BA_ "GenSigSendType" SG_ 292 FLR2RdrDetn375To379CRC 1;
BA_ "GenSigFuncType" SG_ 292 FLR2RdrDetn375To379Counter 27;
BA_ "GenSigSendType" SG_ 292 FLR2RdrDetn375To379Counter 1;
BA_ "GenSigSendType" SG_ 292 FLR2RdrDetn375To379DynPrpty0 1;
BA_ "GenSigSendType" SG_ 292 FLR2RdrDetn375To379DynPrpty1 1;
BA_ "GenSigSendType" SG_ 292 FLR2RdrDetn375To379DynPrpty2 1;
BA_ "GenSigSendType" SG_ 292 FLR2RdrDetn375To379DynPrpty3 1;
BA_ "GenSigSendType" SG_ 292 FLR2RdrDetn375To379DynPrpty4 1;
BA_ "GenSigSendType" SG_ 292 FLR2RdrDetn375To379EleAng0 1;
BA_ "GenSigSendType" SG_ 292 FLR2RdrDetn375To379EleAng1 1;
BA_ "GenSigSendType" SG_ 292 FLR2RdrDetn375To379EleAng2 1;
BA_ "GenSigSendType" SG_ 292 FLR2RdrDetn375To379EleAng3 1;
BA_ "GenSigSendType" SG_ 292 FLR2RdrDetn375To379EleAng4 1;
BA_ "GenSigSendType" SG_ 292 FLR2RdrDetn375To379Mode0 1;
BA_ "GenSigSendType" SG_ 292 FLR2RdrDetn375To379Mode1 1;
BA_ "GenSigSendType" SG_ 292 FLR2RdrDetn375To379Mode2 1;
BA_ "GenSigSendType" SG_ 292 FLR2RdrDetn375To379Mode3 1;
BA_ "GenSigSendType" SG_ 292 FLR2RdrDetn375To379Mode4 1;
BA_ "GenSigSendType" SG_ 292 FLR2RdrDetn375To379Quality0 1;
BA_ "GenSigSendType" SG_ 292 FLR2RdrDetn375To379Quality1 1;
BA_ "GenSigSendType" SG_ 292 FLR2RdrDetn375To379Quality2 1;
BA_ "GenSigSendType" SG_ 292 FLR2RdrDetn375To379Quality3 1;
BA_ "GenSigSendType" SG_ 292 FLR2RdrDetn375To379Quality4 1;
BA_ "GenSigSendType" SG_ 292 FLR2RdrDetn375To379RCS0 1;
BA_ "GenSigStartValue" SG_ 292 FLR2RdrDetn375To379RCS0 500;
BA_ "GenSigSendType" SG_ 292 FLR2RdrDetn375To379RCS1 1;
BA_ "GenSigStartValue" SG_ 292 FLR2RdrDetn375To379RCS1 500;
BA_ "GenSigSendType" SG_ 292 FLR2RdrDetn375To379RCS2 1;
BA_ "GenSigStartValue" SG_ 292 FLR2RdrDetn375To379RCS2 500;
BA_ "GenSigSendType" SG_ 292 FLR2RdrDetn375To379RCS3 1;
BA_ "GenSigStartValue" SG_ 292 FLR2RdrDetn375To379RCS3 500;
BA_ "GenSigSendType" SG_ 292 FLR2RdrDetn375To379RCS4 1;
BA_ "GenSigStartValue" SG_ 292 FLR2RdrDetn375To379RCS4 500;
BA_ "GenSigSendType" SG_ 292 FLR2RdrDetn375To379Range0 1;
BA_ "GenSigSendType" SG_ 292 FLR2RdrDetn375To379Range1 1;
BA_ "GenSigSendType" SG_ 292 FLR2RdrDetn375To379Range2 1;
BA_ "GenSigSendType" SG_ 292 FLR2RdrDetn375To379Range3 1;
BA_ "GenSigSendType" SG_ 292 FLR2RdrDetn375To379Range4 1;
BA_ "GenSigSendType" SG_ 292 FLR2RdrDetn375To379RngRt0 1;
BA_ "GenSigStartValue" SG_ 292 FLR2RdrDetn375To379RngRt0 1111;
BA_ "GenSigSendType" SG_ 292 FLR2RdrDetn375To379RngRt1 1;
BA_ "GenSigStartValue" SG_ 292 FLR2RdrDetn375To379RngRt1 1111;
BA_ "GenSigSendType" SG_ 292 FLR2RdrDetn375To379RngRt2 1;
BA_ "GenSigStartValue" SG_ 292 FLR2RdrDetn375To379RngRt2 1111;
BA_ "GenSigSendType" SG_ 292 FLR2RdrDetn375To379RngRt3 1;
BA_ "GenSigStartValue" SG_ 292 FLR2RdrDetn375To379RngRt3 1111;
BA_ "GenSigSendType" SG_ 292 FLR2RdrDetn375To379RngRt4 1;
BA_ "GenSigStartValue" SG_ 292 FLR2RdrDetn375To379RngRt4 1111;
BA_ "GenSigSendType" SG_ 292 FLR2RdrDetn375To379SNR0 1;
BA_ "GenSigSendType" SG_ 292 FLR2RdrDetn375To379SNR1 1;
BA_ "GenSigSendType" SG_ 292 FLR2RdrDetn375To379SNR2 1;
BA_ "GenSigSendType" SG_ 292 FLR2RdrDetn375To379SNR3 1;
BA_ "GenSigSendType" SG_ 292 FLR2RdrDetn375To379SNR4 1;
BA_ "GenSigSendType" SG_ 292 FLR2RdrDetn375To379ScanID 1;
BA_ "GenSigSendType" SG_ 294 FLR2RdrDetn380To384AziAng0 1;
BA_ "GenSigSendType" SG_ 294 FLR2RdrDetn380To384AziAng1 1;
BA_ "GenSigSendType" SG_ 294 FLR2RdrDetn380To384AziAng2 1;
BA_ "GenSigSendType" SG_ 294 FLR2RdrDetn380To384AziAng3 1;
BA_ "GenSigSendType" SG_ 294 FLR2RdrDetn380To384AziAng4 1;
BA_ "GenSigDataID" SG_ 294 FLR2RdrDetn380To384CRC "0xB05";
BA_ "GenSigFuncType" SG_ 294 FLR2RdrDetn380To384CRC 28;
BA_ "GenSigSendType" SG_ 294 FLR2RdrDetn380To384CRC 1;
BA_ "GenSigFuncType" SG_ 294 FLR2RdrDetn380To384Counter 27;
BA_ "GenSigSendType" SG_ 294 FLR2RdrDetn380To384Counter 1;
BA_ "GenSigSendType" SG_ 294 FLR2RdrDetn380To384DynPrpty0 1;
BA_ "GenSigSendType" SG_ 294 FLR2RdrDetn380To384DynPrpty1 1;
BA_ "GenSigSendType" SG_ 294 FLR2RdrDetn380To384DynPrpty2 1;
BA_ "GenSigSendType" SG_ 294 FLR2RdrDetn380To384DynPrpty3 1;
BA_ "GenSigSendType" SG_ 294 FLR2RdrDetn380To384DynPrpty4 1;
BA_ "GenSigSendType" SG_ 294 FLR2RdrDetn380To384EleAng0 1;
BA_ "GenSigSendType" SG_ 294 FLR2RdrDetn380To384EleAng1 1;
BA_ "GenSigSendType" SG_ 294 FLR2RdrDetn380To384EleAng2 1;
BA_ "GenSigSendType" SG_ 294 FLR2RdrDetn380To384EleAng3 1;
BA_ "GenSigSendType" SG_ 294 FLR2RdrDetn380To384EleAng4 1;
BA_ "GenSigSendType" SG_ 294 FLR2RdrDetn380To384Mode0 1;
BA_ "GenSigSendType" SG_ 294 FLR2RdrDetn380To384Mode1 1;
BA_ "GenSigSendType" SG_ 294 FLR2RdrDetn380To384Mode2 1;
BA_ "GenSigSendType" SG_ 294 FLR2RdrDetn380To384Mode3 1;
BA_ "GenSigSendType" SG_ 294 FLR2RdrDetn380To384Mode4 1;
BA_ "GenSigSendType" SG_ 294 FLR2RdrDetn380To384Quality0 1;
BA_ "GenSigSendType" SG_ 294 FLR2RdrDetn380To384Quality1 1;
BA_ "GenSigSendType" SG_ 294 FLR2RdrDetn380To384Quality2 1;
BA_ "GenSigSendType" SG_ 294 FLR2RdrDetn380To384Quality3 1;
BA_ "GenSigSendType" SG_ 294 FLR2RdrDetn380To384Quality4 1;
BA_ "GenSigSendType" SG_ 294 FLR2RdrDetn380To384RCS0 1;
BA_ "GenSigStartValue" SG_ 294 FLR2RdrDetn380To384RCS0 500;
BA_ "GenSigSendType" SG_ 294 FLR2RdrDetn380To384RCS1 1;
BA_ "GenSigStartValue" SG_ 294 FLR2RdrDetn380To384RCS1 500;
BA_ "GenSigSendType" SG_ 294 FLR2RdrDetn380To384RCS2 1;
BA_ "GenSigStartValue" SG_ 294 FLR2RdrDetn380To384RCS2 500;
BA_ "GenSigSendType" SG_ 294 FLR2RdrDetn380To384RCS3 1;
BA_ "GenSigStartValue" SG_ 294 FLR2RdrDetn380To384RCS3 500;
BA_ "GenSigSendType" SG_ 294 FLR2RdrDetn380To384RCS4 1;
BA_ "GenSigStartValue" SG_ 294 FLR2RdrDetn380To384RCS4 500;
BA_ "GenSigSendType" SG_ 294 FLR2RdrDetn380To384Range0 1;
BA_ "GenSigSendType" SG_ 294 FLR2RdrDetn380To384Range1 1;
BA_ "GenSigSendType" SG_ 294 FLR2RdrDetn380To384Range2 1;
BA_ "GenSigSendType" SG_ 294 FLR2RdrDetn380To384Range3 1;
BA_ "GenSigSendType" SG_ 294 FLR2RdrDetn380To384Range4 1;
BA_ "GenSigSendType" SG_ 294 FLR2RdrDetn380To384RngRt0 1;
BA_ "GenSigStartValue" SG_ 294 FLR2RdrDetn380To384RngRt0 1111;
BA_ "GenSigSendType" SG_ 294 FLR2RdrDetn380To384RngRt1 1;
BA_ "GenSigStartValue" SG_ 294 FLR2RdrDetn380To384RngRt1 1111;
BA_ "GenSigSendType" SG_ 294 FLR2RdrDetn380To384RngRt2 1;
BA_ "GenSigStartValue" SG_ 294 FLR2RdrDetn380To384RngRt2 1111;
BA_ "GenSigSendType" SG_ 294 FLR2RdrDetn380To384RngRt3 1;
BA_ "GenSigStartValue" SG_ 294 FLR2RdrDetn380To384RngRt3 1111;
BA_ "GenSigSendType" SG_ 294 FLR2RdrDetn380To384RngRt4 1;
BA_ "GenSigStartValue" SG_ 294 FLR2RdrDetn380To384RngRt4 1111;
BA_ "GenSigSendType" SG_ 294 FLR2RdrDetn380To384SNR0 1;
BA_ "GenSigSendType" SG_ 294 FLR2RdrDetn380To384SNR1 1;
BA_ "GenSigSendType" SG_ 294 FLR2RdrDetn380To384SNR2 1;
BA_ "GenSigSendType" SG_ 294 FLR2RdrDetn380To384SNR3 1;
BA_ "GenSigSendType" SG_ 294 FLR2RdrDetn380To384SNR4 1;
BA_ "GenSigSendType" SG_ 294 FLR2RdrDetn380To384ScanID 1;
BA_ "GenSigSendType" SG_ 296 FLR2RdrDetn385To389AziAng0 1;
BA_ "GenSigSendType" SG_ 296 FLR2RdrDetn385To389AziAng1 1;
BA_ "GenSigSendType" SG_ 296 FLR2RdrDetn385To389AziAng2 1;
BA_ "GenSigSendType" SG_ 296 FLR2RdrDetn385To389AziAng3 1;
BA_ "GenSigSendType" SG_ 296 FLR2RdrDetn385To389AziAng4 1;
BA_ "GenSigDataID" SG_ 296 FLR2RdrDetn385To389CRC "0xB06";
BA_ "GenSigFuncType" SG_ 296 FLR2RdrDetn385To389CRC 28;
BA_ "GenSigSendType" SG_ 296 FLR2RdrDetn385To389CRC 1;
BA_ "GenSigFuncType" SG_ 296 FLR2RdrDetn385To389Counter 27;
BA_ "GenSigSendType" SG_ 296 FLR2RdrDetn385To389Counter 1;
BA_ "GenSigSendType" SG_ 296 FLR2RdrDetn385To389DynPrpty0 1;
BA_ "GenSigSendType" SG_ 296 FLR2RdrDetn385To389DynPrpty1 1;
BA_ "GenSigSendType" SG_ 296 FLR2RdrDetn385To389DynPrpty2 1;
BA_ "GenSigSendType" SG_ 296 FLR2RdrDetn385To389DynPrpty3 1;
BA_ "GenSigSendType" SG_ 296 FLR2RdrDetn385To389DynPrpty4 1;
BA_ "GenSigSendType" SG_ 296 FLR2RdrDetn385To389EleAng0 1;
BA_ "GenSigSendType" SG_ 296 FLR2RdrDetn385To389EleAng1 1;
BA_ "GenSigSendType" SG_ 296 FLR2RdrDetn385To389EleAng2 1;
BA_ "GenSigSendType" SG_ 296 FLR2RdrDetn385To389EleAng3 1;
BA_ "GenSigSendType" SG_ 296 FLR2RdrDetn385To389EleAng4 1;
BA_ "GenSigSendType" SG_ 296 FLR2RdrDetn385To389Mode0 1;
BA_ "GenSigSendType" SG_ 296 FLR2RdrDetn385To389Mode1 1;
BA_ "GenSigSendType" SG_ 296 FLR2RdrDetn385To389Mode2 1;
BA_ "GenSigSendType" SG_ 296 FLR2RdrDetn385To389Mode3 1;
BA_ "GenSigSendType" SG_ 296 FLR2RdrDetn385To389Mode4 1;
BA_ "GenSigSendType" SG_ 296 FLR2RdrDetn385To389Quality0 1;
BA_ "GenSigSendType" SG_ 296 FLR2RdrDetn385To389Quality1 1;
BA_ "GenSigSendType" SG_ 296 FLR2RdrDetn385To389Quality2 1;
BA_ "GenSigSendType" SG_ 296 FLR2RdrDetn385To389Quality3 1;
BA_ "GenSigSendType" SG_ 296 FLR2RdrDetn385To389Quality4 1;
BA_ "GenSigSendType" SG_ 296 FLR2RdrDetn385To389RCS0 1;
BA_ "GenSigStartValue" SG_ 296 FLR2RdrDetn385To389RCS0 500;
BA_ "GenSigSendType" SG_ 296 FLR2RdrDetn385To389RCS1 1;
BA_ "GenSigStartValue" SG_ 296 FLR2RdrDetn385To389RCS1 500;
BA_ "GenSigSendType" SG_ 296 FLR2RdrDetn385To389RCS2 1;
BA_ "GenSigStartValue" SG_ 296 FLR2RdrDetn385To389RCS2 500;
BA_ "GenSigSendType" SG_ 296 FLR2RdrDetn385To389RCS3 1;
BA_ "GenSigStartValue" SG_ 296 FLR2RdrDetn385To389RCS3 500;
BA_ "GenSigSendType" SG_ 296 FLR2RdrDetn385To389RCS4 1;
BA_ "GenSigStartValue" SG_ 296 FLR2RdrDetn385To389RCS4 500;
BA_ "GenSigSendType" SG_ 296 FLR2RdrDetn385To389Range0 1;
BA_ "GenSigSendType" SG_ 296 FLR2RdrDetn385To389Range1 1;
BA_ "GenSigSendType" SG_ 296 FLR2RdrDetn385To389Range2 1;
BA_ "GenSigSendType" SG_ 296 FLR2RdrDetn385To389Range3 1;
BA_ "GenSigSendType" SG_ 296 FLR2RdrDetn385To389Range4 1;
BA_ "GenSigSendType" SG_ 296 FLR2RdrDetn385To389RngRt0 1;
BA_ "GenSigStartValue" SG_ 296 FLR2RdrDetn385To389RngRt0 1111;
BA_ "GenSigSendType" SG_ 296 FLR2RdrDetn385To389RngRt1 1;
BA_ "GenSigStartValue" SG_ 296 FLR2RdrDetn385To389RngRt1 1111;
BA_ "GenSigSendType" SG_ 296 FLR2RdrDetn385To389RngRt2 1;
BA_ "GenSigStartValue" SG_ 296 FLR2RdrDetn385To389RngRt2 1111;
BA_ "GenSigSendType" SG_ 296 FLR2RdrDetn385To389RngRt3 1;
BA_ "GenSigStartValue" SG_ 296 FLR2RdrDetn385To389RngRt3 1111;
BA_ "GenSigSendType" SG_ 296 FLR2RdrDetn385To389RngRt4 1;
BA_ "GenSigStartValue" SG_ 296 FLR2RdrDetn385To389RngRt4 1111;
BA_ "GenSigSendType" SG_ 296 FLR2RdrDetn385To389SNR0 1;
BA_ "GenSigSendType" SG_ 296 FLR2RdrDetn385To389SNR1 1;
BA_ "GenSigSendType" SG_ 296 FLR2RdrDetn385To389SNR2 1;
BA_ "GenSigSendType" SG_ 296 FLR2RdrDetn385To389SNR3 1;
BA_ "GenSigSendType" SG_ 296 FLR2RdrDetn385To389SNR4 1;
BA_ "GenSigSendType" SG_ 296 FLR2RdrDetn385To389ScanID 1;
BA_ "GenSigSendType" SG_ 298 FLR2RdrDetn390To394AziAng0 1;
BA_ "GenSigSendType" SG_ 298 FLR2RdrDetn390To394AziAng1 1;
BA_ "GenSigSendType" SG_ 298 FLR2RdrDetn390To394AziAng2 1;
BA_ "GenSigSendType" SG_ 298 FLR2RdrDetn390To394AziAng3 1;
BA_ "GenSigSendType" SG_ 298 FLR2RdrDetn390To394AziAng4 1;
BA_ "GenSigDataID" SG_ 298 FLR2RdrDetn390To394CRC "0xB07";
BA_ "GenSigFuncType" SG_ 298 FLR2RdrDetn390To394CRC 28;
BA_ "GenSigSendType" SG_ 298 FLR2RdrDetn390To394CRC 1;
BA_ "GenSigFuncType" SG_ 298 FLR2RdrDetn390To394Counter 27;
BA_ "GenSigSendType" SG_ 298 FLR2RdrDetn390To394Counter 1;
BA_ "GenSigSendType" SG_ 298 FLR2RdrDetn390To394DynPrpty0 1;
BA_ "GenSigSendType" SG_ 298 FLR2RdrDetn390To394DynPrpty1 1;
BA_ "GenSigSendType" SG_ 298 FLR2RdrDetn390To394DynPrpty2 1;
BA_ "GenSigSendType" SG_ 298 FLR2RdrDetn390To394DynPrpty3 1;
BA_ "GenSigSendType" SG_ 298 FLR2RdrDetn390To394DynPrpty4 1;
BA_ "GenSigSendType" SG_ 298 FLR2RdrDetn390To394EleAng0 1;
BA_ "GenSigSendType" SG_ 298 FLR2RdrDetn390To394EleAng1 1;
BA_ "GenSigSendType" SG_ 298 FLR2RdrDetn390To394EleAng2 1;
BA_ "GenSigSendType" SG_ 298 FLR2RdrDetn390To394EleAng3 1;
BA_ "GenSigSendType" SG_ 298 FLR2RdrDetn390To394EleAng4 1;
BA_ "GenSigSendType" SG_ 298 FLR2RdrDetn390To394Mode0 1;
BA_ "GenSigSendType" SG_ 298 FLR2RdrDetn390To394Mode1 1;
BA_ "GenSigSendType" SG_ 298 FLR2RdrDetn390To394Mode2 1;
BA_ "GenSigSendType" SG_ 298 FLR2RdrDetn390To394Mode3 1;
BA_ "GenSigSendType" SG_ 298 FLR2RdrDetn390To394Mode4 1;
BA_ "GenSigSendType" SG_ 298 FLR2RdrDetn390To394Quality0 1;
BA_ "GenSigSendType" SG_ 298 FLR2RdrDetn390To394Quality1 1;
BA_ "GenSigSendType" SG_ 298 FLR2RdrDetn390To394Quality2 1;
BA_ "GenSigSendType" SG_ 298 FLR2RdrDetn390To394Quality3 1;
BA_ "GenSigSendType" SG_ 298 FLR2RdrDetn390To394Quality4 1;
BA_ "GenSigSendType" SG_ 298 FLR2RdrDetn390To394RCS0 1;
BA_ "GenSigStartValue" SG_ 298 FLR2RdrDetn390To394RCS0 500;
BA_ "GenSigSendType" SG_ 298 FLR2RdrDetn390To394RCS1 1;
BA_ "GenSigStartValue" SG_ 298 FLR2RdrDetn390To394RCS1 500;
BA_ "GenSigSendType" SG_ 298 FLR2RdrDetn390To394RCS2 1;
BA_ "GenSigStartValue" SG_ 298 FLR2RdrDetn390To394RCS2 500;
BA_ "GenSigSendType" SG_ 298 FLR2RdrDetn390To394RCS3 1;
BA_ "GenSigStartValue" SG_ 298 FLR2RdrDetn390To394RCS3 500;
BA_ "GenSigSendType" SG_ 298 FLR2RdrDetn390To394RCS4 1;
BA_ "GenSigStartValue" SG_ 298 FLR2RdrDetn390To394RCS4 500;
BA_ "GenSigSendType" SG_ 298 FLR2RdrDetn390To394Range0 1;
BA_ "GenSigSendType" SG_ 298 FLR2RdrDetn390To394Range1 1;
BA_ "GenSigSendType" SG_ 298 FLR2RdrDetn390To394Range2 1;
BA_ "GenSigSendType" SG_ 298 FLR2RdrDetn390To394Range3 1;
BA_ "GenSigSendType" SG_ 298 FLR2RdrDetn390To394Range4 1;
BA_ "GenSigSendType" SG_ 298 FLR2RdrDetn390To394RngRt0 1;
BA_ "GenSigStartValue" SG_ 298 FLR2RdrDetn390To394RngRt0 1111;
BA_ "GenSigSendType" SG_ 298 FLR2RdrDetn390To394RngRt1 1;
BA_ "GenSigStartValue" SG_ 298 FLR2RdrDetn390To394RngRt1 1111;
BA_ "GenSigSendType" SG_ 298 FLR2RdrDetn390To394RngRt2 1;
BA_ "GenSigStartValue" SG_ 298 FLR2RdrDetn390To394RngRt2 1111;
BA_ "GenSigSendType" SG_ 298 FLR2RdrDetn390To394RngRt3 1;
BA_ "GenSigStartValue" SG_ 298 FLR2RdrDetn390To394RngRt3 1111;
BA_ "GenSigSendType" SG_ 298 FLR2RdrDetn390To394RngRt4 1;
BA_ "GenSigStartValue" SG_ 298 FLR2RdrDetn390To394RngRt4 1111;
BA_ "GenSigSendType" SG_ 298 FLR2RdrDetn390To394SNR0 1;
BA_ "GenSigSendType" SG_ 298 FLR2RdrDetn390To394SNR1 1;
BA_ "GenSigSendType" SG_ 298 FLR2RdrDetn390To394SNR2 1;
BA_ "GenSigSendType" SG_ 298 FLR2RdrDetn390To394SNR3 1;
BA_ "GenSigSendType" SG_ 298 FLR2RdrDetn390To394SNR4 1;
BA_ "GenSigSendType" SG_ 298 FLR2RdrDetn390To394ScanID 1;
BA_ "GenSigSendType" SG_ 300 FLR2RdrDetn395To399AziAng0 1;
BA_ "GenSigSendType" SG_ 300 FLR2RdrDetn395To399AziAng1 1;
BA_ "GenSigSendType" SG_ 300 FLR2RdrDetn395To399AziAng2 1;
BA_ "GenSigSendType" SG_ 300 FLR2RdrDetn395To399AziAng3 1;
BA_ "GenSigSendType" SG_ 300 FLR2RdrDetn395To399AziAng4 1;
BA_ "GenSigDataID" SG_ 300 FLR2RdrDetn395To399CRC "0xB08";
BA_ "GenSigFuncType" SG_ 300 FLR2RdrDetn395To399CRC 28;
BA_ "GenSigSendType" SG_ 300 FLR2RdrDetn395To399CRC 1;
BA_ "GenSigFuncType" SG_ 300 FLR2RdrDetn395To399Counter 27;
BA_ "GenSigSendType" SG_ 300 FLR2RdrDetn395To399Counter 1;
BA_ "GenSigSendType" SG_ 300 FLR2RdrDetn395To399DynPrpty0 1;
BA_ "GenSigSendType" SG_ 300 FLR2RdrDetn395To399DynPrpty1 1;
BA_ "GenSigSendType" SG_ 300 FLR2RdrDetn395To399DynPrpty2 1;
BA_ "GenSigSendType" SG_ 300 FLR2RdrDetn395To399DynPrpty3 1;
BA_ "GenSigSendType" SG_ 300 FLR2RdrDetn395To399DynPrpty4 1;
BA_ "GenSigSendType" SG_ 300 FLR2RdrDetn395To399EleAng0 1;
BA_ "GenSigSendType" SG_ 300 FLR2RdrDetn395To399EleAng1 1;
BA_ "GenSigSendType" SG_ 300 FLR2RdrDetn395To399EleAng2 1;
BA_ "GenSigSendType" SG_ 300 FLR2RdrDetn395To399EleAng3 1;
BA_ "GenSigSendType" SG_ 300 FLR2RdrDetn395To399EleAng4 1;
BA_ "GenSigSendType" SG_ 300 FLR2RdrDetn395To399Mode0 1;
BA_ "GenSigSendType" SG_ 300 FLR2RdrDetn395To399Mode1 1;
BA_ "GenSigSendType" SG_ 300 FLR2RdrDetn395To399Mode2 1;
BA_ "GenSigSendType" SG_ 300 FLR2RdrDetn395To399Mode3 1;
BA_ "GenSigSendType" SG_ 300 FLR2RdrDetn395To399Mode4 1;
BA_ "GenSigSendType" SG_ 300 FLR2RdrDetn395To399Quality0 1;
BA_ "GenSigSendType" SG_ 300 FLR2RdrDetn395To399Quality1 1;
BA_ "GenSigSendType" SG_ 300 FLR2RdrDetn395To399Quality2 1;
BA_ "GenSigSendType" SG_ 300 FLR2RdrDetn395To399Quality3 1;
BA_ "GenSigSendType" SG_ 300 FLR2RdrDetn395To399Quality4 1;
BA_ "GenSigSendType" SG_ 300 FLR2RdrDetn395To399RCS0 1;
BA_ "GenSigStartValue" SG_ 300 FLR2RdrDetn395To399RCS0 500;
BA_ "GenSigSendType" SG_ 300 FLR2RdrDetn395To399RCS1 1;
BA_ "GenSigStartValue" SG_ 300 FLR2RdrDetn395To399RCS1 500;
BA_ "GenSigSendType" SG_ 300 FLR2RdrDetn395To399RCS2 1;
BA_ "GenSigStartValue" SG_ 300 FLR2RdrDetn395To399RCS2 500;
BA_ "GenSigSendType" SG_ 300 FLR2RdrDetn395To399RCS3 1;
BA_ "GenSigStartValue" SG_ 300 FLR2RdrDetn395To399RCS3 500;
BA_ "GenSigSendType" SG_ 300 FLR2RdrDetn395To399RCS4 1;
BA_ "GenSigStartValue" SG_ 300 FLR2RdrDetn395To399RCS4 500;
BA_ "GenSigSendType" SG_ 300 FLR2RdrDetn395To399Range0 1;
BA_ "GenSigSendType" SG_ 300 FLR2RdrDetn395To399Range1 1;
BA_ "GenSigSendType" SG_ 300 FLR2RdrDetn395To399Range2 1;
BA_ "GenSigSendType" SG_ 300 FLR2RdrDetn395To399Range3 1;
BA_ "GenSigSendType" SG_ 300 FLR2RdrDetn395To399Range4 1;
BA_ "GenSigSendType" SG_ 300 FLR2RdrDetn395To399RngRt0 1;
BA_ "GenSigStartValue" SG_ 300 FLR2RdrDetn395To399RngRt0 1111;
BA_ "GenSigSendType" SG_ 300 FLR2RdrDetn395To399RngRt1 1;
BA_ "GenSigStartValue" SG_ 300 FLR2RdrDetn395To399RngRt1 1111;
BA_ "GenSigSendType" SG_ 300 FLR2RdrDetn395To399RngRt2 1;
BA_ "GenSigStartValue" SG_ 300 FLR2RdrDetn395To399RngRt2 1111;
BA_ "GenSigSendType" SG_ 300 FLR2RdrDetn395To399RngRt3 1;
BA_ "GenSigStartValue" SG_ 300 FLR2RdrDetn395To399RngRt3 1111;
BA_ "GenSigSendType" SG_ 300 FLR2RdrDetn395To399RngRt4 1;
BA_ "GenSigStartValue" SG_ 300 FLR2RdrDetn395To399RngRt4 1111;
BA_ "GenSigSendType" SG_ 300 FLR2RdrDetn395To399SNR0 1;
BA_ "GenSigSendType" SG_ 300 FLR2RdrDetn395To399SNR1 1;
BA_ "GenSigSendType" SG_ 300 FLR2RdrDetn395To399SNR2 1;
BA_ "GenSigSendType" SG_ 300 FLR2RdrDetn395To399SNR3 1;
BA_ "GenSigSendType" SG_ 300 FLR2RdrDetn395To399SNR4 1;
BA_ "GenSigSendType" SG_ 300 FLR2RdrDetn395To399ScanID 1;
BA_ "GenSigDataID" SG_ 320 FLR2RdrObject0To1CRC "0x8CE";
BA_ "GenSigFuncType" SG_ 320 FLR2RdrObject0To1CRC 28;
BA_ "GenSigSendType" SG_ 320 FLR2RdrObject0To1CRC 1;
BA_ "GenSigSendType" SG_ 320 FLR2RdrObject0To1Class0 1;
BA_ "GenSigSendType" SG_ 320 FLR2RdrObject0To1Class1 1;
BA_ "GenSigFuncType" SG_ 320 FLR2RdrObject0To1Counter 27;
BA_ "GenSigSendType" SG_ 320 FLR2RdrObject0To1Counter 1;
BA_ "GenSigSendType" SG_ 320 FLR2RdrObject0To1DataCoastCntr0 1;
BA_ "GenSigSendType" SG_ 320 FLR2RdrObject0To1DataCoastCntr1 1;
BA_ "GenSigSendType" SG_ 320 FLR2RdrObject0To1DataConf0 1;
BA_ "GenSigSendType" SG_ 320 FLR2RdrObject0To1DataConf1 1;
BA_ "GenSigSendType" SG_ 320 FLR2RdrObject0To1DataLen0 1;
BA_ "GenSigSendType" SG_ 320 FLR2RdrObject0To1DataLen1 1;
BA_ "GenSigSendType" SG_ 320 FLR2RdrObject0To1DataStDLatAcc0 1;
BA_ "GenSigSendType" SG_ 320 FLR2RdrObject0To1DataStDLatAcc1 1;
BA_ "GenSigSendType" SG_ 320 FLR2RdrObject0To1DataStDLatPos0 1;
BA_ "GenSigSendType" SG_ 320 FLR2RdrObject0To1DataStDLatPos1 1;
BA_ "GenSigSendType" SG_ 320 FLR2RdrObject0To1DataStDLatVelo0 1;
BA_ "GenSigSendType" SG_ 320 FLR2RdrObject0To1DataStDLatVelo1 1;
BA_ "GenSigSendType" SG_ 320 FLR2RdrObject0To1DataStDLgtAcc0 1;
BA_ "GenSigSendType" SG_ 320 FLR2RdrObject0To1DataStDLgtAcc1 1;
BA_ "GenSigSendType" SG_ 320 FLR2RdrObject0To1DataStDLgtPos0 1;
BA_ "GenSigSendType" SG_ 320 FLR2RdrObject0To1DataStDLgtPos1 1;
BA_ "GenSigSendType" SG_ 320 FLR2RdrObject0To1DataStDLgtVelo0 1;
BA_ "GenSigSendType" SG_ 320 FLR2RdrObject0To1DataStDLgtVelo1 1;
BA_ "GenSigSendType" SG_ 320 FLR2RdrObject0To1DataWidth0 1;
BA_ "GenSigSendType" SG_ 320 FLR2RdrObject0To1DataWidth1 1;
BA_ "GenSigSendType" SG_ 320 FLR2RdrObject0To1HeadingAng0 1;
BA_ "GenSigStartValue" SG_ 320 FLR2RdrObject0To1HeadingAng0 315;
BA_ "GenSigSendType" SG_ 320 FLR2RdrObject0To1HeadingAng1 1;
BA_ "GenSigStartValue" SG_ 320 FLR2RdrObject0To1HeadingAng1 315;
BA_ "GenSigSendType" SG_ 320 FLR2RdrObject0To1LatAcc0 1;
BA_ "GenSigStartValue" SG_ 320 FLR2RdrObject0To1LatAcc0 356;
BA_ "GenSigSendType" SG_ 320 FLR2RdrObject0To1LatAcc1 1;
BA_ "GenSigStartValue" SG_ 320 FLR2RdrObject0To1LatAcc1 356;
BA_ "GenSigSendType" SG_ 320 FLR2RdrObject0To1LatPos0 1;
BA_ "GenSigStartValue" SG_ 320 FLR2RdrObject0To1LatPos0 4095;
BA_ "GenSigSendType" SG_ 320 FLR2RdrObject0To1LatPos1 1;
BA_ "GenSigStartValue" SG_ 320 FLR2RdrObject0To1LatPos1 4095;
BA_ "GenSigSendType" SG_ 320 FLR2RdrObject0To1LatVelo0 1;
BA_ "GenSigStartValue" SG_ 320 FLR2RdrObject0To1LatVelo0 1024;
BA_ "GenSigSendType" SG_ 320 FLR2RdrObject0To1LatVelo1 1;
BA_ "GenSigStartValue" SG_ 320 FLR2RdrObject0To1LatVelo1 1024;
BA_ "GenSigSendType" SG_ 320 FLR2RdrObject0To1LgtAcc0 1;
BA_ "GenSigStartValue" SG_ 320 FLR2RdrObject0To1LgtAcc0 356;
BA_ "GenSigSendType" SG_ 320 FLR2RdrObject0To1LgtAcc1 1;
BA_ "GenSigStartValue" SG_ 320 FLR2RdrObject0To1LgtAcc1 356;
BA_ "GenSigSendType" SG_ 320 FLR2RdrObject0To1LgtPos0 1;
BA_ "GenSigStartValue" SG_ 320 FLR2RdrObject0To1LgtPos0 4095;
BA_ "GenSigSendType" SG_ 320 FLR2RdrObject0To1LgtPos1 1;
BA_ "GenSigStartValue" SG_ 320 FLR2RdrObject0To1LgtPos1 4095;
BA_ "GenSigSendType" SG_ 320 FLR2RdrObject0To1LgtVelo0 1;
BA_ "GenSigStartValue" SG_ 320 FLR2RdrObject0To1LgtVelo0 1024;
BA_ "GenSigSendType" SG_ 320 FLR2RdrObject0To1LgtVelo1 1;
BA_ "GenSigStartValue" SG_ 320 FLR2RdrObject0To1LgtVelo1 1024;
BA_ "GenSigSendType" SG_ 320 FLR2RdrObject0To1ModeInfo0 1;
BA_ "GenSigSendType" SG_ 320 FLR2RdrObject0To1ModeInfo1 1;
BA_ "GenSigSendType" SG_ 320 FLR2RdrObject0To1MsgCntr 1;
BA_ "GenSigSendType" SG_ 320 FLR2RdrObject0To1MtnModel0 1;
BA_ "GenSigSendType" SG_ 320 FLR2RdrObject0To1MtnModel1 1;
BA_ "GenSigSendType" SG_ 320 FLR2RdrObject0To1MtnPattern0 1;
BA_ "GenSigSendType" SG_ 320 FLR2RdrObject0To1MtnPattern1 1;
BA_ "GenSigSendType" SG_ 320 FLR2RdrObject0To1PedMicroDoppler0 1;
BA_ "GenSigSendType" SG_ 320 FLR2RdrObject0To1PedMicroDoppler1 1;
BA_ "GenSigSendType" SG_ 320 FLR2RdrObject0To1Qly0 1;
BA_ "GenSigSendType" SG_ 320 FLR2RdrObject0To1Qly1 1;
BA_ "GenSigSendType" SG_ 320 FLR2RdrObject0To1ScanID 1;
BA_ "GenSigDataID" SG_ 322 FLR2RdrObject2To3CRC "0x8CF";
BA_ "GenSigFuncType" SG_ 322 FLR2RdrObject2To3CRC 28;
BA_ "GenSigSendType" SG_ 322 FLR2RdrObject2To3CRC 1;
BA_ "GenSigSendType" SG_ 322 FLR2RdrObject2To3Class0 1;
BA_ "GenSigSendType" SG_ 322 FLR2RdrObject2To3Class1 1;
BA_ "GenSigFuncType" SG_ 322 FLR2RdrObject2To3Counter 27;
BA_ "GenSigSendType" SG_ 322 FLR2RdrObject2To3Counter 1;
BA_ "GenSigSendType" SG_ 322 FLR2RdrObject2To3DataCoastCntr0 1;
BA_ "GenSigSendType" SG_ 322 FLR2RdrObject2To3DataCoastCntr1 1;
BA_ "GenSigSendType" SG_ 322 FLR2RdrObject2To3DataConf0 1;
BA_ "GenSigSendType" SG_ 322 FLR2RdrObject2To3DataConf1 1;
BA_ "GenSigSendType" SG_ 322 FLR2RdrObject2To3DataLen0 1;
BA_ "GenSigSendType" SG_ 322 FLR2RdrObject2To3DataLen1 1;
BA_ "GenSigSendType" SG_ 322 FLR2RdrObject2To3DataStDLatAcc0 1;
BA_ "GenSigSendType" SG_ 322 FLR2RdrObject2To3DataStDLatAcc1 1;
BA_ "GenSigSendType" SG_ 322 FLR2RdrObject2To3DataStDLatPos0 1;
BA_ "GenSigSendType" SG_ 322 FLR2RdrObject2To3DataStDLatPos1 1;
BA_ "GenSigSendType" SG_ 322 FLR2RdrObject2To3DataStDLatVelo0 1;
BA_ "GenSigSendType" SG_ 322 FLR2RdrObject2To3DataStDLatVelo1 1;
BA_ "GenSigSendType" SG_ 322 FLR2RdrObject2To3DataStDLgtAcc0 1;
BA_ "GenSigSendType" SG_ 322 FLR2RdrObject2To3DataStDLgtAcc1 1;
BA_ "GenSigSendType" SG_ 322 FLR2RdrObject2To3DataStDLgtPos0 1;
BA_ "GenSigSendType" SG_ 322 FLR2RdrObject2To3DataStDLgtPos1 1;
BA_ "GenSigSendType" SG_ 322 FLR2RdrObject2To3DataStDLgtVelo0 1;
BA_ "GenSigSendType" SG_ 322 FLR2RdrObject2To3DataStDLgtVelo1 1;
BA_ "GenSigSendType" SG_ 322 FLR2RdrObject2To3DataWidth0 1;
BA_ "GenSigSendType" SG_ 322 FLR2RdrObject2To3DataWidth1 1;
BA_ "GenSigSendType" SG_ 322 FLR2RdrObject2To3HeadingAng0 1;
BA_ "GenSigStartValue" SG_ 322 FLR2RdrObject2To3HeadingAng0 315;
BA_ "GenSigSendType" SG_ 322 FLR2RdrObject2To3HeadingAng1 1;
BA_ "GenSigStartValue" SG_ 322 FLR2RdrObject2To3HeadingAng1 315;
BA_ "GenSigSendType" SG_ 322 FLR2RdrObject2To3LatAcc0 1;
BA_ "GenSigStartValue" SG_ 322 FLR2RdrObject2To3LatAcc0 356;
BA_ "GenSigSendType" SG_ 322 FLR2RdrObject2To3LatAcc1 1;
BA_ "GenSigStartValue" SG_ 322 FLR2RdrObject2To3LatAcc1 356;
BA_ "GenSigSendType" SG_ 322 FLR2RdrObject2To3LatPos0 1;
BA_ "GenSigStartValue" SG_ 322 FLR2RdrObject2To3LatPos0 4095;
BA_ "GenSigSendType" SG_ 322 FLR2RdrObject2To3LatPos1 1;
BA_ "GenSigStartValue" SG_ 322 FLR2RdrObject2To3LatPos1 4095;
BA_ "GenSigSendType" SG_ 322 FLR2RdrObject2To3LatVelo0 1;
BA_ "GenSigStartValue" SG_ 322 FLR2RdrObject2To3LatVelo0 1024;
BA_ "GenSigSendType" SG_ 322 FLR2RdrObject2To3LatVelo1 1;
BA_ "GenSigStartValue" SG_ 322 FLR2RdrObject2To3LatVelo1 1024;
BA_ "GenSigSendType" SG_ 322 FLR2RdrObject2To3LgtAcc0 1;
BA_ "GenSigStartValue" SG_ 322 FLR2RdrObject2To3LgtAcc0 356;
BA_ "GenSigSendType" SG_ 322 FLR2RdrObject2To3LgtAcc1 1;
BA_ "GenSigStartValue" SG_ 322 FLR2RdrObject2To3LgtAcc1 356;
BA_ "GenSigSendType" SG_ 322 FLR2RdrObject2To3LgtPos0 1;
BA_ "GenSigStartValue" SG_ 322 FLR2RdrObject2To3LgtPos0 4095;
BA_ "GenSigSendType" SG_ 322 FLR2RdrObject2To3LgtPos1 1;
BA_ "GenSigStartValue" SG_ 322 FLR2RdrObject2To3LgtPos1 4095;
BA_ "GenSigSendType" SG_ 322 FLR2RdrObject2To3LgtVelo0 1;
BA_ "GenSigStartValue" SG_ 322 FLR2RdrObject2To3LgtVelo0 1024;
BA_ "GenSigSendType" SG_ 322 FLR2RdrObject2To3LgtVelo1 1;
BA_ "GenSigStartValue" SG_ 322 FLR2RdrObject2To3LgtVelo1 1024;
BA_ "GenSigSendType" SG_ 322 FLR2RdrObject2To3ModeInfo0 1;
BA_ "GenSigSendType" SG_ 322 FLR2RdrObject2To3ModeInfo1 1;
BA_ "GenSigSendType" SG_ 322 FLR2RdrObject2To3MsgCntr 1;
BA_ "GenSigSendType" SG_ 322 FLR2RdrObject2To3MtnModel0 1;
BA_ "GenSigSendType" SG_ 322 FLR2RdrObject2To3MtnModel1 1;
BA_ "GenSigSendType" SG_ 322 FLR2RdrObject2To3MtnPattern0 1;
BA_ "GenSigSendType" SG_ 322 FLR2RdrObject2To3MtnPattern1 1;
BA_ "GenSigSendType" SG_ 322 FLR2RdrObject2To3PedMicroDoppler0 1;
BA_ "GenSigSendType" SG_ 322 FLR2RdrObject2To3PedMicroDoppler1 1;
BA_ "GenSigSendType" SG_ 322 FLR2RdrObject2To3Qly0 1;
BA_ "GenSigSendType" SG_ 322 FLR2RdrObject2To3Qly1 1;
BA_ "GenSigSendType" SG_ 322 FLR2RdrObject2To3ScanID 1;
VAL_ 278 FLR2RdrDetn340To344Mode0 0 "FLR2RadrDetnMode_RngNearReslMod" 1 "FLR2RadrDetnMode_RngMidReslMod" 2 "FLR2RadrDetnMode_RngLongReslMod" 3 "FLR2RadrDetnMode_DetectionUnpopulated";
VAL_ 278 FLR2RdrDetn340To344Mode1 0 "FLR2RadrDetnMode_RngNearReslMod" 1 "FLR2RadrDetnMode_RngMidReslMod" 2 "FLR2RadrDetnMode_RngLongReslMod" 3 "FLR2RadrDetnMode_DetectionUnpopulated";
VAL_ 278 FLR2RdrDetn340To344Mode2 0 "FLR2RadrDetnMode_RngNearReslMod" 1 "FLR2RadrDetnMode_RngMidReslMod" 2 "FLR2RadrDetnMode_RngLongReslMod" 3 "FLR2RadrDetnMode_DetectionUnpopulated";
VAL_ 278 FLR2RdrDetn340To344Mode3 0 "FLR2RadrDetnMode_RngNearReslMod" 1 "FLR2RadrDetnMode_RngMidReslMod" 2 "FLR2RadrDetnMode_RngLongReslMod" 3 "FLR2RadrDetnMode_DetectionUnpopulated";
VAL_ 278 FLR2RdrDetn340To344Mode4 0 "FLR2RadrDetnMode_RngNearReslMod" 1 "FLR2RadrDetnMode_RngMidReslMod" 2 "FLR2RadrDetnMode_RngLongReslMod" 3 "FLR2RadrDetnMode_DetectionUnpopulated";
VAL_ 278 FLR2RdrDetn340To344Quality0 0 "Quality_Low" 1 "Quality_Medium" 2 "Quality_High" 3 "Quality_DetectionUnpopulated";
VAL_ 278 FLR2RdrDetn340To344Quality1 0 "Quality_Low" 1 "Quality_Medium" 2 "Quality_High" 3 "Quality_DetectionUnpopulated";
VAL_ 278 FLR2RdrDetn340To344Quality2 0 "Quality_Low" 1 "Quality_Medium" 2 "Quality_High" 3 "Quality_DetectionUnpopulated";
VAL_ 278 FLR2RdrDetn340To344Quality3 0 "Quality_Low" 1 "Quality_Medium" 2 "Quality_High" 3 "Quality_DetectionUnpopulated";
VAL_ 278 FLR2RdrDetn340To344Quality4 0 "Quality_Low" 1 "Quality_Medium" 2 "Quality_High" 3 "Quality_DetectionUnpopulated";
VAL_ 280 FLR2RdrDetn345To349Mode0 0 "FLR2RadrDetnMode_RngNearReslMod" 1 "FLR2RadrDetnMode_RngMidReslMod" 2 "FLR2RadrDetnMode_RngLongReslMod" 3 "FLR2RadrDetnMode_DetectionUnpopulated";
VAL_ 280 FLR2RdrDetn345To349Mode1 0 "FLR2RadrDetnMode_RngNearReslMod" 1 "FLR2RadrDetnMode_RngMidReslMod" 2 "FLR2RadrDetnMode_RngLongReslMod" 3 "FLR2RadrDetnMode_DetectionUnpopulated";
VAL_ 280 FLR2RdrDetn345To349Mode2 0 "FLR2RadrDetnMode_RngNearReslMod" 1 "FLR2RadrDetnMode_RngMidReslMod" 2 "FLR2RadrDetnMode_RngLongReslMod" 3 "FLR2RadrDetnMode_DetectionUnpopulated";
VAL_ 280 FLR2RdrDetn345To349Mode3 0 "FLR2RadrDetnMode_RngNearReslMod" 1 "FLR2RadrDetnMode_RngMidReslMod" 2 "FLR2RadrDetnMode_RngLongReslMod" 3 "FLR2RadrDetnMode_DetectionUnpopulated";
VAL_ 280 FLR2RdrDetn345To349Mode4 0 "FLR2RadrDetnMode_RngNearReslMod" 1 "FLR2RadrDetnMode_RngMidReslMod" 2 "FLR2RadrDetnMode_RngLongReslMod" 3 "FLR2RadrDetnMode_DetectionUnpopulated";
VAL_ 280 FLR2RdrDetn345To349Quality0 0 "Quality_Low" 1 "Quality_Medium" 2 "Quality_High" 3 "Quality_DetectionUnpopulated";
VAL_ 280 FLR2RdrDetn345To349Quality1 0 "Quality_Low" 1 "Quality_Medium" 2 "Quality_High" 3 "Quality_DetectionUnpopulated";
VAL_ 280 FLR2RdrDetn345To349Quality2 0 "Quality_Low" 1 "Quality_Medium" 2 "Quality_High" 3 "Quality_DetectionUnpopulated";
VAL_ 280 FLR2RdrDetn345To349Quality3 0 "Quality_Low" 1 "Quality_Medium" 2 "Quality_High" 3 "Quality_DetectionUnpopulated";
VAL_ 280 FLR2RdrDetn345To349Quality4 0 "Quality_Low" 1 "Quality_Medium" 2 "Quality_High" 3 "Quality_DetectionUnpopulated";
VAL_ 282 FLR2RdrDetn350To354Mode0 0 "FLR2RadrDetnMode_RngNearReslMod" 1 "FLR2RadrDetnMode_RngMidReslMod" 2 "FLR2RadrDetnMode_RngLongReslMod" 3 "FLR2RadrDetnMode_DetectionUnpopulated";
VAL_ 282 FLR2RdrDetn350To354Mode1 0 "FLR2RadrDetnMode_RngNearReslMod" 1 "FLR2RadrDetnMode_RngMidReslMod" 2 "FLR2RadrDetnMode_RngLongReslMod" 3 "FLR2RadrDetnMode_DetectionUnpopulated";
VAL_ 282 FLR2RdrDetn350To354Mode2 0 "FLR2RadrDetnMode_RngNearReslMod" 1 "FLR2RadrDetnMode_RngMidReslMod" 2 "FLR2RadrDetnMode_RngLongReslMod" 3 "FLR2RadrDetnMode_DetectionUnpopulated";
VAL_ 282 FLR2RdrDetn350To354Mode3 0 "FLR2RadrDetnMode_RngNearReslMod" 1 "FLR2RadrDetnMode_RngMidReslMod" 2 "FLR2RadrDetnMode_RngLongReslMod" 3 "FLR2RadrDetnMode_DetectionUnpopulated";
VAL_ 282 FLR2RdrDetn350To354Mode4 0 "FLR2RadrDetnMode_RngNearReslMod" 1 "FLR2RadrDetnMode_RngMidReslMod" 2 "FLR2RadrDetnMode_RngLongReslMod" 3 "FLR2RadrDetnMode_DetectionUnpopulated";
VAL_ 282 FLR2RdrDetn350To354Quality0 0 "Quality_Low" 1 "Quality_Medium" 2 "Quality_High" 3 "Quality_DetectionUnpopulated";
VAL_ 282 FLR2RdrDetn350To354Quality1 0 "Quality_Low" 1 "Quality_Medium" 2 "Quality_High" 3 "Quality_DetectionUnpopulated";
VAL_ 282 FLR2RdrDetn350To354Quality2 0 "Quality_Low" 1 "Quality_Medium" 2 "Quality_High" 3 "Quality_DetectionUnpopulated";
VAL_ 282 FLR2RdrDetn350To354Quality3 0 "Quality_Low" 1 "Quality_Medium" 2 "Quality_High" 3 "Quality_DetectionUnpopulated";
VAL_ 282 FLR2RdrDetn350To354Quality4 0 "Quality_Low" 1 "Quality_Medium" 2 "Quality_High" 3 "Quality_DetectionUnpopulated";
VAL_ 284 FLR2RdrDetn355To359Mode0 0 "FLR2RadrDetnMode_RngNearReslMod" 1 "FLR2RadrDetnMode_RngMidReslMod" 2 "FLR2RadrDetnMode_RngLongReslMod" 3 "FLR2RadrDetnMode_DetectionUnpopulated";
VAL_ 284 FLR2RdrDetn355To359Mode1 0 "FLR2RadrDetnMode_RngNearReslMod" 1 "FLR2RadrDetnMode_RngMidReslMod" 2 "FLR2RadrDetnMode_RngLongReslMod" 3 "FLR2RadrDetnMode_DetectionUnpopulated";
VAL_ 284 FLR2RdrDetn355To359Mode2 0 "FLR2RadrDetnMode_RngNearReslMod" 1 "FLR2RadrDetnMode_RngMidReslMod" 2 "FLR2RadrDetnMode_RngLongReslMod" 3 "FLR2RadrDetnMode_DetectionUnpopulated";
VAL_ 284 FLR2RdrDetn355To359Mode3 0 "FLR2RadrDetnMode_RngNearReslMod" 1 "FLR2RadrDetnMode_RngMidReslMod" 2 "FLR2RadrDetnMode_RngLongReslMod" 3 "FLR2RadrDetnMode_DetectionUnpopulated";
VAL_ 284 FLR2RdrDetn355To359Mode4 0 "FLR2RadrDetnMode_RngNearReslMod" 1 "FLR2RadrDetnMode_RngMidReslMod" 2 "FLR2RadrDetnMode_RngLongReslMod" 3 "FLR2RadrDetnMode_DetectionUnpopulated";
VAL_ 284 FLR2RdrDetn355To359Quality0 0 "Quality_Low" 1 "Quality_Medium" 2 "Quality_High" 3 "Quality_DetectionUnpopulated";
VAL_ 284 FLR2RdrDetn355To359Quality1 0 "Quality_Low" 1 "Quality_Medium" 2 "Quality_High" 3 "Quality_DetectionUnpopulated";
VAL_ 284 FLR2RdrDetn355To359Quality2 0 "Quality_Low" 1 "Quality_Medium" 2 "Quality_High" 3 "Quality_DetectionUnpopulated";
VAL_ 284 FLR2RdrDetn355To359Quality3 0 "Quality_Low" 1 "Quality_Medium" 2 "Quality_High" 3 "Quality_DetectionUnpopulated";
VAL_ 284 FLR2RdrDetn355To359Quality4 0 "Quality_Low" 1 "Quality_Medium" 2 "Quality_High" 3 "Quality_DetectionUnpopulated";
VAL_ 286 FLR2RdrDetn360To364Mode0 0 "FLR2RadrDetnMode_RngNearReslMod" 1 "FLR2RadrDetnMode_RngMidReslMod" 2 "FLR2RadrDetnMode_RngLongReslMod" 3 "FLR2RadrDetnMode_DetectionUnpopulated";
VAL_ 286 FLR2RdrDetn360To364Mode1 0 "FLR2RadrDetnMode_RngNearReslMod" 1 "FLR2RadrDetnMode_RngMidReslMod" 2 "FLR2RadrDetnMode_RngLongReslMod" 3 "FLR2RadrDetnMode_DetectionUnpopulated";
VAL_ 286 FLR2RdrDetn360To364Mode2 0 "FLR2RadrDetnMode_RngNearReslMod" 1 "FLR2RadrDetnMode_RngMidReslMod" 2 "FLR2RadrDetnMode_RngLongReslMod" 3 "FLR2RadrDetnMode_DetectionUnpopulated";
VAL_ 286 FLR2RdrDetn360To364Mode3 0 "FLR2RadrDetnMode_RngNearReslMod" 1 "FLR2RadrDetnMode_RngMidReslMod" 2 "FLR2RadrDetnMode_RngLongReslMod" 3 "FLR2RadrDetnMode_DetectionUnpopulated";
VAL_ 286 FLR2RdrDetn360To364Mode4 0 "FLR2RadrDetnMode_RngNearReslMod" 1 "FLR2RadrDetnMode_RngMidReslMod" 2 "FLR2RadrDetnMode_RngLongReslMod" 3 "FLR2RadrDetnMode_DetectionUnpopulated";
VAL_ 286 FLR2RdrDetn360To364Quality0 0 "Quality_Low" 1 "Quality_Medium" 2 "Quality_High" 3 "Quality_DetectionUnpopulated";
VAL_ 286 FLR2RdrDetn360To364Quality1 0 "Quality_Low" 1 "Quality_Medium" 2 "Quality_High" 3 "Quality_DetectionUnpopulated";
VAL_ 286 FLR2RdrDetn360To364Quality2 0 "Quality_Low" 1 "Quality_Medium" 2 "Quality_High" 3 "Quality_DetectionUnpopulated";
VAL_ 286 FLR2RdrDetn360To364Quality3 0 "Quality_Low" 1 "Quality_Medium" 2 "Quality_High" 3 "Quality_DetectionUnpopulated";
VAL_ 286 FLR2RdrDetn360To364Quality4 0 "Quality_Low" 1 "Quality_Medium" 2 "Quality_High" 3 "Quality_DetectionUnpopulated";
VAL_ 288 FLR2RdrDetn365To369Mode0 0 "FLR2RadrDetnMode_RngNearReslMod" 1 "FLR2RadrDetnMode_RngMidReslMod" 2 "FLR2RadrDetnMode_RngLongReslMod" 3 "FLR2RadrDetnMode_DetectionUnpopulated";
VAL_ 288 FLR2RdrDetn365To369Mode1 0 "FLR2RadrDetnMode_RngNearReslMod" 1 "FLR2RadrDetnMode_RngMidReslMod" 2 "FLR2RadrDetnMode_RngLongReslMod" 3 "FLR2RadrDetnMode_DetectionUnpopulated";
VAL_ 288 FLR2RdrDetn365To369Mode2 0 "FLR2RadrDetnMode_RngNearReslMod" 1 "FLR2RadrDetnMode_RngMidReslMod" 2 "FLR2RadrDetnMode_RngLongReslMod" 3 "FLR2RadrDetnMode_DetectionUnpopulated";
VAL_ 288 FLR2RdrDetn365To369Mode3 0 "FLR2RadrDetnMode_RngNearReslMod" 1 "FLR2RadrDetnMode_RngMidReslMod" 2 "FLR2RadrDetnMode_RngLongReslMod" 3 "FLR2RadrDetnMode_DetectionUnpopulated";
VAL_ 288 FLR2RdrDetn365To369Mode4 0 "FLR2RadrDetnMode_RngNearReslMod" 1 "FLR2RadrDetnMode_RngMidReslMod" 2 "FLR2RadrDetnMode_RngLongReslMod" 3 "FLR2RadrDetnMode_DetectionUnpopulated";
VAL_ 288 FLR2RdrDetn365To369Quality0 0 "Quality_Low" 1 "Quality_Medium" 2 "Quality_High" 3 "Quality_DetectionUnpopulated";
VAL_ 288 FLR2RdrDetn365To369Quality1 0 "Quality_Low" 1 "Quality_Medium" 2 "Quality_High" 3 "Quality_DetectionUnpopulated";
VAL_ 288 FLR2RdrDetn365To369Quality2 0 "Quality_Low" 1 "Quality_Medium" 2 "Quality_High" 3 "Quality_DetectionUnpopulated";
VAL_ 288 FLR2RdrDetn365To369Quality3 0 "Quality_Low" 1 "Quality_Medium" 2 "Quality_High" 3 "Quality_DetectionUnpopulated";
VAL_ 288 FLR2RdrDetn365To369Quality4 0 "Quality_Low" 1 "Quality_Medium" 2 "Quality_High" 3 "Quality_DetectionUnpopulated";
VAL_ 290 FLR2RdrDetn370To374Mode0 0 "FLR2RadrDetnMode_RngNearReslMod" 1 "FLR2RadrDetnMode_RngMidReslMod" 2 "FLR2RadrDetnMode_RngLongReslMod" 3 "FLR2RadrDetnMode_DetectionUnpopulated";
VAL_ 290 FLR2RdrDetn370To374Mode1 0 "FLR2RadrDetnMode_RngNearReslMod" 1 "FLR2RadrDetnMode_RngMidReslMod" 2 "FLR2RadrDetnMode_RngLongReslMod" 3 "FLR2RadrDetnMode_DetectionUnpopulated";
VAL_ 290 FLR2RdrDetn370To374Mode2 0 "FLR2RadrDetnMode_RngNearReslMod" 1 "FLR2RadrDetnMode_RngMidReslMod" 2 "FLR2RadrDetnMode_RngLongReslMod" 3 "FLR2RadrDetnMode_DetectionUnpopulated";
VAL_ 290 FLR2RdrDetn370To374Mode3 0 "FLR2RadrDetnMode_RngNearReslMod" 1 "FLR2RadrDetnMode_RngMidReslMod" 2 "FLR2RadrDetnMode_RngLongReslMod" 3 "FLR2RadrDetnMode_DetectionUnpopulated";
VAL_ 290 FLR2RdrDetn370To374Mode4 0 "FLR2RadrDetnMode_RngNearReslMod" 1 "FLR2RadrDetnMode_RngMidReslMod" 2 "FLR2RadrDetnMode_RngLongReslMod" 3 "FLR2RadrDetnMode_DetectionUnpopulated";
VAL_ 290 FLR2RdrDetn370To374Quality0 0 "Quality_Low" 1 "Quality_Medium" 2 "Quality_High" 3 "Quality_DetectionUnpopulated";
VAL_ 290 FLR2RdrDetn370To374Quality1 0 "Quality_Low" 1 "Quality_Medium" 2 "Quality_High" 3 "Quality_DetectionUnpopulated";
VAL_ 290 FLR2RdrDetn370To374Quality2 0 "Quality_Low" 1 "Quality_Medium" 2 "Quality_High" 3 "Quality_DetectionUnpopulated";
VAL_ 290 FLR2RdrDetn370To374Quality3 0 "Quality_Low" 1 "Quality_Medium" 2 "Quality_High" 3 "Quality_DetectionUnpopulated";
VAL_ 290 FLR2RdrDetn370To374Quality4 0 "Quality_Low" 1 "Quality_Medium" 2 "Quality_High" 3 "Quality_DetectionUnpopulated";
VAL_ 292 FLR2RdrDetn375To379Mode0 0 "FLR2RadrDetnMode_RngNearReslMod" 1 "FLR2RadrDetnMode_RngMidReslMod" 2 "FLR2RadrDetnMode_RngLongReslMod" 3 "FLR2RadrDetnMode_DetectionUnpopulated";
VAL_ 292 FLR2RdrDetn375To379Mode1 0 "FLR2RadrDetnMode_RngNearReslMod" 1 "FLR2RadrDetnMode_RngMidReslMod" 2 "FLR2RadrDetnMode_RngLongReslMod" 3 "FLR2RadrDetnMode_DetectionUnpopulated";
VAL_ 292 FLR2RdrDetn375To379Mode2 0 "FLR2RadrDetnMode_RngNearReslMod" 1 "FLR2RadrDetnMode_RngMidReslMod" 2 "FLR2RadrDetnMode_RngLongReslMod" 3 "FLR2RadrDetnMode_DetectionUnpopulated";
VAL_ 292 FLR2RdrDetn375To379Mode3 0 "FLR2RadrDetnMode_RngNearReslMod" 1 "FLR2RadrDetnMode_RngMidReslMod" 2 "FLR2RadrDetnMode_RngLongReslMod" 3 "FLR2RadrDetnMode_DetectionUnpopulated";
VAL_ 292 FLR2RdrDetn375To379Mode4 0 "FLR2RadrDetnMode_RngNearReslMod" 1 "FLR2RadrDetnMode_RngMidReslMod" 2 "FLR2RadrDetnMode_RngLongReslMod" 3 "FLR2RadrDetnMode_DetectionUnpopulated";
VAL_ 292 FLR2RdrDetn375To379Quality0 0 "Quality_Low" 1 "Quality_Medium" 2 "Quality_High" 3 "Quality_DetectionUnpopulated";
VAL_ 292 FLR2RdrDetn375To379Quality1 0 "Quality_Low" 1 "Quality_Medium" 2 "Quality_High" 3 "Quality_DetectionUnpopulated";
VAL_ 292 FLR2RdrDetn375To379Quality2 0 "Quality_Low" 1 "Quality_Medium" 2 "Quality_High" 3 "Quality_DetectionUnpopulated";
VAL_ 292 FLR2RdrDetn375To379Quality3 0 "Quality_Low" 1 "Quality_Medium" 2 "Quality_High" 3 "Quality_DetectionUnpopulated";
VAL_ 292 FLR2RdrDetn375To379Quality4 0 "Quality_Low" 1 "Quality_Medium" 2 "Quality_High" 3 "Quality_DetectionUnpopulated";
VAL_ 294 FLR2RdrDetn380To384Mode0 0 "FLR2RadrDetnMode_RngNearReslMod" 1 "FLR2RadrDetnMode_RngMidReslMod" 2 "FLR2RadrDetnMode_RngLongReslMod" 3 "FLR2RadrDetnMode_DetectionUnpopulated";
VAL_ 294 FLR2RdrDetn380To384Mode1 0 "FLR2RadrDetnMode_RngNearReslMod" 1 "FLR2RadrDetnMode_RngMidReslMod" 2 "FLR2RadrDetnMode_RngLongReslMod" 3 "FLR2RadrDetnMode_DetectionUnpopulated";
VAL_ 294 FLR2RdrDetn380To384Mode2 0 "FLR2RadrDetnMode_RngNearReslMod" 1 "FLR2RadrDetnMode_RngMidReslMod" 2 "FLR2RadrDetnMode_RngLongReslMod" 3 "FLR2RadrDetnMode_DetectionUnpopulated";
VAL_ 294 FLR2RdrDetn380To384Mode3 0 "FLR2RadrDetnMode_RngNearReslMod" 1 "FLR2RadrDetnMode_RngMidReslMod" 2 "FLR2RadrDetnMode_RngLongReslMod" 3 "FLR2RadrDetnMode_DetectionUnpopulated";
VAL_ 294 FLR2RdrDetn380To384Mode4 0 "FLR2RadrDetnMode_RngNearReslMod" 1 "FLR2RadrDetnMode_RngMidReslMod" 2 "FLR2RadrDetnMode_RngLongReslMod" 3 "FLR2RadrDetnMode_DetectionUnpopulated";
VAL_ 294 FLR2RdrDetn380To384Quality0 0 "Quality_Low" 1 "Quality_Medium" 2 "Quality_High" 3 "Quality_DetectionUnpopulated";
VAL_ 294 FLR2RdrDetn380To384Quality1 0 "Quality_Low" 1 "Quality_Medium" 2 "Quality_High" 3 "Quality_DetectionUnpopulated";
VAL_ 294 FLR2RdrDetn380To384Quality2 0 "Quality_Low" 1 "Quality_Medium" 2 "Quality_High" 3 "Quality_DetectionUnpopulated";
VAL_ 294 FLR2RdrDetn380To384Quality3 0 "Quality_Low" 1 "Quality_Medium" 2 "Quality_High" 3 "Quality_DetectionUnpopulated";
VAL_ 294 FLR2RdrDetn380To384Quality4 0 "Quality_Low" 1 "Quality_Medium" 2 "Quality_High" 3 "Quality_DetectionUnpopulated";
VAL_ 296 FLR2RdrDetn385To389Mode0 0 "FLR2RadrDetnMode_RngNearReslMod" 1 "FLR2RadrDetnMode_RngMidReslMod" 2 "FLR2RadrDetnMode_RngLongReslMod" 3 "FLR2RadrDetnMode_DetectionUnpopulated";
VAL_ 296 FLR2RdrDetn385To389Mode1 0 "FLR2RadrDetnMode_RngNearReslMod" 1 "FLR2RadrDetnMode_RngMidReslMod" 2 "FLR2RadrDetnMode_RngLongReslMod" 3 "FLR2RadrDetnMode_DetectionUnpopulated";
VAL_ 296 FLR2RdrDetn385To389Mode2 0 "FLR2RadrDetnMode_RngNearReslMod" 1 "FLR2RadrDetnMode_RngMidReslMod" 2 "FLR2RadrDetnMode_RngLongReslMod" 3 "FLR2RadrDetnMode_DetectionUnpopulated";
VAL_ 296 FLR2RdrDetn385To389Mode3 0 "FLR2RadrDetnMode_RngNearReslMod" 1 "FLR2RadrDetnMode_RngMidReslMod" 2 "FLR2RadrDetnMode_RngLongReslMod" 3 "FLR2RadrDetnMode_DetectionUnpopulated";
VAL_ 296 FLR2RdrDetn385To389Mode4 0 "FLR2RadrDetnMode_RngNearReslMod" 1 "FLR2RadrDetnMode_RngMidReslMod" 2 "FLR2RadrDetnMode_RngLongReslMod" 3 "FLR2RadrDetnMode_DetectionUnpopulated";
VAL_ 296 FLR2RdrDetn385To389Quality0 0 "Quality_Low" 1 "Quality_Medium" 2 "Quality_High" 3 "Quality_DetectionUnpopulated";
VAL_ 296 FLR2RdrDetn385To389Quality1 0 "Quality_Low" 1 "Quality_Medium" 2 "Quality_High" 3 "Quality_DetectionUnpopulated";
VAL_ 296 FLR2RdrDetn385To389Quality2 0 "Quality_Low" 1 "Quality_Medium" 2 "Quality_High" 3 "Quality_DetectionUnpopulated";
VAL_ 296 FLR2RdrDetn385To389Quality3 0 "Quality_Low" 1 "Quality_Medium" 2 "Quality_High" 3 "Quality_DetectionUnpopulated";
VAL_ 296 FLR2RdrDetn385To389Quality4 0 "Quality_Low" 1 "Quality_Medium" 2 "Quality_High" 3 "Quality_DetectionUnpopulated";
VAL_ 298 FLR2RdrDetn390To394Mode0 0 "FLR2RadrDetnMode_RngNearReslMod" 1 "FLR2RadrDetnMode_RngMidReslMod" 2 "FLR2RadrDetnMode_RngLongReslMod" 3 "FLR2RadrDetnMode_DetectionUnpopulated";
VAL_ 298 FLR2RdrDetn390To394Mode1 0 "FLR2RadrDetnMode_RngNearReslMod" 1 "FLR2RadrDetnMode_RngMidReslMod" 2 "FLR2RadrDetnMode_RngLongReslMod" 3 "FLR2RadrDetnMode_DetectionUnpopulated";
VAL_ 298 FLR2RdrDetn390To394Mode2 0 "FLR2RadrDetnMode_RngNearReslMod" 1 "FLR2RadrDetnMode_RngMidReslMod" 2 "FLR2RadrDetnMode_RngLongReslMod" 3 "FLR2RadrDetnMode_DetectionUnpopulated";
VAL_ 298 FLR2RdrDetn390To394Mode3 0 "FLR2RadrDetnMode_RngNearReslMod" 1 "FLR2RadrDetnMode_RngMidReslMod" 2 "FLR2RadrDetnMode_RngLongReslMod" 3 "FLR2RadrDetnMode_DetectionUnpopulated";
VAL_ 298 FLR2RdrDetn390To394Mode4 0 "FLR2RadrDetnMode_RngNearReslMod" 1 "FLR2RadrDetnMode_RngMidReslMod" 2 "FLR2RadrDetnMode_RngLongReslMod" 3 "FLR2RadrDetnMode_DetectionUnpopulated";
VAL_ 298 FLR2RdrDetn390To394Quality0 0 "Quality_Low" 1 "Quality_Medium" 2 "Quality_High" 3 "Quality_DetectionUnpopulated";
VAL_ 298 FLR2RdrDetn390To394Quality1 0 "Quality_Low" 1 "Quality_Medium" 2 "Quality_High" 3 "Quality_DetectionUnpopulated";
VAL_ 298 FLR2RdrDetn390To394Quality2 0 "Quality_Low" 1 "Quality_Medium" 2 "Quality_High" 3 "Quality_DetectionUnpopulated";
VAL_ 298 FLR2RdrDetn390To394Quality3 0 "Quality_Low" 1 "Quality_Medium" 2 "Quality_High" 3 "Quality_DetectionUnpopulated";
VAL_ 298 FLR2RdrDetn390To394Quality4 0 "Quality_Low" 1 "Quality_Medium" 2 "Quality_High" 3 "Quality_DetectionUnpopulated";
VAL_ 300 FLR2RdrDetn395To399Mode0 0 "FLR2RadrDetnMode_RngNearReslMod" 1 "FLR2RadrDetnMode_RngMidReslMod" 2 "FLR2RadrDetnMode_RngLongReslMod" 3 "FLR2RadrDetnMode_DetectionUnpopulated";
VAL_ 300 FLR2RdrDetn395To399Mode1 0 "FLR2RadrDetnMode_RngNearReslMod" 1 "FLR2RadrDetnMode_RngMidReslMod" 2 "FLR2RadrDetnMode_RngLongReslMod" 3 "FLR2RadrDetnMode_DetectionUnpopulated";
VAL_ 300 FLR2RdrDetn395To399Mode2 0 "FLR2RadrDetnMode_RngNearReslMod" 1 "FLR2RadrDetnMode_RngMidReslMod" 2 "FLR2RadrDetnMode_RngLongReslMod" 3 "FLR2RadrDetnMode_DetectionUnpopulated";
VAL_ 300 FLR2RdrDetn395To399Mode3 0 "FLR2RadrDetnMode_RngNearReslMod" 1 "FLR2RadrDetnMode_RngMidReslMod" 2 "FLR2RadrDetnMode_RngLongReslMod" 3 "FLR2RadrDetnMode_DetectionUnpopulated";
VAL_ 300 FLR2RdrDetn395To399Mode4 0 "FLR2RadrDetnMode_RngNearReslMod" 1 "FLR2RadrDetnMode_RngMidReslMod" 2 "FLR2RadrDetnMode_RngLongReslMod" 3 "FLR2RadrDetnMode_DetectionUnpopulated";
VAL_ 300 FLR2RdrDetn395To399Quality0 0 "Quality_Low" 1 "Quality_Medium" 2 "Quality_High" 3 "Quality_DetectionUnpopulated";
VAL_ 300 FLR2RdrDetn395To399Quality1 0 "Quality_Low" 1 "Quality_Medium" 2 "Quality_High" 3 "Quality_DetectionUnpopulated";
VAL_ 300 FLR2RdrDetn395To399Quality2 0 "Quality_Low" 1 "Quality_Medium" 2 "Quality_High" 3 "Quality_DetectionUnpopulated";
VAL_ 300 FLR2RdrDetn395To399Quality3 0 "Quality_Low" 1 "Quality_Medium" 2 "Quality_High" 3 "Quality_DetectionUnpopulated";
VAL_ 300 FLR2RdrDetn395To399Quality4 0 "Quality_Low" 1 "Quality_Medium" 2 "Quality_High" 3 "Quality_DetectionUnpopulated";
VAL_ 320 FLR2RdrObject0To1Class0 0 "FLR2ObjectClassification2_Unknown" 1 "FLR2ObjectClassification2_MotVeh" 2 "FLR2ObjectClassification2_Bicycle" 3 "FLR2ObjectClassification2_Ped";
VAL_ 320 FLR2RdrObject0To1Class1 0 "FLR2ObjectClassification2_Unknown" 1 "FLR2ObjectClassification2_MotVeh" 2 "FLR2ObjectClassification2_Bicycle" 3 "FLR2ObjectClassification2_Ped";
VAL_ 320 FLR2RdrObject0To1DataCoastCntr0 0 "FLR2ObjDataCoastingCntr_DeletedMaintainanceState" 1 "FLR2ObjDataCoastingCntr_NewMaintainanceState" 2 "FLR2ObjDataCoastingCntr_MeasuredMaintainanceState" 3 "FLR2ObjDataCoastingCntr_PredictedMaintainanceState";
VAL_ 320 FLR2RdrObject0To1DataCoastCntr1 0 "FLR2ObjDataCoastingCntr_DeletedMaintainanceState" 1 "FLR2ObjDataCoastingCntr_NewMaintainanceState" 2 "FLR2ObjDataCoastingCntr_MeasuredMaintainanceState" 3 "FLR2ObjDataCoastingCntr_PredictedMaintainanceState";
VAL_ 320 FLR2RdrObject0To1ModeInfo0 0 "FLR2Modeinfo_RngNearResl" 1 "FLR2Modeinfo_RngMidReslMod" 2 "FLR2Modeinfo_RngLongReslMod";
VAL_ 320 FLR2RdrObject0To1ModeInfo1 0 "FLR2Modeinfo_RngNearResl" 1 "FLR2Modeinfo_RngMidReslMod" 2 "FLR2Modeinfo_RngLongReslMod";
VAL_ 320 FLR2RdrObject0To1MtnPattern0 0 "FLR2MotionPattern_Movg" 1 "FLR2MotionPattern_Staty" 2 "FLR2MotionPattern_OnCmgn" 3 "FLR2MotionPattern_MovgLeToRi" 4 "FLR2MotionPattern_MovgRiToLe" 5 "FLR2MotionPattern_UkwnToRadarSnsr" 6 "FLR2MotionPattern_Stop" 7 "FLR2MotionPattern_StopNotSafe";
VAL_ 320 FLR2RdrObject0To1MtnPattern1 0 "FLR2MotionPattern_Movg" 1 "FLR2MotionPattern_Staty" 2 "FLR2MotionPattern_OnCmgn" 3 "FLR2MotionPattern_MovgLeToRi" 4 "FLR2MotionPattern_MovgRiToLe" 5 "FLR2MotionPattern_UkwnToRadarSnsr" 6 "FLR2MotionPattern_Stop" 7 "FLR2MotionPattern_StopNotSafe";
VAL_ 322 FLR2RdrObject2To3Class0 0 "FLR2ObjectClassification2_Unknown" 1 "FLR2ObjectClassification2_MotVeh" 2 "FLR2ObjectClassification2_Bicycle" 3 "FLR2ObjectClassification2_Ped";
VAL_ 322 FLR2RdrObject2To3Class1 0 "FLR2ObjectClassification2_Unknown" 1 "FLR2ObjectClassification2_MotVeh" 2 "FLR2ObjectClassification2_Bicycle" 3 "FLR2ObjectClassification2_Ped";
VAL_ 322 FLR2RdrObject2To3DataCoastCntr0 0 "FLR2ObjDataCoastingCntr_DeletedMaintainanceState" 1 "FLR2ObjDataCoastingCntr_NewMaintainanceState" 2 "FLR2ObjDataCoastingCntr_MeasuredMaintainanceState" 3 "FLR2ObjDataCoastingCntr_PredictedMaintainanceState";
VAL_ 322 FLR2RdrObject2To3DataCoastCntr1 0 "FLR2ObjDataCoastingCntr_DeletedMaintainanceState" 1 "FLR2ObjDataCoastingCntr_NewMaintainanceState" 2 "FLR2ObjDataCoastingCntr_MeasuredMaintainanceState" 3 "FLR2ObjDataCoastingCntr_PredictedMaintainanceState";
VAL_ 322 FLR2RdrObject2To3ModeInfo0 0 "FLR2Modeinfo_RngNearResl" 1 "FLR2Modeinfo_RngMidReslMod" 2 "FLR2Modeinfo_RngLongReslMod";
VAL_ 322 FLR2RdrObject2To3ModeInfo1 0 "FLR2Modeinfo_RngNearResl" 1 "FLR2Modeinfo_RngMidReslMod" 2 "FLR2Modeinfo_RngLongReslMod";
VAL_ 322 FLR2RdrObject2To3MtnPattern0 0 "FLR2MotionPattern_Movg" 1 "FLR2MotionPattern_Staty" 2 "FLR2MotionPattern_OnCmgn" 3 "FLR2MotionPattern_MovgLeToRi" 4 "FLR2MotionPattern_MovgRiToLe" 5 "FLR2MotionPattern_UkwnToRadarSnsr" 6 "FLR2MotionPattern_Stop" 7 "FLR2MotionPattern_StopNotSafe";
VAL_ 322 FLR2RdrObject2To3MtnPattern1 0 "FLR2MotionPattern_Movg" 1 "FLR2MotionPattern_Staty" 2 "FLR2MotionPattern_OnCmgn" 3 "FLR2MotionPattern_MovgLeToRi" 4 "FLR2MotionPattern_MovgRiToLe" 5 "FLR2MotionPattern_UkwnToRadarSnsr" 6 "FLR2MotionPattern_Stop" 7 "FLR2MotionPattern_StopNotSafe";
SIG_GROUP_ 278 FLR2RdrDetn340To344 1 : FLR2RdrDetn340To344AziAng0 FLR2RdrDetn340To344AziAng1 FLR2RdrDetn340To344AziAng2 FLR2RdrDetn340To344AziAng3 FLR2RdrDetn340To344AziAng4 FLR2RdrDetn340To344Counter FLR2RdrDetn340To344CRC FLR2RdrDetn340To344DynPrpty0 FLR2RdrDetn340To344DynPrpty1 FLR2RdrDetn340To344DynPrpty2 FLR2RdrDetn340To344DynPrpty3 FLR2RdrDetn340To344DynPrpty4 FLR2RdrDetn340To344EleAng0 FLR2RdrDetn340To344EleAng1 FLR2RdrDetn340To344EleAng2 FLR2RdrDetn340To344EleAng3 FLR2RdrDetn340To344EleAng4 FLR2RdrDetn340To344Mode0 FLR2RdrDetn340To344Mode1 FLR2RdrDetn340To344Mode2 FLR2RdrDetn340To344Mode3 FLR2RdrDetn340To344Mode4 FLR2RdrDetn340To344Quality0 FLR2RdrDetn340To344Quality1 FLR2RdrDetn340To344Quality2 FLR2RdrDetn340To344Quality3 FLR2RdrDetn340To344Quality4 FLR2RdrDetn340To344Range0 FLR2RdrDetn340To344Range1 FLR2RdrDetn340To344Range2 FLR2RdrDetn340To344Range3 FLR2RdrDetn340To344Range4 FLR2RdrDetn340To344RCS0 FLR2RdrDetn340To344RCS1 FLR2RdrDetn340To344RCS2 FLR2RdrDetn340To344RCS3 FLR2RdrDetn340To344RCS4 FLR2RdrDetn340To344RngRt0 FLR2RdrDetn340To344RngRt1 FLR2RdrDetn340To344RngRt2 FLR2RdrDetn340To344RngRt3 FLR2RdrDetn340To344RngRt4 FLR2RdrDetn340To344ScanID FLR2RdrDetn340To344SNR0 FLR2RdrDetn340To344SNR1 FLR2RdrDetn340To344SNR2 FLR2RdrDetn340To344SNR3 FLR2RdrDetn340To344SNR4;
SIG_GROUP_ 280 FLR2RdrDetn345To349 1 : FLR2RdrDetn345To349AziAng0 FLR2RdrDetn345To349AziAng1 FLR2RdrDetn345To349AziAng2 FLR2RdrDetn345To349AziAng3 FLR2RdrDetn345To349AziAng4 FLR2RdrDetn345To349Counter FLR2RdrDetn345To349CRC FLR2RdrDetn345To349DynPrpty0 FLR2RdrDetn345To349DynPrpty1 FLR2RdrDetn345To349DynPrpty2 FLR2RdrDetn345To349DynPrpty3 FLR2RdrDetn345To349DynPrpty4 FLR2RdrDetn345To349EleAng0 FLR2RdrDetn345To349EleAng1 FLR2RdrDetn345To349EleAng2 FLR2RdrDetn345To349EleAng3 FLR2RdrDetn345To349EleAng4 FLR2RdrDetn345To349Mode0 FLR2RdrDetn345To349Mode1 FLR2RdrDetn345To349Mode2 FLR2RdrDetn345To349Mode3 FLR2RdrDetn345To349Mode4 FLR2RdrDetn345To349Quality0 FLR2RdrDetn345To349Quality1 FLR2RdrDetn345To349Quality2 FLR2RdrDetn345To349Quality3 FLR2RdrDetn345To349Quality4 FLR2RdrDetn345To349Range0 FLR2RdrDetn345To349Range1 FLR2RdrDetn345To349Range2 FLR2RdrDetn345To349Range3 FLR2RdrDetn345To349Range4 FLR2RdrDetn345To349RCS0 FLR2RdrDetn345To349RCS1 FLR2RdrDetn345To349RCS2 FLR2RdrDetn345To349RCS3 FLR2RdrDetn345To349RCS4 FLR2RdrDetn345To349RngRt0 FLR2RdrDetn345To349RngRt1 FLR2RdrDetn345To349RngRt2 FLR2RdrDetn345To349RngRt3 FLR2RdrDetn345To349RngRt4 FLR2RdrDetn345To349ScanID FLR2RdrDetn345To349SNR0 FLR2RdrDetn345To349SNR1 FLR2RdrDetn345To349SNR2 FLR2RdrDetn345To349SNR3 FLR2RdrDetn345To349SNR4;
SIG_GROUP_ 282 FLR2RdrDetn350To354 1 : FLR2RdrDetn350To354AziAng0 FLR2RdrDetn350To354AziAng1 FLR2RdrDetn350To354AziAng2 FLR2RdrDetn350To354AziAng3 FLR2RdrDetn350To354AziAng4 FLR2RdrDetn350To354Counter FLR2RdrDetn350To354CRC FLR2RdrDetn350To354DynPrpty0 FLR2RdrDetn350To354DynPrpty1 FLR2RdrDetn350To354DynPrpty2 FLR2RdrDetn350To354DynPrpty3 FLR2RdrDetn350To354DynPrpty4 FLR2RdrDetn350To354EleAng0 FLR2RdrDetn350To354EleAng1 FLR2RdrDetn350To354EleAng2 FLR2RdrDetn350To354EleAng3 FLR2RdrDetn350To354EleAng4 FLR2RdrDetn350To354Mode0 FLR2RdrDetn350To354Mode1 FLR2RdrDetn350To354Mode2 FLR2RdrDetn350To354Mode3 FLR2RdrDetn350To354Mode4 FLR2RdrDetn350To354Quality0 FLR2RdrDetn350To354Quality1 FLR2RdrDetn350To354Quality2 FLR2RdrDetn350To354Quality3 FLR2RdrDetn350To354Quality4 FLR2RdrDetn350To354Range0 FLR2RdrDetn350To354Range1 FLR2RdrDetn350To354Range2 FLR2RdrDetn350To354Range3 FLR2RdrDetn350To354Range4 FLR2RdrDetn350To354RCS0 FLR2RdrDetn350To354RCS1 FLR2RdrDetn350To354RCS2 FLR2RdrDetn350To354RCS3 FLR2RdrDetn350To354RCS4 FLR2RdrDetn350To354RngRt0 FLR2RdrDetn350To354RngRt1 FLR2RdrDetn350To354RngRt2 FLR2RdrDetn350To354RngRt3 FLR2RdrDetn350To354RngRt4 FLR2RdrDetn350To354ScanID FLR2RdrDetn350To354SNR0 FLR2RdrDetn350To354SNR1 FLR2RdrDetn350To354SNR2 FLR2RdrDetn350To354SNR3 FLR2RdrDetn350To354SNR4;
SIG_GROUP_ 284 FLR2RdrDetn355To359 1 : FLR2RdrDetn355To359AziAng0 FLR2RdrDetn355To359AziAng1 FLR2RdrDetn355To359AziAng2 FLR2RdrDetn355To359AziAng3 FLR2RdrDetn355To359AziAng4 FLR2RdrDetn355To359Counter FLR2RdrDetn355To359CRC FLR2RdrDetn355To359DynPrpty0 FLR2RdrDetn355To359DynPrpty1 FLR2RdrDetn355To359DynPrpty2 FLR2RdrDetn355To359DynPrpty3 FLR2RdrDetn355To359DynPrpty4 FLR2RdrDetn355To359EleAng0 FLR2RdrDetn355To359EleAng1 FLR2RdrDetn355To359EleAng2 FLR2RdrDetn355To359EleAng3 FLR2RdrDetn355To359EleAng4 FLR2RdrDetn355To359Mode0 FLR2RdrDetn355To359Mode1 FLR2RdrDetn355To359Mode2 FLR2RdrDetn355To359Mode3 FLR2RdrDetn355To359Mode4 FLR2RdrDetn355To359Quality0 FLR2RdrDetn355To359Quality1 FLR2RdrDetn355To359Quality2 FLR2RdrDetn355To359Quality3 FLR2RdrDetn355To359Quality4 FLR2RdrDetn355To359Range0 FLR2RdrDetn355To359Range1 FLR2RdrDetn355To359Range2 FLR2RdrDetn355To359Range3 FLR2RdrDetn355To359Range4 FLR2RdrDetn355To359RCS0 FLR2RdrDetn355To359RCS1 FLR2RdrDetn355To359RCS2 FLR2RdrDetn355To359RCS3 FLR2RdrDetn355To359RCS4 FLR2RdrDetn355To359RngRt0 FLR2RdrDetn355To359RngRt1 FLR2RdrDetn355To359RngRt2 FLR2RdrDetn355To359RngRt3 FLR2RdrDetn355To359RngRt4 FLR2RdrDetn355To359ScanID FLR2RdrDetn355To359SNR0 FLR2RdrDetn355To359SNR1 FLR2RdrDetn355To359SNR2 FLR2RdrDetn355To359SNR3 FLR2RdrDetn355To359SNR4;
SIG_GROUP_ 286 FLR2RdrDetn360To364 1 : FLR2RdrDetn360To364AziAng0 FLR2RdrDetn360To364AziAng1 FLR2RdrDetn360To364AziAng2 FLR2RdrDetn360To364AziAng3 FLR2RdrDetn360To364AziAng4 FLR2RdrDetn360To364Counter FLR2RdrDetn360To364CRC FLR2RdrDetn360To364DynPrpty0 FLR2RdrDetn360To364DynPrpty1 FLR2RdrDetn360To364DynPrpty2 FLR2RdrDetn360To364DynPrpty3 FLR2RdrDetn360To364DynPrpty4 FLR2RdrDetn360To364EleAng0 FLR2RdrDetn360To364EleAng1 FLR2RdrDetn360To364EleAng2 FLR2RdrDetn360To364EleAng3 FLR2RdrDetn360To364EleAng4 FLR2RdrDetn360To364Mode0 FLR2RdrDetn360To364Mode1 FLR2RdrDetn360To364Mode2 FLR2RdrDetn360To364Mode3 FLR2RdrDetn360To364Mode4 FLR2RdrDetn360To364Quality0 FLR2RdrDetn360To364Quality1 FLR2RdrDetn360To364Quality2 FLR2RdrDetn360To364Quality3 FLR2RdrDetn360To364Quality4 FLR2RdrDetn360To364Range0 FLR2RdrDetn360To364Range1 FLR2RdrDetn360To364Range2 FLR2RdrDetn360To364Range3 FLR2RdrDetn360To364Range4 FLR2RdrDetn360To364RCS0 FLR2RdrDetn360To364RCS1 FLR2RdrDetn360To364RCS2 FLR2RdrDetn360To364RCS3 FLR2RdrDetn360To364RCS4 FLR2RdrDetn360To364RngRt0 FLR2RdrDetn360To364RngRt1 FLR2RdrDetn360To364RngRt2 FLR2RdrDetn360To364RngRt3 FLR2RdrDetn360To364RngRt4 FLR2RdrDetn360To364ScanID FLR2RdrDetn360To364SNR0 FLR2RdrDetn360To364SNR1 FLR2RdrDetn360To364SNR2 FLR2RdrDetn360To364SNR3 FLR2RdrDetn360To364SNR4;
SIG_GROUP_ 288 FLR2RdrDetn365To369 1 : FLR2RdrDetn365To369AziAng0 FLR2RdrDetn365To369AziAng1 FLR2RdrDetn365To369AziAng2 FLR2RdrDetn365To369AziAng3 FLR2RdrDetn365To369AziAng4 FLR2RdrDetn365To369Counter FLR2RdrDetn365To369CRC FLR2RdrDetn365To369DynPrpty0 FLR2RdrDetn365To369DynPrpty1 FLR2RdrDetn365To369DynPrpty2 FLR2RdrDetn365To369DynPrpty3 FLR2RdrDetn365To369DynPrpty4 FLR2RdrDetn365To369EleAng0 FLR2RdrDetn365To369EleAng1 FLR2RdrDetn365To369EleAng2 FLR2RdrDetn365To369EleAng3 FLR2RdrDetn365To369EleAng4 FLR2RdrDetn365To369Mode0 FLR2RdrDetn365To369Mode1 FLR2RdrDetn365To369Mode2 FLR2RdrDetn365To369Mode3 FLR2RdrDetn365To369Mode4 FLR2RdrDetn365To369Quality0 FLR2RdrDetn365To369Quality1 FLR2RdrDetn365To369Quality2 FLR2RdrDetn365To369Quality3 FLR2RdrDetn365To369Quality4 FLR2RdrDetn365To369Range0 FLR2RdrDetn365To369Range1 FLR2RdrDetn365To369Range2 FLR2RdrDetn365To369Range3 FLR2RdrDetn365To369Range4 FLR2RdrDetn365To369RCS0 FLR2RdrDetn365To369RCS1 FLR2RdrDetn365To369RCS2 FLR2RdrDetn365To369RCS3 FLR2RdrDetn365To369RCS4 FLR2RdrDetn365To369RngRt0 FLR2RdrDetn365To369RngRt1 FLR2RdrDetn365To369RngRt2 FLR2RdrDetn365To369RngRt3 FLR2RdrDetn365To369RngRt4 FLR2RdrDetn365To369ScanID FLR2RdrDetn365To369SNR0 FLR2RdrDetn365To369SNR1 FLR2RdrDetn365To369SNR2 FLR2RdrDetn365To369SNR3 FLR2RdrDetn365To369SNR4;
SIG_GROUP_ 290 FLR2RdrDetn370To374 1 : FLR2RdrDetn370To374AziAng0 FLR2RdrDetn370To374AziAng1 FLR2RdrDetn370To374AziAng2 FLR2RdrDetn370To374AziAng3 FLR2RdrDetn370To374AziAng4 FLR2RdrDetn370To374Counter FLR2RdrDetn370To374CRC FLR2RdrDetn370To374DynPrpty0 FLR2RdrDetn370To374DynPrpty1 FLR2RdrDetn370To374DynPrpty2 FLR2RdrDetn370To374DynPrpty3 FLR2RdrDetn370To374DynPrpty4 FLR2RdrDetn370To374EleAng0 FLR2RdrDetn370To374EleAng1 FLR2RdrDetn370To374EleAng2 FLR2RdrDetn370To374EleAng3 FLR2RdrDetn370To374EleAng4 FLR2RdrDetn370To374Mode0 FLR2RdrDetn370To374Mode1 FLR2RdrDetn370To374Mode2 FLR2RdrDetn370To374Mode3 FLR2RdrDetn370To374Mode4 FLR2RdrDetn370To374Quality0 FLR2RdrDetn370To374Quality1 FLR2RdrDetn370To374Quality2 FLR2RdrDetn370To374Quality3 FLR2RdrDetn370To374Quality4 FLR2RdrDetn370To374Range0 FLR2RdrDetn370To374Range1 FLR2RdrDetn370To374Range2 FLR2RdrDetn370To374Range3 FLR2RdrDetn370To374Range4 FLR2RdrDetn370To374RCS0 FLR2RdrDetn370To374RCS1 FLR2RdrDetn370To374RCS2 FLR2RdrDetn370To374RCS3 FLR2RdrDetn370To374RCS4 FLR2RdrDetn370To374RngRt0 FLR2RdrDetn370To374RngRt1 FLR2RdrDetn370To374RngRt2 FLR2RdrDetn370To374RngRt3 FLR2RdrDetn370To374RngRt4 FLR2RdrDetn370To374ScanID FLR2RdrDetn370To374SNR0 FLR2RdrDetn370To374SNR1 FLR2RdrDetn370To374SNR2 FLR2RdrDetn370To374SNR3 FLR2RdrDetn370To374SNR4;
SIG_GROUP_ 292 FLR2RdrDetn375To379 1 : FLR2RdrDetn375To379AziAng0 FLR2RdrDetn375To379AziAng1 FLR2RdrDetn375To379AziAng2 FLR2RdrDetn375To379AziAng3 FLR2RdrDetn375To379AziAng4 FLR2RdrDetn375To379Counter FLR2RdrDetn375To379CRC FLR2RdrDetn375To379DynPrpty0 FLR2RdrDetn375To379DynPrpty1 FLR2RdrDetn375To379DynPrpty2 FLR2RdrDetn375To379DynPrpty3 FLR2RdrDetn375To379DynPrpty4 FLR2RdrDetn375To379EleAng0 FLR2RdrDetn375To379EleAng1 FLR2RdrDetn375To379EleAng2 FLR2RdrDetn375To379EleAng3 FLR2RdrDetn375To379EleAng4 FLR2RdrDetn375To379Mode0 FLR2RdrDetn375To379Mode1 FLR2RdrDetn375To379Mode2 FLR2RdrDetn375To379Mode3 FLR2RdrDetn375To379Mode4 FLR2RdrDetn375To379Quality0 FLR2RdrDetn375To379Quality1 FLR2RdrDetn375To379Quality2 FLR2RdrDetn375To379Quality3 FLR2RdrDetn375To379Quality4 FLR2RdrDetn375To379Range0 FLR2RdrDetn375To379Range1 FLR2RdrDetn375To379Range2 FLR2RdrDetn375To379Range3 FLR2RdrDetn375To379Range4 FLR2RdrDetn375To379RCS0 FLR2RdrDetn375To379RCS1 FLR2RdrDetn375To379RCS2 FLR2RdrDetn375To379RCS3 FLR2RdrDetn375To379RCS4 FLR2RdrDetn375To379RngRt0 FLR2RdrDetn375To379RngRt1 FLR2RdrDetn375To379RngRt2 FLR2RdrDetn375To379RngRt3 FLR2RdrDetn375To379RngRt4 FLR2RdrDetn375To379ScanID FLR2RdrDetn375To379SNR0 FLR2RdrDetn375To379SNR1 FLR2RdrDetn375To379SNR2 FLR2RdrDetn375To379SNR3 FLR2RdrDetn375To379SNR4;
SIG_GROUP_ 294 FLR2RdrDetn380To384 1 : FLR2RdrDetn380To384AziAng0 FLR2RdrDetn380To384AziAng1 FLR2RdrDetn380To384AziAng2 FLR2RdrDetn380To384AziAng3 FLR2RdrDetn380To384AziAng4 FLR2RdrDetn380To384Counter FLR2RdrDetn380To384CRC FLR2RdrDetn380To384DynPrpty0 FLR2RdrDetn380To384DynPrpty1 FLR2RdrDetn380To384DynPrpty2 FLR2RdrDetn380To384DynPrpty3 FLR2RdrDetn380To384DynPrpty4 FLR2RdrDetn380To384EleAng0 FLR2RdrDetn380To384EleAng1 FLR2RdrDetn380To384EleAng2 FLR2RdrDetn380To384EleAng3 FLR2RdrDetn380To384EleAng4 FLR2RdrDetn380To384Mode0 FLR2RdrDetn380To384Mode1 FLR2RdrDetn380To384Mode2 FLR2RdrDetn380To384Mode3 FLR2RdrDetn380To384Mode4 FLR2RdrDetn380To384Quality0 FLR2RdrDetn380To384Quality1 FLR2RdrDetn380To384Quality2 FLR2RdrDetn380To384Quality3 FLR2RdrDetn380To384Quality4 FLR2RdrDetn380To384Range0 FLR2RdrDetn380To384Range1 FLR2RdrDetn380To384Range2 FLR2RdrDetn380To384Range3 FLR2RdrDetn380To384Range4 FLR2RdrDetn380To384RCS0 FLR2RdrDetn380To384RCS1 FLR2RdrDetn380To384RCS2 FLR2RdrDetn380To384RCS3 FLR2RdrDetn380To384RCS4 FLR2RdrDetn380To384RngRt0 FLR2RdrDetn380To384RngRt1 FLR2RdrDetn380To384RngRt2 FLR2RdrDetn380To384RngRt3 FLR2RdrDetn380To384RngRt4 FLR2RdrDetn380To384ScanID FLR2RdrDetn380To384SNR0 FLR2RdrDetn380To384SNR1 FLR2RdrDetn380To384SNR2 FLR2RdrDetn380To384SNR3 FLR2RdrDetn380To384SNR4;
SIG_GROUP_ 296 FLR2RdrDetn385To389 1 : FLR2RdrDetn385To389AziAng0 FLR2RdrDetn385To389AziAng1 FLR2RdrDetn385To389AziAng2 FLR2RdrDetn385To389AziAng3 FLR2RdrDetn385To389AziAng4 FLR2RdrDetn385To389Counter FLR2RdrDetn385To389CRC FLR2RdrDetn385To389DynPrpty0 FLR2RdrDetn385To389DynPrpty1 FLR2RdrDetn385To389DynPrpty2 FLR2RdrDetn385To389DynPrpty3 FLR2RdrDetn385To389DynPrpty4 FLR2RdrDetn385To389EleAng0 FLR2RdrDetn385To389EleAng1 FLR2RdrDetn385To389EleAng2 FLR2RdrDetn385To389EleAng3 FLR2RdrDetn385To389EleAng4 FLR2RdrDetn385To389Mode0 FLR2RdrDetn385To389Mode1 FLR2RdrDetn385To389Mode2 FLR2RdrDetn385To389Mode3 FLR2RdrDetn385To389Mode4 FLR2RdrDetn385To389Quality0 FLR2RdrDetn385To389Quality1 FLR2RdrDetn385To389Quality2 FLR2RdrDetn385To389Quality3 FLR2RdrDetn385To389Quality4 FLR2RdrDetn385To389Range0 FLR2RdrDetn385To389Range1 FLR2RdrDetn385To389Range2 FLR2RdrDetn385To389Range3 FLR2RdrDetn385To389Range4 FLR2RdrDetn385To389RCS0 FLR2RdrDetn385To389RCS1 FLR2RdrDetn385To389RCS2 FLR2RdrDetn385To389RCS3 FLR2RdrDetn385To389RCS4 FLR2RdrDetn385To389RngRt0 FLR2RdrDetn385To389RngRt1 FLR2RdrDetn385To389RngRt2 FLR2RdrDetn385To389RngRt3 FLR2RdrDetn385To389RngRt4 FLR2RdrDetn385To389ScanID FLR2RdrDetn385To389SNR0 FLR2RdrDetn385To389SNR1 FLR2RdrDetn385To389SNR2 FLR2RdrDetn385To389SNR3 FLR2RdrDetn385To389SNR4;
SIG_GROUP_ 298 FLR2RdrDetn390To394 1 : FLR2RdrDetn390To394AziAng0 FLR2RdrDetn390To394AziAng1 FLR2RdrDetn390To394AziAng2 FLR2RdrDetn390To394AziAng3 FLR2RdrDetn390To394AziAng4 FLR2RdrDetn390To394Counter FLR2RdrDetn390To394CRC FLR2RdrDetn390To394DynPrpty0 FLR2RdrDetn390To394DynPrpty1 FLR2RdrDetn390To394DynPrpty2 FLR2RdrDetn390To394DynPrpty3 FLR2RdrDetn390To394DynPrpty4 FLR2RdrDetn390To394EleAng0 FLR2RdrDetn390To394EleAng1 FLR2RdrDetn390To394EleAng2 FLR2RdrDetn390To394EleAng3 FLR2RdrDetn390To394EleAng4 FLR2RdrDetn390To394Mode0 FLR2RdrDetn390To394Mode1 FLR2RdrDetn390To394Mode2 FLR2RdrDetn390To394Mode3 FLR2RdrDetn390To394Mode4 FLR2RdrDetn390To394Quality0 FLR2RdrDetn390To394Quality1 FLR2RdrDetn390To394Quality2 FLR2RdrDetn390To394Quality3 FLR2RdrDetn390To394Quality4 FLR2RdrDetn390To394Range0 FLR2RdrDetn390To394Range1 FLR2RdrDetn390To394Range2 FLR2RdrDetn390To394Range3 FLR2RdrDetn390To394Range4 FLR2RdrDetn390To394RCS0 FLR2RdrDetn390To394RCS1 FLR2RdrDetn390To394RCS2 FLR2RdrDetn390To394RCS3 FLR2RdrDetn390To394RCS4 FLR2RdrDetn390To394RngRt0 FLR2RdrDetn390To394RngRt1 FLR2RdrDetn390To394RngRt2 FLR2RdrDetn390To394RngRt3 FLR2RdrDetn390To394RngRt4 FLR2RdrDetn390To394ScanID FLR2RdrDetn390To394SNR0 FLR2RdrDetn390To394SNR1 FLR2RdrDetn390To394SNR2 FLR2RdrDetn390To394SNR3 FLR2RdrDetn390To394SNR4;
SIG_GROUP_ 300 FLR2RdrDetn395To399 1 : FLR2RdrDetn395To399AziAng0 FLR2RdrDetn395To399AziAng1 FLR2RdrDetn395To399AziAng2 FLR2RdrDetn395To399AziAng3 FLR2RdrDetn395To399AziAng4 FLR2RdrDetn395To399Counter FLR2RdrDetn395To399CRC FLR2RdrDetn395To399DynPrpty0 FLR2RdrDetn395To399DynPrpty1 FLR2RdrDetn395To399DynPrpty2 FLR2RdrDetn395To399DynPrpty3 FLR2RdrDetn395To399DynPrpty4 FLR2RdrDetn395To399EleAng0 FLR2RdrDetn395To399EleAng1 FLR2RdrDetn395To399EleAng2 FLR2RdrDetn395To399EleAng3 FLR2RdrDetn395To399EleAng4 FLR2RdrDetn395To399Mode0 FLR2RdrDetn395To399Mode1 FLR2RdrDetn395To399Mode2 FLR2RdrDetn395To399Mode3 FLR2RdrDetn395To399Mode4 FLR2RdrDetn395To399Quality0 FLR2RdrDetn395To399Quality1 FLR2RdrDetn395To399Quality2 FLR2RdrDetn395To399Quality3 FLR2RdrDetn395To399Quality4 FLR2RdrDetn395To399Range0 FLR2RdrDetn395To399Range1 FLR2RdrDetn395To399Range2 FLR2RdrDetn395To399Range3 FLR2RdrDetn395To399Range4 FLR2RdrDetn395To399RCS0 FLR2RdrDetn395To399RCS1 FLR2RdrDetn395To399RCS2 FLR2RdrDetn395To399RCS3 FLR2RdrDetn395To399RCS4 FLR2RdrDetn395To399RngRt0 FLR2RdrDetn395To399RngRt1 FLR2RdrDetn395To399RngRt2 FLR2RdrDetn395To399RngRt3 FLR2RdrDetn395To399RngRt4 FLR2RdrDetn395To399ScanID FLR2RdrDetn395To399SNR0 FLR2RdrDetn395To399SNR1 FLR2RdrDetn395To399SNR2 FLR2RdrDetn395To399SNR3 FLR2RdrDetn395To399SNR4;
SIG_GROUP_ 320 FLR2RdrObject0To1 1 : FLR2RdrObject0To1Class0 FLR2RdrObject0To1Class1 FLR2RdrObject0To1Counter FLR2RdrObject0To1CRC FLR2RdrObject0To1DataCoastCntr0 FLR2RdrObject0To1DataCoastCntr1 FLR2RdrObject0To1DataConf0 FLR2RdrObject0To1DataConf1 FLR2RdrObject0To1DataLen0 FLR2RdrObject0To1DataLen1 FLR2RdrObject0To1DataStDLatAcc0 FLR2RdrObject0To1DataStDLatAcc1 FLR2RdrObject0To1DataStDLatPos0 FLR2RdrObject0To1DataStDLatPos1 FLR2RdrObject0To1DataStDLatVelo0 FLR2RdrObject0To1DataStDLatVelo1 FLR2RdrObject0To1DataStDLgtAcc0 FLR2RdrObject0To1DataStDLgtAcc1 FLR2RdrObject0To1DataStDLgtPos0 FLR2RdrObject0To1DataStDLgtPos1 FLR2RdrObject0To1DataStDLgtVelo0 FLR2RdrObject0To1DataStDLgtVelo1 FLR2RdrObject0To1DataWidth0 FLR2RdrObject0To1DataWidth1 FLR2RdrObject0To1HeadingAng0 FLR2RdrObject0To1HeadingAng1 FLR2RdrObject0To1LatAcc0 FLR2RdrObject0To1LatAcc1 FLR2RdrObject0To1LatPos0 FLR2RdrObject0To1LatPos1 FLR2RdrObject0To1LatVelo0 FLR2RdrObject0To1LatVelo1 FLR2RdrObject0To1LgtAcc0 FLR2RdrObject0To1LgtAcc1 FLR2RdrObject0To1LgtPos0 FLR2RdrObject0To1LgtPos1 FLR2RdrObject0To1LgtVelo0 FLR2RdrObject0To1LgtVelo1 FLR2RdrObject0To1ModeInfo0 FLR2RdrObject0To1ModeInfo1 FLR2RdrObject0To1MsgCntr FLR2RdrObject0To1MtnModel0 FLR2RdrObject0To1MtnModel1 FLR2RdrObject0To1MtnPattern0 FLR2RdrObject0To1MtnPattern1 FLR2RdrObject0To1PedMicroDoppler0 FLR2RdrObject0To1PedMicroDoppler1 FLR2RdrObject0To1Qly0 FLR2RdrObject0To1Qly1 FLR2RdrObject0To1ScanID;
SIG_GROUP_ 322 FLR2RdrObject2To3 1 : FLR2RdrObject2To3Class0 FLR2RdrObject2To3Class1 FLR2RdrObject2To3Counter FLR2RdrObject2To3CRC FLR2RdrObject2To3DataCoastCntr0 FLR2RdrObject2To3DataCoastCntr1 FLR2RdrObject2To3DataConf0 FLR2RdrObject2To3DataConf1 FLR2RdrObject2To3DataLen0 FLR2RdrObject2To3DataLen1 FLR2RdrObject2To3DataStDLatAcc0 FLR2RdrObject2To3DataStDLatAcc1 FLR2RdrObject2To3DataStDLatPos0 FLR2RdrObject2To3DataStDLatPos1 FLR2RdrObject2To3DataStDLatVelo0 FLR2RdrObject2To3DataStDLatVelo1 FLR2RdrObject2To3DataStDLgtAcc0 FLR2RdrObject2To3DataStDLgtAcc1 FLR2RdrObject2To3DataStDLgtPos0 FLR2RdrObject2To3DataStDLgtPos1 FLR2RdrObject2To3DataStDLgtVelo0 FLR2RdrObject2To3DataStDLgtVelo1 FLR2RdrObject2To3DataWidth0 FLR2RdrObject2To3DataWidth1 FLR2RdrObject2To3HeadingAng0 FLR2RdrObject2To3HeadingAng1 FLR2RdrObject2To3LatAcc0 FLR2RdrObject2To3LatAcc1 FLR2RdrObject2To3LatPos0 FLR2RdrObject2To3LatPos1 FLR2RdrObject2To3LatVelo0 FLR2RdrObject2To3LatVelo1 FLR2RdrObject2To3LgtAcc0 FLR2RdrObject2To3LgtAcc1 FLR2RdrObject2To3LgtPos0 FLR2RdrObject2To3LgtPos1 FLR2RdrObject2To3LgtVelo0 FLR2RdrObject2To3LgtVelo1 FLR2RdrObject2To3ModeInfo0 FLR2RdrObject2To3ModeInfo1 FLR2RdrObject2To3MsgCntr FLR2RdrObject2To3MtnModel0 FLR2RdrObject2To3MtnModel1 FLR2RdrObject2To3MtnPattern0 FLR2RdrObject2To3MtnPattern1 FLR2RdrObject2To3PedMicroDoppler0 FLR2RdrObject2To3PedMicroDoppler1 FLR2RdrObject2To3Qly0 FLR2RdrObject2To3Qly1 FLR2RdrObject2To3ScanID;
