// *************************************************************************** *
// *                                                                           *
// * Description:         CANDB File                                           *
// * Generated at:        2023-01-05 13:51                                     *
// * System:              FLRsystem_MAIN_26                                    *
// * Network:             FLR1CAN                                              *
// *                                                                           *
// *************************************************************************** *
VERSION "FLR1CAN"

NS_ :

BS_ :

BU_ :  FLR FLRdpHPA FLRdpHPB

BO_ 118 FlrFlr1canFr13 : 64 FLR
 SG_ FLR2RdrDetn060To064_UB : 359|1@0+ (1,0) [0|1] "" FLRdpHPA,FLRdpHPB
 SG_ FLR2RdrDetn060To064AziAng0 : 32|9@1+ (0.0035,-0.87266) [-0.87266|0.91584] "rad" FLRdpHPA,FLRdpHPB
 SG_ FLR2RdrDetn060To064AziAng1 : 96|9@1+ (0.0035,-0.87266) [-0.87266|0.91584] "rad" FLRdpHPA,FLRdpHPB
 SG_ FLR2RdrDetn060To064AziAng2 : 160|9@1+ (0.0035,-0.87266) [-0.87266|0.91584] "rad" FLRdpHPA,FLRdpHPB
 SG_ FLR2RdrDetn060To064AziAng3 : 224|9@1+ (0.0035,-0.87266) [-0.87266|0.91584] "rad" FLRdpHPA,FLRdpHPB
 SG_ FLR2RdrDetn060To064AziAng4 : 288|9@1+ (0.0035,-0.87266) [-0.87266|0.91584] "rad" FLRdpHPA,FLRdpHPB
 SG_ FLR2RdrDetn060To064Counter : 16|8@1+ (1.0,0.0) [0.0|255.0] "Unitless" FLRdpHPA,FLRdpHPB
 SG_ FLR2RdrDetn060To064CRC : 0|16@1+ (1.0,0.0) [0.0|65535.0] "Unitless" FLRdpHPA,FLRdpHPB
 SG_ FLR2RdrDetn060To064DynPrpty0 : 93|1@1+ (1.0,0.0) [0.0|1.0] "Unitless" FLRdpHPA,FLRdpHPB
 SG_ FLR2RdrDetn060To064DynPrpty1 : 157|1@1+ (1.0,0.0) [0.0|1.0] "Unitless" FLRdpHPA,FLRdpHPB
 SG_ FLR2RdrDetn060To064DynPrpty2 : 221|1@1+ (1.0,0.0) [0.0|1.0] "Unitless" FLRdpHPA,FLRdpHPB
 SG_ FLR2RdrDetn060To064DynPrpty3 : 285|1@1+ (1.0,0.0) [0.0|1.0] "Unitless" FLRdpHPA,FLRdpHPB
 SG_ FLR2RdrDetn060To064DynPrpty4 : 349|1@1+ (1.0,0.0) [0.0|1.0] "Unitless" FLRdpHPA,FLRdpHPB
 SG_ FLR2RdrDetn060To064EleAng0 : 64|8@1+ (0.002,0.0) [0.0|0.5] "rad" FLRdpHPA,FLRdpHPB
 SG_ FLR2RdrDetn060To064EleAng1 : 128|8@1+ (0.002,0.0) [0.0|0.5] "rad" FLRdpHPA,FLRdpHPB
 SG_ FLR2RdrDetn060To064EleAng2 : 192|8@1+ (0.002,0.0) [0.0|0.5] "rad" FLRdpHPA,FLRdpHPB
 SG_ FLR2RdrDetn060To064EleAng3 : 256|8@1+ (0.002,0.0) [0.0|0.5] "rad" FLRdpHPA,FLRdpHPB
 SG_ FLR2RdrDetn060To064EleAng4 : 320|8@1+ (0.002,0.0) [0.0|0.5] "rad" FLRdpHPA,FLRdpHPB
 SG_ FLR2RdrDetn060To064Mode0 : 60|2@1+ (1,0) [0|3] "" FLRdpHPA,FLRdpHPB
 SG_ FLR2RdrDetn060To064Mode1 : 124|2@1+ (1,0) [0|3] "" FLRdpHPA,FLRdpHPB
 SG_ FLR2RdrDetn060To064Mode2 : 188|2@1+ (1,0) [0|3] "" FLRdpHPA,FLRdpHPB
 SG_ FLR2RdrDetn060To064Mode3 : 252|2@1+ (1,0) [0|3] "" FLRdpHPA,FLRdpHPB
 SG_ FLR2RdrDetn060To064Mode4 : 316|2@1+ (1,0) [0|3] "" FLRdpHPA,FLRdpHPB
 SG_ FLR2RdrDetn060To064Quality0 : 62|2@1+ (1,0) [0|3] "" FLRdpHPA,FLRdpHPB
 SG_ FLR2RdrDetn060To064Quality1 : 126|2@1+ (1,0) [0|3] "" FLRdpHPA,FLRdpHPB
 SG_ FLR2RdrDetn060To064Quality2 : 190|2@1+ (1,0) [0|3] "" FLRdpHPA,FLRdpHPB
 SG_ FLR2RdrDetn060To064Quality3 : 254|2@1+ (1,0) [0|3] "" FLRdpHPA,FLRdpHPB
 SG_ FLR2RdrDetn060To064Quality4 : 318|2@1+ (1,0) [0|3] "" FLRdpHPA,FLRdpHPB
 SG_ FLR2RdrDetn060To064Range0 : 48|12@1+ (0.1,0.4) [0.4|300.0] "m" FLRdpHPA,FLRdpHPB
 SG_ FLR2RdrDetn060To064Range1 : 112|12@1+ (0.1,0.4) [0.4|300.0] "m" FLRdpHPA,FLRdpHPB
 SG_ FLR2RdrDetn060To064Range2 : 176|12@1+ (0.1,0.4) [0.4|300.0] "m" FLRdpHPA,FLRdpHPB
 SG_ FLR2RdrDetn060To064Range3 : 240|12@1+ (0.1,0.4) [0.4|300.0] "m" FLRdpHPA,FLRdpHPB
 SG_ FLR2RdrDetn060To064Range4 : 304|12@1+ (0.1,0.4) [0.4|300.0] "m" FLRdpHPA,FLRdpHPB
 SG_ FLR2RdrDetn060To064RCS0 : 83|10@1+ (0.2,-100.0) [-100.0|70.0] "dBsm" FLRdpHPA,FLRdpHPB
 SG_ FLR2RdrDetn060To064RCS1 : 147|10@1+ (0.2,-100.0) [-100.0|70.0] "dBsm" FLRdpHPA,FLRdpHPB
 SG_ FLR2RdrDetn060To064RCS2 : 211|10@1+ (0.2,-100.0) [-100.0|70.0] "dBsm" FLRdpHPA,FLRdpHPB
 SG_ FLR2RdrDetn060To064RCS3 : 275|10@1+ (0.2,-100.0) [-100.0|70.0] "dBsm" FLRdpHPA,FLRdpHPB
 SG_ FLR2RdrDetn060To064RCS4 : 339|10@1+ (0.2,-100.0) [-100.0|70.0] "dBsm" FLRdpHPA,FLRdpHPB
 SG_ FLR2RdrDetn060To064RngRt0 : 72|11@1+ (0.1,-111.11) [-111.11|55.59000000000002] "m/s" FLRdpHPA,FLRdpHPB
 SG_ FLR2RdrDetn060To064RngRt1 : 136|11@1+ (0.1,-111.11) [-111.11|55.59000000000002] "m/s" FLRdpHPA,FLRdpHPB
 SG_ FLR2RdrDetn060To064RngRt2 : 200|11@1+ (0.1,-111.11) [-111.11|55.59000000000002] "m/s" FLRdpHPA,FLRdpHPB
 SG_ FLR2RdrDetn060To064RngRt3 : 264|11@1+ (0.1,-111.11) [-111.11|55.59000000000002] "m/s" FLRdpHPA,FLRdpHPB
 SG_ FLR2RdrDetn060To064RngRt4 : 328|11@1+ (0.1,-111.11) [-111.11|55.59000000000002] "m/s" FLRdpHPA,FLRdpHPB
 SG_ FLR2RdrDetn060To064ScanID : 24|8@1+ (1.0,0.0) [0.0|255.0] "Unitless" FLRdpHPA,FLRdpHPB
 SG_ FLR2RdrDetn060To064SNR0 : 41|7@1+ (0.5,0.0) [0.0|63.5] "dB" FLRdpHPA,FLRdpHPB
 SG_ FLR2RdrDetn060To064SNR1 : 105|7@1+ (0.5,0.0) [0.0|63.5] "dB" FLRdpHPA,FLRdpHPB
 SG_ FLR2RdrDetn060To064SNR2 : 169|7@1+ (0.5,0.0) [0.0|63.5] "dB" FLRdpHPA,FLRdpHPB
 SG_ FLR2RdrDetn060To064SNR3 : 233|7@1+ (0.5,0.0) [0.0|63.5] "dB" FLRdpHPA,FLRdpHPB
 SG_ FLR2RdrDetn060To064SNR4 : 297|7@1+ (0.5,0.0) [0.0|63.5] "dB" FLRdpHPA,FLRdpHPB

BO_ 121 FlrFlr1canFr14 : 64 FLR
 SG_ FLR2RdrDetn065To069_UB : 359|1@0+ (1,0) [0|1] "" FLRdpHPA,FLRdpHPB
 SG_ FLR2RdrDetn065To069AziAng0 : 32|9@1+ (0.0035,-0.87266) [-0.87266|0.91584] "rad" FLRdpHPA,FLRdpHPB
 SG_ FLR2RdrDetn065To069AziAng1 : 96|9@1+ (0.0035,-0.87266) [-0.87266|0.91584] "rad" FLRdpHPA,FLRdpHPB
 SG_ FLR2RdrDetn065To069AziAng2 : 160|9@1+ (0.0035,-0.87266) [-0.87266|0.91584] "rad" FLRdpHPA,FLRdpHPB
 SG_ FLR2RdrDetn065To069AziAng3 : 224|9@1+ (0.0035,-0.87266) [-0.87266|0.91584] "rad" FLRdpHPA,FLRdpHPB
 SG_ FLR2RdrDetn065To069AziAng4 : 288|9@1+ (0.0035,-0.87266) [-0.87266|0.91584] "rad" FLRdpHPA,FLRdpHPB
 SG_ FLR2RdrDetn065To069Counter : 16|8@1+ (1.0,0.0) [0.0|255.0] "Unitless" FLRdpHPA,FLRdpHPB
 SG_ FLR2RdrDetn065To069CRC : 0|16@1+ (1.0,0.0) [0.0|65535.0] "Unitless" FLRdpHPA,FLRdpHPB
 SG_ FLR2RdrDetn065To069DynPrpty0 : 93|1@1+ (1.0,0.0) [0.0|1.0] "Unitless" FLRdpHPA,FLRdpHPB
 SG_ FLR2RdrDetn065To069DynPrpty1 : 157|1@1+ (1.0,0.0) [0.0|1.0] "Unitless" FLRdpHPA,FLRdpHPB
 SG_ FLR2RdrDetn065To069DynPrpty2 : 221|1@1+ (1.0,0.0) [0.0|1.0] "Unitless" FLRdpHPA,FLRdpHPB
 SG_ FLR2RdrDetn065To069DynPrpty3 : 285|1@1+ (1.0,0.0) [0.0|1.0] "Unitless" FLRdpHPA,FLRdpHPB
 SG_ FLR2RdrDetn065To069DynPrpty4 : 349|1@1+ (1.0,0.0) [0.0|1.0] "Unitless" FLRdpHPA,FLRdpHPB
 SG_ FLR2RdrDetn065To069EleAng0 : 64|8@1+ (0.002,0.0) [0.0|0.5] "rad" FLRdpHPA,FLRdpHPB
 SG_ FLR2RdrDetn065To069EleAng1 : 128|8@1+ (0.002,0.0) [0.0|0.5] "rad" FLRdpHPA,FLRdpHPB
 SG_ FLR2RdrDetn065To069EleAng2 : 192|8@1+ (0.002,0.0) [0.0|0.5] "rad" FLRdpHPA,FLRdpHPB
 SG_ FLR2RdrDetn065To069EleAng3 : 256|8@1+ (0.002,0.0) [0.0|0.5] "rad" FLRdpHPA,FLRdpHPB
 SG_ FLR2RdrDetn065To069EleAng4 : 320|8@1+ (0.002,0.0) [0.0|0.5] "rad" FLRdpHPA,FLRdpHPB
 SG_ FLR2RdrDetn065To069Mode0 : 60|2@1+ (1,0) [0|3] "" FLRdpHPA,FLRdpHPB
 SG_ FLR2RdrDetn065To069Mode1 : 124|2@1+ (1,0) [0|3] "" FLRdpHPA,FLRdpHPB
 SG_ FLR2RdrDetn065To069Mode2 : 188|2@1+ (1,0) [0|3] "" FLRdpHPA,FLRdpHPB
 SG_ FLR2RdrDetn065To069Mode3 : 252|2@1+ (1,0) [0|3] "" FLRdpHPA,FLRdpHPB
 SG_ FLR2RdrDetn065To069Mode4 : 316|2@1+ (1,0) [0|3] "" FLRdpHPA,FLRdpHPB
 SG_ FLR2RdrDetn065To069Quality0 : 62|2@1+ (1,0) [0|3] "" FLRdpHPA,FLRdpHPB
 SG_ FLR2RdrDetn065To069Quality1 : 126|2@1+ (1,0) [0|3] "" FLRdpHPA,FLRdpHPB
 SG_ FLR2RdrDetn065To069Quality2 : 190|2@1+ (1,0) [0|3] "" FLRdpHPA,FLRdpHPB
 SG_ FLR2RdrDetn065To069Quality3 : 254|2@1+ (1,0) [0|3] "" FLRdpHPA,FLRdpHPB
 SG_ FLR2RdrDetn065To069Quality4 : 318|2@1+ (1,0) [0|3] "" FLRdpHPA,FLRdpHPB
 SG_ FLR2RdrDetn065To069Range0 : 48|12@1+ (0.1,0.4) [0.4|300.0] "m" FLRdpHPA,FLRdpHPB
 SG_ FLR2RdrDetn065To069Range1 : 112|12@1+ (0.1,0.4) [0.4|300.0] "m" FLRdpHPA,FLRdpHPB
 SG_ FLR2RdrDetn065To069Range2 : 176|12@1+ (0.1,0.4) [0.4|300.0] "m" FLRdpHPA,FLRdpHPB
 SG_ FLR2RdrDetn065To069Range3 : 240|12@1+ (0.1,0.4) [0.4|300.0] "m" FLRdpHPA,FLRdpHPB
 SG_ FLR2RdrDetn065To069Range4 : 304|12@1+ (0.1,0.4) [0.4|300.0] "m" FLRdpHPA,FLRdpHPB
 SG_ FLR2RdrDetn065To069RCS0 : 83|10@1+ (0.2,-100.0) [-100.0|70.0] "dBsm" FLRdpHPA,FLRdpHPB
 SG_ FLR2RdrDetn065To069RCS1 : 147|10@1+ (0.2,-100.0) [-100.0|70.0] "dBsm" FLRdpHPA,FLRdpHPB
 SG_ FLR2RdrDetn065To069RCS2 : 211|10@1+ (0.2,-100.0) [-100.0|70.0] "dBsm" FLRdpHPA,FLRdpHPB
 SG_ FLR2RdrDetn065To069RCS3 : 275|10@1+ (0.2,-100.0) [-100.0|70.0] "dBsm" FLRdpHPA,FLRdpHPB
 SG_ FLR2RdrDetn065To069RCS4 : 339|10@1+ (0.2,-100.0) [-100.0|70.0] "dBsm" FLRdpHPA,FLRdpHPB
 SG_ FLR2RdrDetn065To069RngRt0 : 72|11@1+ (0.1,-111.11) [-111.11|55.59000000000002] "m/s" FLRdpHPA,FLRdpHPB
 SG_ FLR2RdrDetn065To069RngRt1 : 136|11@1+ (0.1,-111.11) [-111.11|55.59000000000002] "m/s" FLRdpHPA,FLRdpHPB
 SG_ FLR2RdrDetn065To069RngRt2 : 200|11@1+ (0.1,-111.11) [-111.11|55.59000000000002] "m/s" FLRdpHPA,FLRdpHPB
 SG_ FLR2RdrDetn065To069RngRt3 : 264|11@1+ (0.1,-111.11) [-111.11|55.59000000000002] "m/s" FLRdpHPA,FLRdpHPB
 SG_ FLR2RdrDetn065To069RngRt4 : 328|11@1+ (0.1,-111.11) [-111.11|55.59000000000002] "m/s" FLRdpHPA,FLRdpHPB
 SG_ FLR2RdrDetn065To069ScanID : 24|8@1+ (1.0,0.0) [0.0|255.0] "Unitless" FLRdpHPA,FLRdpHPB
 SG_ FLR2RdrDetn065To069SNR0 : 41|7@1+ (0.5,0.0) [0.0|63.5] "dB" FLRdpHPA,FLRdpHPB
 SG_ FLR2RdrDetn065To069SNR1 : 105|7@1+ (0.5,0.0) [0.0|63.5] "dB" FLRdpHPA,FLRdpHPB
 SG_ FLR2RdrDetn065To069SNR2 : 169|7@1+ (0.5,0.0) [0.0|63.5] "dB" FLRdpHPA,FLRdpHPB
 SG_ FLR2RdrDetn065To069SNR3 : 233|7@1+ (0.5,0.0) [0.0|63.5] "dB" FLRdpHPA,FLRdpHPB
 SG_ FLR2RdrDetn065To069SNR4 : 297|7@1+ (0.5,0.0) [0.0|63.5] "dB" FLRdpHPA,FLRdpHPB

BO_ 124 FlrFlr1canFr15 : 64 FLR
 SG_ FLR2RdrDetn070To074_UB : 359|1@0+ (1,0) [0|1] "" FLRdpHPA,FLRdpHPB
 SG_ FLR2RdrDetn070To074AziAng0 : 32|9@1+ (0.0035,-0.87266) [-0.87266|0.91584] "rad" FLRdpHPA,FLRdpHPB
 SG_ FLR2RdrDetn070To074AziAng1 : 96|9@1+ (0.0035,-0.87266) [-0.87266|0.91584] "rad" FLRdpHPA,FLRdpHPB
 SG_ FLR2RdrDetn070To074AziAng2 : 160|9@1+ (0.0035,-0.87266) [-0.87266|0.91584] "rad" FLRdpHPA,FLRdpHPB
 SG_ FLR2RdrDetn070To074AziAng3 : 224|9@1+ (0.0035,-0.87266) [-0.87266|0.91584] "rad" FLRdpHPA,FLRdpHPB
 SG_ FLR2RdrDetn070To074AziAng4 : 288|9@1+ (0.0035,-0.87266) [-0.87266|0.91584] "rad" FLRdpHPA,FLRdpHPB
 SG_ FLR2RdrDetn070To074Counter : 16|8@1+ (1.0,0.0) [0.0|255.0] "Unitless" FLRdpHPA,FLRdpHPB
 SG_ FLR2RdrDetn070To074CRC : 0|16@1+ (1.0,0.0) [0.0|65535.0] "Unitless" FLRdpHPA,FLRdpHPB
 SG_ FLR2RdrDetn070To074DynPrpty0 : 93|1@1+ (1.0,0.0) [0.0|1.0] "Unitless" FLRdpHPA,FLRdpHPB
 SG_ FLR2RdrDetn070To074DynPrpty1 : 157|1@1+ (1.0,0.0) [0.0|1.0] "Unitless" FLRdpHPA,FLRdpHPB
 SG_ FLR2RdrDetn070To074DynPrpty2 : 221|1@1+ (1.0,0.0) [0.0|1.0] "Unitless" FLRdpHPA,FLRdpHPB
 SG_ FLR2RdrDetn070To074DynPrpty3 : 285|1@1+ (1.0,0.0) [0.0|1.0] "Unitless" FLRdpHPA,FLRdpHPB
 SG_ FLR2RdrDetn070To074DynPrpty4 : 349|1@1+ (1.0,0.0) [0.0|1.0] "Unitless" FLRdpHPA,FLRdpHPB
 SG_ FLR2RdrDetn070To074EleAng0 : 64|8@1+ (0.002,0.0) [0.0|0.5] "rad" FLRdpHPA,FLRdpHPB
 SG_ FLR2RdrDetn070To074EleAng1 : 128|8@1+ (0.002,0.0) [0.0|0.5] "rad" FLRdpHPA,FLRdpHPB
 SG_ FLR2RdrDetn070To074EleAng2 : 192|8@1+ (0.002,0.0) [0.0|0.5] "rad" FLRdpHPA,FLRdpHPB
 SG_ FLR2RdrDetn070To074EleAng3 : 256|8@1+ (0.002,0.0) [0.0|0.5] "rad" FLRdpHPA,FLRdpHPB
 SG_ FLR2RdrDetn070To074EleAng4 : 320|8@1+ (0.002,0.0) [0.0|0.5] "rad" FLRdpHPA,FLRdpHPB
 SG_ FLR2RdrDetn070To074Mode0 : 60|2@1+ (1,0) [0|3] "" FLRdpHPA,FLRdpHPB
 SG_ FLR2RdrDetn070To074Mode1 : 124|2@1+ (1,0) [0|3] "" FLRdpHPA,FLRdpHPB
 SG_ FLR2RdrDetn070To074Mode2 : 188|2@1+ (1,0) [0|3] "" FLRdpHPA,FLRdpHPB
 SG_ FLR2RdrDetn070To074Mode3 : 252|2@1+ (1,0) [0|3] "" FLRdpHPA,FLRdpHPB
 SG_ FLR2RdrDetn070To074Mode4 : 316|2@1+ (1,0) [0|3] "" FLRdpHPA,FLRdpHPB
 SG_ FLR2RdrDetn070To074Quality0 : 62|2@1+ (1,0) [0|3] "" FLRdpHPA,FLRdpHPB
 SG_ FLR2RdrDetn070To074Quality1 : 126|2@1+ (1,0) [0|3] "" FLRdpHPA,FLRdpHPB
 SG_ FLR2RdrDetn070To074Quality2 : 190|2@1+ (1,0) [0|3] "" FLRdpHPA,FLRdpHPB
 SG_ FLR2RdrDetn070To074Quality3 : 254|2@1+ (1,0) [0|3] "" FLRdpHPA,FLRdpHPB
 SG_ FLR2RdrDetn070To074Quality4 : 318|2@1+ (1,0) [0|3] "" FLRdpHPA,FLRdpHPB
 SG_ FLR2RdrDetn070To074Range0 : 48|12@1+ (0.1,0.4) [0.4|300.0] "m" FLRdpHPA,FLRdpHPB
 SG_ FLR2RdrDetn070To074Range1 : 112|12@1+ (0.1,0.4) [0.4|300.0] "m" FLRdpHPA,FLRdpHPB
 SG_ FLR2RdrDetn070To074Range2 : 176|12@1+ (0.1,0.4) [0.4|300.0] "m" FLRdpHPA,FLRdpHPB
 SG_ FLR2RdrDetn070To074Range3 : 240|12@1+ (0.1,0.4) [0.4|300.0] "m" FLRdpHPA,FLRdpHPB
 SG_ FLR2RdrDetn070To074Range4 : 304|12@1+ (0.1,0.4) [0.4|300.0] "m" FLRdpHPA,FLRdpHPB
 SG_ FLR2RdrDetn070To074RCS0 : 83|10@1+ (0.2,-100.0) [-100.0|70.0] "dBsm" FLRdpHPA,FLRdpHPB
 SG_ FLR2RdrDetn070To074RCS1 : 147|10@1+ (0.2,-100.0) [-100.0|70.0] "dBsm" FLRdpHPA,FLRdpHPB
 SG_ FLR2RdrDetn070To074RCS2 : 211|10@1+ (0.2,-100.0) [-100.0|70.0] "dBsm" FLRdpHPA,FLRdpHPB
 SG_ FLR2RdrDetn070To074RCS3 : 275|10@1+ (0.2,-100.0) [-100.0|70.0] "dBsm" FLRdpHPA,FLRdpHPB
 SG_ FLR2RdrDetn070To074RCS4 : 339|10@1+ (0.2,-100.0) [-100.0|70.0] "dBsm" FLRdpHPA,FLRdpHPB
 SG_ FLR2RdrDetn070To074RngRt0 : 72|11@1+ (0.1,-111.11) [-111.11|55.59000000000002] "m/s" FLRdpHPA,FLRdpHPB
 SG_ FLR2RdrDetn070To074RngRt1 : 136|11@1+ (0.1,-111.11) [-111.11|55.59000000000002] "m/s" FLRdpHPA,FLRdpHPB
 SG_ FLR2RdrDetn070To074RngRt2 : 200|11@1+ (0.1,-111.11) [-111.11|55.59000000000002] "m/s" FLRdpHPA,FLRdpHPB
 SG_ FLR2RdrDetn070To074RngRt3 : 264|11@1+ (0.1,-111.11) [-111.11|55.59000000000002] "m/s" FLRdpHPA,FLRdpHPB
 SG_ FLR2RdrDetn070To074RngRt4 : 328|11@1+ (0.1,-111.11) [-111.11|55.59000000000002] "m/s" FLRdpHPA,FLRdpHPB
 SG_ FLR2RdrDetn070To074ScanID : 24|8@1+ (1.0,0.0) [0.0|255.0] "Unitless" FLRdpHPA,FLRdpHPB
 SG_ FLR2RdrDetn070To074SNR0 : 41|7@1+ (0.5,0.0) [0.0|63.5] "dB" FLRdpHPA,FLRdpHPB
 SG_ FLR2RdrDetn070To074SNR1 : 105|7@1+ (0.5,0.0) [0.0|63.5] "dB" FLRdpHPA,FLRdpHPB
 SG_ FLR2RdrDetn070To074SNR2 : 169|7@1+ (0.5,0.0) [0.0|63.5] "dB" FLRdpHPA,FLRdpHPB
 SG_ FLR2RdrDetn070To074SNR3 : 233|7@1+ (0.5,0.0) [0.0|63.5] "dB" FLRdpHPA,FLRdpHPB
 SG_ FLR2RdrDetn070To074SNR4 : 297|7@1+ (0.5,0.0) [0.0|63.5] "dB" FLRdpHPA,FLRdpHPB

BO_ 131 FlrFlr1canFr16 : 64 FLR
 SG_ FLR2RdrDetn075To079_UB : 359|1@0+ (1,0) [0|1] "" FLRdpHPA,FLRdpHPB
 SG_ FLR2RdrDetn075To079AziAng0 : 32|9@1+ (0.0035,-0.87266) [-0.87266|0.91584] "rad" FLRdpHPA,FLRdpHPB
 SG_ FLR2RdrDetn075To079AziAng1 : 96|9@1+ (0.0035,-0.87266) [-0.87266|0.91584] "rad" FLRdpHPA,FLRdpHPB
 SG_ FLR2RdrDetn075To079AziAng2 : 160|9@1+ (0.0035,-0.87266) [-0.87266|0.91584] "rad" FLRdpHPA,FLRdpHPB
 SG_ FLR2RdrDetn075To079AziAng3 : 224|9@1+ (0.0035,-0.87266) [-0.87266|0.91584] "rad" FLRdpHPA,FLRdpHPB
 SG_ FLR2RdrDetn075To079AziAng4 : 288|9@1+ (0.0035,-0.87266) [-0.87266|0.91584] "rad" FLRdpHPA,FLRdpHPB
 SG_ FLR2RdrDetn075To079Counter : 16|8@1+ (1.0,0.0) [0.0|255.0] "Unitless" FLRdpHPA,FLRdpHPB
 SG_ FLR2RdrDetn075To079CRC : 0|16@1+ (1.0,0.0) [0.0|65535.0] "Unitless" FLRdpHPA,FLRdpHPB
 SG_ FLR2RdrDetn075To079DynPrpty0 : 93|1@1+ (1.0,0.0) [0.0|1.0] "Unitless" FLRdpHPA,FLRdpHPB
 SG_ FLR2RdrDetn075To079DynPrpty1 : 157|1@1+ (1.0,0.0) [0.0|1.0] "Unitless" FLRdpHPA,FLRdpHPB
 SG_ FLR2RdrDetn075To079DynPrpty2 : 221|1@1+ (1.0,0.0) [0.0|1.0] "Unitless" FLRdpHPA,FLRdpHPB
 SG_ FLR2RdrDetn075To079DynPrpty3 : 285|1@1+ (1.0,0.0) [0.0|1.0] "Unitless" FLRdpHPA,FLRdpHPB
 SG_ FLR2RdrDetn075To079DynPrpty4 : 349|1@1+ (1.0,0.0) [0.0|1.0] "Unitless" FLRdpHPA,FLRdpHPB
 SG_ FLR2RdrDetn075To079EleAng0 : 64|8@1+ (0.002,0.0) [0.0|0.5] "rad" FLRdpHPA,FLRdpHPB
 SG_ FLR2RdrDetn075To079EleAng1 : 128|8@1+ (0.002,0.0) [0.0|0.5] "rad" FLRdpHPA,FLRdpHPB
 SG_ FLR2RdrDetn075To079EleAng2 : 192|8@1+ (0.002,0.0) [0.0|0.5] "rad" FLRdpHPA,FLRdpHPB
 SG_ FLR2RdrDetn075To079EleAng3 : 256|8@1+ (0.002,0.0) [0.0|0.5] "rad" FLRdpHPA,FLRdpHPB
 SG_ FLR2RdrDetn075To079EleAng4 : 320|8@1+ (0.002,0.0) [0.0|0.5] "rad" FLRdpHPA,FLRdpHPB
 SG_ FLR2RdrDetn075To079Mode0 : 60|2@1+ (1,0) [0|3] "" FLRdpHPA,FLRdpHPB
 SG_ FLR2RdrDetn075To079Mode1 : 124|2@1+ (1,0) [0|3] "" FLRdpHPA,FLRdpHPB
 SG_ FLR2RdrDetn075To079Mode2 : 188|2@1+ (1,0) [0|3] "" FLRdpHPA,FLRdpHPB
 SG_ FLR2RdrDetn075To079Mode3 : 252|2@1+ (1,0) [0|3] "" FLRdpHPA,FLRdpHPB
 SG_ FLR2RdrDetn075To079Mode4 : 316|2@1+ (1,0) [0|3] "" FLRdpHPA,FLRdpHPB
 SG_ FLR2RdrDetn075To079Quality0 : 62|2@1+ (1,0) [0|3] "" FLRdpHPA,FLRdpHPB
 SG_ FLR2RdrDetn075To079Quality1 : 126|2@1+ (1,0) [0|3] "" FLRdpHPA,FLRdpHPB
 SG_ FLR2RdrDetn075To079Quality2 : 190|2@1+ (1,0) [0|3] "" FLRdpHPA,FLRdpHPB
 SG_ FLR2RdrDetn075To079Quality3 : 254|2@1+ (1,0) [0|3] "" FLRdpHPA,FLRdpHPB
 SG_ FLR2RdrDetn075To079Quality4 : 318|2@1+ (1,0) [0|3] "" FLRdpHPA,FLRdpHPB
 SG_ FLR2RdrDetn075To079Range0 : 48|12@1+ (0.1,0.4) [0.4|300.0] "m" FLRdpHPA,FLRdpHPB
 SG_ FLR2RdrDetn075To079Range1 : 112|12@1+ (0.1,0.4) [0.4|300.0] "m" FLRdpHPA,FLRdpHPB
 SG_ FLR2RdrDetn075To079Range2 : 176|12@1+ (0.1,0.4) [0.4|300.0] "m" FLRdpHPA,FLRdpHPB
 SG_ FLR2RdrDetn075To079Range3 : 240|12@1+ (0.1,0.4) [0.4|300.0] "m" FLRdpHPA,FLRdpHPB
 SG_ FLR2RdrDetn075To079Range4 : 304|12@1+ (0.1,0.4) [0.4|300.0] "m" FLRdpHPA,FLRdpHPB
 SG_ FLR2RdrDetn075To079RCS0 : 83|10@1+ (0.2,-100.0) [-100.0|70.0] "dBsm" FLRdpHPA,FLRdpHPB
 SG_ FLR2RdrDetn075To079RCS1 : 147|10@1+ (0.2,-100.0) [-100.0|70.0] "dBsm" FLRdpHPA,FLRdpHPB
 SG_ FLR2RdrDetn075To079RCS2 : 211|10@1+ (0.2,-100.0) [-100.0|70.0] "dBsm" FLRdpHPA,FLRdpHPB
 SG_ FLR2RdrDetn075To079RCS3 : 275|10@1+ (0.2,-100.0) [-100.0|70.0] "dBsm" FLRdpHPA,FLRdpHPB
 SG_ FLR2RdrDetn075To079RCS4 : 339|10@1+ (0.2,-100.0) [-100.0|70.0] "dBsm" FLRdpHPA,FLRdpHPB
 SG_ FLR2RdrDetn075To079RngRt0 : 72|11@1+ (0.1,-111.11) [-111.11|55.59000000000002] "m/s" FLRdpHPA,FLRdpHPB
 SG_ FLR2RdrDetn075To079RngRt1 : 136|11@1+ (0.1,-111.11) [-111.11|55.59000000000002] "m/s" FLRdpHPA,FLRdpHPB
 SG_ FLR2RdrDetn075To079RngRt2 : 200|11@1+ (0.1,-111.11) [-111.11|55.59000000000002] "m/s" FLRdpHPA,FLRdpHPB
 SG_ FLR2RdrDetn075To079RngRt3 : 264|11@1+ (0.1,-111.11) [-111.11|55.59000000000002] "m/s" FLRdpHPA,FLRdpHPB
 SG_ FLR2RdrDetn075To079RngRt4 : 328|11@1+ (0.1,-111.11) [-111.11|55.59000000000002] "m/s" FLRdpHPA,FLRdpHPB
 SG_ FLR2RdrDetn075To079ScanID : 24|8@1+ (1.0,0.0) [0.0|255.0] "Unitless" FLRdpHPA,FLRdpHPB
 SG_ FLR2RdrDetn075To079SNR0 : 41|7@1+ (0.5,0.0) [0.0|63.5] "dB" FLRdpHPA,FLRdpHPB
 SG_ FLR2RdrDetn075To079SNR1 : 105|7@1+ (0.5,0.0) [0.0|63.5] "dB" FLRdpHPA,FLRdpHPB
 SG_ FLR2RdrDetn075To079SNR2 : 169|7@1+ (0.5,0.0) [0.0|63.5] "dB" FLRdpHPA,FLRdpHPB
 SG_ FLR2RdrDetn075To079SNR3 : 233|7@1+ (0.5,0.0) [0.0|63.5] "dB" FLRdpHPA,FLRdpHPB
 SG_ FLR2RdrDetn075To079SNR4 : 297|7@1+ (0.5,0.0) [0.0|63.5] "dB" FLRdpHPA,FLRdpHPB

BO_ 134 FlrFlr1canFr17 : 64 FLR
 SG_ FLR2RdrDetn080To084_UB : 359|1@0+ (1,0) [0|1] "" FLRdpHPA,FLRdpHPB
 SG_ FLR2RdrDetn080To084AziAng0 : 32|9@1+ (0.0035,-0.87266) [-0.87266|0.91584] "rad" FLRdpHPA,FLRdpHPB
 SG_ FLR2RdrDetn080To084AziAng1 : 96|9@1+ (0.0035,-0.87266) [-0.87266|0.91584] "rad" FLRdpHPA,FLRdpHPB
 SG_ FLR2RdrDetn080To084AziAng2 : 160|9@1+ (0.0035,-0.87266) [-0.87266|0.91584] "rad" FLRdpHPA,FLRdpHPB
 SG_ FLR2RdrDetn080To084AziAng3 : 224|9@1+ (0.0035,-0.87266) [-0.87266|0.91584] "rad" FLRdpHPA,FLRdpHPB
 SG_ FLR2RdrDetn080To084AziAng4 : 288|9@1+ (0.0035,-0.87266) [-0.87266|0.91584] "rad" FLRdpHPA,FLRdpHPB
 SG_ FLR2RdrDetn080To084Counter : 16|8@1+ (1.0,0.0) [0.0|255.0] "Unitless" FLRdpHPA,FLRdpHPB
 SG_ FLR2RdrDetn080To084CRC : 0|16@1+ (1.0,0.0) [0.0|65535.0] "Unitless" FLRdpHPA,FLRdpHPB
 SG_ FLR2RdrDetn080To084DynPrpty0 : 93|1@1+ (1.0,0.0) [0.0|1.0] "Unitless" FLRdpHPA,FLRdpHPB
 SG_ FLR2RdrDetn080To084DynPrpty1 : 157|1@1+ (1.0,0.0) [0.0|1.0] "Unitless" FLRdpHPA,FLRdpHPB
 SG_ FLR2RdrDetn080To084DynPrpty2 : 221|1@1+ (1.0,0.0) [0.0|1.0] "Unitless" FLRdpHPA,FLRdpHPB
 SG_ FLR2RdrDetn080To084DynPrpty3 : 285|1@1+ (1.0,0.0) [0.0|1.0] "Unitless" FLRdpHPA,FLRdpHPB
 SG_ FLR2RdrDetn080To084DynPrpty4 : 349|1@1+ (1.0,0.0) [0.0|1.0] "Unitless" FLRdpHPA,FLRdpHPB
 SG_ FLR2RdrDetn080To084EleAng0 : 64|8@1+ (0.002,0.0) [0.0|0.5] "rad" FLRdpHPA,FLRdpHPB
 SG_ FLR2RdrDetn080To084EleAng1 : 128|8@1+ (0.002,0.0) [0.0|0.5] "rad" FLRdpHPA,FLRdpHPB
 SG_ FLR2RdrDetn080To084EleAng2 : 192|8@1+ (0.002,0.0) [0.0|0.5] "rad" FLRdpHPA,FLRdpHPB
 SG_ FLR2RdrDetn080To084EleAng3 : 256|8@1+ (0.002,0.0) [0.0|0.5] "rad" FLRdpHPA,FLRdpHPB
 SG_ FLR2RdrDetn080To084EleAng4 : 320|8@1+ (0.002,0.0) [0.0|0.5] "rad" FLRdpHPA,FLRdpHPB
 SG_ FLR2RdrDetn080To084Mode0 : 60|2@1+ (1,0) [0|3] "" FLRdpHPA,FLRdpHPB
 SG_ FLR2RdrDetn080To084Mode1 : 124|2@1+ (1,0) [0|3] "" FLRdpHPA,FLRdpHPB
 SG_ FLR2RdrDetn080To084Mode2 : 188|2@1+ (1,0) [0|3] "" FLRdpHPA,FLRdpHPB
 SG_ FLR2RdrDetn080To084Mode3 : 252|2@1+ (1,0) [0|3] "" FLRdpHPA,FLRdpHPB
 SG_ FLR2RdrDetn080To084Mode4 : 316|2@1+ (1,0) [0|3] "" FLRdpHPA,FLRdpHPB
 SG_ FLR2RdrDetn080To084Quality0 : 62|2@1+ (1,0) [0|3] "" FLRdpHPA,FLRdpHPB
 SG_ FLR2RdrDetn080To084Quality1 : 126|2@1+ (1,0) [0|3] "" FLRdpHPA,FLRdpHPB
 SG_ FLR2RdrDetn080To084Quality2 : 190|2@1+ (1,0) [0|3] "" FLRdpHPA,FLRdpHPB
 SG_ FLR2RdrDetn080To084Quality3 : 254|2@1+ (1,0) [0|3] "" FLRdpHPA,FLRdpHPB
 SG_ FLR2RdrDetn080To084Quality4 : 318|2@1+ (1,0) [0|3] "" FLRdpHPA,FLRdpHPB
 SG_ FLR2RdrDetn080To084Range0 : 48|12@1+ (0.1,0.4) [0.4|300.0] "m" FLRdpHPA,FLRdpHPB
 SG_ FLR2RdrDetn080To084Range1 : 112|12@1+ (0.1,0.4) [0.4|300.0] "m" FLRdpHPA,FLRdpHPB
 SG_ FLR2RdrDetn080To084Range2 : 176|12@1+ (0.1,0.4) [0.4|300.0] "m" FLRdpHPA,FLRdpHPB
 SG_ FLR2RdrDetn080To084Range3 : 240|12@1+ (0.1,0.4) [0.4|300.0] "m" FLRdpHPA,FLRdpHPB
 SG_ FLR2RdrDetn080To084Range4 : 304|12@1+ (0.1,0.4) [0.4|300.0] "m" FLRdpHPA,FLRdpHPB
 SG_ FLR2RdrDetn080To084RCS0 : 83|10@1+ (0.2,-100.0) [-100.0|70.0] "dBsm" FLRdpHPA,FLRdpHPB
 SG_ FLR2RdrDetn080To084RCS1 : 147|10@1+ (0.2,-100.0) [-100.0|70.0] "dBsm" FLRdpHPA,FLRdpHPB
 SG_ FLR2RdrDetn080To084RCS2 : 211|10@1+ (0.2,-100.0) [-100.0|70.0] "dBsm" FLRdpHPA,FLRdpHPB
 SG_ FLR2RdrDetn080To084RCS3 : 275|10@1+ (0.2,-100.0) [-100.0|70.0] "dBsm" FLRdpHPA,FLRdpHPB
 SG_ FLR2RdrDetn080To084RCS4 : 339|10@1+ (0.2,-100.0) [-100.0|70.0] "dBsm" FLRdpHPA,FLRdpHPB
 SG_ FLR2RdrDetn080To084RngRt0 : 72|11@1+ (0.1,-111.11) [-111.11|55.59000000000002] "m/s" FLRdpHPA,FLRdpHPB
 SG_ FLR2RdrDetn080To084RngRt1 : 136|11@1+ (0.1,-111.11) [-111.11|55.59000000000002] "m/s" FLRdpHPA,FLRdpHPB
 SG_ FLR2RdrDetn080To084RngRt2 : 200|11@1+ (0.1,-111.11) [-111.11|55.59000000000002] "m/s" FLRdpHPA,FLRdpHPB
 SG_ FLR2RdrDetn080To084RngRt3 : 264|11@1+ (0.1,-111.11) [-111.11|55.59000000000002] "m/s" FLRdpHPA,FLRdpHPB
 SG_ FLR2RdrDetn080To084RngRt4 : 328|11@1+ (0.1,-111.11) [-111.11|55.59000000000002] "m/s" FLRdpHPA,FLRdpHPB
 SG_ FLR2RdrDetn080To084ScanID : 24|8@1+ (1.0,0.0) [0.0|255.0] "Unitless" FLRdpHPA,FLRdpHPB
 SG_ FLR2RdrDetn080To084SNR0 : 41|7@1+ (0.5,0.0) [0.0|63.5] "dB" FLRdpHPA,FLRdpHPB
 SG_ FLR2RdrDetn080To084SNR1 : 105|7@1+ (0.5,0.0) [0.0|63.5] "dB" FLRdpHPA,FLRdpHPB
 SG_ FLR2RdrDetn080To084SNR2 : 169|7@1+ (0.5,0.0) [0.0|63.5] "dB" FLRdpHPA,FLRdpHPB
 SG_ FLR2RdrDetn080To084SNR3 : 233|7@1+ (0.5,0.0) [0.0|63.5] "dB" FLRdpHPA,FLRdpHPB
 SG_ FLR2RdrDetn080To084SNR4 : 297|7@1+ (0.5,0.0) [0.0|63.5] "dB" FLRdpHPA,FLRdpHPB

BO_ 137 FlrFlr1canFr18 : 64 FLR
 SG_ FLR2RdrDetn085To089_UB : 359|1@0+ (1,0) [0|1] "" FLRdpHPA,FLRdpHPB
 SG_ FLR2RdrDetn085To089AziAng0 : 32|9@1+ (0.0035,-0.87266) [-0.87266|0.91584] "rad" FLRdpHPA,FLRdpHPB
 SG_ FLR2RdrDetn085To089AziAng1 : 96|9@1+ (0.0035,-0.87266) [-0.87266|0.91584] "rad" FLRdpHPA,FLRdpHPB
 SG_ FLR2RdrDetn085To089AziAng2 : 160|9@1+ (0.0035,-0.87266) [-0.87266|0.91584] "rad" FLRdpHPA,FLRdpHPB
 SG_ FLR2RdrDetn085To089AziAng3 : 224|9@1+ (0.0035,-0.87266) [-0.87266|0.91584] "rad" FLRdpHPA,FLRdpHPB
 SG_ FLR2RdrDetn085To089AziAng4 : 288|9@1+ (0.0035,-0.87266) [-0.87266|0.91584] "rad" FLRdpHPA,FLRdpHPB
 SG_ FLR2RdrDetn085To089Counter : 16|8@1+ (1.0,0.0) [0.0|255.0] "Unitless" FLRdpHPA,FLRdpHPB
 SG_ FLR2RdrDetn085To089CRC : 0|16@1+ (1.0,0.0) [0.0|65535.0] "Unitless" FLRdpHPA,FLRdpHPB
 SG_ FLR2RdrDetn085To089DynPrpty0 : 93|1@1+ (1.0,0.0) [0.0|1.0] "Unitless" FLRdpHPA,FLRdpHPB
 SG_ FLR2RdrDetn085To089DynPrpty1 : 157|1@1+ (1.0,0.0) [0.0|1.0] "Unitless" FLRdpHPA,FLRdpHPB
 SG_ FLR2RdrDetn085To089DynPrpty2 : 221|1@1+ (1.0,0.0) [0.0|1.0] "Unitless" FLRdpHPA,FLRdpHPB
 SG_ FLR2RdrDetn085To089DynPrpty3 : 285|1@1+ (1.0,0.0) [0.0|1.0] "Unitless" FLRdpHPA,FLRdpHPB
 SG_ FLR2RdrDetn085To089DynPrpty4 : 349|1@1+ (1.0,0.0) [0.0|1.0] "Unitless" FLRdpHPA,FLRdpHPB
 SG_ FLR2RdrDetn085To089EleAng0 : 64|8@1+ (0.002,0.0) [0.0|0.5] "rad" FLRdpHPA,FLRdpHPB
 SG_ FLR2RdrDetn085To089EleAng1 : 128|8@1+ (0.002,0.0) [0.0|0.5] "rad" FLRdpHPA,FLRdpHPB
 SG_ FLR2RdrDetn085To089EleAng2 : 192|8@1+ (0.002,0.0) [0.0|0.5] "rad" FLRdpHPA,FLRdpHPB
 SG_ FLR2RdrDetn085To089EleAng3 : 256|8@1+ (0.002,0.0) [0.0|0.5] "rad" FLRdpHPA,FLRdpHPB
 SG_ FLR2RdrDetn085To089EleAng4 : 320|8@1+ (0.002,0.0) [0.0|0.5] "rad" FLRdpHPA,FLRdpHPB
 SG_ FLR2RdrDetn085To089Mode0 : 60|2@1+ (1,0) [0|3] "" FLRdpHPA,FLRdpHPB
 SG_ FLR2RdrDetn085To089Mode1 : 124|2@1+ (1,0) [0|3] "" FLRdpHPA,FLRdpHPB
 SG_ FLR2RdrDetn085To089Mode2 : 188|2@1+ (1,0) [0|3] "" FLRdpHPA,FLRdpHPB
 SG_ FLR2RdrDetn085To089Mode3 : 252|2@1+ (1,0) [0|3] "" FLRdpHPA,FLRdpHPB
 SG_ FLR2RdrDetn085To089Mode4 : 316|2@1+ (1,0) [0|3] "" FLRdpHPA,FLRdpHPB
 SG_ FLR2RdrDetn085To089Quality0 : 62|2@1+ (1,0) [0|3] "" FLRdpHPA,FLRdpHPB
 SG_ FLR2RdrDetn085To089Quality1 : 126|2@1+ (1,0) [0|3] "" FLRdpHPA,FLRdpHPB
 SG_ FLR2RdrDetn085To089Quality2 : 190|2@1+ (1,0) [0|3] "" FLRdpHPA,FLRdpHPB
 SG_ FLR2RdrDetn085To089Quality3 : 254|2@1+ (1,0) [0|3] "" FLRdpHPA,FLRdpHPB
 SG_ FLR2RdrDetn085To089Quality4 : 318|2@1+ (1,0) [0|3] "" FLRdpHPA,FLRdpHPB
 SG_ FLR2RdrDetn085To089Range0 : 48|12@1+ (0.1,0.4) [0.4|300.0] "m" FLRdpHPA,FLRdpHPB
 SG_ FLR2RdrDetn085To089Range1 : 112|12@1+ (0.1,0.4) [0.4|300.0] "m" FLRdpHPA,FLRdpHPB
 SG_ FLR2RdrDetn085To089Range2 : 176|12@1+ (0.1,0.4) [0.4|300.0] "m" FLRdpHPA,FLRdpHPB
 SG_ FLR2RdrDetn085To089Range3 : 240|12@1+ (0.1,0.4) [0.4|300.0] "m" FLRdpHPA,FLRdpHPB
 SG_ FLR2RdrDetn085To089Range4 : 304|12@1+ (0.1,0.4) [0.4|300.0] "m" FLRdpHPA,FLRdpHPB
 SG_ FLR2RdrDetn085To089RCS0 : 83|10@1+ (0.2,-100.0) [-100.0|70.0] "dBsm" FLRdpHPA,FLRdpHPB
 SG_ FLR2RdrDetn085To089RCS1 : 147|10@1+ (0.2,-100.0) [-100.0|70.0] "dBsm" FLRdpHPA,FLRdpHPB
 SG_ FLR2RdrDetn085To089RCS2 : 211|10@1+ (0.2,-100.0) [-100.0|70.0] "dBsm" FLRdpHPA,FLRdpHPB
 SG_ FLR2RdrDetn085To089RCS3 : 275|10@1+ (0.2,-100.0) [-100.0|70.0] "dBsm" FLRdpHPA,FLRdpHPB
 SG_ FLR2RdrDetn085To089RCS4 : 339|10@1+ (0.2,-100.0) [-100.0|70.0] "dBsm" FLRdpHPA,FLRdpHPB
 SG_ FLR2RdrDetn085To089RngRt0 : 72|11@1+ (0.1,-111.11) [-111.11|55.59000000000002] "m/s" FLRdpHPA,FLRdpHPB
 SG_ FLR2RdrDetn085To089RngRt1 : 136|11@1+ (0.1,-111.11) [-111.11|55.59000000000002] "m/s" FLRdpHPA,FLRdpHPB
 SG_ FLR2RdrDetn085To089RngRt2 : 200|11@1+ (0.1,-111.11) [-111.11|55.59000000000002] "m/s" FLRdpHPA,FLRdpHPB
 SG_ FLR2RdrDetn085To089RngRt3 : 264|11@1+ (0.1,-111.11) [-111.11|55.59000000000002] "m/s" FLRdpHPA,FLRdpHPB
 SG_ FLR2RdrDetn085To089RngRt4 : 328|11@1+ (0.1,-111.11) [-111.11|55.59000000000002] "m/s" FLRdpHPA,FLRdpHPB
 SG_ FLR2RdrDetn085To089ScanID : 24|8@1+ (1.0,0.0) [0.0|255.0] "Unitless" FLRdpHPA,FLRdpHPB
 SG_ FLR2RdrDetn085To089SNR0 : 41|7@1+ (0.5,0.0) [0.0|63.5] "dB" FLRdpHPA,FLRdpHPB
 SG_ FLR2RdrDetn085To089SNR1 : 105|7@1+ (0.5,0.0) [0.0|63.5] "dB" FLRdpHPA,FLRdpHPB
 SG_ FLR2RdrDetn085To089SNR2 : 169|7@1+ (0.5,0.0) [0.0|63.5] "dB" FLRdpHPA,FLRdpHPB
 SG_ FLR2RdrDetn085To089SNR3 : 233|7@1+ (0.5,0.0) [0.0|63.5] "dB" FLRdpHPA,FLRdpHPB
 SG_ FLR2RdrDetn085To089SNR4 : 297|7@1+ (0.5,0.0) [0.0|63.5] "dB" FLRdpHPA,FLRdpHPB

BO_ 140 FlrFlr1canFr19 : 64 FLR
 SG_ FLR2RdrDetn090To094_UB : 359|1@0+ (1,0) [0|1] "" FLRdpHPA,FLRdpHPB
 SG_ FLR2RdrDetn090To094AziAng0 : 32|9@1+ (0.0035,-0.87266) [-0.87266|0.91584] "rad" FLRdpHPA,FLRdpHPB
 SG_ FLR2RdrDetn090To094AziAng1 : 96|9@1+ (0.0035,-0.87266) [-0.87266|0.91584] "rad" FLRdpHPA,FLRdpHPB
 SG_ FLR2RdrDetn090To094AziAng2 : 160|9@1+ (0.0035,-0.87266) [-0.87266|0.91584] "rad" FLRdpHPA,FLRdpHPB
 SG_ FLR2RdrDetn090To094AziAng3 : 224|9@1+ (0.0035,-0.87266) [-0.87266|0.91584] "rad" FLRdpHPA,FLRdpHPB
 SG_ FLR2RdrDetn090To094AziAng4 : 288|9@1+ (0.0035,-0.87266) [-0.87266|0.91584] "rad" FLRdpHPA,FLRdpHPB
 SG_ FLR2RdrDetn090To094Counter : 16|8@1+ (1.0,0.0) [0.0|255.0] "Unitless" FLRdpHPA,FLRdpHPB
 SG_ FLR2RdrDetn090To094CRC : 0|16@1+ (1.0,0.0) [0.0|65535.0] "Unitless" FLRdpHPA,FLRdpHPB
 SG_ FLR2RdrDetn090To094DynPrpty0 : 93|1@1+ (1.0,0.0) [0.0|1.0] "Unitless" FLRdpHPA,FLRdpHPB
 SG_ FLR2RdrDetn090To094DynPrpty1 : 157|1@1+ (1.0,0.0) [0.0|1.0] "Unitless" FLRdpHPA,FLRdpHPB
 SG_ FLR2RdrDetn090To094DynPrpty2 : 221|1@1+ (1.0,0.0) [0.0|1.0] "Unitless" FLRdpHPA,FLRdpHPB
 SG_ FLR2RdrDetn090To094DynPrpty3 : 285|1@1+ (1.0,0.0) [0.0|1.0] "Unitless" FLRdpHPA,FLRdpHPB
 SG_ FLR2RdrDetn090To094DynPrpty4 : 349|1@1+ (1.0,0.0) [0.0|1.0] "Unitless" FLRdpHPA,FLRdpHPB
 SG_ FLR2RdrDetn090To094EleAng0 : 64|8@1+ (0.002,0.0) [0.0|0.5] "rad" FLRdpHPA,FLRdpHPB
 SG_ FLR2RdrDetn090To094EleAng1 : 128|8@1+ (0.002,0.0) [0.0|0.5] "rad" FLRdpHPA,FLRdpHPB
 SG_ FLR2RdrDetn090To094EleAng2 : 192|8@1+ (0.002,0.0) [0.0|0.5] "rad" FLRdpHPA,FLRdpHPB
 SG_ FLR2RdrDetn090To094EleAng3 : 256|8@1+ (0.002,0.0) [0.0|0.5] "rad" FLRdpHPA,FLRdpHPB
 SG_ FLR2RdrDetn090To094EleAng4 : 320|8@1+ (0.002,0.0) [0.0|0.5] "rad" FLRdpHPA,FLRdpHPB
 SG_ FLR2RdrDetn090To094Mode0 : 60|2@1+ (1,0) [0|3] "" FLRdpHPA,FLRdpHPB
 SG_ FLR2RdrDetn090To094Mode1 : 124|2@1+ (1,0) [0|3] "" FLRdpHPA,FLRdpHPB
 SG_ FLR2RdrDetn090To094Mode2 : 188|2@1+ (1,0) [0|3] "" FLRdpHPA,FLRdpHPB
 SG_ FLR2RdrDetn090To094Mode3 : 252|2@1+ (1,0) [0|3] "" FLRdpHPA,FLRdpHPB
 SG_ FLR2RdrDetn090To094Mode4 : 316|2@1+ (1,0) [0|3] "" FLRdpHPA,FLRdpHPB
 SG_ FLR2RdrDetn090To094Quality0 : 62|2@1+ (1,0) [0|3] "" FLRdpHPA,FLRdpHPB
 SG_ FLR2RdrDetn090To094Quality1 : 126|2@1+ (1,0) [0|3] "" FLRdpHPA,FLRdpHPB
 SG_ FLR2RdrDetn090To094Quality2 : 190|2@1+ (1,0) [0|3] "" FLRdpHPA,FLRdpHPB
 SG_ FLR2RdrDetn090To094Quality3 : 254|2@1+ (1,0) [0|3] "" FLRdpHPA,FLRdpHPB
 SG_ FLR2RdrDetn090To094Quality4 : 318|2@1+ (1,0) [0|3] "" FLRdpHPA,FLRdpHPB
 SG_ FLR2RdrDetn090To094Range0 : 48|12@1+ (0.1,0.4) [0.4|300.0] "m" FLRdpHPA,FLRdpHPB
 SG_ FLR2RdrDetn090To094Range1 : 112|12@1+ (0.1,0.4) [0.4|300.0] "m" FLRdpHPA,FLRdpHPB
 SG_ FLR2RdrDetn090To094Range2 : 176|12@1+ (0.1,0.4) [0.4|300.0] "m" FLRdpHPA,FLRdpHPB
 SG_ FLR2RdrDetn090To094Range3 : 240|12@1+ (0.1,0.4) [0.4|300.0] "m" FLRdpHPA,FLRdpHPB
 SG_ FLR2RdrDetn090To094Range4 : 304|12@1+ (0.1,0.4) [0.4|300.0] "m" FLRdpHPA,FLRdpHPB
 SG_ FLR2RdrDetn090To094RCS0 : 83|10@1+ (0.2,-100.0) [-100.0|70.0] "dBsm" FLRdpHPA,FLRdpHPB
 SG_ FLR2RdrDetn090To094RCS1 : 147|10@1+ (0.2,-100.0) [-100.0|70.0] "dBsm" FLRdpHPA,FLRdpHPB
 SG_ FLR2RdrDetn090To094RCS2 : 211|10@1+ (0.2,-100.0) [-100.0|70.0] "dBsm" FLRdpHPA,FLRdpHPB
 SG_ FLR2RdrDetn090To094RCS3 : 275|10@1+ (0.2,-100.0) [-100.0|70.0] "dBsm" FLRdpHPA,FLRdpHPB
 SG_ FLR2RdrDetn090To094RCS4 : 339|10@1+ (0.2,-100.0) [-100.0|70.0] "dBsm" FLRdpHPA,FLRdpHPB
 SG_ FLR2RdrDetn090To094RngRt0 : 72|11@1+ (0.1,-111.11) [-111.11|55.59000000000002] "m/s" FLRdpHPA,FLRdpHPB
 SG_ FLR2RdrDetn090To094RngRt1 : 136|11@1+ (0.1,-111.11) [-111.11|55.59000000000002] "m/s" FLRdpHPA,FLRdpHPB
 SG_ FLR2RdrDetn090To094RngRt2 : 200|11@1+ (0.1,-111.11) [-111.11|55.59000000000002] "m/s" FLRdpHPA,FLRdpHPB
 SG_ FLR2RdrDetn090To094RngRt3 : 264|11@1+ (0.1,-111.11) [-111.11|55.59000000000002] "m/s" FLRdpHPA,FLRdpHPB
 SG_ FLR2RdrDetn090To094RngRt4 : 328|11@1+ (0.1,-111.11) [-111.11|55.59000000000002] "m/s" FLRdpHPA,FLRdpHPB
 SG_ FLR2RdrDetn090To094ScanID : 24|8@1+ (1.0,0.0) [0.0|255.0] "Unitless" FLRdpHPA,FLRdpHPB
 SG_ FLR2RdrDetn090To094SNR0 : 41|7@1+ (0.5,0.0) [0.0|63.5] "dB" FLRdpHPA,FLRdpHPB
 SG_ FLR2RdrDetn090To094SNR1 : 105|7@1+ (0.5,0.0) [0.0|63.5] "dB" FLRdpHPA,FLRdpHPB
 SG_ FLR2RdrDetn090To094SNR2 : 169|7@1+ (0.5,0.0) [0.0|63.5] "dB" FLRdpHPA,FLRdpHPB
 SG_ FLR2RdrDetn090To094SNR3 : 233|7@1+ (0.5,0.0) [0.0|63.5] "dB" FLRdpHPA,FLRdpHPB
 SG_ FLR2RdrDetn090To094SNR4 : 297|7@1+ (0.5,0.0) [0.0|63.5] "dB" FLRdpHPA,FLRdpHPB

BO_ 144 FlrFlr1canFr20 : 64 FLR
 SG_ FLR2RdrDetn095To099_UB : 359|1@0+ (1,0) [0|1] "" FLRdpHPA,FLRdpHPB
 SG_ FLR2RdrDetn095To099AziAng0 : 32|9@1+ (0.0035,-0.87266) [-0.87266|0.91584] "rad" FLRdpHPA,FLRdpHPB
 SG_ FLR2RdrDetn095To099AziAng1 : 96|9@1+ (0.0035,-0.87266) [-0.87266|0.91584] "rad" FLRdpHPA,FLRdpHPB
 SG_ FLR2RdrDetn095To099AziAng2 : 160|9@1+ (0.0035,-0.87266) [-0.87266|0.91584] "rad" FLRdpHPA,FLRdpHPB
 SG_ FLR2RdrDetn095To099AziAng3 : 224|9@1+ (0.0035,-0.87266) [-0.87266|0.91584] "rad" FLRdpHPA,FLRdpHPB
 SG_ FLR2RdrDetn095To099AziAng4 : 288|9@1+ (0.0035,-0.87266) [-0.87266|0.91584] "rad" FLRdpHPA,FLRdpHPB
 SG_ FLR2RdrDetn095To099Counter : 16|8@1+ (1.0,0.0) [0.0|255.0] "Unitless" FLRdpHPA,FLRdpHPB
 SG_ FLR2RdrDetn095To099CRC : 0|16@1+ (1.0,0.0) [0.0|65535.0] "Unitless" FLRdpHPA,FLRdpHPB
 SG_ FLR2RdrDetn095To099DynPrpty0 : 93|1@1+ (1.0,0.0) [0.0|1.0] "Unitless" FLRdpHPA,FLRdpHPB
 SG_ FLR2RdrDetn095To099DynPrpty1 : 157|1@1+ (1.0,0.0) [0.0|1.0] "Unitless" FLRdpHPA,FLRdpHPB
 SG_ FLR2RdrDetn095To099DynPrpty2 : 221|1@1+ (1.0,0.0) [0.0|1.0] "Unitless" FLRdpHPA,FLRdpHPB
 SG_ FLR2RdrDetn095To099DynPrpty3 : 285|1@1+ (1.0,0.0) [0.0|1.0] "Unitless" FLRdpHPA,FLRdpHPB
 SG_ FLR2RdrDetn095To099DynPrpty4 : 349|1@1+ (1.0,0.0) [0.0|1.0] "Unitless" FLRdpHPA,FLRdpHPB
 SG_ FLR2RdrDetn095To099EleAng0 : 64|8@1+ (0.002,0.0) [0.0|0.5] "rad" FLRdpHPA,FLRdpHPB
 SG_ FLR2RdrDetn095To099EleAng1 : 128|8@1+ (0.002,0.0) [0.0|0.5] "rad" FLRdpHPA,FLRdpHPB
 SG_ FLR2RdrDetn095To099EleAng2 : 192|8@1+ (0.002,0.0) [0.0|0.5] "rad" FLRdpHPA,FLRdpHPB
 SG_ FLR2RdrDetn095To099EleAng3 : 256|8@1+ (0.002,0.0) [0.0|0.5] "rad" FLRdpHPA,FLRdpHPB
 SG_ FLR2RdrDetn095To099EleAng4 : 320|8@1+ (0.002,0.0) [0.0|0.5] "rad" FLRdpHPA,FLRdpHPB
 SG_ FLR2RdrDetn095To099Mode0 : 60|2@1+ (1,0) [0|3] "" FLRdpHPA,FLRdpHPB
 SG_ FLR2RdrDetn095To099Mode1 : 124|2@1+ (1,0) [0|3] "" FLRdpHPA,FLRdpHPB
 SG_ FLR2RdrDetn095To099Mode2 : 188|2@1+ (1,0) [0|3] "" FLRdpHPA,FLRdpHPB
 SG_ FLR2RdrDetn095To099Mode3 : 252|2@1+ (1,0) [0|3] "" FLRdpHPA,FLRdpHPB
 SG_ FLR2RdrDetn095To099Mode4 : 316|2@1+ (1,0) [0|3] "" FLRdpHPA,FLRdpHPB
 SG_ FLR2RdrDetn095To099Quality0 : 62|2@1+ (1,0) [0|3] "" FLRdpHPA,FLRdpHPB
 SG_ FLR2RdrDetn095To099Quality1 : 126|2@1+ (1,0) [0|3] "" FLRdpHPA,FLRdpHPB
 SG_ FLR2RdrDetn095To099Quality2 : 190|2@1+ (1,0) [0|3] "" FLRdpHPA,FLRdpHPB
 SG_ FLR2RdrDetn095To099Quality3 : 254|2@1+ (1,0) [0|3] "" FLRdpHPA,FLRdpHPB
 SG_ FLR2RdrDetn095To099Quality4 : 318|2@1+ (1,0) [0|3] "" FLRdpHPA,FLRdpHPB
 SG_ FLR2RdrDetn095To099Range0 : 48|12@1+ (0.1,0.4) [0.4|300.0] "m" FLRdpHPA,FLRdpHPB
 SG_ FLR2RdrDetn095To099Range1 : 112|12@1+ (0.1,0.4) [0.4|300.0] "m" FLRdpHPA,FLRdpHPB
 SG_ FLR2RdrDetn095To099Range2 : 176|12@1+ (0.1,0.4) [0.4|300.0] "m" FLRdpHPA,FLRdpHPB
 SG_ FLR2RdrDetn095To099Range3 : 240|12@1+ (0.1,0.4) [0.4|300.0] "m" FLRdpHPA,FLRdpHPB
 SG_ FLR2RdrDetn095To099Range4 : 304|12@1+ (0.1,0.4) [0.4|300.0] "m" FLRdpHPA,FLRdpHPB
 SG_ FLR2RdrDetn095To099RCS0 : 83|10@1+ (0.2,-100.0) [-100.0|70.0] "dBsm" FLRdpHPA,FLRdpHPB
 SG_ FLR2RdrDetn095To099RCS1 : 147|10@1+ (0.2,-100.0) [-100.0|70.0] "dBsm" FLRdpHPA,FLRdpHPB
 SG_ FLR2RdrDetn095To099RCS2 : 211|10@1+ (0.2,-100.0) [-100.0|70.0] "dBsm" FLRdpHPA,FLRdpHPB
 SG_ FLR2RdrDetn095To099RCS3 : 275|10@1+ (0.2,-100.0) [-100.0|70.0] "dBsm" FLRdpHPA,FLRdpHPB
 SG_ FLR2RdrDetn095To099RCS4 : 339|10@1+ (0.2,-100.0) [-100.0|70.0] "dBsm" FLRdpHPA,FLRdpHPB
 SG_ FLR2RdrDetn095To099RngRt0 : 72|11@1+ (0.1,-111.11) [-111.11|55.59000000000002] "m/s" FLRdpHPA,FLRdpHPB
 SG_ FLR2RdrDetn095To099RngRt1 : 136|11@1+ (0.1,-111.11) [-111.11|55.59000000000002] "m/s" FLRdpHPA,FLRdpHPB
 SG_ FLR2RdrDetn095To099RngRt2 : 200|11@1+ (0.1,-111.11) [-111.11|55.59000000000002] "m/s" FLRdpHPA,FLRdpHPB
 SG_ FLR2RdrDetn095To099RngRt3 : 264|11@1+ (0.1,-111.11) [-111.11|55.59000000000002] "m/s" FLRdpHPA,FLRdpHPB
 SG_ FLR2RdrDetn095To099RngRt4 : 328|11@1+ (0.1,-111.11) [-111.11|55.59000000000002] "m/s" FLRdpHPA,FLRdpHPB
 SG_ FLR2RdrDetn095To099ScanID : 24|8@1+ (1.0,0.0) [0.0|255.0] "Unitless" FLRdpHPA,FLRdpHPB
 SG_ FLR2RdrDetn095To099SNR0 : 41|7@1+ (0.5,0.0) [0.0|63.5] "dB" FLRdpHPA,FLRdpHPB
 SG_ FLR2RdrDetn095To099SNR1 : 105|7@1+ (0.5,0.0) [0.0|63.5] "dB" FLRdpHPA,FLRdpHPB
 SG_ FLR2RdrDetn095To099SNR2 : 169|7@1+ (0.5,0.0) [0.0|63.5] "dB" FLRdpHPA,FLRdpHPB
 SG_ FLR2RdrDetn095To099SNR3 : 233|7@1+ (0.5,0.0) [0.0|63.5] "dB" FLRdpHPA,FLRdpHPB
 SG_ FLR2RdrDetn095To099SNR4 : 297|7@1+ (0.5,0.0) [0.0|63.5] "dB" FLRdpHPA,FLRdpHPB

BO_ 147 FlrFlr1canFr21 : 64 FLR
 SG_ FLR2RdrDetn100To104_UB : 359|1@0+ (1,0) [0|1] "" FLRdpHPA,FLRdpHPB
 SG_ FLR2RdrDetn100To104AziAng0 : 32|9@1+ (0.0035,-0.87266) [-0.87266|0.91584] "rad" FLRdpHPA,FLRdpHPB
 SG_ FLR2RdrDetn100To104AziAng1 : 96|9@1+ (0.0035,-0.87266) [-0.87266|0.91584] "rad" FLRdpHPA,FLRdpHPB
 SG_ FLR2RdrDetn100To104AziAng2 : 160|9@1+ (0.0035,-0.87266) [-0.87266|0.91584] "rad" FLRdpHPA,FLRdpHPB
 SG_ FLR2RdrDetn100To104AziAng3 : 224|9@1+ (0.0035,-0.87266) [-0.87266|0.91584] "rad" FLRdpHPA,FLRdpHPB
 SG_ FLR2RdrDetn100To104AziAng4 : 288|9@1+ (0.0035,-0.87266) [-0.87266|0.91584] "rad" FLRdpHPA,FLRdpHPB
 SG_ FLR2RdrDetn100To104Counter : 16|8@1+ (1.0,0.0) [0.0|255.0] "Unitless" FLRdpHPA,FLRdpHPB
 SG_ FLR2RdrDetn100To104CRC : 0|16@1+ (1.0,0.0) [0.0|65535.0] "Unitless" FLRdpHPA,FLRdpHPB
 SG_ FLR2RdrDetn100To104DynPrpty0 : 93|1@1+ (1.0,0.0) [0.0|1.0] "Unitless" FLRdpHPA,FLRdpHPB
 SG_ FLR2RdrDetn100To104DynPrpty1 : 157|1@1+ (1.0,0.0) [0.0|1.0] "Unitless" FLRdpHPA,FLRdpHPB
 SG_ FLR2RdrDetn100To104DynPrpty2 : 221|1@1+ (1.0,0.0) [0.0|1.0] "Unitless" FLRdpHPA,FLRdpHPB
 SG_ FLR2RdrDetn100To104DynPrpty3 : 285|1@1+ (1.0,0.0) [0.0|1.0] "Unitless" FLRdpHPA,FLRdpHPB
 SG_ FLR2RdrDetn100To104DynPrpty4 : 349|1@1+ (1.0,0.0) [0.0|1.0] "Unitless" FLRdpHPA,FLRdpHPB
 SG_ FLR2RdrDetn100To104EleAng0 : 64|8@1+ (0.002,0.0) [0.0|0.5] "rad" FLRdpHPA,FLRdpHPB
 SG_ FLR2RdrDetn100To104EleAng1 : 128|8@1+ (0.002,0.0) [0.0|0.5] "rad" FLRdpHPA,FLRdpHPB
 SG_ FLR2RdrDetn100To104EleAng2 : 192|8@1+ (0.002,0.0) [0.0|0.5] "rad" FLRdpHPA,FLRdpHPB
 SG_ FLR2RdrDetn100To104EleAng3 : 256|8@1+ (0.002,0.0) [0.0|0.5] "rad" FLRdpHPA,FLRdpHPB
 SG_ FLR2RdrDetn100To104EleAng4 : 320|8@1+ (0.002,0.0) [0.0|0.5] "rad" FLRdpHPA,FLRdpHPB
 SG_ FLR2RdrDetn100To104Mode0 : 60|2@1+ (1,0) [0|3] "" FLRdpHPA,FLRdpHPB
 SG_ FLR2RdrDetn100To104Mode1 : 124|2@1+ (1,0) [0|3] "" FLRdpHPA,FLRdpHPB
 SG_ FLR2RdrDetn100To104Mode2 : 188|2@1+ (1,0) [0|3] "" FLRdpHPA,FLRdpHPB
 SG_ FLR2RdrDetn100To104Mode3 : 252|2@1+ (1,0) [0|3] "" FLRdpHPA,FLRdpHPB
 SG_ FLR2RdrDetn100To104Mode4 : 316|2@1+ (1,0) [0|3] "" FLRdpHPA,FLRdpHPB
 SG_ FLR2RdrDetn100To104Quality0 : 62|2@1+ (1,0) [0|3] "" FLRdpHPA,FLRdpHPB
 SG_ FLR2RdrDetn100To104Quality1 : 126|2@1+ (1,0) [0|3] "" FLRdpHPA,FLRdpHPB
 SG_ FLR2RdrDetn100To104Quality2 : 190|2@1+ (1,0) [0|3] "" FLRdpHPA,FLRdpHPB
 SG_ FLR2RdrDetn100To104Quality3 : 254|2@1+ (1,0) [0|3] "" FLRdpHPA,FLRdpHPB
 SG_ FLR2RdrDetn100To104Quality4 : 318|2@1+ (1,0) [0|3] "" FLRdpHPA,FLRdpHPB
 SG_ FLR2RdrDetn100To104Range0 : 48|12@1+ (0.1,0.4) [0.4|300.0] "m" FLRdpHPA,FLRdpHPB
 SG_ FLR2RdrDetn100To104Range1 : 112|12@1+ (0.1,0.4) [0.4|300.0] "m" FLRdpHPA,FLRdpHPB
 SG_ FLR2RdrDetn100To104Range2 : 176|12@1+ (0.1,0.4) [0.4|300.0] "m" FLRdpHPA,FLRdpHPB
 SG_ FLR2RdrDetn100To104Range3 : 240|12@1+ (0.1,0.4) [0.4|300.0] "m" FLRdpHPA,FLRdpHPB
 SG_ FLR2RdrDetn100To104Range4 : 304|12@1+ (0.1,0.4) [0.4|300.0] "m" FLRdpHPA,FLRdpHPB
 SG_ FLR2RdrDetn100To104RCS0 : 83|10@1+ (0.2,-100.0) [-100.0|70.0] "dBsm" FLRdpHPA,FLRdpHPB
 SG_ FLR2RdrDetn100To104RCS1 : 147|10@1+ (0.2,-100.0) [-100.0|70.0] "dBsm" FLRdpHPA,FLRdpHPB
 SG_ FLR2RdrDetn100To104RCS2 : 211|10@1+ (0.2,-100.0) [-100.0|70.0] "dBsm" FLRdpHPA,FLRdpHPB
 SG_ FLR2RdrDetn100To104RCS3 : 275|10@1+ (0.2,-100.0) [-100.0|70.0] "dBsm" FLRdpHPA,FLRdpHPB
 SG_ FLR2RdrDetn100To104RCS4 : 339|10@1+ (0.2,-100.0) [-100.0|70.0] "dBsm" FLRdpHPA,FLRdpHPB
 SG_ FLR2RdrDetn100To104RngRt0 : 72|11@1+ (0.1,-111.11) [-111.11|55.59000000000002] "m/s" FLRdpHPA,FLRdpHPB
 SG_ FLR2RdrDetn100To104RngRt1 : 136|11@1+ (0.1,-111.11) [-111.11|55.59000000000002] "m/s" FLRdpHPA,FLRdpHPB
 SG_ FLR2RdrDetn100To104RngRt2 : 200|11@1+ (0.1,-111.11) [-111.11|55.59000000000002] "m/s" FLRdpHPA,FLRdpHPB
 SG_ FLR2RdrDetn100To104RngRt3 : 264|11@1+ (0.1,-111.11) [-111.11|55.59000000000002] "m/s" FLRdpHPA,FLRdpHPB
 SG_ FLR2RdrDetn100To104RngRt4 : 328|11@1+ (0.1,-111.11) [-111.11|55.59000000000002] "m/s" FLRdpHPA,FLRdpHPB
 SG_ FLR2RdrDetn100To104ScanID : 24|8@1+ (1.0,0.0) [0.0|255.0] "Unitless" FLRdpHPA,FLRdpHPB
 SG_ FLR2RdrDetn100To104SNR0 : 41|7@1+ (0.5,0.0) [0.0|63.5] "dB" FLRdpHPA,FLRdpHPB
 SG_ FLR2RdrDetn100To104SNR1 : 105|7@1+ (0.5,0.0) [0.0|63.5] "dB" FLRdpHPA,FLRdpHPB
 SG_ FLR2RdrDetn100To104SNR2 : 169|7@1+ (0.5,0.0) [0.0|63.5] "dB" FLRdpHPA,FLRdpHPB
 SG_ FLR2RdrDetn100To104SNR3 : 233|7@1+ (0.5,0.0) [0.0|63.5] "dB" FLRdpHPA,FLRdpHPB
 SG_ FLR2RdrDetn100To104SNR4 : 297|7@1+ (0.5,0.0) [0.0|63.5] "dB" FLRdpHPA,FLRdpHPB

BO_ 150 FlrFlr1canFr22 : 64 FLR
 SG_ FLR2RdrDetn105To109_UB : 359|1@0+ (1,0) [0|1] "" FLRdpHPA,FLRdpHPB
 SG_ FLR2RdrDetn105To109AziAng0 : 32|9@1+ (0.0035,-0.87266) [-0.87266|0.91584] "rad" FLRdpHPA,FLRdpHPB
 SG_ FLR2RdrDetn105To109AziAng1 : 96|9@1+ (0.0035,-0.87266) [-0.87266|0.91584] "rad" FLRdpHPA,FLRdpHPB
 SG_ FLR2RdrDetn105To109AziAng2 : 160|9@1+ (0.0035,-0.87266) [-0.87266|0.91584] "rad" FLRdpHPA,FLRdpHPB
 SG_ FLR2RdrDetn105To109AziAng3 : 224|9@1+ (0.0035,-0.87266) [-0.87266|0.91584] "rad" FLRdpHPA,FLRdpHPB
 SG_ FLR2RdrDetn105To109AziAng4 : 288|9@1+ (0.0035,-0.87266) [-0.87266|0.91584] "rad" FLRdpHPA,FLRdpHPB
 SG_ FLR2RdrDetn105To109Counter : 16|8@1+ (1.0,0.0) [0.0|255.0] "Unitless" FLRdpHPA,FLRdpHPB
 SG_ FLR2RdrDetn105To109CRC : 0|16@1+ (1.0,0.0) [0.0|65535.0] "Unitless" FLRdpHPA,FLRdpHPB
 SG_ FLR2RdrDetn105To109DynPrpty0 : 93|1@1+ (1.0,0.0) [0.0|1.0] "Unitless" FLRdpHPA,FLRdpHPB
 SG_ FLR2RdrDetn105To109DynPrpty1 : 157|1@1+ (1.0,0.0) [0.0|1.0] "Unitless" FLRdpHPA,FLRdpHPB
 SG_ FLR2RdrDetn105To109DynPrpty2 : 221|1@1+ (1.0,0.0) [0.0|1.0] "Unitless" FLRdpHPA,FLRdpHPB
 SG_ FLR2RdrDetn105To109DynPrpty3 : 285|1@1+ (1.0,0.0) [0.0|1.0] "Unitless" FLRdpHPA,FLRdpHPB
 SG_ FLR2RdrDetn105To109DynPrpty4 : 349|1@1+ (1.0,0.0) [0.0|1.0] "Unitless" FLRdpHPA,FLRdpHPB
 SG_ FLR2RdrDetn105To109EleAng0 : 64|8@1+ (0.002,0.0) [0.0|0.5] "rad" FLRdpHPA,FLRdpHPB
 SG_ FLR2RdrDetn105To109EleAng1 : 128|8@1+ (0.002,0.0) [0.0|0.5] "rad" FLRdpHPA,FLRdpHPB
 SG_ FLR2RdrDetn105To109EleAng2 : 192|8@1+ (0.002,0.0) [0.0|0.5] "rad" FLRdpHPA,FLRdpHPB
 SG_ FLR2RdrDetn105To109EleAng3 : 256|8@1+ (0.002,0.0) [0.0|0.5] "rad" FLRdpHPA,FLRdpHPB
 SG_ FLR2RdrDetn105To109EleAng4 : 320|8@1+ (0.002,0.0) [0.0|0.5] "rad" FLRdpHPA,FLRdpHPB
 SG_ FLR2RdrDetn105To109Mode0 : 60|2@1+ (1,0) [0|3] "" FLRdpHPA,FLRdpHPB
 SG_ FLR2RdrDetn105To109Mode1 : 124|2@1+ (1,0) [0|3] "" FLRdpHPA,FLRdpHPB
 SG_ FLR2RdrDetn105To109Mode2 : 188|2@1+ (1,0) [0|3] "" FLRdpHPA,FLRdpHPB
 SG_ FLR2RdrDetn105To109Mode3 : 252|2@1+ (1,0) [0|3] "" FLRdpHPA,FLRdpHPB
 SG_ FLR2RdrDetn105To109Mode4 : 316|2@1+ (1,0) [0|3] "" FLRdpHPA,FLRdpHPB
 SG_ FLR2RdrDetn105To109Quality0 : 62|2@1+ (1,0) [0|3] "" FLRdpHPA,FLRdpHPB
 SG_ FLR2RdrDetn105To109Quality1 : 126|2@1+ (1,0) [0|3] "" FLRdpHPA,FLRdpHPB
 SG_ FLR2RdrDetn105To109Quality2 : 190|2@1+ (1,0) [0|3] "" FLRdpHPA,FLRdpHPB
 SG_ FLR2RdrDetn105To109Quality3 : 254|2@1+ (1,0) [0|3] "" FLRdpHPA,FLRdpHPB
 SG_ FLR2RdrDetn105To109Quality4 : 318|2@1+ (1,0) [0|3] "" FLRdpHPA,FLRdpHPB
 SG_ FLR2RdrDetn105To109Range0 : 48|12@1+ (0.1,0.4) [0.4|300.0] "m" FLRdpHPA,FLRdpHPB
 SG_ FLR2RdrDetn105To109Range1 : 112|12@1+ (0.1,0.4) [0.4|300.0] "m" FLRdpHPA,FLRdpHPB
 SG_ FLR2RdrDetn105To109Range2 : 176|12@1+ (0.1,0.4) [0.4|300.0] "m" FLRdpHPA,FLRdpHPB
 SG_ FLR2RdrDetn105To109Range3 : 240|12@1+ (0.1,0.4) [0.4|300.0] "m" FLRdpHPA,FLRdpHPB
 SG_ FLR2RdrDetn105To109Range4 : 304|12@1+ (0.1,0.4) [0.4|300.0] "m" FLRdpHPA,FLRdpHPB
 SG_ FLR2RdrDetn105To109RCS0 : 83|10@1+ (0.2,-100.0) [-100.0|70.0] "dBsm" FLRdpHPA,FLRdpHPB
 SG_ FLR2RdrDetn105To109RCS1 : 147|10@1+ (0.2,-100.0) [-100.0|70.0] "dBsm" FLRdpHPA,FLRdpHPB
 SG_ FLR2RdrDetn105To109RCS2 : 211|10@1+ (0.2,-100.0) [-100.0|70.0] "dBsm" FLRdpHPA,FLRdpHPB
 SG_ FLR2RdrDetn105To109RCS3 : 275|10@1+ (0.2,-100.0) [-100.0|70.0] "dBsm" FLRdpHPA,FLRdpHPB
 SG_ FLR2RdrDetn105To109RCS4 : 339|10@1+ (0.2,-100.0) [-100.0|70.0] "dBsm" FLRdpHPA,FLRdpHPB
 SG_ FLR2RdrDetn105To109RngRt0 : 72|11@1+ (0.1,-111.11) [-111.11|55.59000000000002] "m/s" FLRdpHPA,FLRdpHPB
 SG_ FLR2RdrDetn105To109RngRt1 : 136|11@1+ (0.1,-111.11) [-111.11|55.59000000000002] "m/s" FLRdpHPA,FLRdpHPB
 SG_ FLR2RdrDetn105To109RngRt2 : 200|11@1+ (0.1,-111.11) [-111.11|55.59000000000002] "m/s" FLRdpHPA,FLRdpHPB
 SG_ FLR2RdrDetn105To109RngRt3 : 264|11@1+ (0.1,-111.11) [-111.11|55.59000000000002] "m/s" FLRdpHPA,FLRdpHPB
 SG_ FLR2RdrDetn105To109RngRt4 : 328|11@1+ (0.1,-111.11) [-111.11|55.59000000000002] "m/s" FLRdpHPA,FLRdpHPB
 SG_ FLR2RdrDetn105To109ScanID : 24|8@1+ (1.0,0.0) [0.0|255.0] "Unitless" FLRdpHPA,FLRdpHPB
 SG_ FLR2RdrDetn105To109SNR0 : 41|7@1+ (0.5,0.0) [0.0|63.5] "dB" FLRdpHPA,FLRdpHPB
 SG_ FLR2RdrDetn105To109SNR1 : 105|7@1+ (0.5,0.0) [0.0|63.5] "dB" FLRdpHPA,FLRdpHPB
 SG_ FLR2RdrDetn105To109SNR2 : 169|7@1+ (0.5,0.0) [0.0|63.5] "dB" FLRdpHPA,FLRdpHPB
 SG_ FLR2RdrDetn105To109SNR3 : 233|7@1+ (0.5,0.0) [0.0|63.5] "dB" FLRdpHPA,FLRdpHPB
 SG_ FLR2RdrDetn105To109SNR4 : 297|7@1+ (0.5,0.0) [0.0|63.5] "dB" FLRdpHPA,FLRdpHPB

BO_ 153 FlrFlr1canFr23 : 64 FLR
 SG_ FLR2RdrDetn110To114_UB : 359|1@0+ (1,0) [0|1] "" FLRdpHPA,FLRdpHPB
 SG_ FLR2RdrDetn110To114AziAng0 : 32|9@1+ (0.0035,-0.87266) [-0.87266|0.91584] "rad" FLRdpHPA,FLRdpHPB
 SG_ FLR2RdrDetn110To114AziAng1 : 96|9@1+ (0.0035,-0.87266) [-0.87266|0.91584] "rad" FLRdpHPA,FLRdpHPB
 SG_ FLR2RdrDetn110To114AziAng2 : 160|9@1+ (0.0035,-0.87266) [-0.87266|0.91584] "rad" FLRdpHPA,FLRdpHPB
 SG_ FLR2RdrDetn110To114AziAng3 : 224|9@1+ (0.0035,-0.87266) [-0.87266|0.91584] "rad" FLRdpHPA,FLRdpHPB
 SG_ FLR2RdrDetn110To114AziAng4 : 288|9@1+ (0.0035,-0.87266) [-0.87266|0.91584] "rad" FLRdpHPA,FLRdpHPB
 SG_ FLR2RdrDetn110To114Counter : 16|8@1+ (1.0,0.0) [0.0|255.0] "Unitless" FLRdpHPA,FLRdpHPB
 SG_ FLR2RdrDetn110To114CRC : 0|16@1+ (1.0,0.0) [0.0|65535.0] "Unitless" FLRdpHPA,FLRdpHPB
 SG_ FLR2RdrDetn110To114DynPrpty0 : 93|1@1+ (1.0,0.0) [0.0|1.0] "Unitless" FLRdpHPA,FLRdpHPB
 SG_ FLR2RdrDetn110To114DynPrpty1 : 157|1@1+ (1.0,0.0) [0.0|1.0] "Unitless" FLRdpHPA,FLRdpHPB
 SG_ FLR2RdrDetn110To114DynPrpty2 : 221|1@1+ (1.0,0.0) [0.0|1.0] "Unitless" FLRdpHPA,FLRdpHPB
 SG_ FLR2RdrDetn110To114DynPrpty3 : 285|1@1+ (1.0,0.0) [0.0|1.0] "Unitless" FLRdpHPA,FLRdpHPB
 SG_ FLR2RdrDetn110To114DynPrpty4 : 349|1@1+ (1.0,0.0) [0.0|1.0] "Unitless" FLRdpHPA,FLRdpHPB
 SG_ FLR2RdrDetn110To114EleAng0 : 64|8@1+ (0.002,0.0) [0.0|0.5] "rad" FLRdpHPA,FLRdpHPB
 SG_ FLR2RdrDetn110To114EleAng1 : 128|8@1+ (0.002,0.0) [0.0|0.5] "rad" FLRdpHPA,FLRdpHPB
 SG_ FLR2RdrDetn110To114EleAng2 : 192|8@1+ (0.002,0.0) [0.0|0.5] "rad" FLRdpHPA,FLRdpHPB
 SG_ FLR2RdrDetn110To114EleAng3 : 256|8@1+ (0.002,0.0) [0.0|0.5] "rad" FLRdpHPA,FLRdpHPB
 SG_ FLR2RdrDetn110To114EleAng4 : 320|8@1+ (0.002,0.0) [0.0|0.5] "rad" FLRdpHPA,FLRdpHPB
 SG_ FLR2RdrDetn110To114Mode0 : 60|2@1+ (1,0) [0|3] "" FLRdpHPA,FLRdpHPB
 SG_ FLR2RdrDetn110To114Mode1 : 124|2@1+ (1,0) [0|3] "" FLRdpHPA,FLRdpHPB
 SG_ FLR2RdrDetn110To114Mode2 : 188|2@1+ (1,0) [0|3] "" FLRdpHPA,FLRdpHPB
 SG_ FLR2RdrDetn110To114Mode3 : 252|2@1+ (1,0) [0|3] "" FLRdpHPA,FLRdpHPB
 SG_ FLR2RdrDetn110To114Mode4 : 316|2@1+ (1,0) [0|3] "" FLRdpHPA,FLRdpHPB
 SG_ FLR2RdrDetn110To114Quality0 : 62|2@1+ (1,0) [0|3] "" FLRdpHPA,FLRdpHPB
 SG_ FLR2RdrDetn110To114Quality1 : 126|2@1+ (1,0) [0|3] "" FLRdpHPA,FLRdpHPB
 SG_ FLR2RdrDetn110To114Quality2 : 190|2@1+ (1,0) [0|3] "" FLRdpHPA,FLRdpHPB
 SG_ FLR2RdrDetn110To114Quality3 : 254|2@1+ (1,0) [0|3] "" FLRdpHPA,FLRdpHPB
 SG_ FLR2RdrDetn110To114Quality4 : 318|2@1+ (1,0) [0|3] "" FLRdpHPA,FLRdpHPB
 SG_ FLR2RdrDetn110To114Range0 : 48|12@1+ (0.1,0.4) [0.4|300.0] "m" FLRdpHPA,FLRdpHPB
 SG_ FLR2RdrDetn110To114Range1 : 112|12@1+ (0.1,0.4) [0.4|300.0] "m" FLRdpHPA,FLRdpHPB
 SG_ FLR2RdrDetn110To114Range2 : 176|12@1+ (0.1,0.4) [0.4|300.0] "m" FLRdpHPA,FLRdpHPB
 SG_ FLR2RdrDetn110To114Range3 : 240|12@1+ (0.1,0.4) [0.4|300.0] "m" FLRdpHPA,FLRdpHPB
 SG_ FLR2RdrDetn110To114Range4 : 304|12@1+ (0.1,0.4) [0.4|300.0] "m" FLRdpHPA,FLRdpHPB
 SG_ FLR2RdrDetn110To114RCS0 : 83|10@1+ (0.2,-100.0) [-100.0|70.0] "dBsm" FLRdpHPA,FLRdpHPB
 SG_ FLR2RdrDetn110To114RCS1 : 147|10@1+ (0.2,-100.0) [-100.0|70.0] "dBsm" FLRdpHPA,FLRdpHPB
 SG_ FLR2RdrDetn110To114RCS2 : 211|10@1+ (0.2,-100.0) [-100.0|70.0] "dBsm" FLRdpHPA,FLRdpHPB
 SG_ FLR2RdrDetn110To114RCS3 : 275|10@1+ (0.2,-100.0) [-100.0|70.0] "dBsm" FLRdpHPA,FLRdpHPB
 SG_ FLR2RdrDetn110To114RCS4 : 339|10@1+ (0.2,-100.0) [-100.0|70.0] "dBsm" FLRdpHPA,FLRdpHPB
 SG_ FLR2RdrDetn110To114RngRt0 : 72|11@1+ (0.1,-111.11) [-111.11|55.59000000000002] "m/s" FLRdpHPA,FLRdpHPB
 SG_ FLR2RdrDetn110To114RngRt1 : 136|11@1+ (0.1,-111.11) [-111.11|55.59000000000002] "m/s" FLRdpHPA,FLRdpHPB
 SG_ FLR2RdrDetn110To114RngRt2 : 200|11@1+ (0.1,-111.11) [-111.11|55.59000000000002] "m/s" FLRdpHPA,FLRdpHPB
 SG_ FLR2RdrDetn110To114RngRt3 : 264|11@1+ (0.1,-111.11) [-111.11|55.59000000000002] "m/s" FLRdpHPA,FLRdpHPB
 SG_ FLR2RdrDetn110To114RngRt4 : 328|11@1+ (0.1,-111.11) [-111.11|55.59000000000002] "m/s" FLRdpHPA,FLRdpHPB
 SG_ FLR2RdrDetn110To114ScanID : 24|8@1+ (1.0,0.0) [0.0|255.0] "Unitless" FLRdpHPA,FLRdpHPB
 SG_ FLR2RdrDetn110To114SNR0 : 41|7@1+ (0.5,0.0) [0.0|63.5] "dB" FLRdpHPA,FLRdpHPB
 SG_ FLR2RdrDetn110To114SNR1 : 105|7@1+ (0.5,0.0) [0.0|63.5] "dB" FLRdpHPA,FLRdpHPB
 SG_ FLR2RdrDetn110To114SNR2 : 169|7@1+ (0.5,0.0) [0.0|63.5] "dB" FLRdpHPA,FLRdpHPB
 SG_ FLR2RdrDetn110To114SNR3 : 233|7@1+ (0.5,0.0) [0.0|63.5] "dB" FLRdpHPA,FLRdpHPB
 SG_ FLR2RdrDetn110To114SNR4 : 297|7@1+ (0.5,0.0) [0.0|63.5] "dB" FLRdpHPA,FLRdpHPB

BO_ 156 FlrFlr1canFr24 : 64 FLR
 SG_ FLR2RdrDetn115To119_UB : 359|1@0+ (1,0) [0|1] "" FLRdpHPA,FLRdpHPB
 SG_ FLR2RdrDetn115To119AziAng0 : 32|9@1+ (0.0035,-0.87266) [-0.87266|0.91584] "rad" FLRdpHPA,FLRdpHPB
 SG_ FLR2RdrDetn115To119AziAng1 : 96|9@1+ (0.0035,-0.87266) [-0.87266|0.91584] "rad" FLRdpHPA,FLRdpHPB
 SG_ FLR2RdrDetn115To119AziAng2 : 160|9@1+ (0.0035,-0.87266) [-0.87266|0.91584] "rad" FLRdpHPA,FLRdpHPB
 SG_ FLR2RdrDetn115To119AziAng3 : 224|9@1+ (0.0035,-0.87266) [-0.87266|0.91584] "rad" FLRdpHPA,FLRdpHPB
 SG_ FLR2RdrDetn115To119AziAng4 : 288|9@1+ (0.0035,-0.87266) [-0.87266|0.91584] "rad" FLRdpHPA,FLRdpHPB
 SG_ FLR2RdrDetn115To119Counter : 16|8@1+ (1.0,0.0) [0.0|255.0] "Unitless" FLRdpHPA,FLRdpHPB
 SG_ FLR2RdrDetn115To119CRC : 0|16@1+ (1.0,0.0) [0.0|65535.0] "Unitless" FLRdpHPA,FLRdpHPB
 SG_ FLR2RdrDetn115To119DynPrpty0 : 93|1@1+ (1.0,0.0) [0.0|1.0] "Unitless" FLRdpHPA,FLRdpHPB
 SG_ FLR2RdrDetn115To119DynPrpty1 : 157|1@1+ (1.0,0.0) [0.0|1.0] "Unitless" FLRdpHPA,FLRdpHPB
 SG_ FLR2RdrDetn115To119DynPrpty2 : 221|1@1+ (1.0,0.0) [0.0|1.0] "Unitless" FLRdpHPA,FLRdpHPB
 SG_ FLR2RdrDetn115To119DynPrpty3 : 285|1@1+ (1.0,0.0) [0.0|1.0] "Unitless" FLRdpHPA,FLRdpHPB
 SG_ FLR2RdrDetn115To119DynPrpty4 : 349|1@1+ (1.0,0.0) [0.0|1.0] "Unitless" FLRdpHPA,FLRdpHPB
 SG_ FLR2RdrDetn115To119EleAng0 : 64|8@1+ (0.002,0.0) [0.0|0.5] "rad" FLRdpHPA,FLRdpHPB
 SG_ FLR2RdrDetn115To119EleAng1 : 128|8@1+ (0.002,0.0) [0.0|0.5] "rad" FLRdpHPA,FLRdpHPB
 SG_ FLR2RdrDetn115To119EleAng2 : 192|8@1+ (0.002,0.0) [0.0|0.5] "rad" FLRdpHPA,FLRdpHPB
 SG_ FLR2RdrDetn115To119EleAng3 : 256|8@1+ (0.002,0.0) [0.0|0.5] "rad" FLRdpHPA,FLRdpHPB
 SG_ FLR2RdrDetn115To119EleAng4 : 320|8@1+ (0.002,0.0) [0.0|0.5] "rad" FLRdpHPA,FLRdpHPB
 SG_ FLR2RdrDetn115To119Mode0 : 60|2@1+ (1,0) [0|3] "" FLRdpHPA,FLRdpHPB
 SG_ FLR2RdrDetn115To119Mode1 : 124|2@1+ (1,0) [0|3] "" FLRdpHPA,FLRdpHPB
 SG_ FLR2RdrDetn115To119Mode2 : 188|2@1+ (1,0) [0|3] "" FLRdpHPA,FLRdpHPB
 SG_ FLR2RdrDetn115To119Mode3 : 252|2@1+ (1,0) [0|3] "" FLRdpHPA,FLRdpHPB
 SG_ FLR2RdrDetn115To119Mode4 : 316|2@1+ (1,0) [0|3] "" FLRdpHPA,FLRdpHPB
 SG_ FLR2RdrDetn115To119Quality0 : 62|2@1+ (1,0) [0|3] "" FLRdpHPA,FLRdpHPB
 SG_ FLR2RdrDetn115To119Quality1 : 126|2@1+ (1,0) [0|3] "" FLRdpHPA,FLRdpHPB
 SG_ FLR2RdrDetn115To119Quality2 : 190|2@1+ (1,0) [0|3] "" FLRdpHPA,FLRdpHPB
 SG_ FLR2RdrDetn115To119Quality3 : 254|2@1+ (1,0) [0|3] "" FLRdpHPA,FLRdpHPB
 SG_ FLR2RdrDetn115To119Quality4 : 318|2@1+ (1,0) [0|3] "" FLRdpHPA,FLRdpHPB
 SG_ FLR2RdrDetn115To119Range0 : 48|12@1+ (0.1,0.4) [0.4|300.0] "m" FLRdpHPA,FLRdpHPB
 SG_ FLR2RdrDetn115To119Range1 : 112|12@1+ (0.1,0.4) [0.4|300.0] "m" FLRdpHPA,FLRdpHPB
 SG_ FLR2RdrDetn115To119Range2 : 176|12@1+ (0.1,0.4) [0.4|300.0] "m" FLRdpHPA,FLRdpHPB
 SG_ FLR2RdrDetn115To119Range3 : 240|12@1+ (0.1,0.4) [0.4|300.0] "m" FLRdpHPA,FLRdpHPB
 SG_ FLR2RdrDetn115To119Range4 : 304|12@1+ (0.1,0.4) [0.4|300.0] "m" FLRdpHPA,FLRdpHPB
 SG_ FLR2RdrDetn115To119RCS0 : 83|10@1+ (0.2,-100.0) [-100.0|70.0] "dBsm" FLRdpHPA,FLRdpHPB
 SG_ FLR2RdrDetn115To119RCS1 : 147|10@1+ (0.2,-100.0) [-100.0|70.0] "dBsm" FLRdpHPA,FLRdpHPB
 SG_ FLR2RdrDetn115To119RCS2 : 211|10@1+ (0.2,-100.0) [-100.0|70.0] "dBsm" FLRdpHPA,FLRdpHPB
 SG_ FLR2RdrDetn115To119RCS3 : 275|10@1+ (0.2,-100.0) [-100.0|70.0] "dBsm" FLRdpHPA,FLRdpHPB
 SG_ FLR2RdrDetn115To119RCS4 : 339|10@1+ (0.2,-100.0) [-100.0|70.0] "dBsm" FLRdpHPA,FLRdpHPB
 SG_ FLR2RdrDetn115To119RngRt0 : 72|11@1+ (0.1,-111.11) [-111.11|55.59000000000002] "m/s" FLRdpHPA,FLRdpHPB
 SG_ FLR2RdrDetn115To119RngRt1 : 136|11@1+ (0.1,-111.11) [-111.11|55.59000000000002] "m/s" FLRdpHPA,FLRdpHPB
 SG_ FLR2RdrDetn115To119RngRt2 : 200|11@1+ (0.1,-111.11) [-111.11|55.59000000000002] "m/s" FLRdpHPA,FLRdpHPB
 SG_ FLR2RdrDetn115To119RngRt3 : 264|11@1+ (0.1,-111.11) [-111.11|55.59000000000002] "m/s" FLRdpHPA,FLRdpHPB
 SG_ FLR2RdrDetn115To119RngRt4 : 328|11@1+ (0.1,-111.11) [-111.11|55.59000000000002] "m/s" FLRdpHPA,FLRdpHPB
 SG_ FLR2RdrDetn115To119ScanID : 24|8@1+ (1.0,0.0) [0.0|255.0] "Unitless" FLRdpHPA,FLRdpHPB
 SG_ FLR2RdrDetn115To119SNR0 : 41|7@1+ (0.5,0.0) [0.0|63.5] "dB" FLRdpHPA,FLRdpHPB
 SG_ FLR2RdrDetn115To119SNR1 : 105|7@1+ (0.5,0.0) [0.0|63.5] "dB" FLRdpHPA,FLRdpHPB
 SG_ FLR2RdrDetn115To119SNR2 : 169|7@1+ (0.5,0.0) [0.0|63.5] "dB" FLRdpHPA,FLRdpHPB
 SG_ FLR2RdrDetn115To119SNR3 : 233|7@1+ (0.5,0.0) [0.0|63.5] "dB" FLRdpHPA,FLRdpHPB
 SG_ FLR2RdrDetn115To119SNR4 : 297|7@1+ (0.5,0.0) [0.0|63.5] "dB" FLRdpHPA,FLRdpHPB

BO_ 160 FlrFlr1canFr25 : 64 FLR
 SG_ FLR2RdrDetn120To124_UB : 359|1@0+ (1,0) [0|1] "" FLRdpHPA,FLRdpHPB
 SG_ FLR2RdrDetn120To124AziAng0 : 32|9@1+ (0.0035,-0.87266) [-0.87266|0.91584] "rad" FLRdpHPA,FLRdpHPB
 SG_ FLR2RdrDetn120To124AziAng1 : 96|9@1+ (0.0035,-0.87266) [-0.87266|0.91584] "rad" FLRdpHPA,FLRdpHPB
 SG_ FLR2RdrDetn120To124AziAng2 : 160|9@1+ (0.0035,-0.87266) [-0.87266|0.91584] "rad" FLRdpHPA,FLRdpHPB
 SG_ FLR2RdrDetn120To124AziAng3 : 224|9@1+ (0.0035,-0.87266) [-0.87266|0.91584] "rad" FLRdpHPA,FLRdpHPB
 SG_ FLR2RdrDetn120To124AziAng4 : 288|9@1+ (0.0035,-0.87266) [-0.87266|0.91584] "rad" FLRdpHPA,FLRdpHPB
 SG_ FLR2RdrDetn120To124Counter : 16|8@1+ (1.0,0.0) [0.0|255.0] "Unitless" FLRdpHPA,FLRdpHPB
 SG_ FLR2RdrDetn120To124CRC : 0|16@1+ (1.0,0.0) [0.0|65535.0] "Unitless" FLRdpHPA,FLRdpHPB
 SG_ FLR2RdrDetn120To124DynPrpty0 : 93|1@1+ (1.0,0.0) [0.0|1.0] "Unitless" FLRdpHPA,FLRdpHPB
 SG_ FLR2RdrDetn120To124DynPrpty1 : 157|1@1+ (1.0,0.0) [0.0|1.0] "Unitless" FLRdpHPA,FLRdpHPB
 SG_ FLR2RdrDetn120To124DynPrpty2 : 221|1@1+ (1.0,0.0) [0.0|1.0] "Unitless" FLRdpHPA,FLRdpHPB
 SG_ FLR2RdrDetn120To124DynPrpty3 : 285|1@1+ (1.0,0.0) [0.0|1.0] "Unitless" FLRdpHPA,FLRdpHPB
 SG_ FLR2RdrDetn120To124DynPrpty4 : 349|1@1+ (1.0,0.0) [0.0|1.0] "Unitless" FLRdpHPA,FLRdpHPB
 SG_ FLR2RdrDetn120To124EleAng0 : 64|8@1+ (0.002,0.0) [0.0|0.5] "rad" FLRdpHPA,FLRdpHPB
 SG_ FLR2RdrDetn120To124EleAng1 : 128|8@1+ (0.002,0.0) [0.0|0.5] "rad" FLRdpHPA,FLRdpHPB
 SG_ FLR2RdrDetn120To124EleAng2 : 192|8@1+ (0.002,0.0) [0.0|0.5] "rad" FLRdpHPA,FLRdpHPB
 SG_ FLR2RdrDetn120To124EleAng3 : 256|8@1+ (0.002,0.0) [0.0|0.5] "rad" FLRdpHPA,FLRdpHPB
 SG_ FLR2RdrDetn120To124EleAng4 : 320|8@1+ (0.002,0.0) [0.0|0.5] "rad" FLRdpHPA,FLRdpHPB
 SG_ FLR2RdrDetn120To124Mode0 : 60|2@1+ (1,0) [0|3] "" FLRdpHPA,FLRdpHPB
 SG_ FLR2RdrDetn120To124Mode1 : 124|2@1+ (1,0) [0|3] "" FLRdpHPA,FLRdpHPB
 SG_ FLR2RdrDetn120To124Mode2 : 188|2@1+ (1,0) [0|3] "" FLRdpHPA,FLRdpHPB
 SG_ FLR2RdrDetn120To124Mode3 : 252|2@1+ (1,0) [0|3] "" FLRdpHPA,FLRdpHPB
 SG_ FLR2RdrDetn120To124Mode4 : 316|2@1+ (1,0) [0|3] "" FLRdpHPA,FLRdpHPB
 SG_ FLR2RdrDetn120To124Quality0 : 62|2@1+ (1,0) [0|3] "" FLRdpHPA,FLRdpHPB
 SG_ FLR2RdrDetn120To124Quality1 : 126|2@1+ (1,0) [0|3] "" FLRdpHPA,FLRdpHPB
 SG_ FLR2RdrDetn120To124Quality2 : 190|2@1+ (1,0) [0|3] "" FLRdpHPA,FLRdpHPB
 SG_ FLR2RdrDetn120To124Quality3 : 254|2@1+ (1,0) [0|3] "" FLRdpHPA,FLRdpHPB
 SG_ FLR2RdrDetn120To124Quality4 : 318|2@1+ (1,0) [0|3] "" FLRdpHPA,FLRdpHPB
 SG_ FLR2RdrDetn120To124Range0 : 48|12@1+ (0.1,0.4) [0.4|300.0] "m" FLRdpHPA,FLRdpHPB
 SG_ FLR2RdrDetn120To124Range1 : 112|12@1+ (0.1,0.4) [0.4|300.0] "m" FLRdpHPA,FLRdpHPB
 SG_ FLR2RdrDetn120To124Range2 : 176|12@1+ (0.1,0.4) [0.4|300.0] "m" FLRdpHPA,FLRdpHPB
 SG_ FLR2RdrDetn120To124Range3 : 240|12@1+ (0.1,0.4) [0.4|300.0] "m" FLRdpHPA,FLRdpHPB
 SG_ FLR2RdrDetn120To124Range4 : 304|12@1+ (0.1,0.4) [0.4|300.0] "m" FLRdpHPA,FLRdpHPB
 SG_ FLR2RdrDetn120To124RCS0 : 83|10@1+ (0.2,-100.0) [-100.0|70.0] "dBsm" FLRdpHPA,FLRdpHPB
 SG_ FLR2RdrDetn120To124RCS1 : 147|10@1+ (0.2,-100.0) [-100.0|70.0] "dBsm" FLRdpHPA,FLRdpHPB
 SG_ FLR2RdrDetn120To124RCS2 : 211|10@1+ (0.2,-100.0) [-100.0|70.0] "dBsm" FLRdpHPA,FLRdpHPB
 SG_ FLR2RdrDetn120To124RCS3 : 275|10@1+ (0.2,-100.0) [-100.0|70.0] "dBsm" FLRdpHPA,FLRdpHPB
 SG_ FLR2RdrDetn120To124RCS4 : 339|10@1+ (0.2,-100.0) [-100.0|70.0] "dBsm" FLRdpHPA,FLRdpHPB
 SG_ FLR2RdrDetn120To124RngRt0 : 72|11@1+ (0.1,-111.11) [-111.11|55.59000000000002] "m/s" FLRdpHPA,FLRdpHPB
 SG_ FLR2RdrDetn120To124RngRt1 : 136|11@1+ (0.1,-111.11) [-111.11|55.59000000000002] "m/s" FLRdpHPA,FLRdpHPB
 SG_ FLR2RdrDetn120To124RngRt2 : 200|11@1+ (0.1,-111.11) [-111.11|55.59000000000002] "m/s" FLRdpHPA,FLRdpHPB
 SG_ FLR2RdrDetn120To124RngRt3 : 264|11@1+ (0.1,-111.11) [-111.11|55.59000000000002] "m/s" FLRdpHPA,FLRdpHPB
 SG_ FLR2RdrDetn120To124RngRt4 : 328|11@1+ (0.1,-111.11) [-111.11|55.59000000000002] "m/s" FLRdpHPA,FLRdpHPB
 SG_ FLR2RdrDetn120To124ScanID : 24|8@1+ (1.0,0.0) [0.0|255.0] "Unitless" FLRdpHPA,FLRdpHPB
 SG_ FLR2RdrDetn120To124SNR0 : 41|7@1+ (0.5,0.0) [0.0|63.5] "dB" FLRdpHPA,FLRdpHPB
 SG_ FLR2RdrDetn120To124SNR1 : 105|7@1+ (0.5,0.0) [0.0|63.5] "dB" FLRdpHPA,FLRdpHPB
 SG_ FLR2RdrDetn120To124SNR2 : 169|7@1+ (0.5,0.0) [0.0|63.5] "dB" FLRdpHPA,FLRdpHPB
 SG_ FLR2RdrDetn120To124SNR3 : 233|7@1+ (0.5,0.0) [0.0|63.5] "dB" FLRdpHPA,FLRdpHPB
 SG_ FLR2RdrDetn120To124SNR4 : 297|7@1+ (0.5,0.0) [0.0|63.5] "dB" FLRdpHPA,FLRdpHPB

BO_ 163 FlrFlr1canFr26 : 64 FLR
 SG_ FLR2RdrDetn125To129_UB : 359|1@0+ (1,0) [0|1] "" FLRdpHPA,FLRdpHPB
 SG_ FLR2RdrDetn125To129AziAng0 : 32|9@1+ (0.0035,-0.87266) [-0.87266|0.91584] "rad" FLRdpHPA,FLRdpHPB
 SG_ FLR2RdrDetn125To129AziAng1 : 96|9@1+ (0.0035,-0.87266) [-0.87266|0.91584] "rad" FLRdpHPA,FLRdpHPB
 SG_ FLR2RdrDetn125To129AziAng2 : 160|9@1+ (0.0035,-0.87266) [-0.87266|0.91584] "rad" FLRdpHPA,FLRdpHPB
 SG_ FLR2RdrDetn125To129AziAng3 : 224|9@1+ (0.0035,-0.87266) [-0.87266|0.91584] "rad" FLRdpHPA,FLRdpHPB
 SG_ FLR2RdrDetn125To129AziAng4 : 288|9@1+ (0.0035,-0.87266) [-0.87266|0.91584] "rad" FLRdpHPA,FLRdpHPB
 SG_ FLR2RdrDetn125To129Counter : 16|8@1+ (1.0,0.0) [0.0|255.0] "Unitless" FLRdpHPA,FLRdpHPB
 SG_ FLR2RdrDetn125To129CRC : 0|16@1+ (1.0,0.0) [0.0|65535.0] "Unitless" FLRdpHPA,FLRdpHPB
 SG_ FLR2RdrDetn125To129DynPrpty0 : 93|1@1+ (1.0,0.0) [0.0|1.0] "Unitless" FLRdpHPA,FLRdpHPB
 SG_ FLR2RdrDetn125To129DynPrpty1 : 157|1@1+ (1.0,0.0) [0.0|1.0] "Unitless" FLRdpHPA,FLRdpHPB
 SG_ FLR2RdrDetn125To129DynPrpty2 : 221|1@1+ (1.0,0.0) [0.0|1.0] "Unitless" FLRdpHPA,FLRdpHPB
 SG_ FLR2RdrDetn125To129DynPrpty3 : 285|1@1+ (1.0,0.0) [0.0|1.0] "Unitless" FLRdpHPA,FLRdpHPB
 SG_ FLR2RdrDetn125To129DynPrpty4 : 349|1@1+ (1.0,0.0) [0.0|1.0] "Unitless" FLRdpHPA,FLRdpHPB
 SG_ FLR2RdrDetn125To129EleAng0 : 64|8@1+ (0.002,0.0) [0.0|0.5] "rad" FLRdpHPA,FLRdpHPB
 SG_ FLR2RdrDetn125To129EleAng1 : 128|8@1+ (0.002,0.0) [0.0|0.5] "rad" FLRdpHPA,FLRdpHPB
 SG_ FLR2RdrDetn125To129EleAng2 : 192|8@1+ (0.002,0.0) [0.0|0.5] "rad" FLRdpHPA,FLRdpHPB
 SG_ FLR2RdrDetn125To129EleAng3 : 256|8@1+ (0.002,0.0) [0.0|0.5] "rad" FLRdpHPA,FLRdpHPB
 SG_ FLR2RdrDetn125To129EleAng4 : 320|8@1+ (0.002,0.0) [0.0|0.5] "rad" FLRdpHPA,FLRdpHPB
 SG_ FLR2RdrDetn125To129Mode0 : 60|2@1+ (1,0) [0|3] "" FLRdpHPA,FLRdpHPB
 SG_ FLR2RdrDetn125To129Mode1 : 124|2@1+ (1,0) [0|3] "" FLRdpHPA,FLRdpHPB
 SG_ FLR2RdrDetn125To129Mode2 : 188|2@1+ (1,0) [0|3] "" FLRdpHPA,FLRdpHPB
 SG_ FLR2RdrDetn125To129Mode3 : 252|2@1+ (1,0) [0|3] "" FLRdpHPA,FLRdpHPB
 SG_ FLR2RdrDetn125To129Mode4 : 316|2@1+ (1,0) [0|3] "" FLRdpHPA,FLRdpHPB
 SG_ FLR2RdrDetn125To129Quality0 : 62|2@1+ (1,0) [0|3] "" FLRdpHPA,FLRdpHPB
 SG_ FLR2RdrDetn125To129Quality1 : 126|2@1+ (1,0) [0|3] "" FLRdpHPA,FLRdpHPB
 SG_ FLR2RdrDetn125To129Quality2 : 190|2@1+ (1,0) [0|3] "" FLRdpHPA,FLRdpHPB
 SG_ FLR2RdrDetn125To129Quality3 : 254|2@1+ (1,0) [0|3] "" FLRdpHPA,FLRdpHPB
 SG_ FLR2RdrDetn125To129Quality4 : 318|2@1+ (1,0) [0|3] "" FLRdpHPA,FLRdpHPB
 SG_ FLR2RdrDetn125To129Range0 : 48|12@1+ (0.1,0.4) [0.4|300.0] "m" FLRdpHPA,FLRdpHPB
 SG_ FLR2RdrDetn125To129Range1 : 112|12@1+ (0.1,0.4) [0.4|300.0] "m" FLRdpHPA,FLRdpHPB
 SG_ FLR2RdrDetn125To129Range2 : 176|12@1+ (0.1,0.4) [0.4|300.0] "m" FLRdpHPA,FLRdpHPB
 SG_ FLR2RdrDetn125To129Range3 : 240|12@1+ (0.1,0.4) [0.4|300.0] "m" FLRdpHPA,FLRdpHPB
 SG_ FLR2RdrDetn125To129Range4 : 304|12@1+ (0.1,0.4) [0.4|300.0] "m" FLRdpHPA,FLRdpHPB
 SG_ FLR2RdrDetn125To129RCS0 : 83|10@1+ (0.2,-100.0) [-100.0|70.0] "dBsm" FLRdpHPA,FLRdpHPB
 SG_ FLR2RdrDetn125To129RCS1 : 147|10@1+ (0.2,-100.0) [-100.0|70.0] "dBsm" FLRdpHPA,FLRdpHPB
 SG_ FLR2RdrDetn125To129RCS2 : 211|10@1+ (0.2,-100.0) [-100.0|70.0] "dBsm" FLRdpHPA,FLRdpHPB
 SG_ FLR2RdrDetn125To129RCS3 : 275|10@1+ (0.2,-100.0) [-100.0|70.0] "dBsm" FLRdpHPA,FLRdpHPB
 SG_ FLR2RdrDetn125To129RCS4 : 339|10@1+ (0.2,-100.0) [-100.0|70.0] "dBsm" FLRdpHPA,FLRdpHPB
 SG_ FLR2RdrDetn125To129RngRt0 : 72|11@1+ (0.1,-111.11) [-111.11|55.59000000000002] "m/s" FLRdpHPA,FLRdpHPB
 SG_ FLR2RdrDetn125To129RngRt1 : 136|11@1+ (0.1,-111.11) [-111.11|55.59000000000002] "m/s" FLRdpHPA,FLRdpHPB
 SG_ FLR2RdrDetn125To129RngRt2 : 200|11@1+ (0.1,-111.11) [-111.11|55.59000000000002] "m/s" FLRdpHPA,FLRdpHPB
 SG_ FLR2RdrDetn125To129RngRt3 : 264|11@1+ (0.1,-111.11) [-111.11|55.59000000000002] "m/s" FLRdpHPA,FLRdpHPB
 SG_ FLR2RdrDetn125To129RngRt4 : 328|11@1+ (0.1,-111.11) [-111.11|55.59000000000002] "m/s" FLRdpHPA,FLRdpHPB
 SG_ FLR2RdrDetn125To129ScanID : 24|8@1+ (1.0,0.0) [0.0|255.0] "Unitless" FLRdpHPA,FLRdpHPB
 SG_ FLR2RdrDetn125To129SNR0 : 41|7@1+ (0.5,0.0) [0.0|63.5] "dB" FLRdpHPA,FLRdpHPB
 SG_ FLR2RdrDetn125To129SNR1 : 105|7@1+ (0.5,0.0) [0.0|63.5] "dB" FLRdpHPA,FLRdpHPB
 SG_ FLR2RdrDetn125To129SNR2 : 169|7@1+ (0.5,0.0) [0.0|63.5] "dB" FLRdpHPA,FLRdpHPB
 SG_ FLR2RdrDetn125To129SNR3 : 233|7@1+ (0.5,0.0) [0.0|63.5] "dB" FLRdpHPA,FLRdpHPB
 SG_ FLR2RdrDetn125To129SNR4 : 297|7@1+ (0.5,0.0) [0.0|63.5] "dB" FLRdpHPA,FLRdpHPB

CM_ SG_ 118 FLR2RdrDetn060To064AziAng0 "Azimuth Angle";
CM_ SG_ 118 FLR2RdrDetn060To064AziAng1 "Azimuth Angle";
CM_ SG_ 118 FLR2RdrDetn060To064AziAng2 "Azimuth Angle";
CM_ SG_ 118 FLR2RdrDetn060To064AziAng3 "Azimuth Angle";
CM_ SG_ 118 FLR2RdrDetn060To064AziAng4 "Azimuth Angle";
CM_ SG_ 118 FLR2RdrDetn060To064DynPrpty0 "Moving/Stationary";
CM_ SG_ 118 FLR2RdrDetn060To064DynPrpty1 "Moving/Stationary";
CM_ SG_ 118 FLR2RdrDetn060To064DynPrpty2 "Moving/Stationary";
CM_ SG_ 118 FLR2RdrDetn060To064DynPrpty3 "Moving/Stationary";
CM_ SG_ 118 FLR2RdrDetn060To064DynPrpty4 "Moving/Stationary";
CM_ SG_ 118 FLR2RdrDetn060To064EleAng0 "Elevation angle";
CM_ SG_ 118 FLR2RdrDetn060To064EleAng1 "Elevation angle";
CM_ SG_ 118 FLR2RdrDetn060To064EleAng2 "Elevation angle";
CM_ SG_ 118 FLR2RdrDetn060To064EleAng3 "Elevation angle";
CM_ SG_ 118 FLR2RdrDetn060To064EleAng4 "Elevation angle";
CM_ SG_ 118 FLR2RdrDetn060To064Mode0 "What chirp mode the detection is from";
CM_ SG_ 118 FLR2RdrDetn060To064Mode1 "What chirp mode the detection is from";
CM_ SG_ 118 FLR2RdrDetn060To064Mode2 "What chirp mode the detection is from";
CM_ SG_ 118 FLR2RdrDetn060To064Mode3 "What chirp mode the detection is from";
CM_ SG_ 118 FLR2RdrDetn060To064Mode4 "What chirp mode the detection is from";
CM_ SG_ 118 FLR2RdrDetn060To064Quality0 "Quality";
CM_ SG_ 118 FLR2RdrDetn060To064Quality1 "Quality";
CM_ SG_ 118 FLR2RdrDetn060To064Quality2 "Quality";
CM_ SG_ 118 FLR2RdrDetn060To064Quality3 "Quality";
CM_ SG_ 118 FLR2RdrDetn060To064Quality4 "Quality";
CM_ SG_ 118 FLR2RdrDetn060To064Range0 "Range from sensor to object";
CM_ SG_ 118 FLR2RdrDetn060To064Range1 "Range from sensor to object";
CM_ SG_ 118 FLR2RdrDetn060To064Range2 "Range from sensor to object";
CM_ SG_ 118 FLR2RdrDetn060To064Range3 "Range from sensor to object";
CM_ SG_ 118 FLR2RdrDetn060To064Range4 "Range from sensor to object";
CM_ SG_ 118 FLR2RdrDetn060To064RCS0 "RCS";
CM_ SG_ 118 FLR2RdrDetn060To064RCS1 "RCS";
CM_ SG_ 118 FLR2RdrDetn060To064RCS2 "RCS";
CM_ SG_ 118 FLR2RdrDetn060To064RCS3 "RCS";
CM_ SG_ 118 FLR2RdrDetn060To064RCS4 "RCS";
CM_ SG_ 118 FLR2RdrDetn060To064RngRt0 "Speed towards/away from the sensor";
CM_ SG_ 118 FLR2RdrDetn060To064RngRt1 "Speed towards/away from the sensor";
CM_ SG_ 118 FLR2RdrDetn060To064RngRt2 "Speed towards/away from the sensor";
CM_ SG_ 118 FLR2RdrDetn060To064RngRt3 "Speed towards/away from the sensor";
CM_ SG_ 118 FLR2RdrDetn060To064RngRt4 "Speed towards/away from the sensor";
CM_ SG_ 118 FLR2RdrDetn060To064ScanID "Value to tie status, detection data and object data frames together";
CM_ SG_ 118 FLR2RdrDetn060To064SNR0 "Signal to Noise Ratio";
CM_ SG_ 118 FLR2RdrDetn060To064SNR1 "Signal to Noise Ration";
CM_ SG_ 118 FLR2RdrDetn060To064SNR2 "Signal to Noise Ration";
CM_ SG_ 118 FLR2RdrDetn060To064SNR3 "Signal to Noise Ration";
CM_ SG_ 118 FLR2RdrDetn060To064SNR4 "Signal to Noise Ration";
CM_ SG_ 121 FLR2RdrDetn065To069AziAng0 "Azimuth Angle";
CM_ SG_ 121 FLR2RdrDetn065To069AziAng1 "Azimuth Angle";
CM_ SG_ 121 FLR2RdrDetn065To069AziAng2 "Azimuth Angle";
CM_ SG_ 121 FLR2RdrDetn065To069AziAng3 "Azimuth Angle";
CM_ SG_ 121 FLR2RdrDetn065To069AziAng4 "Azimuth Angle";
CM_ SG_ 121 FLR2RdrDetn065To069DynPrpty0 "Moving/Stationary";
CM_ SG_ 121 FLR2RdrDetn065To069DynPrpty1 "Moving/Stationary";
CM_ SG_ 121 FLR2RdrDetn065To069DynPrpty2 "Moving/Stationary";
CM_ SG_ 121 FLR2RdrDetn065To069DynPrpty3 "Moving/Stationary";
CM_ SG_ 121 FLR2RdrDetn065To069DynPrpty4 "Moving/Stationary";
CM_ SG_ 121 FLR2RdrDetn065To069EleAng0 "Elevation angle";
CM_ SG_ 121 FLR2RdrDetn065To069EleAng1 "Elevation angle";
CM_ SG_ 121 FLR2RdrDetn065To069EleAng2 "Elevation angle";
CM_ SG_ 121 FLR2RdrDetn065To069EleAng3 "Elevation angle";
CM_ SG_ 121 FLR2RdrDetn065To069EleAng4 "Elevation angle";
CM_ SG_ 121 FLR2RdrDetn065To069Mode0 "What chirp mode the detection is from";
CM_ SG_ 121 FLR2RdrDetn065To069Mode1 "What chirp mode the detection is from";
CM_ SG_ 121 FLR2RdrDetn065To069Mode2 "What chirp mode the detection is from";
CM_ SG_ 121 FLR2RdrDetn065To069Mode3 "What chirp mode the detection is from";
CM_ SG_ 121 FLR2RdrDetn065To069Mode4 "What chirp mode the detection is from";
CM_ SG_ 121 FLR2RdrDetn065To069Quality0 "Quality";
CM_ SG_ 121 FLR2RdrDetn065To069Quality1 "Quality";
CM_ SG_ 121 FLR2RdrDetn065To069Quality2 "Quality";
CM_ SG_ 121 FLR2RdrDetn065To069Quality3 "Quality";
CM_ SG_ 121 FLR2RdrDetn065To069Quality4 "Quality";
CM_ SG_ 121 FLR2RdrDetn065To069Range0 "Range from sensor to object";
CM_ SG_ 121 FLR2RdrDetn065To069Range1 "Range from sensor to object";
CM_ SG_ 121 FLR2RdrDetn065To069Range2 "Range from sensor to object";
CM_ SG_ 121 FLR2RdrDetn065To069Range3 "Range from sensor to object";
CM_ SG_ 121 FLR2RdrDetn065To069Range4 "Range from sensor to object";
CM_ SG_ 121 FLR2RdrDetn065To069RCS0 "RCS";
CM_ SG_ 121 FLR2RdrDetn065To069RCS1 "RCS";
CM_ SG_ 121 FLR2RdrDetn065To069RCS2 "RCS";
CM_ SG_ 121 FLR2RdrDetn065To069RCS3 "RCS";
CM_ SG_ 121 FLR2RdrDetn065To069RCS4 "RCS";
CM_ SG_ 121 FLR2RdrDetn065To069RngRt0 "Speed towards/away from the sensor";
CM_ SG_ 121 FLR2RdrDetn065To069RngRt1 "Speed towards/away from the sensor";
CM_ SG_ 121 FLR2RdrDetn065To069RngRt2 "Speed towards/away from the sensor";
CM_ SG_ 121 FLR2RdrDetn065To069RngRt3 "Speed towards/away from the sensor";
CM_ SG_ 121 FLR2RdrDetn065To069RngRt4 "Speed towards/away from the sensor";
CM_ SG_ 121 FLR2RdrDetn065To069ScanID "Value to tie status, detection data and object data frames together";
CM_ SG_ 121 FLR2RdrDetn065To069SNR0 "Signal to Noise Ratio";
CM_ SG_ 121 FLR2RdrDetn065To069SNR1 "Signal to Noise Ration";
CM_ SG_ 121 FLR2RdrDetn065To069SNR2 "Signal to Noise Ration";
CM_ SG_ 121 FLR2RdrDetn065To069SNR3 "Signal to Noise Ration";
CM_ SG_ 121 FLR2RdrDetn065To069SNR4 "Signal to Noise Ration";
CM_ SG_ 124 FLR2RdrDetn070To074AziAng0 "Azimuth Angle";
CM_ SG_ 124 FLR2RdrDetn070To074AziAng1 "Azimuth Angle";
CM_ SG_ 124 FLR2RdrDetn070To074AziAng2 "Azimuth Angle";
CM_ SG_ 124 FLR2RdrDetn070To074AziAng3 "Azimuth Angle";
CM_ SG_ 124 FLR2RdrDetn070To074AziAng4 "Azimuth Angle";
CM_ SG_ 124 FLR2RdrDetn070To074DynPrpty0 "Moving/Stationary";
CM_ SG_ 124 FLR2RdrDetn070To074DynPrpty1 "Moving/Stationary";
CM_ SG_ 124 FLR2RdrDetn070To074DynPrpty2 "Moving/Stationary";
CM_ SG_ 124 FLR2RdrDetn070To074DynPrpty3 "Moving/Stationary";
CM_ SG_ 124 FLR2RdrDetn070To074DynPrpty4 "Moving/Stationary";
CM_ SG_ 124 FLR2RdrDetn070To074EleAng0 "Elevation angle";
CM_ SG_ 124 FLR2RdrDetn070To074EleAng1 "Elevation angle";
CM_ SG_ 124 FLR2RdrDetn070To074EleAng2 "Elevation angle";
CM_ SG_ 124 FLR2RdrDetn070To074EleAng3 "Elevation angle";
CM_ SG_ 124 FLR2RdrDetn070To074EleAng4 "Elevation angle";
CM_ SG_ 124 FLR2RdrDetn070To074Mode0 "What chirp mode the detection is from";
CM_ SG_ 124 FLR2RdrDetn070To074Mode1 "What chirp mode the detection is from";
CM_ SG_ 124 FLR2RdrDetn070To074Mode2 "What chirp mode the detection is from";
CM_ SG_ 124 FLR2RdrDetn070To074Mode3 "What chirp mode the detection is from";
CM_ SG_ 124 FLR2RdrDetn070To074Mode4 "What chirp mode the detection is from";
CM_ SG_ 124 FLR2RdrDetn070To074Quality0 "Quality";
CM_ SG_ 124 FLR2RdrDetn070To074Quality1 "Quality";
CM_ SG_ 124 FLR2RdrDetn070To074Quality2 "Quality";
CM_ SG_ 124 FLR2RdrDetn070To074Quality3 "Quality";
CM_ SG_ 124 FLR2RdrDetn070To074Quality4 "Quality";
CM_ SG_ 124 FLR2RdrDetn070To074Range0 "Range from sensor to object";
CM_ SG_ 124 FLR2RdrDetn070To074Range1 "Range from sensor to object";
CM_ SG_ 124 FLR2RdrDetn070To074Range2 "Range from sensor to object";
CM_ SG_ 124 FLR2RdrDetn070To074Range3 "Range from sensor to object";
CM_ SG_ 124 FLR2RdrDetn070To074Range4 "Range from sensor to object";
CM_ SG_ 124 FLR2RdrDetn070To074RCS0 "RCS";
CM_ SG_ 124 FLR2RdrDetn070To074RCS1 "RCS";
CM_ SG_ 124 FLR2RdrDetn070To074RCS2 "RCS";
CM_ SG_ 124 FLR2RdrDetn070To074RCS3 "RCS";
CM_ SG_ 124 FLR2RdrDetn070To074RCS4 "RCS";
CM_ SG_ 124 FLR2RdrDetn070To074RngRt0 "Speed towards/away from the sensor";
CM_ SG_ 124 FLR2RdrDetn070To074RngRt1 "Speed towards/away from the sensor";
CM_ SG_ 124 FLR2RdrDetn070To074RngRt2 "Speed towards/away from the sensor";
CM_ SG_ 124 FLR2RdrDetn070To074RngRt3 "Speed towards/away from the sensor";
CM_ SG_ 124 FLR2RdrDetn070To074RngRt4 "Speed towards/away from the sensor";
CM_ SG_ 124 FLR2RdrDetn070To074ScanID "Value to tie status, detection data and object data frames together";
CM_ SG_ 124 FLR2RdrDetn070To074SNR0 "Signal to Noise Ratio";
CM_ SG_ 124 FLR2RdrDetn070To074SNR1 "Signal to Noise Ration";
CM_ SG_ 124 FLR2RdrDetn070To074SNR2 "Signal to Noise Ration";
CM_ SG_ 124 FLR2RdrDetn070To074SNR3 "Signal to Noise Ration";
CM_ SG_ 124 FLR2RdrDetn070To074SNR4 "Signal to Noise Ration";
CM_ SG_ 131 FLR2RdrDetn075To079AziAng0 "Azimuth Angle";
CM_ SG_ 131 FLR2RdrDetn075To079AziAng1 "Azimuth Angle";
CM_ SG_ 131 FLR2RdrDetn075To079AziAng2 "Azimuth Angle";
CM_ SG_ 131 FLR2RdrDetn075To079AziAng3 "Azimuth Angle";
CM_ SG_ 131 FLR2RdrDetn075To079AziAng4 "Azimuth Angle";
CM_ SG_ 131 FLR2RdrDetn075To079DynPrpty0 "Moving/Stationary";
CM_ SG_ 131 FLR2RdrDetn075To079DynPrpty1 "Moving/Stationary";
CM_ SG_ 131 FLR2RdrDetn075To079DynPrpty2 "Moving/Stationary";
CM_ SG_ 131 FLR2RdrDetn075To079DynPrpty3 "Moving/Stationary";
CM_ SG_ 131 FLR2RdrDetn075To079DynPrpty4 "Moving/Stationary";
CM_ SG_ 131 FLR2RdrDetn075To079EleAng0 "Elevation angle";
CM_ SG_ 131 FLR2RdrDetn075To079EleAng1 "Elevation angle";
CM_ SG_ 131 FLR2RdrDetn075To079EleAng2 "Elevation angle";
CM_ SG_ 131 FLR2RdrDetn075To079EleAng3 "Elevation angle";
CM_ SG_ 131 FLR2RdrDetn075To079EleAng4 "Elevation angle";
CM_ SG_ 131 FLR2RdrDetn075To079Mode0 "What chirp mode the detection is from";
CM_ SG_ 131 FLR2RdrDetn075To079Mode1 "What chirp mode the detection is from";
CM_ SG_ 131 FLR2RdrDetn075To079Mode2 "What chirp mode the detection is from";
CM_ SG_ 131 FLR2RdrDetn075To079Mode3 "What chirp mode the detection is from";
CM_ SG_ 131 FLR2RdrDetn075To079Mode4 "What chirp mode the detection is from";
CM_ SG_ 131 FLR2RdrDetn075To079Quality0 "Quality";
CM_ SG_ 131 FLR2RdrDetn075To079Quality1 "Quality";
CM_ SG_ 131 FLR2RdrDetn075To079Quality2 "Quality";
CM_ SG_ 131 FLR2RdrDetn075To079Quality3 "Quality";
CM_ SG_ 131 FLR2RdrDetn075To079Quality4 "Quality";
CM_ SG_ 131 FLR2RdrDetn075To079Range0 "Range from sensor to object";
CM_ SG_ 131 FLR2RdrDetn075To079Range1 "Range from sensor to object";
CM_ SG_ 131 FLR2RdrDetn075To079Range2 "Range from sensor to object";
CM_ SG_ 131 FLR2RdrDetn075To079Range3 "Range from sensor to object";
CM_ SG_ 131 FLR2RdrDetn075To079Range4 "Range from sensor to object";
CM_ SG_ 131 FLR2RdrDetn075To079RCS0 "RCS";
CM_ SG_ 131 FLR2RdrDetn075To079RCS1 "RCS";
CM_ SG_ 131 FLR2RdrDetn075To079RCS2 "RCS";
CM_ SG_ 131 FLR2RdrDetn075To079RCS3 "RCS";
CM_ SG_ 131 FLR2RdrDetn075To079RCS4 "RCS";
CM_ SG_ 131 FLR2RdrDetn075To079RngRt0 "Speed towards/away from the sensor";
CM_ SG_ 131 FLR2RdrDetn075To079RngRt1 "Speed towards/away from the sensor";
CM_ SG_ 131 FLR2RdrDetn075To079RngRt2 "Speed towards/away from the sensor";
CM_ SG_ 131 FLR2RdrDetn075To079RngRt3 "Speed towards/away from the sensor";
CM_ SG_ 131 FLR2RdrDetn075To079RngRt4 "Speed towards/away from the sensor";
CM_ SG_ 131 FLR2RdrDetn075To079ScanID "Value to tie status, detection data and object data frames together";
CM_ SG_ 131 FLR2RdrDetn075To079SNR0 "Signal to Noise Ratio";
CM_ SG_ 131 FLR2RdrDetn075To079SNR1 "Signal to Noise Ration";
CM_ SG_ 131 FLR2RdrDetn075To079SNR2 "Signal to Noise Ration";
CM_ SG_ 131 FLR2RdrDetn075To079SNR3 "Signal to Noise Ration";
CM_ SG_ 131 FLR2RdrDetn075To079SNR4 "Signal to Noise Ration";
CM_ SG_ 134 FLR2RdrDetn080To084AziAng0 "Azimuth Angle";
CM_ SG_ 134 FLR2RdrDetn080To084AziAng1 "Azimuth Angle";
CM_ SG_ 134 FLR2RdrDetn080To084AziAng2 "Azimuth Angle";
CM_ SG_ 134 FLR2RdrDetn080To084AziAng3 "Azimuth Angle";
CM_ SG_ 134 FLR2RdrDetn080To084AziAng4 "Azimuth Angle";
CM_ SG_ 134 FLR2RdrDetn080To084DynPrpty0 "Moving/Stationary";
CM_ SG_ 134 FLR2RdrDetn080To084DynPrpty1 "Moving/Stationary";
CM_ SG_ 134 FLR2RdrDetn080To084DynPrpty2 "Moving/Stationary";
CM_ SG_ 134 FLR2RdrDetn080To084DynPrpty3 "Moving/Stationary";
CM_ SG_ 134 FLR2RdrDetn080To084DynPrpty4 "Moving/Stationary";
CM_ SG_ 134 FLR2RdrDetn080To084EleAng0 "Elevation angle";
CM_ SG_ 134 FLR2RdrDetn080To084EleAng1 "Elevation angle";
CM_ SG_ 134 FLR2RdrDetn080To084EleAng2 "Elevation angle";
CM_ SG_ 134 FLR2RdrDetn080To084EleAng3 "Elevation angle";
CM_ SG_ 134 FLR2RdrDetn080To084EleAng4 "Elevation angle";
CM_ SG_ 134 FLR2RdrDetn080To084Mode0 "What chirp mode the detection is from";
CM_ SG_ 134 FLR2RdrDetn080To084Mode1 "What chirp mode the detection is from";
CM_ SG_ 134 FLR2RdrDetn080To084Mode2 "What chirp mode the detection is from";
CM_ SG_ 134 FLR2RdrDetn080To084Mode3 "What chirp mode the detection is from";
CM_ SG_ 134 FLR2RdrDetn080To084Mode4 "What chirp mode the detection is from";
CM_ SG_ 134 FLR2RdrDetn080To084Quality0 "Quality";
CM_ SG_ 134 FLR2RdrDetn080To084Quality1 "Quality";
CM_ SG_ 134 FLR2RdrDetn080To084Quality2 "Quality";
CM_ SG_ 134 FLR2RdrDetn080To084Quality3 "Quality";
CM_ SG_ 134 FLR2RdrDetn080To084Quality4 "Quality";
CM_ SG_ 134 FLR2RdrDetn080To084Range0 "Range from sensor to object";
CM_ SG_ 134 FLR2RdrDetn080To084Range1 "Range from sensor to object";
CM_ SG_ 134 FLR2RdrDetn080To084Range2 "Range from sensor to object";
CM_ SG_ 134 FLR2RdrDetn080To084Range3 "Range from sensor to object";
CM_ SG_ 134 FLR2RdrDetn080To084Range4 "Range from sensor to object";
CM_ SG_ 134 FLR2RdrDetn080To084RCS0 "RCS";
CM_ SG_ 134 FLR2RdrDetn080To084RCS1 "RCS";
CM_ SG_ 134 FLR2RdrDetn080To084RCS2 "RCS";
CM_ SG_ 134 FLR2RdrDetn080To084RCS3 "RCS";
CM_ SG_ 134 FLR2RdrDetn080To084RCS4 "RCS";
CM_ SG_ 134 FLR2RdrDetn080To084RngRt0 "Speed towards/away from the sensor";
CM_ SG_ 134 FLR2RdrDetn080To084RngRt1 "Speed towards/away from the sensor";
CM_ SG_ 134 FLR2RdrDetn080To084RngRt2 "Speed towards/away from the sensor";
CM_ SG_ 134 FLR2RdrDetn080To084RngRt3 "Speed towards/away from the sensor";
CM_ SG_ 134 FLR2RdrDetn080To084RngRt4 "Speed towards/away from the sensor";
CM_ SG_ 134 FLR2RdrDetn080To084ScanID "Value to tie status, detection data and object data frames together";
CM_ SG_ 134 FLR2RdrDetn080To084SNR0 "Signal to Noise Ratio";
CM_ SG_ 134 FLR2RdrDetn080To084SNR1 "Signal to Noise Ration";
CM_ SG_ 134 FLR2RdrDetn080To084SNR2 "Signal to Noise Ration";
CM_ SG_ 134 FLR2RdrDetn080To084SNR3 "Signal to Noise Ration";
CM_ SG_ 134 FLR2RdrDetn080To084SNR4 "Signal to Noise Ration";
CM_ SG_ 137 FLR2RdrDetn085To089AziAng0 "Azimuth Angle";
CM_ SG_ 137 FLR2RdrDetn085To089AziAng1 "Azimuth Angle";
CM_ SG_ 137 FLR2RdrDetn085To089AziAng2 "Azimuth Angle";
CM_ SG_ 137 FLR2RdrDetn085To089AziAng3 "Azimuth Angle";
CM_ SG_ 137 FLR2RdrDetn085To089AziAng4 "Azimuth Angle";
CM_ SG_ 137 FLR2RdrDetn085To089DynPrpty0 "Moving/Stationary";
CM_ SG_ 137 FLR2RdrDetn085To089DynPrpty1 "Moving/Stationary";
CM_ SG_ 137 FLR2RdrDetn085To089DynPrpty2 "Moving/Stationary";
CM_ SG_ 137 FLR2RdrDetn085To089DynPrpty3 "Moving/Stationary";
CM_ SG_ 137 FLR2RdrDetn085To089DynPrpty4 "Moving/Stationary";
CM_ SG_ 137 FLR2RdrDetn085To089EleAng0 "Elevation angle";
CM_ SG_ 137 FLR2RdrDetn085To089EleAng1 "Elevation angle";
CM_ SG_ 137 FLR2RdrDetn085To089EleAng2 "Elevation angle";
CM_ SG_ 137 FLR2RdrDetn085To089EleAng3 "Elevation angle";
CM_ SG_ 137 FLR2RdrDetn085To089EleAng4 "Elevation angle";
CM_ SG_ 137 FLR2RdrDetn085To089Mode0 "What chirp mode the detection is from";
CM_ SG_ 137 FLR2RdrDetn085To089Mode1 "What chirp mode the detection is from";
CM_ SG_ 137 FLR2RdrDetn085To089Mode2 "What chirp mode the detection is from";
CM_ SG_ 137 FLR2RdrDetn085To089Mode3 "What chirp mode the detection is from";
CM_ SG_ 137 FLR2RdrDetn085To089Mode4 "What chirp mode the detection is from";
CM_ SG_ 137 FLR2RdrDetn085To089Quality0 "Quality";
CM_ SG_ 137 FLR2RdrDetn085To089Quality1 "Quality";
CM_ SG_ 137 FLR2RdrDetn085To089Quality2 "Quality";
CM_ SG_ 137 FLR2RdrDetn085To089Quality3 "Quality";
CM_ SG_ 137 FLR2RdrDetn085To089Quality4 "Quality";
CM_ SG_ 137 FLR2RdrDetn085To089Range0 "Range from sensor to object";
CM_ SG_ 137 FLR2RdrDetn085To089Range1 "Range from sensor to object";
CM_ SG_ 137 FLR2RdrDetn085To089Range2 "Range from sensor to object";
CM_ SG_ 137 FLR2RdrDetn085To089Range3 "Range from sensor to object";
CM_ SG_ 137 FLR2RdrDetn085To089Range4 "Range from sensor to object";
CM_ SG_ 137 FLR2RdrDetn085To089RCS0 "RCS";
CM_ SG_ 137 FLR2RdrDetn085To089RCS1 "RCS";
CM_ SG_ 137 FLR2RdrDetn085To089RCS2 "RCS";
CM_ SG_ 137 FLR2RdrDetn085To089RCS3 "RCS";
CM_ SG_ 137 FLR2RdrDetn085To089RCS4 "RCS";
CM_ SG_ 137 FLR2RdrDetn085To089RngRt0 "Speed towards/away from the sensor";
CM_ SG_ 137 FLR2RdrDetn085To089RngRt1 "Speed towards/away from the sensor";
CM_ SG_ 137 FLR2RdrDetn085To089RngRt2 "Speed towards/away from the sensor";
CM_ SG_ 137 FLR2RdrDetn085To089RngRt3 "Speed towards/away from the sensor";
CM_ SG_ 137 FLR2RdrDetn085To089RngRt4 "Speed towards/away from the sensor";
CM_ SG_ 137 FLR2RdrDetn085To089ScanID "Value to tie status, detection data and object data frames together";
CM_ SG_ 137 FLR2RdrDetn085To089SNR0 "Signal to Noise Ratio";
CM_ SG_ 137 FLR2RdrDetn085To089SNR1 "Signal to Noise Ration";
CM_ SG_ 137 FLR2RdrDetn085To089SNR2 "Signal to Noise Ration";
CM_ SG_ 137 FLR2RdrDetn085To089SNR3 "Signal to Noise Ration";
CM_ SG_ 137 FLR2RdrDetn085To089SNR4 "Signal to Noise Ration";
CM_ SG_ 140 FLR2RdrDetn090To094AziAng0 "Azimuth Angle";
CM_ SG_ 140 FLR2RdrDetn090To094AziAng1 "Azimuth Angle";
CM_ SG_ 140 FLR2RdrDetn090To094AziAng2 "Azimuth Angle";
CM_ SG_ 140 FLR2RdrDetn090To094AziAng3 "Azimuth Angle";
CM_ SG_ 140 FLR2RdrDetn090To094AziAng4 "Azimuth Angle";
CM_ SG_ 140 FLR2RdrDetn090To094DynPrpty0 "Moving/Stationary";
CM_ SG_ 140 FLR2RdrDetn090To094DynPrpty1 "Moving/Stationary";
CM_ SG_ 140 FLR2RdrDetn090To094DynPrpty2 "Moving/Stationary";
CM_ SG_ 140 FLR2RdrDetn090To094DynPrpty3 "Moving/Stationary";
CM_ SG_ 140 FLR2RdrDetn090To094DynPrpty4 "Moving/Stationary";
CM_ SG_ 140 FLR2RdrDetn090To094EleAng0 "Elevation angle";
CM_ SG_ 140 FLR2RdrDetn090To094EleAng1 "Elevation angle";
CM_ SG_ 140 FLR2RdrDetn090To094EleAng2 "Elevation angle";
CM_ SG_ 140 FLR2RdrDetn090To094EleAng3 "Elevation angle";
CM_ SG_ 140 FLR2RdrDetn090To094EleAng4 "Elevation angle";
CM_ SG_ 140 FLR2RdrDetn090To094Mode0 "What chirp mode the detection is from";
CM_ SG_ 140 FLR2RdrDetn090To094Mode1 "What chirp mode the detection is from";
CM_ SG_ 140 FLR2RdrDetn090To094Mode2 "What chirp mode the detection is from";
CM_ SG_ 140 FLR2RdrDetn090To094Mode3 "What chirp mode the detection is from";
CM_ SG_ 140 FLR2RdrDetn090To094Mode4 "What chirp mode the detection is from";
CM_ SG_ 140 FLR2RdrDetn090To094Quality0 "Quality";
CM_ SG_ 140 FLR2RdrDetn090To094Quality1 "Quality";
CM_ SG_ 140 FLR2RdrDetn090To094Quality2 "Quality";
CM_ SG_ 140 FLR2RdrDetn090To094Quality3 "Quality";
CM_ SG_ 140 FLR2RdrDetn090To094Quality4 "Quality";
CM_ SG_ 140 FLR2RdrDetn090To094Range0 "Range from sensor to object";
CM_ SG_ 140 FLR2RdrDetn090To094Range1 "Range from sensor to object";
CM_ SG_ 140 FLR2RdrDetn090To094Range2 "Range from sensor to object";
CM_ SG_ 140 FLR2RdrDetn090To094Range3 "Range from sensor to object";
CM_ SG_ 140 FLR2RdrDetn090To094Range4 "Range from sensor to object";
CM_ SG_ 140 FLR2RdrDetn090To094RCS0 "RCS";
CM_ SG_ 140 FLR2RdrDetn090To094RCS1 "RCS";
CM_ SG_ 140 FLR2RdrDetn090To094RCS2 "RCS";
CM_ SG_ 140 FLR2RdrDetn090To094RCS3 "RCS";
CM_ SG_ 140 FLR2RdrDetn090To094RCS4 "RCS";
CM_ SG_ 140 FLR2RdrDetn090To094RngRt0 "Speed towards/away from the sensor";
CM_ SG_ 140 FLR2RdrDetn090To094RngRt1 "Speed towards/away from the sensor";
CM_ SG_ 140 FLR2RdrDetn090To094RngRt2 "Speed towards/away from the sensor";
CM_ SG_ 140 FLR2RdrDetn090To094RngRt3 "Speed towards/away from the sensor";
CM_ SG_ 140 FLR2RdrDetn090To094RngRt4 "Speed towards/away from the sensor";
CM_ SG_ 140 FLR2RdrDetn090To094ScanID "Value to tie status, detection data and object data frames together";
CM_ SG_ 140 FLR2RdrDetn090To094SNR0 "Signal to Noise Ratio";
CM_ SG_ 140 FLR2RdrDetn090To094SNR1 "Signal to Noise Ration";
CM_ SG_ 140 FLR2RdrDetn090To094SNR2 "Signal to Noise Ration";
CM_ SG_ 140 FLR2RdrDetn090To094SNR3 "Signal to Noise Ration";
CM_ SG_ 140 FLR2RdrDetn090To094SNR4 "Signal to Noise Ration";
CM_ SG_ 144 FLR2RdrDetn095To099AziAng0 "Azimuth Angle";
CM_ SG_ 144 FLR2RdrDetn095To099AziAng1 "Azimuth Angle";
CM_ SG_ 144 FLR2RdrDetn095To099AziAng2 "Azimuth Angle";
CM_ SG_ 144 FLR2RdrDetn095To099AziAng3 "Azimuth Angle";
CM_ SG_ 144 FLR2RdrDetn095To099AziAng4 "Azimuth Angle";
CM_ SG_ 144 FLR2RdrDetn095To099DynPrpty0 "Moving/Stationary";
CM_ SG_ 144 FLR2RdrDetn095To099DynPrpty1 "Moving/Stationary";
CM_ SG_ 144 FLR2RdrDetn095To099DynPrpty2 "Moving/Stationary";
CM_ SG_ 144 FLR2RdrDetn095To099DynPrpty3 "Moving/Stationary";
CM_ SG_ 144 FLR2RdrDetn095To099DynPrpty4 "Moving/Stationary";
CM_ SG_ 144 FLR2RdrDetn095To099EleAng0 "Elevation angle";
CM_ SG_ 144 FLR2RdrDetn095To099EleAng1 "Elevation angle";
CM_ SG_ 144 FLR2RdrDetn095To099EleAng2 "Elevation angle";
CM_ SG_ 144 FLR2RdrDetn095To099EleAng3 "Elevation angle";
CM_ SG_ 144 FLR2RdrDetn095To099EleAng4 "Elevation angle";
CM_ SG_ 144 FLR2RdrDetn095To099Mode0 "What chirp mode the detection is from";
CM_ SG_ 144 FLR2RdrDetn095To099Mode1 "What chirp mode the detection is from";
CM_ SG_ 144 FLR2RdrDetn095To099Mode2 "What chirp mode the detection is from";
CM_ SG_ 144 FLR2RdrDetn095To099Mode3 "What chirp mode the detection is from";
CM_ SG_ 144 FLR2RdrDetn095To099Mode4 "What chirp mode the detection is from";
CM_ SG_ 144 FLR2RdrDetn095To099Quality0 "Quality";
CM_ SG_ 144 FLR2RdrDetn095To099Quality1 "Quality";
CM_ SG_ 144 FLR2RdrDetn095To099Quality2 "Quality";
CM_ SG_ 144 FLR2RdrDetn095To099Quality3 "Quality";
CM_ SG_ 144 FLR2RdrDetn095To099Quality4 "Quality";
CM_ SG_ 144 FLR2RdrDetn095To099Range0 "Range from sensor to object";
CM_ SG_ 144 FLR2RdrDetn095To099Range1 "Range from sensor to object";
CM_ SG_ 144 FLR2RdrDetn095To099Range2 "Range from sensor to object";
CM_ SG_ 144 FLR2RdrDetn095To099Range3 "Range from sensor to object";
CM_ SG_ 144 FLR2RdrDetn095To099Range4 "Range from sensor to object";
CM_ SG_ 144 FLR2RdrDetn095To099RCS0 "RCS";
CM_ SG_ 144 FLR2RdrDetn095To099RCS1 "RCS";
CM_ SG_ 144 FLR2RdrDetn095To099RCS2 "RCS";
CM_ SG_ 144 FLR2RdrDetn095To099RCS3 "RCS";
CM_ SG_ 144 FLR2RdrDetn095To099RCS4 "RCS";
CM_ SG_ 144 FLR2RdrDetn095To099RngRt0 "Speed towards/away from the sensor";
CM_ SG_ 144 FLR2RdrDetn095To099RngRt1 "Speed towards/away from the sensor";
CM_ SG_ 144 FLR2RdrDetn095To099RngRt2 "Speed towards/away from the sensor";
CM_ SG_ 144 FLR2RdrDetn095To099RngRt3 "Speed towards/away from the sensor";
CM_ SG_ 144 FLR2RdrDetn095To099RngRt4 "Speed towards/away from the sensor";
CM_ SG_ 144 FLR2RdrDetn095To099ScanID "Value to tie status, detection data and object data frames together";
CM_ SG_ 144 FLR2RdrDetn095To099SNR0 "Signal to Noise Ratio";
CM_ SG_ 144 FLR2RdrDetn095To099SNR1 "Signal to Noise Ration";
CM_ SG_ 144 FLR2RdrDetn095To099SNR2 "Signal to Noise Ration";
CM_ SG_ 144 FLR2RdrDetn095To099SNR3 "Signal to Noise Ration";
CM_ SG_ 144 FLR2RdrDetn095To099SNR4 "Signal to Noise Ration";
CM_ SG_ 147 FLR2RdrDetn100To104AziAng0 "Azimuth Angle";
CM_ SG_ 147 FLR2RdrDetn100To104AziAng1 "Azimuth Angle";
CM_ SG_ 147 FLR2RdrDetn100To104AziAng2 "Azimuth Angle";
CM_ SG_ 147 FLR2RdrDetn100To104AziAng3 "Azimuth Angle";
CM_ SG_ 147 FLR2RdrDetn100To104AziAng4 "Azimuth Angle";
CM_ SG_ 147 FLR2RdrDetn100To104DynPrpty0 "Moving/Stationary";
CM_ SG_ 147 FLR2RdrDetn100To104DynPrpty1 "Moving/Stationary";
CM_ SG_ 147 FLR2RdrDetn100To104DynPrpty2 "Moving/Stationary";
CM_ SG_ 147 FLR2RdrDetn100To104DynPrpty3 "Moving/Stationary";
CM_ SG_ 147 FLR2RdrDetn100To104DynPrpty4 "Moving/Stationary";
CM_ SG_ 147 FLR2RdrDetn100To104EleAng0 "Elevation angle";
CM_ SG_ 147 FLR2RdrDetn100To104EleAng1 "Elevation angle";
CM_ SG_ 147 FLR2RdrDetn100To104EleAng2 "Elevation angle";
CM_ SG_ 147 FLR2RdrDetn100To104EleAng3 "Elevation angle";
CM_ SG_ 147 FLR2RdrDetn100To104EleAng4 "Elevation angle";
CM_ SG_ 147 FLR2RdrDetn100To104Mode0 "What chirp mode the detection is from";
CM_ SG_ 147 FLR2RdrDetn100To104Mode1 "What chirp mode the detection is from";
CM_ SG_ 147 FLR2RdrDetn100To104Mode2 "What chirp mode the detection is from";
CM_ SG_ 147 FLR2RdrDetn100To104Mode3 "What chirp mode the detection is from";
CM_ SG_ 147 FLR2RdrDetn100To104Mode4 "What chirp mode the detection is from";
CM_ SG_ 147 FLR2RdrDetn100To104Quality0 "Quality";
CM_ SG_ 147 FLR2RdrDetn100To104Quality1 "Quality";
CM_ SG_ 147 FLR2RdrDetn100To104Quality2 "Quality";
CM_ SG_ 147 FLR2RdrDetn100To104Quality3 "Quality";
CM_ SG_ 147 FLR2RdrDetn100To104Quality4 "Quality";
CM_ SG_ 147 FLR2RdrDetn100To104Range0 "Range from sensor to object";
CM_ SG_ 147 FLR2RdrDetn100To104Range1 "Range from sensor to object";
CM_ SG_ 147 FLR2RdrDetn100To104Range2 "Range from sensor to object";
CM_ SG_ 147 FLR2RdrDetn100To104Range3 "Range from sensor to object";
CM_ SG_ 147 FLR2RdrDetn100To104Range4 "Range from sensor to object";
CM_ SG_ 147 FLR2RdrDetn100To104RCS0 "RCS";
CM_ SG_ 147 FLR2RdrDetn100To104RCS1 "RCS";
CM_ SG_ 147 FLR2RdrDetn100To104RCS2 "RCS";
CM_ SG_ 147 FLR2RdrDetn100To104RCS3 "RCS";
CM_ SG_ 147 FLR2RdrDetn100To104RCS4 "RCS";
CM_ SG_ 147 FLR2RdrDetn100To104RngRt0 "Speed towards/away from the sensor";
CM_ SG_ 147 FLR2RdrDetn100To104RngRt1 "Speed towards/away from the sensor";
CM_ SG_ 147 FLR2RdrDetn100To104RngRt2 "Speed towards/away from the sensor";
CM_ SG_ 147 FLR2RdrDetn100To104RngRt3 "Speed towards/away from the sensor";
CM_ SG_ 147 FLR2RdrDetn100To104RngRt4 "Speed towards/away from the sensor";
CM_ SG_ 147 FLR2RdrDetn100To104ScanID "Value to tie status, detection data and object data frames together";
CM_ SG_ 147 FLR2RdrDetn100To104SNR0 "Signal to Noise Ratio";
CM_ SG_ 147 FLR2RdrDetn100To104SNR1 "Signal to Noise Ration";
CM_ SG_ 147 FLR2RdrDetn100To104SNR2 "Signal to Noise Ration";
CM_ SG_ 147 FLR2RdrDetn100To104SNR3 "Signal to Noise Ration";
CM_ SG_ 147 FLR2RdrDetn100To104SNR4 "Signal to Noise Ration";
CM_ SG_ 150 FLR2RdrDetn105To109AziAng0 "Azimuth Angle";
CM_ SG_ 150 FLR2RdrDetn105To109AziAng1 "Azimuth Angle";
CM_ SG_ 150 FLR2RdrDetn105To109AziAng2 "Azimuth Angle";
CM_ SG_ 150 FLR2RdrDetn105To109AziAng3 "Azimuth Angle";
CM_ SG_ 150 FLR2RdrDetn105To109AziAng4 "Azimuth Angle";
CM_ SG_ 150 FLR2RdrDetn105To109DynPrpty0 "Moving/Stationary";
CM_ SG_ 150 FLR2RdrDetn105To109DynPrpty1 "Moving/Stationary";
CM_ SG_ 150 FLR2RdrDetn105To109DynPrpty2 "Moving/Stationary";
CM_ SG_ 150 FLR2RdrDetn105To109DynPrpty3 "Moving/Stationary";
CM_ SG_ 150 FLR2RdrDetn105To109DynPrpty4 "Moving/Stationary";
CM_ SG_ 150 FLR2RdrDetn105To109EleAng0 "Elevation angle";
CM_ SG_ 150 FLR2RdrDetn105To109EleAng1 "Elevation angle";
CM_ SG_ 150 FLR2RdrDetn105To109EleAng2 "Elevation angle";
CM_ SG_ 150 FLR2RdrDetn105To109EleAng3 "Elevation angle";
CM_ SG_ 150 FLR2RdrDetn105To109EleAng4 "Elevation angle";
CM_ SG_ 150 FLR2RdrDetn105To109Mode0 "What chirp mode the detection is from";
CM_ SG_ 150 FLR2RdrDetn105To109Mode1 "What chirp mode the detection is from";
CM_ SG_ 150 FLR2RdrDetn105To109Mode2 "What chirp mode the detection is from";
CM_ SG_ 150 FLR2RdrDetn105To109Mode3 "What chirp mode the detection is from";
CM_ SG_ 150 FLR2RdrDetn105To109Mode4 "What chirp mode the detection is from";
CM_ SG_ 150 FLR2RdrDetn105To109Quality0 "Quality";
CM_ SG_ 150 FLR2RdrDetn105To109Quality1 "Quality";
CM_ SG_ 150 FLR2RdrDetn105To109Quality2 "Quality";
CM_ SG_ 150 FLR2RdrDetn105To109Quality3 "Quality";
CM_ SG_ 150 FLR2RdrDetn105To109Quality4 "Quality";
CM_ SG_ 150 FLR2RdrDetn105To109Range0 "Range from sensor to object";
CM_ SG_ 150 FLR2RdrDetn105To109Range1 "Range from sensor to object";
CM_ SG_ 150 FLR2RdrDetn105To109Range2 "Range from sensor to object";
CM_ SG_ 150 FLR2RdrDetn105To109Range3 "Range from sensor to object";
CM_ SG_ 150 FLR2RdrDetn105To109Range4 "Range from sensor to object";
CM_ SG_ 150 FLR2RdrDetn105To109RCS0 "RCS";
CM_ SG_ 150 FLR2RdrDetn105To109RCS1 "RCS";
CM_ SG_ 150 FLR2RdrDetn105To109RCS2 "RCS";
CM_ SG_ 150 FLR2RdrDetn105To109RCS3 "RCS";
CM_ SG_ 150 FLR2RdrDetn105To109RCS4 "RCS";
CM_ SG_ 150 FLR2RdrDetn105To109RngRt0 "Speed towards/away from the sensor";
CM_ SG_ 150 FLR2RdrDetn105To109RngRt1 "Speed towards/away from the sensor";
CM_ SG_ 150 FLR2RdrDetn105To109RngRt2 "Speed towards/away from the sensor";
CM_ SG_ 150 FLR2RdrDetn105To109RngRt3 "Speed towards/away from the sensor";
CM_ SG_ 150 FLR2RdrDetn105To109RngRt4 "Speed towards/away from the sensor";
CM_ SG_ 150 FLR2RdrDetn105To109ScanID "Value to tie status, detection data and object data frames together";
CM_ SG_ 150 FLR2RdrDetn105To109SNR0 "Signal to Noise Ratio";
CM_ SG_ 150 FLR2RdrDetn105To109SNR1 "Signal to Noise Ration";
CM_ SG_ 150 FLR2RdrDetn105To109SNR2 "Signal to Noise Ration";
CM_ SG_ 150 FLR2RdrDetn105To109SNR3 "Signal to Noise Ration";
CM_ SG_ 150 FLR2RdrDetn105To109SNR4 "Signal to Noise Ration";
CM_ SG_ 153 FLR2RdrDetn110To114AziAng0 "Azimuth Angle";
CM_ SG_ 153 FLR2RdrDetn110To114AziAng1 "Azimuth Angle";
CM_ SG_ 153 FLR2RdrDetn110To114AziAng2 "Azimuth Angle";
CM_ SG_ 153 FLR2RdrDetn110To114AziAng3 "Azimuth Angle";
CM_ SG_ 153 FLR2RdrDetn110To114AziAng4 "Azimuth Angle";
CM_ SG_ 153 FLR2RdrDetn110To114DynPrpty0 "Moving/Stationary";
CM_ SG_ 153 FLR2RdrDetn110To114DynPrpty1 "Moving/Stationary";
CM_ SG_ 153 FLR2RdrDetn110To114DynPrpty2 "Moving/Stationary";
CM_ SG_ 153 FLR2RdrDetn110To114DynPrpty3 "Moving/Stationary";
CM_ SG_ 153 FLR2RdrDetn110To114DynPrpty4 "Moving/Stationary";
CM_ SG_ 153 FLR2RdrDetn110To114EleAng0 "Elevation angle";
CM_ SG_ 153 FLR2RdrDetn110To114EleAng1 "Elevation angle";
CM_ SG_ 153 FLR2RdrDetn110To114EleAng2 "Elevation angle";
CM_ SG_ 153 FLR2RdrDetn110To114EleAng3 "Elevation angle";
CM_ SG_ 153 FLR2RdrDetn110To114EleAng4 "Elevation angle";
CM_ SG_ 153 FLR2RdrDetn110To114Mode0 "What chirp mode the detection is from";
CM_ SG_ 153 FLR2RdrDetn110To114Mode1 "What chirp mode the detection is from";
CM_ SG_ 153 FLR2RdrDetn110To114Mode2 "What chirp mode the detection is from";
CM_ SG_ 153 FLR2RdrDetn110To114Mode3 "What chirp mode the detection is from";
CM_ SG_ 153 FLR2RdrDetn110To114Mode4 "What chirp mode the detection is from";
CM_ SG_ 153 FLR2RdrDetn110To114Quality0 "Quality";
CM_ SG_ 153 FLR2RdrDetn110To114Quality1 "Quality";
CM_ SG_ 153 FLR2RdrDetn110To114Quality2 "Quality";
CM_ SG_ 153 FLR2RdrDetn110To114Quality3 "Quality";
CM_ SG_ 153 FLR2RdrDetn110To114Quality4 "Quality";
CM_ SG_ 153 FLR2RdrDetn110To114Range0 "Range from sensor to object";
CM_ SG_ 153 FLR2RdrDetn110To114Range1 "Range from sensor to object";
CM_ SG_ 153 FLR2RdrDetn110To114Range2 "Range from sensor to object";
CM_ SG_ 153 FLR2RdrDetn110To114Range3 "Range from sensor to object";
CM_ SG_ 153 FLR2RdrDetn110To114Range4 "Range from sensor to object";
CM_ SG_ 153 FLR2RdrDetn110To114RCS0 "RCS";
CM_ SG_ 153 FLR2RdrDetn110To114RCS1 "RCS";
CM_ SG_ 153 FLR2RdrDetn110To114RCS2 "RCS";
CM_ SG_ 153 FLR2RdrDetn110To114RCS3 "RCS";
CM_ SG_ 153 FLR2RdrDetn110To114RCS4 "RCS";
CM_ SG_ 153 FLR2RdrDetn110To114RngRt0 "Speed towards/away from the sensor";
CM_ SG_ 153 FLR2RdrDetn110To114RngRt1 "Speed towards/away from the sensor";
CM_ SG_ 153 FLR2RdrDetn110To114RngRt2 "Speed towards/away from the sensor";
CM_ SG_ 153 FLR2RdrDetn110To114RngRt3 "Speed towards/away from the sensor";
CM_ SG_ 153 FLR2RdrDetn110To114RngRt4 "Speed towards/away from the sensor";
CM_ SG_ 153 FLR2RdrDetn110To114ScanID "Value to tie status, detection data and object data frames together";
CM_ SG_ 153 FLR2RdrDetn110To114SNR0 "Signal to Noise Ratio";
CM_ SG_ 153 FLR2RdrDetn110To114SNR1 "Signal to Noise Ration";
CM_ SG_ 153 FLR2RdrDetn110To114SNR2 "Signal to Noise Ration";
CM_ SG_ 153 FLR2RdrDetn110To114SNR3 "Signal to Noise Ration";
CM_ SG_ 153 FLR2RdrDetn110To114SNR4 "Signal to Noise Ration";
CM_ SG_ 156 FLR2RdrDetn115To119AziAng0 "Azimuth Angle";
CM_ SG_ 156 FLR2RdrDetn115To119AziAng1 "Azimuth Angle";
CM_ SG_ 156 FLR2RdrDetn115To119AziAng2 "Azimuth Angle";
CM_ SG_ 156 FLR2RdrDetn115To119AziAng3 "Azimuth Angle";
CM_ SG_ 156 FLR2RdrDetn115To119AziAng4 "Azimuth Angle";
CM_ SG_ 156 FLR2RdrDetn115To119DynPrpty0 "Moving/Stationary";
CM_ SG_ 156 FLR2RdrDetn115To119DynPrpty1 "Moving/Stationary";
CM_ SG_ 156 FLR2RdrDetn115To119DynPrpty2 "Moving/Stationary";
CM_ SG_ 156 FLR2RdrDetn115To119DynPrpty3 "Moving/Stationary";
CM_ SG_ 156 FLR2RdrDetn115To119DynPrpty4 "Moving/Stationary";
CM_ SG_ 156 FLR2RdrDetn115To119EleAng0 "Elevation angle";
CM_ SG_ 156 FLR2RdrDetn115To119EleAng1 "Elevation angle";
CM_ SG_ 156 FLR2RdrDetn115To119EleAng2 "Elevation angle";
CM_ SG_ 156 FLR2RdrDetn115To119EleAng3 "Elevation angle";
CM_ SG_ 156 FLR2RdrDetn115To119EleAng4 "Elevation angle";
CM_ SG_ 156 FLR2RdrDetn115To119Mode0 "What chirp mode the detection is from";
CM_ SG_ 156 FLR2RdrDetn115To119Mode1 "What chirp mode the detection is from";
CM_ SG_ 156 FLR2RdrDetn115To119Mode2 "What chirp mode the detection is from";
CM_ SG_ 156 FLR2RdrDetn115To119Mode3 "What chirp mode the detection is from";
CM_ SG_ 156 FLR2RdrDetn115To119Mode4 "What chirp mode the detection is from";
CM_ SG_ 156 FLR2RdrDetn115To119Quality0 "Quality";
CM_ SG_ 156 FLR2RdrDetn115To119Quality1 "Quality";
CM_ SG_ 156 FLR2RdrDetn115To119Quality2 "Quality";
CM_ SG_ 156 FLR2RdrDetn115To119Quality3 "Quality";
CM_ SG_ 156 FLR2RdrDetn115To119Quality4 "Quality";
CM_ SG_ 156 FLR2RdrDetn115To119Range0 "Range from sensor to object";
CM_ SG_ 156 FLR2RdrDetn115To119Range1 "Range from sensor to object";
CM_ SG_ 156 FLR2RdrDetn115To119Range2 "Range from sensor to object";
CM_ SG_ 156 FLR2RdrDetn115To119Range3 "Range from sensor to object";
CM_ SG_ 156 FLR2RdrDetn115To119Range4 "Range from sensor to object";
CM_ SG_ 156 FLR2RdrDetn115To119RCS0 "RCS";
CM_ SG_ 156 FLR2RdrDetn115To119RCS1 "RCS";
CM_ SG_ 156 FLR2RdrDetn115To119RCS2 "RCS";
CM_ SG_ 156 FLR2RdrDetn115To119RCS3 "RCS";
CM_ SG_ 156 FLR2RdrDetn115To119RCS4 "RCS";
CM_ SG_ 156 FLR2RdrDetn115To119RngRt0 "Speed towards/away from the sensor";
CM_ SG_ 156 FLR2RdrDetn115To119RngRt1 "Speed towards/away from the sensor";
CM_ SG_ 156 FLR2RdrDetn115To119RngRt2 "Speed towards/away from the sensor";
CM_ SG_ 156 FLR2RdrDetn115To119RngRt3 "Speed towards/away from the sensor";
CM_ SG_ 156 FLR2RdrDetn115To119RngRt4 "Speed towards/away from the sensor";
CM_ SG_ 156 FLR2RdrDetn115To119ScanID "Value to tie status, detection data and object data frames together";
CM_ SG_ 156 FLR2RdrDetn115To119SNR0 "Signal to Noise Ratio";
CM_ SG_ 156 FLR2RdrDetn115To119SNR1 "Signal to Noise Ration";
CM_ SG_ 156 FLR2RdrDetn115To119SNR2 "Signal to Noise Ration";
CM_ SG_ 156 FLR2RdrDetn115To119SNR3 "Signal to Noise Ration";
CM_ SG_ 156 FLR2RdrDetn115To119SNR4 "Signal to Noise Ration";
CM_ SG_ 160 FLR2RdrDetn120To124AziAng0 "Azimuth Angle";
CM_ SG_ 160 FLR2RdrDetn120To124AziAng1 "Azimuth Angle";
CM_ SG_ 160 FLR2RdrDetn120To124AziAng2 "Azimuth Angle";
CM_ SG_ 160 FLR2RdrDetn120To124AziAng3 "Azimuth Angle";
CM_ SG_ 160 FLR2RdrDetn120To124AziAng4 "Azimuth Angle";
CM_ SG_ 160 FLR2RdrDetn120To124DynPrpty0 "Moving/Stationary";
CM_ SG_ 160 FLR2RdrDetn120To124DynPrpty1 "Moving/Stationary";
CM_ SG_ 160 FLR2RdrDetn120To124DynPrpty2 "Moving/Stationary";
CM_ SG_ 160 FLR2RdrDetn120To124DynPrpty3 "Moving/Stationary";
CM_ SG_ 160 FLR2RdrDetn120To124DynPrpty4 "Moving/Stationary";
CM_ SG_ 160 FLR2RdrDetn120To124EleAng0 "Elevation angle";
CM_ SG_ 160 FLR2RdrDetn120To124EleAng1 "Elevation angle";
CM_ SG_ 160 FLR2RdrDetn120To124EleAng2 "Elevation angle";
CM_ SG_ 160 FLR2RdrDetn120To124EleAng3 "Elevation angle";
CM_ SG_ 160 FLR2RdrDetn120To124EleAng4 "Elevation angle";
CM_ SG_ 160 FLR2RdrDetn120To124Mode0 "What chirp mode the detection is from";
CM_ SG_ 160 FLR2RdrDetn120To124Mode1 "What chirp mode the detection is from";
CM_ SG_ 160 FLR2RdrDetn120To124Mode2 "What chirp mode the detection is from";
CM_ SG_ 160 FLR2RdrDetn120To124Mode3 "What chirp mode the detection is from";
CM_ SG_ 160 FLR2RdrDetn120To124Mode4 "What chirp mode the detection is from";
CM_ SG_ 160 FLR2RdrDetn120To124Quality0 "Quality";
CM_ SG_ 160 FLR2RdrDetn120To124Quality1 "Quality";
CM_ SG_ 160 FLR2RdrDetn120To124Quality2 "Quality";
CM_ SG_ 160 FLR2RdrDetn120To124Quality3 "Quality";
CM_ SG_ 160 FLR2RdrDetn120To124Quality4 "Quality";
CM_ SG_ 160 FLR2RdrDetn120To124Range0 "Range from sensor to object";
CM_ SG_ 160 FLR2RdrDetn120To124Range1 "Range from sensor to object";
CM_ SG_ 160 FLR2RdrDetn120To124Range2 "Range from sensor to object";
CM_ SG_ 160 FLR2RdrDetn120To124Range3 "Range from sensor to object";
CM_ SG_ 160 FLR2RdrDetn120To124Range4 "Range from sensor to object";
CM_ SG_ 160 FLR2RdrDetn120To124RCS0 "RCS";
CM_ SG_ 160 FLR2RdrDetn120To124RCS1 "RCS";
CM_ SG_ 160 FLR2RdrDetn120To124RCS2 "RCS";
CM_ SG_ 160 FLR2RdrDetn120To124RCS3 "RCS";
CM_ SG_ 160 FLR2RdrDetn120To124RCS4 "RCS";
CM_ SG_ 160 FLR2RdrDetn120To124RngRt0 "Speed towards/away from the sensor";
CM_ SG_ 160 FLR2RdrDetn120To124RngRt1 "Speed towards/away from the sensor";
CM_ SG_ 160 FLR2RdrDetn120To124RngRt2 "Speed towards/away from the sensor";
CM_ SG_ 160 FLR2RdrDetn120To124RngRt3 "Speed towards/away from the sensor";
CM_ SG_ 160 FLR2RdrDetn120To124RngRt4 "Speed towards/away from the sensor";
CM_ SG_ 160 FLR2RdrDetn120To124ScanID "Value to tie status, detection data and object data frames together";
CM_ SG_ 160 FLR2RdrDetn120To124SNR0 "Signal to Noise Ratio";
CM_ SG_ 160 FLR2RdrDetn120To124SNR1 "Signal to Noise Ration";
CM_ SG_ 160 FLR2RdrDetn120To124SNR2 "Signal to Noise Ration";
CM_ SG_ 160 FLR2RdrDetn120To124SNR3 "Signal to Noise Ration";
CM_ SG_ 160 FLR2RdrDetn120To124SNR4 "Signal to Noise Ration";
CM_ SG_ 163 FLR2RdrDetn125To129AziAng0 "Azimuth Angle";
CM_ SG_ 163 FLR2RdrDetn125To129AziAng1 "Azimuth Angle";
CM_ SG_ 163 FLR2RdrDetn125To129AziAng2 "Azimuth Angle";
CM_ SG_ 163 FLR2RdrDetn125To129AziAng3 "Azimuth Angle";
CM_ SG_ 163 FLR2RdrDetn125To129AziAng4 "Azimuth Angle";
CM_ SG_ 163 FLR2RdrDetn125To129DynPrpty0 "Moving/Stationary";
CM_ SG_ 163 FLR2RdrDetn125To129DynPrpty1 "Moving/Stationary";
CM_ SG_ 163 FLR2RdrDetn125To129DynPrpty2 "Moving/Stationary";
CM_ SG_ 163 FLR2RdrDetn125To129DynPrpty3 "Moving/Stationary";
CM_ SG_ 163 FLR2RdrDetn125To129DynPrpty4 "Moving/Stationary";
CM_ SG_ 163 FLR2RdrDetn125To129EleAng0 "Elevation angle";
CM_ SG_ 163 FLR2RdrDetn125To129EleAng1 "Elevation angle";
CM_ SG_ 163 FLR2RdrDetn125To129EleAng2 "Elevation angle";
CM_ SG_ 163 FLR2RdrDetn125To129EleAng3 "Elevation angle";
CM_ SG_ 163 FLR2RdrDetn125To129EleAng4 "Elevation angle";
CM_ SG_ 163 FLR2RdrDetn125To129Mode0 "What chirp mode the detection is from";
CM_ SG_ 163 FLR2RdrDetn125To129Mode1 "What chirp mode the detection is from";
CM_ SG_ 163 FLR2RdrDetn125To129Mode2 "What chirp mode the detection is from";
CM_ SG_ 163 FLR2RdrDetn125To129Mode3 "What chirp mode the detection is from";
CM_ SG_ 163 FLR2RdrDetn125To129Mode4 "What chirp mode the detection is from";
CM_ SG_ 163 FLR2RdrDetn125To129Quality0 "Quality";
CM_ SG_ 163 FLR2RdrDetn125To129Quality1 "Quality";
CM_ SG_ 163 FLR2RdrDetn125To129Quality2 "Quality";
CM_ SG_ 163 FLR2RdrDetn125To129Quality3 "Quality";
CM_ SG_ 163 FLR2RdrDetn125To129Quality4 "Quality";
CM_ SG_ 163 FLR2RdrDetn125To129Range0 "Range from sensor to object";
CM_ SG_ 163 FLR2RdrDetn125To129Range1 "Range from sensor to object";
CM_ SG_ 163 FLR2RdrDetn125To129Range2 "Range from sensor to object";
CM_ SG_ 163 FLR2RdrDetn125To129Range3 "Range from sensor to object";
CM_ SG_ 163 FLR2RdrDetn125To129Range4 "Range from sensor to object";
CM_ SG_ 163 FLR2RdrDetn125To129RCS0 "RCS";
CM_ SG_ 163 FLR2RdrDetn125To129RCS1 "RCS";
CM_ SG_ 163 FLR2RdrDetn125To129RCS2 "RCS";
CM_ SG_ 163 FLR2RdrDetn125To129RCS3 "RCS";
CM_ SG_ 163 FLR2RdrDetn125To129RCS4 "RCS";
CM_ SG_ 163 FLR2RdrDetn125To129RngRt0 "Speed towards/away from the sensor";
CM_ SG_ 163 FLR2RdrDetn125To129RngRt1 "Speed towards/away from the sensor";
CM_ SG_ 163 FLR2RdrDetn125To129RngRt2 "Speed towards/away from the sensor";
CM_ SG_ 163 FLR2RdrDetn125To129RngRt3 "Speed towards/away from the sensor";
CM_ SG_ 163 FLR2RdrDetn125To129RngRt4 "Speed towards/away from the sensor";
CM_ SG_ 163 FLR2RdrDetn125To129ScanID "Value to tie status, detection data and object data frames together";
CM_ SG_ 163 FLR2RdrDetn125To129SNR0 "Signal to Noise Ratio";
CM_ SG_ 163 FLR2RdrDetn125To129SNR1 "Signal to Noise Ration";
CM_ SG_ 163 FLR2RdrDetn125To129SNR2 "Signal to Noise Ration";
CM_ SG_ 163 FLR2RdrDetn125To129SNR3 "Signal to Noise Ration";
CM_ SG_ 163 FLR2RdrDetn125To129SNR4 "Signal to Noise Ration";
BA_DEF_ BO_ "CANFD_BRS" ENUM "0","1";
BA_DEF_ BO_ "GenMsgCycleTime" INT 0 65536; // [ms]
BA_DEF_ BO_ "GenMsgDelayTime" INT 0 65536; // [ms]
BA_DEF_ BO_ "GenMsgSendType" ENUM "cyclic", "spontaneous", "not-used", "not-used", "not-used", "cyclicAndSpontaneous", "not-used", "cyclicIfActive", "NoMsgSendType"; // [us]
BA_DEF_ BO_ "GenMsgStartDelayTime" INT 0 65536; // [ms]
BA_DEF_ BO_ "VFrameFormat" ENUM "StandardCAN","ExtendedCAN","reserved","J1939PG","reserved","reserved","reserved","reserved","reserved","reserved","reserved","reserved","reserved","reserved","StandardCAN_FD","ExtendedCAN_FD";
BA_DEF_ SG_ "GenSigSendType" ENUM "Cyclic","OnWrite","OnWriteWithRepetition","OnChange","OnChangeWithRepetition","IfActive","IfActiveWithRepetition","NoSigSendType";
BA_DEF_ SG_ "GenSigStartValue" HEX 0 80000000;
BA_DEF_ BO_ "GenMsgILSupport" ENUM "No","Yes";
BA_DEF_ BO_ "NmAsrMessage" ENUM "No","Yes";
BA_DEF_ SG_ "GenSigFuncType" ENUM "NoFunction","n/a","n/a","n/a","n/a","n/a","n/a","n/a","n/a","n/a","n/a","n/a","n/a","n/a","n/a","CHK","CNTR","n/a","n/a","n/a","CNTR_AR_01","CRC_AR_01_BOTH","CRC_AR_01_ALT","CRC_AR_01_LOW","CRC_AR_01_NIBBLE","CNTR_AR_04","CRC_AR_04A","CNTR_AR_05","CRC_AR_05";
BA_DEF_ SG_ "GenSigDataID" STRING;
BA_DEF_DEF_ "CANFD_BRS" "1";
BA_DEF_DEF_ "GenSigStartValue" 0;
BA_DEF_DEF_ "VFrameFormat" "J1939PG";
BA_DEF_DEF_ "GenSigSendType" "NoSigSendType";
BA_DEF_DEF_ "GenMsgCycleTime" 0;
BA_DEF_DEF_ "GenMsgDelayTime" 0;
BA_DEF_DEF_ "GenMsgStartDelayTime" 0;
BA_DEF_DEF_ "GenMsgSendType" "NoMsgSendType";
BA_DEF_DEF_ "GenMsgILSupport" "Yes";
BA_DEF_DEF_ "NmAsrMessage" "No";
BA_DEF_DEF_ "GenSigFuncType" "NoFunction";
BA_DEF_DEF_ "GenSigDataID" "";
// Frame: FlrFlr1canFr13
BA_ "GenMsgDelayTime" BO_ 118 40.000;
BA_ "GenMsgSendType" BO_ 118 1;
BA_ "VFrameFormat" BO_ 118 14;
// Frame: FlrFlr1canFr14
BA_ "GenMsgDelayTime" BO_ 121 40.000;
BA_ "GenMsgSendType" BO_ 121 1;
BA_ "VFrameFormat" BO_ 121 14;
// Frame: FlrFlr1canFr15
BA_ "GenMsgDelayTime" BO_ 124 40.000;
BA_ "GenMsgSendType" BO_ 124 1;
BA_ "VFrameFormat" BO_ 124 14;
// Frame: FlrFlr1canFr16
BA_ "GenMsgDelayTime" BO_ 131 40.000;
BA_ "GenMsgSendType" BO_ 131 1;
BA_ "VFrameFormat" BO_ 131 14;
// Frame: FlrFlr1canFr17
BA_ "GenMsgDelayTime" BO_ 134 40.000;
BA_ "GenMsgSendType" BO_ 134 1;
BA_ "VFrameFormat" BO_ 134 14;
// Frame: FlrFlr1canFr18
BA_ "GenMsgDelayTime" BO_ 137 40.000;
BA_ "GenMsgSendType" BO_ 137 1;
BA_ "VFrameFormat" BO_ 137 14;
// Frame: FlrFlr1canFr19
BA_ "GenMsgDelayTime" BO_ 140 40.000;
BA_ "GenMsgSendType" BO_ 140 1;
BA_ "VFrameFormat" BO_ 140 14;
// Frame: FlrFlr1canFr20
BA_ "GenMsgDelayTime" BO_ 144 40.000;
BA_ "GenMsgSendType" BO_ 144 1;
BA_ "VFrameFormat" BO_ 144 14;
// Frame: FlrFlr1canFr21
BA_ "GenMsgDelayTime" BO_ 147 40.000;
BA_ "GenMsgSendType" BO_ 147 1;
BA_ "VFrameFormat" BO_ 147 14;
// Frame: FlrFlr1canFr22
BA_ "GenMsgDelayTime" BO_ 150 40.000;
BA_ "GenMsgSendType" BO_ 150 1;
BA_ "VFrameFormat" BO_ 150 14;
// Frame: FlrFlr1canFr23
BA_ "GenMsgDelayTime" BO_ 153 40.000;
BA_ "GenMsgSendType" BO_ 153 1;
BA_ "VFrameFormat" BO_ 153 14;
// Frame: FlrFlr1canFr24
BA_ "GenMsgDelayTime" BO_ 156 40.000;
BA_ "GenMsgSendType" BO_ 156 1;
BA_ "VFrameFormat" BO_ 156 14;
// Frame: FlrFlr1canFr25
BA_ "GenMsgDelayTime" BO_ 160 40.000;
BA_ "GenMsgSendType" BO_ 160 1;
BA_ "VFrameFormat" BO_ 160 14;
// Frame: FlrFlr1canFr26
BA_ "GenMsgDelayTime" BO_ 163 40.000;
BA_ "GenMsgSendType" BO_ 163 1;
BA_ "VFrameFormat" BO_ 163 14;
BA_ "GenSigSendType" SG_ 118 FLR2RdrDetn060To064AziAng0 1;
BA_ "GenSigSendType" SG_ 118 FLR2RdrDetn060To064AziAng1 1;
BA_ "GenSigSendType" SG_ 118 FLR2RdrDetn060To064AziAng2 1;
BA_ "GenSigSendType" SG_ 118 FLR2RdrDetn060To064AziAng3 1;
BA_ "GenSigSendType" SG_ 118 FLR2RdrDetn060To064AziAng4 1;
BA_ "GenSigDataID" SG_ 118 FLR2RdrDetn060To064CRC "0xAC5";
BA_ "GenSigFuncType" SG_ 118 FLR2RdrDetn060To064CRC 28;
BA_ "GenSigSendType" SG_ 118 FLR2RdrDetn060To064CRC 1;
BA_ "GenSigFuncType" SG_ 118 FLR2RdrDetn060To064Counter 27;
BA_ "GenSigSendType" SG_ 118 FLR2RdrDetn060To064Counter 1;
BA_ "GenSigSendType" SG_ 118 FLR2RdrDetn060To064DynPrpty0 1;
BA_ "GenSigSendType" SG_ 118 FLR2RdrDetn060To064DynPrpty1 1;
BA_ "GenSigSendType" SG_ 118 FLR2RdrDetn060To064DynPrpty2 1;
BA_ "GenSigSendType" SG_ 118 FLR2RdrDetn060To064DynPrpty3 1;
BA_ "GenSigSendType" SG_ 118 FLR2RdrDetn060To064DynPrpty4 1;
BA_ "GenSigSendType" SG_ 118 FLR2RdrDetn060To064EleAng0 1;
BA_ "GenSigSendType" SG_ 118 FLR2RdrDetn060To064EleAng1 1;
BA_ "GenSigSendType" SG_ 118 FLR2RdrDetn060To064EleAng2 1;
BA_ "GenSigSendType" SG_ 118 FLR2RdrDetn060To064EleAng3 1;
BA_ "GenSigSendType" SG_ 118 FLR2RdrDetn060To064EleAng4 1;
BA_ "GenSigSendType" SG_ 118 FLR2RdrDetn060To064Mode0 1;
BA_ "GenSigSendType" SG_ 118 FLR2RdrDetn060To064Mode1 1;
BA_ "GenSigSendType" SG_ 118 FLR2RdrDetn060To064Mode2 1;
BA_ "GenSigSendType" SG_ 118 FLR2RdrDetn060To064Mode3 1;
BA_ "GenSigSendType" SG_ 118 FLR2RdrDetn060To064Mode4 1;
BA_ "GenSigSendType" SG_ 118 FLR2RdrDetn060To064Quality0 1;
BA_ "GenSigSendType" SG_ 118 FLR2RdrDetn060To064Quality1 1;
BA_ "GenSigSendType" SG_ 118 FLR2RdrDetn060To064Quality2 1;
BA_ "GenSigSendType" SG_ 118 FLR2RdrDetn060To064Quality3 1;
BA_ "GenSigSendType" SG_ 118 FLR2RdrDetn060To064Quality4 1;
BA_ "GenSigSendType" SG_ 118 FLR2RdrDetn060To064RCS0 1;
BA_ "GenSigStartValue" SG_ 118 FLR2RdrDetn060To064RCS0 500;
BA_ "GenSigSendType" SG_ 118 FLR2RdrDetn060To064RCS1 1;
BA_ "GenSigStartValue" SG_ 118 FLR2RdrDetn060To064RCS1 500;
BA_ "GenSigSendType" SG_ 118 FLR2RdrDetn060To064RCS2 1;
BA_ "GenSigStartValue" SG_ 118 FLR2RdrDetn060To064RCS2 500;
BA_ "GenSigSendType" SG_ 118 FLR2RdrDetn060To064RCS3 1;
BA_ "GenSigStartValue" SG_ 118 FLR2RdrDetn060To064RCS3 500;
BA_ "GenSigSendType" SG_ 118 FLR2RdrDetn060To064RCS4 1;
BA_ "GenSigStartValue" SG_ 118 FLR2RdrDetn060To064RCS4 500;
BA_ "GenSigSendType" SG_ 118 FLR2RdrDetn060To064Range0 1;
BA_ "GenSigSendType" SG_ 118 FLR2RdrDetn060To064Range1 1;
BA_ "GenSigSendType" SG_ 118 FLR2RdrDetn060To064Range2 1;
BA_ "GenSigSendType" SG_ 118 FLR2RdrDetn060To064Range3 1;
BA_ "GenSigSendType" SG_ 118 FLR2RdrDetn060To064Range4 1;
BA_ "GenSigSendType" SG_ 118 FLR2RdrDetn060To064RngRt0 1;
BA_ "GenSigStartValue" SG_ 118 FLR2RdrDetn060To064RngRt0 1111;
BA_ "GenSigSendType" SG_ 118 FLR2RdrDetn060To064RngRt1 1;
BA_ "GenSigStartValue" SG_ 118 FLR2RdrDetn060To064RngRt1 1111;
BA_ "GenSigSendType" SG_ 118 FLR2RdrDetn060To064RngRt2 1;
BA_ "GenSigStartValue" SG_ 118 FLR2RdrDetn060To064RngRt2 1111;
BA_ "GenSigSendType" SG_ 118 FLR2RdrDetn060To064RngRt3 1;
BA_ "GenSigStartValue" SG_ 118 FLR2RdrDetn060To064RngRt3 1111;
BA_ "GenSigSendType" SG_ 118 FLR2RdrDetn060To064RngRt4 1;
BA_ "GenSigStartValue" SG_ 118 FLR2RdrDetn060To064RngRt4 1111;
BA_ "GenSigSendType" SG_ 118 FLR2RdrDetn060To064SNR0 1;
BA_ "GenSigSendType" SG_ 118 FLR2RdrDetn060To064SNR1 1;
BA_ "GenSigSendType" SG_ 118 FLR2RdrDetn060To064SNR2 1;
BA_ "GenSigSendType" SG_ 118 FLR2RdrDetn060To064SNR3 1;
BA_ "GenSigSendType" SG_ 118 FLR2RdrDetn060To064SNR4 1;
BA_ "GenSigSendType" SG_ 118 FLR2RdrDetn060To064ScanID 1;
BA_ "GenSigSendType" SG_ 121 FLR2RdrDetn065To069AziAng0 1;
BA_ "GenSigSendType" SG_ 121 FLR2RdrDetn065To069AziAng1 1;
BA_ "GenSigSendType" SG_ 121 FLR2RdrDetn065To069AziAng2 1;
BA_ "GenSigSendType" SG_ 121 FLR2RdrDetn065To069AziAng3 1;
BA_ "GenSigSendType" SG_ 121 FLR2RdrDetn065To069AziAng4 1;
BA_ "GenSigDataID" SG_ 121 FLR2RdrDetn065To069CRC "0xAC6";
BA_ "GenSigFuncType" SG_ 121 FLR2RdrDetn065To069CRC 28;
BA_ "GenSigSendType" SG_ 121 FLR2RdrDetn065To069CRC 1;
BA_ "GenSigFuncType" SG_ 121 FLR2RdrDetn065To069Counter 27;
BA_ "GenSigSendType" SG_ 121 FLR2RdrDetn065To069Counter 1;
BA_ "GenSigSendType" SG_ 121 FLR2RdrDetn065To069DynPrpty0 1;
BA_ "GenSigSendType" SG_ 121 FLR2RdrDetn065To069DynPrpty1 1;
BA_ "GenSigSendType" SG_ 121 FLR2RdrDetn065To069DynPrpty2 1;
BA_ "GenSigSendType" SG_ 121 FLR2RdrDetn065To069DynPrpty3 1;
BA_ "GenSigSendType" SG_ 121 FLR2RdrDetn065To069DynPrpty4 1;
BA_ "GenSigSendType" SG_ 121 FLR2RdrDetn065To069EleAng0 1;
BA_ "GenSigSendType" SG_ 121 FLR2RdrDetn065To069EleAng1 1;
BA_ "GenSigSendType" SG_ 121 FLR2RdrDetn065To069EleAng2 1;
BA_ "GenSigSendType" SG_ 121 FLR2RdrDetn065To069EleAng3 1;
BA_ "GenSigSendType" SG_ 121 FLR2RdrDetn065To069EleAng4 1;
BA_ "GenSigSendType" SG_ 121 FLR2RdrDetn065To069Mode0 1;
BA_ "GenSigSendType" SG_ 121 FLR2RdrDetn065To069Mode1 1;
BA_ "GenSigSendType" SG_ 121 FLR2RdrDetn065To069Mode2 1;
BA_ "GenSigSendType" SG_ 121 FLR2RdrDetn065To069Mode3 1;
BA_ "GenSigSendType" SG_ 121 FLR2RdrDetn065To069Mode4 1;
BA_ "GenSigSendType" SG_ 121 FLR2RdrDetn065To069Quality0 1;
BA_ "GenSigSendType" SG_ 121 FLR2RdrDetn065To069Quality1 1;
BA_ "GenSigSendType" SG_ 121 FLR2RdrDetn065To069Quality2 1;
BA_ "GenSigSendType" SG_ 121 FLR2RdrDetn065To069Quality3 1;
BA_ "GenSigSendType" SG_ 121 FLR2RdrDetn065To069Quality4 1;
BA_ "GenSigSendType" SG_ 121 FLR2RdrDetn065To069RCS0 1;
BA_ "GenSigStartValue" SG_ 121 FLR2RdrDetn065To069RCS0 500;
BA_ "GenSigSendType" SG_ 121 FLR2RdrDetn065To069RCS1 1;
BA_ "GenSigStartValue" SG_ 121 FLR2RdrDetn065To069RCS1 500;
BA_ "GenSigSendType" SG_ 121 FLR2RdrDetn065To069RCS2 1;
BA_ "GenSigStartValue" SG_ 121 FLR2RdrDetn065To069RCS2 500;
BA_ "GenSigSendType" SG_ 121 FLR2RdrDetn065To069RCS3 1;
BA_ "GenSigStartValue" SG_ 121 FLR2RdrDetn065To069RCS3 500;
BA_ "GenSigSendType" SG_ 121 FLR2RdrDetn065To069RCS4 1;
BA_ "GenSigStartValue" SG_ 121 FLR2RdrDetn065To069RCS4 500;
BA_ "GenSigSendType" SG_ 121 FLR2RdrDetn065To069Range0 1;
BA_ "GenSigSendType" SG_ 121 FLR2RdrDetn065To069Range1 1;
BA_ "GenSigSendType" SG_ 121 FLR2RdrDetn065To069Range2 1;
BA_ "GenSigSendType" SG_ 121 FLR2RdrDetn065To069Range3 1;
BA_ "GenSigSendType" SG_ 121 FLR2RdrDetn065To069Range4 1;
BA_ "GenSigSendType" SG_ 121 FLR2RdrDetn065To069RngRt0 1;
BA_ "GenSigStartValue" SG_ 121 FLR2RdrDetn065To069RngRt0 1111;
BA_ "GenSigSendType" SG_ 121 FLR2RdrDetn065To069RngRt1 1;
BA_ "GenSigStartValue" SG_ 121 FLR2RdrDetn065To069RngRt1 1111;
BA_ "GenSigSendType" SG_ 121 FLR2RdrDetn065To069RngRt2 1;
BA_ "GenSigStartValue" SG_ 121 FLR2RdrDetn065To069RngRt2 1111;
BA_ "GenSigSendType" SG_ 121 FLR2RdrDetn065To069RngRt3 1;
BA_ "GenSigStartValue" SG_ 121 FLR2RdrDetn065To069RngRt3 1111;
BA_ "GenSigSendType" SG_ 121 FLR2RdrDetn065To069RngRt4 1;
BA_ "GenSigStartValue" SG_ 121 FLR2RdrDetn065To069RngRt4 1111;
BA_ "GenSigSendType" SG_ 121 FLR2RdrDetn065To069SNR0 1;
BA_ "GenSigSendType" SG_ 121 FLR2RdrDetn065To069SNR1 1;
BA_ "GenSigSendType" SG_ 121 FLR2RdrDetn065To069SNR2 1;
BA_ "GenSigSendType" SG_ 121 FLR2RdrDetn065To069SNR3 1;
BA_ "GenSigSendType" SG_ 121 FLR2RdrDetn065To069SNR4 1;
BA_ "GenSigSendType" SG_ 121 FLR2RdrDetn065To069ScanID 1;
BA_ "GenSigSendType" SG_ 124 FLR2RdrDetn070To074AziAng0 1;
BA_ "GenSigSendType" SG_ 124 FLR2RdrDetn070To074AziAng1 1;
BA_ "GenSigSendType" SG_ 124 FLR2RdrDetn070To074AziAng2 1;
BA_ "GenSigSendType" SG_ 124 FLR2RdrDetn070To074AziAng3 1;
BA_ "GenSigSendType" SG_ 124 FLR2RdrDetn070To074AziAng4 1;
BA_ "GenSigDataID" SG_ 124 FLR2RdrDetn070To074CRC "0xAC7";
BA_ "GenSigFuncType" SG_ 124 FLR2RdrDetn070To074CRC 28;
BA_ "GenSigSendType" SG_ 124 FLR2RdrDetn070To074CRC 1;
BA_ "GenSigFuncType" SG_ 124 FLR2RdrDetn070To074Counter 27;
BA_ "GenSigSendType" SG_ 124 FLR2RdrDetn070To074Counter 1;
BA_ "GenSigSendType" SG_ 124 FLR2RdrDetn070To074DynPrpty0 1;
BA_ "GenSigSendType" SG_ 124 FLR2RdrDetn070To074DynPrpty1 1;
BA_ "GenSigSendType" SG_ 124 FLR2RdrDetn070To074DynPrpty2 1;
BA_ "GenSigSendType" SG_ 124 FLR2RdrDetn070To074DynPrpty3 1;
BA_ "GenSigSendType" SG_ 124 FLR2RdrDetn070To074DynPrpty4 1;
BA_ "GenSigSendType" SG_ 124 FLR2RdrDetn070To074EleAng0 1;
BA_ "GenSigSendType" SG_ 124 FLR2RdrDetn070To074EleAng1 1;
BA_ "GenSigSendType" SG_ 124 FLR2RdrDetn070To074EleAng2 1;
BA_ "GenSigSendType" SG_ 124 FLR2RdrDetn070To074EleAng3 1;
BA_ "GenSigSendType" SG_ 124 FLR2RdrDetn070To074EleAng4 1;
BA_ "GenSigSendType" SG_ 124 FLR2RdrDetn070To074Mode0 1;
BA_ "GenSigSendType" SG_ 124 FLR2RdrDetn070To074Mode1 1;
BA_ "GenSigSendType" SG_ 124 FLR2RdrDetn070To074Mode2 1;
BA_ "GenSigSendType" SG_ 124 FLR2RdrDetn070To074Mode3 1;
BA_ "GenSigSendType" SG_ 124 FLR2RdrDetn070To074Mode4 1;
BA_ "GenSigSendType" SG_ 124 FLR2RdrDetn070To074Quality0 1;
BA_ "GenSigSendType" SG_ 124 FLR2RdrDetn070To074Quality1 1;
BA_ "GenSigSendType" SG_ 124 FLR2RdrDetn070To074Quality2 1;
BA_ "GenSigSendType" SG_ 124 FLR2RdrDetn070To074Quality3 1;
BA_ "GenSigSendType" SG_ 124 FLR2RdrDetn070To074Quality4 1;
BA_ "GenSigSendType" SG_ 124 FLR2RdrDetn070To074RCS0 1;
BA_ "GenSigStartValue" SG_ 124 FLR2RdrDetn070To074RCS0 500;
BA_ "GenSigSendType" SG_ 124 FLR2RdrDetn070To074RCS1 1;
BA_ "GenSigStartValue" SG_ 124 FLR2RdrDetn070To074RCS1 500;
BA_ "GenSigSendType" SG_ 124 FLR2RdrDetn070To074RCS2 1;
BA_ "GenSigStartValue" SG_ 124 FLR2RdrDetn070To074RCS2 500;
BA_ "GenSigSendType" SG_ 124 FLR2RdrDetn070To074RCS3 1;
BA_ "GenSigStartValue" SG_ 124 FLR2RdrDetn070To074RCS3 500;
BA_ "GenSigSendType" SG_ 124 FLR2RdrDetn070To074RCS4 1;
BA_ "GenSigStartValue" SG_ 124 FLR2RdrDetn070To074RCS4 500;
BA_ "GenSigSendType" SG_ 124 FLR2RdrDetn070To074Range0 1;
BA_ "GenSigSendType" SG_ 124 FLR2RdrDetn070To074Range1 1;
BA_ "GenSigSendType" SG_ 124 FLR2RdrDetn070To074Range2 1;
BA_ "GenSigSendType" SG_ 124 FLR2RdrDetn070To074Range3 1;
BA_ "GenSigSendType" SG_ 124 FLR2RdrDetn070To074Range4 1;
BA_ "GenSigSendType" SG_ 124 FLR2RdrDetn070To074RngRt0 1;
BA_ "GenSigStartValue" SG_ 124 FLR2RdrDetn070To074RngRt0 1111;
BA_ "GenSigSendType" SG_ 124 FLR2RdrDetn070To074RngRt1 1;
BA_ "GenSigStartValue" SG_ 124 FLR2RdrDetn070To074RngRt1 1111;
BA_ "GenSigSendType" SG_ 124 FLR2RdrDetn070To074RngRt2 1;
BA_ "GenSigStartValue" SG_ 124 FLR2RdrDetn070To074RngRt2 1111;
BA_ "GenSigSendType" SG_ 124 FLR2RdrDetn070To074RngRt3 1;
BA_ "GenSigStartValue" SG_ 124 FLR2RdrDetn070To074RngRt3 1111;
BA_ "GenSigSendType" SG_ 124 FLR2RdrDetn070To074RngRt4 1;
BA_ "GenSigStartValue" SG_ 124 FLR2RdrDetn070To074RngRt4 1111;
BA_ "GenSigSendType" SG_ 124 FLR2RdrDetn070To074SNR0 1;
BA_ "GenSigSendType" SG_ 124 FLR2RdrDetn070To074SNR1 1;
BA_ "GenSigSendType" SG_ 124 FLR2RdrDetn070To074SNR2 1;
BA_ "GenSigSendType" SG_ 124 FLR2RdrDetn070To074SNR3 1;
BA_ "GenSigSendType" SG_ 124 FLR2RdrDetn070To074SNR4 1;
BA_ "GenSigSendType" SG_ 124 FLR2RdrDetn070To074ScanID 1;
BA_ "GenSigSendType" SG_ 131 FLR2RdrDetn075To079AziAng0 1;
BA_ "GenSigSendType" SG_ 131 FLR2RdrDetn075To079AziAng1 1;
BA_ "GenSigSendType" SG_ 131 FLR2RdrDetn075To079AziAng2 1;
BA_ "GenSigSendType" SG_ 131 FLR2RdrDetn075To079AziAng3 1;
BA_ "GenSigSendType" SG_ 131 FLR2RdrDetn075To079AziAng4 1;
BA_ "GenSigDataID" SG_ 131 FLR2RdrDetn075To079CRC "0xAC8";
BA_ "GenSigFuncType" SG_ 131 FLR2RdrDetn075To079CRC 28;
BA_ "GenSigSendType" SG_ 131 FLR2RdrDetn075To079CRC 1;
BA_ "GenSigFuncType" SG_ 131 FLR2RdrDetn075To079Counter 27;
BA_ "GenSigSendType" SG_ 131 FLR2RdrDetn075To079Counter 1;
BA_ "GenSigSendType" SG_ 131 FLR2RdrDetn075To079DynPrpty0 1;
BA_ "GenSigSendType" SG_ 131 FLR2RdrDetn075To079DynPrpty1 1;
BA_ "GenSigSendType" SG_ 131 FLR2RdrDetn075To079DynPrpty2 1;
BA_ "GenSigSendType" SG_ 131 FLR2RdrDetn075To079DynPrpty3 1;
BA_ "GenSigSendType" SG_ 131 FLR2RdrDetn075To079DynPrpty4 1;
BA_ "GenSigSendType" SG_ 131 FLR2RdrDetn075To079EleAng0 1;
BA_ "GenSigSendType" SG_ 131 FLR2RdrDetn075To079EleAng1 1;
BA_ "GenSigSendType" SG_ 131 FLR2RdrDetn075To079EleAng2 1;
BA_ "GenSigSendType" SG_ 131 FLR2RdrDetn075To079EleAng3 1;
BA_ "GenSigSendType" SG_ 131 FLR2RdrDetn075To079EleAng4 1;
BA_ "GenSigSendType" SG_ 131 FLR2RdrDetn075To079Mode0 1;
BA_ "GenSigSendType" SG_ 131 FLR2RdrDetn075To079Mode1 1;
BA_ "GenSigSendType" SG_ 131 FLR2RdrDetn075To079Mode2 1;
BA_ "GenSigSendType" SG_ 131 FLR2RdrDetn075To079Mode3 1;
BA_ "GenSigSendType" SG_ 131 FLR2RdrDetn075To079Mode4 1;
BA_ "GenSigSendType" SG_ 131 FLR2RdrDetn075To079Quality0 1;
BA_ "GenSigSendType" SG_ 131 FLR2RdrDetn075To079Quality1 1;
BA_ "GenSigSendType" SG_ 131 FLR2RdrDetn075To079Quality2 1;
BA_ "GenSigSendType" SG_ 131 FLR2RdrDetn075To079Quality3 1;
BA_ "GenSigSendType" SG_ 131 FLR2RdrDetn075To079Quality4 1;
BA_ "GenSigSendType" SG_ 131 FLR2RdrDetn075To079RCS0 1;
BA_ "GenSigStartValue" SG_ 131 FLR2RdrDetn075To079RCS0 500;
BA_ "GenSigSendType" SG_ 131 FLR2RdrDetn075To079RCS1 1;
BA_ "GenSigStartValue" SG_ 131 FLR2RdrDetn075To079RCS1 500;
BA_ "GenSigSendType" SG_ 131 FLR2RdrDetn075To079RCS2 1;
BA_ "GenSigStartValue" SG_ 131 FLR2RdrDetn075To079RCS2 500;
BA_ "GenSigSendType" SG_ 131 FLR2RdrDetn075To079RCS3 1;
BA_ "GenSigStartValue" SG_ 131 FLR2RdrDetn075To079RCS3 500;
BA_ "GenSigSendType" SG_ 131 FLR2RdrDetn075To079RCS4 1;
BA_ "GenSigStartValue" SG_ 131 FLR2RdrDetn075To079RCS4 500;
BA_ "GenSigSendType" SG_ 131 FLR2RdrDetn075To079Range0 1;
BA_ "GenSigSendType" SG_ 131 FLR2RdrDetn075To079Range1 1;
BA_ "GenSigSendType" SG_ 131 FLR2RdrDetn075To079Range2 1;
BA_ "GenSigSendType" SG_ 131 FLR2RdrDetn075To079Range3 1;
BA_ "GenSigSendType" SG_ 131 FLR2RdrDetn075To079Range4 1;
BA_ "GenSigSendType" SG_ 131 FLR2RdrDetn075To079RngRt0 1;
BA_ "GenSigStartValue" SG_ 131 FLR2RdrDetn075To079RngRt0 1111;
BA_ "GenSigSendType" SG_ 131 FLR2RdrDetn075To079RngRt1 1;
BA_ "GenSigStartValue" SG_ 131 FLR2RdrDetn075To079RngRt1 1111;
BA_ "GenSigSendType" SG_ 131 FLR2RdrDetn075To079RngRt2 1;
BA_ "GenSigStartValue" SG_ 131 FLR2RdrDetn075To079RngRt2 1111;
BA_ "GenSigSendType" SG_ 131 FLR2RdrDetn075To079RngRt3 1;
BA_ "GenSigStartValue" SG_ 131 FLR2RdrDetn075To079RngRt3 1111;
BA_ "GenSigSendType" SG_ 131 FLR2RdrDetn075To079RngRt4 1;
BA_ "GenSigStartValue" SG_ 131 FLR2RdrDetn075To079RngRt4 1111;
BA_ "GenSigSendType" SG_ 131 FLR2RdrDetn075To079SNR0 1;
BA_ "GenSigSendType" SG_ 131 FLR2RdrDetn075To079SNR1 1;
BA_ "GenSigSendType" SG_ 131 FLR2RdrDetn075To079SNR2 1;
BA_ "GenSigSendType" SG_ 131 FLR2RdrDetn075To079SNR3 1;
BA_ "GenSigSendType" SG_ 131 FLR2RdrDetn075To079SNR4 1;
BA_ "GenSigSendType" SG_ 131 FLR2RdrDetn075To079ScanID 1;
BA_ "GenSigSendType" SG_ 134 FLR2RdrDetn080To084AziAng0 1;
BA_ "GenSigSendType" SG_ 134 FLR2RdrDetn080To084AziAng1 1;
BA_ "GenSigSendType" SG_ 134 FLR2RdrDetn080To084AziAng2 1;
BA_ "GenSigSendType" SG_ 134 FLR2RdrDetn080To084AziAng3 1;
BA_ "GenSigSendType" SG_ 134 FLR2RdrDetn080To084AziAng4 1;
BA_ "GenSigDataID" SG_ 134 FLR2RdrDetn080To084CRC "0xAC9";
BA_ "GenSigFuncType" SG_ 134 FLR2RdrDetn080To084CRC 28;
BA_ "GenSigSendType" SG_ 134 FLR2RdrDetn080To084CRC 1;
BA_ "GenSigFuncType" SG_ 134 FLR2RdrDetn080To084Counter 27;
BA_ "GenSigSendType" SG_ 134 FLR2RdrDetn080To084Counter 1;
BA_ "GenSigSendType" SG_ 134 FLR2RdrDetn080To084DynPrpty0 1;
BA_ "GenSigSendType" SG_ 134 FLR2RdrDetn080To084DynPrpty1 1;
BA_ "GenSigSendType" SG_ 134 FLR2RdrDetn080To084DynPrpty2 1;
BA_ "GenSigSendType" SG_ 134 FLR2RdrDetn080To084DynPrpty3 1;
BA_ "GenSigSendType" SG_ 134 FLR2RdrDetn080To084DynPrpty4 1;
BA_ "GenSigSendType" SG_ 134 FLR2RdrDetn080To084EleAng0 1;
BA_ "GenSigSendType" SG_ 134 FLR2RdrDetn080To084EleAng1 1;
BA_ "GenSigSendType" SG_ 134 FLR2RdrDetn080To084EleAng2 1;
BA_ "GenSigSendType" SG_ 134 FLR2RdrDetn080To084EleAng3 1;
BA_ "GenSigSendType" SG_ 134 FLR2RdrDetn080To084EleAng4 1;
BA_ "GenSigSendType" SG_ 134 FLR2RdrDetn080To084Mode0 1;
BA_ "GenSigSendType" SG_ 134 FLR2RdrDetn080To084Mode1 1;
BA_ "GenSigSendType" SG_ 134 FLR2RdrDetn080To084Mode2 1;
BA_ "GenSigSendType" SG_ 134 FLR2RdrDetn080To084Mode3 1;
BA_ "GenSigSendType" SG_ 134 FLR2RdrDetn080To084Mode4 1;
BA_ "GenSigSendType" SG_ 134 FLR2RdrDetn080To084Quality0 1;
BA_ "GenSigSendType" SG_ 134 FLR2RdrDetn080To084Quality1 1;
BA_ "GenSigSendType" SG_ 134 FLR2RdrDetn080To084Quality2 1;
BA_ "GenSigSendType" SG_ 134 FLR2RdrDetn080To084Quality3 1;
BA_ "GenSigSendType" SG_ 134 FLR2RdrDetn080To084Quality4 1;
BA_ "GenSigSendType" SG_ 134 FLR2RdrDetn080To084RCS0 1;
BA_ "GenSigStartValue" SG_ 134 FLR2RdrDetn080To084RCS0 500;
BA_ "GenSigSendType" SG_ 134 FLR2RdrDetn080To084RCS1 1;
BA_ "GenSigStartValue" SG_ 134 FLR2RdrDetn080To084RCS1 500;
BA_ "GenSigSendType" SG_ 134 FLR2RdrDetn080To084RCS2 1;
BA_ "GenSigStartValue" SG_ 134 FLR2RdrDetn080To084RCS2 500;
BA_ "GenSigSendType" SG_ 134 FLR2RdrDetn080To084RCS3 1;
BA_ "GenSigStartValue" SG_ 134 FLR2RdrDetn080To084RCS3 500;
BA_ "GenSigSendType" SG_ 134 FLR2RdrDetn080To084RCS4 1;
BA_ "GenSigStartValue" SG_ 134 FLR2RdrDetn080To084RCS4 500;
BA_ "GenSigSendType" SG_ 134 FLR2RdrDetn080To084Range0 1;
BA_ "GenSigSendType" SG_ 134 FLR2RdrDetn080To084Range1 1;
BA_ "GenSigSendType" SG_ 134 FLR2RdrDetn080To084Range2 1;
BA_ "GenSigSendType" SG_ 134 FLR2RdrDetn080To084Range3 1;
BA_ "GenSigSendType" SG_ 134 FLR2RdrDetn080To084Range4 1;
BA_ "GenSigSendType" SG_ 134 FLR2RdrDetn080To084RngRt0 1;
BA_ "GenSigStartValue" SG_ 134 FLR2RdrDetn080To084RngRt0 1111;
BA_ "GenSigSendType" SG_ 134 FLR2RdrDetn080To084RngRt1 1;
BA_ "GenSigStartValue" SG_ 134 FLR2RdrDetn080To084RngRt1 1111;
BA_ "GenSigSendType" SG_ 134 FLR2RdrDetn080To084RngRt2 1;
BA_ "GenSigStartValue" SG_ 134 FLR2RdrDetn080To084RngRt2 1111;
BA_ "GenSigSendType" SG_ 134 FLR2RdrDetn080To084RngRt3 1;
BA_ "GenSigStartValue" SG_ 134 FLR2RdrDetn080To084RngRt3 1111;
BA_ "GenSigSendType" SG_ 134 FLR2RdrDetn080To084RngRt4 1;
BA_ "GenSigStartValue" SG_ 134 FLR2RdrDetn080To084RngRt4 1111;
BA_ "GenSigSendType" SG_ 134 FLR2RdrDetn080To084SNR0 1;
BA_ "GenSigSendType" SG_ 134 FLR2RdrDetn080To084SNR1 1;
BA_ "GenSigSendType" SG_ 134 FLR2RdrDetn080To084SNR2 1;
BA_ "GenSigSendType" SG_ 134 FLR2RdrDetn080To084SNR3 1;
BA_ "GenSigSendType" SG_ 134 FLR2RdrDetn080To084SNR4 1;
BA_ "GenSigSendType" SG_ 134 FLR2RdrDetn080To084ScanID 1;
BA_ "GenSigSendType" SG_ 137 FLR2RdrDetn085To089AziAng0 1;
BA_ "GenSigSendType" SG_ 137 FLR2RdrDetn085To089AziAng1 1;
BA_ "GenSigSendType" SG_ 137 FLR2RdrDetn085To089AziAng2 1;
BA_ "GenSigSendType" SG_ 137 FLR2RdrDetn085To089AziAng3 1;
BA_ "GenSigSendType" SG_ 137 FLR2RdrDetn085To089AziAng4 1;
BA_ "GenSigDataID" SG_ 137 FLR2RdrDetn085To089CRC "0xACA";
BA_ "GenSigFuncType" SG_ 137 FLR2RdrDetn085To089CRC 28;
BA_ "GenSigSendType" SG_ 137 FLR2RdrDetn085To089CRC 1;
BA_ "GenSigFuncType" SG_ 137 FLR2RdrDetn085To089Counter 27;
BA_ "GenSigSendType" SG_ 137 FLR2RdrDetn085To089Counter 1;
BA_ "GenSigSendType" SG_ 137 FLR2RdrDetn085To089DynPrpty0 1;
BA_ "GenSigSendType" SG_ 137 FLR2RdrDetn085To089DynPrpty1 1;
BA_ "GenSigSendType" SG_ 137 FLR2RdrDetn085To089DynPrpty2 1;
BA_ "GenSigSendType" SG_ 137 FLR2RdrDetn085To089DynPrpty3 1;
BA_ "GenSigSendType" SG_ 137 FLR2RdrDetn085To089DynPrpty4 1;
BA_ "GenSigSendType" SG_ 137 FLR2RdrDetn085To089EleAng0 1;
BA_ "GenSigSendType" SG_ 137 FLR2RdrDetn085To089EleAng1 1;
BA_ "GenSigSendType" SG_ 137 FLR2RdrDetn085To089EleAng2 1;
BA_ "GenSigSendType" SG_ 137 FLR2RdrDetn085To089EleAng3 1;
BA_ "GenSigSendType" SG_ 137 FLR2RdrDetn085To089EleAng4 1;
BA_ "GenSigSendType" SG_ 137 FLR2RdrDetn085To089Mode0 1;
BA_ "GenSigSendType" SG_ 137 FLR2RdrDetn085To089Mode1 1;
BA_ "GenSigSendType" SG_ 137 FLR2RdrDetn085To089Mode2 1;
BA_ "GenSigSendType" SG_ 137 FLR2RdrDetn085To089Mode3 1;
BA_ "GenSigSendType" SG_ 137 FLR2RdrDetn085To089Mode4 1;
BA_ "GenSigSendType" SG_ 137 FLR2RdrDetn085To089Quality0 1;
BA_ "GenSigSendType" SG_ 137 FLR2RdrDetn085To089Quality1 1;
BA_ "GenSigSendType" SG_ 137 FLR2RdrDetn085To089Quality2 1;
BA_ "GenSigSendType" SG_ 137 FLR2RdrDetn085To089Quality3 1;
BA_ "GenSigSendType" SG_ 137 FLR2RdrDetn085To089Quality4 1;
BA_ "GenSigSendType" SG_ 137 FLR2RdrDetn085To089RCS0 1;
BA_ "GenSigStartValue" SG_ 137 FLR2RdrDetn085To089RCS0 500;
BA_ "GenSigSendType" SG_ 137 FLR2RdrDetn085To089RCS1 1;
BA_ "GenSigStartValue" SG_ 137 FLR2RdrDetn085To089RCS1 500;
BA_ "GenSigSendType" SG_ 137 FLR2RdrDetn085To089RCS2 1;
BA_ "GenSigStartValue" SG_ 137 FLR2RdrDetn085To089RCS2 500;
BA_ "GenSigSendType" SG_ 137 FLR2RdrDetn085To089RCS3 1;
BA_ "GenSigStartValue" SG_ 137 FLR2RdrDetn085To089RCS3 500;
BA_ "GenSigSendType" SG_ 137 FLR2RdrDetn085To089RCS4 1;
BA_ "GenSigStartValue" SG_ 137 FLR2RdrDetn085To089RCS4 500;
BA_ "GenSigSendType" SG_ 137 FLR2RdrDetn085To089Range0 1;
BA_ "GenSigSendType" SG_ 137 FLR2RdrDetn085To089Range1 1;
BA_ "GenSigSendType" SG_ 137 FLR2RdrDetn085To089Range2 1;
BA_ "GenSigSendType" SG_ 137 FLR2RdrDetn085To089Range3 1;
BA_ "GenSigSendType" SG_ 137 FLR2RdrDetn085To089Range4 1;
BA_ "GenSigSendType" SG_ 137 FLR2RdrDetn085To089RngRt0 1;
BA_ "GenSigStartValue" SG_ 137 FLR2RdrDetn085To089RngRt0 1111;
BA_ "GenSigSendType" SG_ 137 FLR2RdrDetn085To089RngRt1 1;
BA_ "GenSigStartValue" SG_ 137 FLR2RdrDetn085To089RngRt1 1111;
BA_ "GenSigSendType" SG_ 137 FLR2RdrDetn085To089RngRt2 1;
BA_ "GenSigStartValue" SG_ 137 FLR2RdrDetn085To089RngRt2 1111;
BA_ "GenSigSendType" SG_ 137 FLR2RdrDetn085To089RngRt3 1;
BA_ "GenSigStartValue" SG_ 137 FLR2RdrDetn085To089RngRt3 1111;
BA_ "GenSigSendType" SG_ 137 FLR2RdrDetn085To089RngRt4 1;
BA_ "GenSigStartValue" SG_ 137 FLR2RdrDetn085To089RngRt4 1111;
BA_ "GenSigSendType" SG_ 137 FLR2RdrDetn085To089SNR0 1;
BA_ "GenSigSendType" SG_ 137 FLR2RdrDetn085To089SNR1 1;
BA_ "GenSigSendType" SG_ 137 FLR2RdrDetn085To089SNR2 1;
BA_ "GenSigSendType" SG_ 137 FLR2RdrDetn085To089SNR3 1;
BA_ "GenSigSendType" SG_ 137 FLR2RdrDetn085To089SNR4 1;
BA_ "GenSigSendType" SG_ 137 FLR2RdrDetn085To089ScanID 1;
BA_ "GenSigSendType" SG_ 140 FLR2RdrDetn090To094AziAng0 1;
BA_ "GenSigSendType" SG_ 140 FLR2RdrDetn090To094AziAng1 1;
BA_ "GenSigSendType" SG_ 140 FLR2RdrDetn090To094AziAng2 1;
BA_ "GenSigSendType" SG_ 140 FLR2RdrDetn090To094AziAng3 1;
BA_ "GenSigSendType" SG_ 140 FLR2RdrDetn090To094AziAng4 1;
BA_ "GenSigDataID" SG_ 140 FLR2RdrDetn090To094CRC "0xACB";
BA_ "GenSigFuncType" SG_ 140 FLR2RdrDetn090To094CRC 28;
BA_ "GenSigSendType" SG_ 140 FLR2RdrDetn090To094CRC 1;
BA_ "GenSigFuncType" SG_ 140 FLR2RdrDetn090To094Counter 27;
BA_ "GenSigSendType" SG_ 140 FLR2RdrDetn090To094Counter 1;
BA_ "GenSigSendType" SG_ 140 FLR2RdrDetn090To094DynPrpty0 1;
BA_ "GenSigSendType" SG_ 140 FLR2RdrDetn090To094DynPrpty1 1;
BA_ "GenSigSendType" SG_ 140 FLR2RdrDetn090To094DynPrpty2 1;
BA_ "GenSigSendType" SG_ 140 FLR2RdrDetn090To094DynPrpty3 1;
BA_ "GenSigSendType" SG_ 140 FLR2RdrDetn090To094DynPrpty4 1;
BA_ "GenSigSendType" SG_ 140 FLR2RdrDetn090To094EleAng0 1;
BA_ "GenSigSendType" SG_ 140 FLR2RdrDetn090To094EleAng1 1;
BA_ "GenSigSendType" SG_ 140 FLR2RdrDetn090To094EleAng2 1;
BA_ "GenSigSendType" SG_ 140 FLR2RdrDetn090To094EleAng3 1;
BA_ "GenSigSendType" SG_ 140 FLR2RdrDetn090To094EleAng4 1;
BA_ "GenSigSendType" SG_ 140 FLR2RdrDetn090To094Mode0 1;
BA_ "GenSigSendType" SG_ 140 FLR2RdrDetn090To094Mode1 1;
BA_ "GenSigSendType" SG_ 140 FLR2RdrDetn090To094Mode2 1;
BA_ "GenSigSendType" SG_ 140 FLR2RdrDetn090To094Mode3 1;
BA_ "GenSigSendType" SG_ 140 FLR2RdrDetn090To094Mode4 1;
BA_ "GenSigSendType" SG_ 140 FLR2RdrDetn090To094Quality0 1;
BA_ "GenSigSendType" SG_ 140 FLR2RdrDetn090To094Quality1 1;
BA_ "GenSigSendType" SG_ 140 FLR2RdrDetn090To094Quality2 1;
BA_ "GenSigSendType" SG_ 140 FLR2RdrDetn090To094Quality3 1;
BA_ "GenSigSendType" SG_ 140 FLR2RdrDetn090To094Quality4 1;
BA_ "GenSigSendType" SG_ 140 FLR2RdrDetn090To094RCS0 1;
BA_ "GenSigStartValue" SG_ 140 FLR2RdrDetn090To094RCS0 500;
BA_ "GenSigSendType" SG_ 140 FLR2RdrDetn090To094RCS1 1;
BA_ "GenSigStartValue" SG_ 140 FLR2RdrDetn090To094RCS1 500;
BA_ "GenSigSendType" SG_ 140 FLR2RdrDetn090To094RCS2 1;
BA_ "GenSigStartValue" SG_ 140 FLR2RdrDetn090To094RCS2 500;
BA_ "GenSigSendType" SG_ 140 FLR2RdrDetn090To094RCS3 1;
BA_ "GenSigStartValue" SG_ 140 FLR2RdrDetn090To094RCS3 500;
BA_ "GenSigSendType" SG_ 140 FLR2RdrDetn090To094RCS4 1;
BA_ "GenSigStartValue" SG_ 140 FLR2RdrDetn090To094RCS4 500;
BA_ "GenSigSendType" SG_ 140 FLR2RdrDetn090To094Range0 1;
BA_ "GenSigSendType" SG_ 140 FLR2RdrDetn090To094Range1 1;
BA_ "GenSigSendType" SG_ 140 FLR2RdrDetn090To094Range2 1;
BA_ "GenSigSendType" SG_ 140 FLR2RdrDetn090To094Range3 1;
BA_ "GenSigSendType" SG_ 140 FLR2RdrDetn090To094Range4 1;
BA_ "GenSigSendType" SG_ 140 FLR2RdrDetn090To094RngRt0 1;
BA_ "GenSigStartValue" SG_ 140 FLR2RdrDetn090To094RngRt0 1111;
BA_ "GenSigSendType" SG_ 140 FLR2RdrDetn090To094RngRt1 1;
BA_ "GenSigStartValue" SG_ 140 FLR2RdrDetn090To094RngRt1 1111;
BA_ "GenSigSendType" SG_ 140 FLR2RdrDetn090To094RngRt2 1;
BA_ "GenSigStartValue" SG_ 140 FLR2RdrDetn090To094RngRt2 1111;
BA_ "GenSigSendType" SG_ 140 FLR2RdrDetn090To094RngRt3 1;
BA_ "GenSigStartValue" SG_ 140 FLR2RdrDetn090To094RngRt3 1111;
BA_ "GenSigSendType" SG_ 140 FLR2RdrDetn090To094RngRt4 1;
BA_ "GenSigStartValue" SG_ 140 FLR2RdrDetn090To094RngRt4 1111;
BA_ "GenSigSendType" SG_ 140 FLR2RdrDetn090To094SNR0 1;
BA_ "GenSigSendType" SG_ 140 FLR2RdrDetn090To094SNR1 1;
BA_ "GenSigSendType" SG_ 140 FLR2RdrDetn090To094SNR2 1;
BA_ "GenSigSendType" SG_ 140 FLR2RdrDetn090To094SNR3 1;
BA_ "GenSigSendType" SG_ 140 FLR2RdrDetn090To094SNR4 1;
BA_ "GenSigSendType" SG_ 140 FLR2RdrDetn090To094ScanID 1;
BA_ "GenSigSendType" SG_ 144 FLR2RdrDetn095To099AziAng0 1;
BA_ "GenSigSendType" SG_ 144 FLR2RdrDetn095To099AziAng1 1;
BA_ "GenSigSendType" SG_ 144 FLR2RdrDetn095To099AziAng2 1;
BA_ "GenSigSendType" SG_ 144 FLR2RdrDetn095To099AziAng3 1;
BA_ "GenSigSendType" SG_ 144 FLR2RdrDetn095To099AziAng4 1;
BA_ "GenSigDataID" SG_ 144 FLR2RdrDetn095To099CRC "0xACC";
BA_ "GenSigFuncType" SG_ 144 FLR2RdrDetn095To099CRC 28;
BA_ "GenSigSendType" SG_ 144 FLR2RdrDetn095To099CRC 1;
BA_ "GenSigFuncType" SG_ 144 FLR2RdrDetn095To099Counter 27;
BA_ "GenSigSendType" SG_ 144 FLR2RdrDetn095To099Counter 1;
BA_ "GenSigSendType" SG_ 144 FLR2RdrDetn095To099DynPrpty0 1;
BA_ "GenSigSendType" SG_ 144 FLR2RdrDetn095To099DynPrpty1 1;
BA_ "GenSigSendType" SG_ 144 FLR2RdrDetn095To099DynPrpty2 1;
BA_ "GenSigSendType" SG_ 144 FLR2RdrDetn095To099DynPrpty3 1;
BA_ "GenSigSendType" SG_ 144 FLR2RdrDetn095To099DynPrpty4 1;
BA_ "GenSigSendType" SG_ 144 FLR2RdrDetn095To099EleAng0 1;
BA_ "GenSigSendType" SG_ 144 FLR2RdrDetn095To099EleAng1 1;
BA_ "GenSigSendType" SG_ 144 FLR2RdrDetn095To099EleAng2 1;
BA_ "GenSigSendType" SG_ 144 FLR2RdrDetn095To099EleAng3 1;
BA_ "GenSigSendType" SG_ 144 FLR2RdrDetn095To099EleAng4 1;
BA_ "GenSigSendType" SG_ 144 FLR2RdrDetn095To099Mode0 1;
BA_ "GenSigSendType" SG_ 144 FLR2RdrDetn095To099Mode1 1;
BA_ "GenSigSendType" SG_ 144 FLR2RdrDetn095To099Mode2 1;
BA_ "GenSigSendType" SG_ 144 FLR2RdrDetn095To099Mode3 1;
BA_ "GenSigSendType" SG_ 144 FLR2RdrDetn095To099Mode4 1;
BA_ "GenSigSendType" SG_ 144 FLR2RdrDetn095To099Quality0 1;
BA_ "GenSigSendType" SG_ 144 FLR2RdrDetn095To099Quality1 1;
BA_ "GenSigSendType" SG_ 144 FLR2RdrDetn095To099Quality2 1;
BA_ "GenSigSendType" SG_ 144 FLR2RdrDetn095To099Quality3 1;
BA_ "GenSigSendType" SG_ 144 FLR2RdrDetn095To099Quality4 1;
BA_ "GenSigSendType" SG_ 144 FLR2RdrDetn095To099RCS0 1;
BA_ "GenSigStartValue" SG_ 144 FLR2RdrDetn095To099RCS0 500;
BA_ "GenSigSendType" SG_ 144 FLR2RdrDetn095To099RCS1 1;
BA_ "GenSigStartValue" SG_ 144 FLR2RdrDetn095To099RCS1 500;
BA_ "GenSigSendType" SG_ 144 FLR2RdrDetn095To099RCS2 1;
BA_ "GenSigStartValue" SG_ 144 FLR2RdrDetn095To099RCS2 500;
BA_ "GenSigSendType" SG_ 144 FLR2RdrDetn095To099RCS3 1;
BA_ "GenSigStartValue" SG_ 144 FLR2RdrDetn095To099RCS3 500;
BA_ "GenSigSendType" SG_ 144 FLR2RdrDetn095To099RCS4 1;
BA_ "GenSigStartValue" SG_ 144 FLR2RdrDetn095To099RCS4 500;
BA_ "GenSigSendType" SG_ 144 FLR2RdrDetn095To099Range0 1;
BA_ "GenSigSendType" SG_ 144 FLR2RdrDetn095To099Range1 1;
BA_ "GenSigSendType" SG_ 144 FLR2RdrDetn095To099Range2 1;
BA_ "GenSigSendType" SG_ 144 FLR2RdrDetn095To099Range3 1;
BA_ "GenSigSendType" SG_ 144 FLR2RdrDetn095To099Range4 1;
BA_ "GenSigSendType" SG_ 144 FLR2RdrDetn095To099RngRt0 1;
BA_ "GenSigStartValue" SG_ 144 FLR2RdrDetn095To099RngRt0 1111;
BA_ "GenSigSendType" SG_ 144 FLR2RdrDetn095To099RngRt1 1;
BA_ "GenSigStartValue" SG_ 144 FLR2RdrDetn095To099RngRt1 1111;
BA_ "GenSigSendType" SG_ 144 FLR2RdrDetn095To099RngRt2 1;
BA_ "GenSigStartValue" SG_ 144 FLR2RdrDetn095To099RngRt2 1111;
BA_ "GenSigSendType" SG_ 144 FLR2RdrDetn095To099RngRt3 1;
BA_ "GenSigStartValue" SG_ 144 FLR2RdrDetn095To099RngRt3 1111;
BA_ "GenSigSendType" SG_ 144 FLR2RdrDetn095To099RngRt4 1;
BA_ "GenSigStartValue" SG_ 144 FLR2RdrDetn095To099RngRt4 1111;
BA_ "GenSigSendType" SG_ 144 FLR2RdrDetn095To099SNR0 1;
BA_ "GenSigSendType" SG_ 144 FLR2RdrDetn095To099SNR1 1;
BA_ "GenSigSendType" SG_ 144 FLR2RdrDetn095To099SNR2 1;
BA_ "GenSigSendType" SG_ 144 FLR2RdrDetn095To099SNR3 1;
BA_ "GenSigSendType" SG_ 144 FLR2RdrDetn095To099SNR4 1;
BA_ "GenSigSendType" SG_ 144 FLR2RdrDetn095To099ScanID 1;
BA_ "GenSigSendType" SG_ 147 FLR2RdrDetn100To104AziAng0 1;
BA_ "GenSigSendType" SG_ 147 FLR2RdrDetn100To104AziAng1 1;
BA_ "GenSigSendType" SG_ 147 FLR2RdrDetn100To104AziAng2 1;
BA_ "GenSigSendType" SG_ 147 FLR2RdrDetn100To104AziAng3 1;
BA_ "GenSigSendType" SG_ 147 FLR2RdrDetn100To104AziAng4 1;
BA_ "GenSigDataID" SG_ 147 FLR2RdrDetn100To104CRC "0xACD";
BA_ "GenSigFuncType" SG_ 147 FLR2RdrDetn100To104CRC 28;
BA_ "GenSigSendType" SG_ 147 FLR2RdrDetn100To104CRC 1;
BA_ "GenSigFuncType" SG_ 147 FLR2RdrDetn100To104Counter 27;
BA_ "GenSigSendType" SG_ 147 FLR2RdrDetn100To104Counter 1;
BA_ "GenSigSendType" SG_ 147 FLR2RdrDetn100To104DynPrpty0 1;
BA_ "GenSigSendType" SG_ 147 FLR2RdrDetn100To104DynPrpty1 1;
BA_ "GenSigSendType" SG_ 147 FLR2RdrDetn100To104DynPrpty2 1;
BA_ "GenSigSendType" SG_ 147 FLR2RdrDetn100To104DynPrpty3 1;
BA_ "GenSigSendType" SG_ 147 FLR2RdrDetn100To104DynPrpty4 1;
BA_ "GenSigSendType" SG_ 147 FLR2RdrDetn100To104EleAng0 1;
BA_ "GenSigSendType" SG_ 147 FLR2RdrDetn100To104EleAng1 1;
BA_ "GenSigSendType" SG_ 147 FLR2RdrDetn100To104EleAng2 1;
BA_ "GenSigSendType" SG_ 147 FLR2RdrDetn100To104EleAng3 1;
BA_ "GenSigSendType" SG_ 147 FLR2RdrDetn100To104EleAng4 1;
BA_ "GenSigSendType" SG_ 147 FLR2RdrDetn100To104Mode0 1;
BA_ "GenSigSendType" SG_ 147 FLR2RdrDetn100To104Mode1 1;
BA_ "GenSigSendType" SG_ 147 FLR2RdrDetn100To104Mode2 1;
BA_ "GenSigSendType" SG_ 147 FLR2RdrDetn100To104Mode3 1;
BA_ "GenSigSendType" SG_ 147 FLR2RdrDetn100To104Mode4 1;
BA_ "GenSigSendType" SG_ 147 FLR2RdrDetn100To104Quality0 1;
BA_ "GenSigSendType" SG_ 147 FLR2RdrDetn100To104Quality1 1;
BA_ "GenSigSendType" SG_ 147 FLR2RdrDetn100To104Quality2 1;
BA_ "GenSigSendType" SG_ 147 FLR2RdrDetn100To104Quality3 1;
BA_ "GenSigSendType" SG_ 147 FLR2RdrDetn100To104Quality4 1;
BA_ "GenSigSendType" SG_ 147 FLR2RdrDetn100To104RCS0 1;
BA_ "GenSigStartValue" SG_ 147 FLR2RdrDetn100To104RCS0 500;
BA_ "GenSigSendType" SG_ 147 FLR2RdrDetn100To104RCS1 1;
BA_ "GenSigStartValue" SG_ 147 FLR2RdrDetn100To104RCS1 500;
BA_ "GenSigSendType" SG_ 147 FLR2RdrDetn100To104RCS2 1;
BA_ "GenSigStartValue" SG_ 147 FLR2RdrDetn100To104RCS2 500;
BA_ "GenSigSendType" SG_ 147 FLR2RdrDetn100To104RCS3 1;
BA_ "GenSigStartValue" SG_ 147 FLR2RdrDetn100To104RCS3 500;
BA_ "GenSigSendType" SG_ 147 FLR2RdrDetn100To104RCS4 1;
BA_ "GenSigStartValue" SG_ 147 FLR2RdrDetn100To104RCS4 500;
BA_ "GenSigSendType" SG_ 147 FLR2RdrDetn100To104Range0 1;
BA_ "GenSigSendType" SG_ 147 FLR2RdrDetn100To104Range1 1;
BA_ "GenSigSendType" SG_ 147 FLR2RdrDetn100To104Range2 1;
BA_ "GenSigSendType" SG_ 147 FLR2RdrDetn100To104Range3 1;
BA_ "GenSigSendType" SG_ 147 FLR2RdrDetn100To104Range4 1;
BA_ "GenSigSendType" SG_ 147 FLR2RdrDetn100To104RngRt0 1;
BA_ "GenSigStartValue" SG_ 147 FLR2RdrDetn100To104RngRt0 1111;
BA_ "GenSigSendType" SG_ 147 FLR2RdrDetn100To104RngRt1 1;
BA_ "GenSigStartValue" SG_ 147 FLR2RdrDetn100To104RngRt1 1111;
BA_ "GenSigSendType" SG_ 147 FLR2RdrDetn100To104RngRt2 1;
BA_ "GenSigStartValue" SG_ 147 FLR2RdrDetn100To104RngRt2 1111;
BA_ "GenSigSendType" SG_ 147 FLR2RdrDetn100To104RngRt3 1;
BA_ "GenSigStartValue" SG_ 147 FLR2RdrDetn100To104RngRt3 1111;
BA_ "GenSigSendType" SG_ 147 FLR2RdrDetn100To104RngRt4 1;
BA_ "GenSigStartValue" SG_ 147 FLR2RdrDetn100To104RngRt4 1111;
BA_ "GenSigSendType" SG_ 147 FLR2RdrDetn100To104SNR0 1;
BA_ "GenSigSendType" SG_ 147 FLR2RdrDetn100To104SNR1 1;
BA_ "GenSigSendType" SG_ 147 FLR2RdrDetn100To104SNR2 1;
BA_ "GenSigSendType" SG_ 147 FLR2RdrDetn100To104SNR3 1;
BA_ "GenSigSendType" SG_ 147 FLR2RdrDetn100To104SNR4 1;
BA_ "GenSigSendType" SG_ 147 FLR2RdrDetn100To104ScanID 1;
BA_ "GenSigSendType" SG_ 150 FLR2RdrDetn105To109AziAng0 1;
BA_ "GenSigSendType" SG_ 150 FLR2RdrDetn105To109AziAng1 1;
BA_ "GenSigSendType" SG_ 150 FLR2RdrDetn105To109AziAng2 1;
BA_ "GenSigSendType" SG_ 150 FLR2RdrDetn105To109AziAng3 1;
BA_ "GenSigSendType" SG_ 150 FLR2RdrDetn105To109AziAng4 1;
BA_ "GenSigDataID" SG_ 150 FLR2RdrDetn105To109CRC "0xACE";
BA_ "GenSigFuncType" SG_ 150 FLR2RdrDetn105To109CRC 28;
BA_ "GenSigSendType" SG_ 150 FLR2RdrDetn105To109CRC 1;
BA_ "GenSigFuncType" SG_ 150 FLR2RdrDetn105To109Counter 27;
BA_ "GenSigSendType" SG_ 150 FLR2RdrDetn105To109Counter 1;
BA_ "GenSigSendType" SG_ 150 FLR2RdrDetn105To109DynPrpty0 1;
BA_ "GenSigSendType" SG_ 150 FLR2RdrDetn105To109DynPrpty1 1;
BA_ "GenSigSendType" SG_ 150 FLR2RdrDetn105To109DynPrpty2 1;
BA_ "GenSigSendType" SG_ 150 FLR2RdrDetn105To109DynPrpty3 1;
BA_ "GenSigSendType" SG_ 150 FLR2RdrDetn105To109DynPrpty4 1;
BA_ "GenSigSendType" SG_ 150 FLR2RdrDetn105To109EleAng0 1;
BA_ "GenSigSendType" SG_ 150 FLR2RdrDetn105To109EleAng1 1;
BA_ "GenSigSendType" SG_ 150 FLR2RdrDetn105To109EleAng2 1;
BA_ "GenSigSendType" SG_ 150 FLR2RdrDetn105To109EleAng3 1;
BA_ "GenSigSendType" SG_ 150 FLR2RdrDetn105To109EleAng4 1;
BA_ "GenSigSendType" SG_ 150 FLR2RdrDetn105To109Mode0 1;
BA_ "GenSigSendType" SG_ 150 FLR2RdrDetn105To109Mode1 1;
BA_ "GenSigSendType" SG_ 150 FLR2RdrDetn105To109Mode2 1;
BA_ "GenSigSendType" SG_ 150 FLR2RdrDetn105To109Mode3 1;
BA_ "GenSigSendType" SG_ 150 FLR2RdrDetn105To109Mode4 1;
BA_ "GenSigSendType" SG_ 150 FLR2RdrDetn105To109Quality0 1;
BA_ "GenSigSendType" SG_ 150 FLR2RdrDetn105To109Quality1 1;
BA_ "GenSigSendType" SG_ 150 FLR2RdrDetn105To109Quality2 1;
BA_ "GenSigSendType" SG_ 150 FLR2RdrDetn105To109Quality3 1;
BA_ "GenSigSendType" SG_ 150 FLR2RdrDetn105To109Quality4 1;
BA_ "GenSigSendType" SG_ 150 FLR2RdrDetn105To109RCS0 1;
BA_ "GenSigStartValue" SG_ 150 FLR2RdrDetn105To109RCS0 500;
BA_ "GenSigSendType" SG_ 150 FLR2RdrDetn105To109RCS1 1;
BA_ "GenSigStartValue" SG_ 150 FLR2RdrDetn105To109RCS1 500;
BA_ "GenSigSendType" SG_ 150 FLR2RdrDetn105To109RCS2 1;
BA_ "GenSigStartValue" SG_ 150 FLR2RdrDetn105To109RCS2 500;
BA_ "GenSigSendType" SG_ 150 FLR2RdrDetn105To109RCS3 1;
BA_ "GenSigStartValue" SG_ 150 FLR2RdrDetn105To109RCS3 500;
BA_ "GenSigSendType" SG_ 150 FLR2RdrDetn105To109RCS4 1;
BA_ "GenSigStartValue" SG_ 150 FLR2RdrDetn105To109RCS4 500;
BA_ "GenSigSendType" SG_ 150 FLR2RdrDetn105To109Range0 1;
BA_ "GenSigSendType" SG_ 150 FLR2RdrDetn105To109Range1 1;
BA_ "GenSigSendType" SG_ 150 FLR2RdrDetn105To109Range2 1;
BA_ "GenSigSendType" SG_ 150 FLR2RdrDetn105To109Range3 1;
BA_ "GenSigSendType" SG_ 150 FLR2RdrDetn105To109Range4 1;
BA_ "GenSigSendType" SG_ 150 FLR2RdrDetn105To109RngRt0 1;
BA_ "GenSigStartValue" SG_ 150 FLR2RdrDetn105To109RngRt0 1111;
BA_ "GenSigSendType" SG_ 150 FLR2RdrDetn105To109RngRt1 1;
BA_ "GenSigStartValue" SG_ 150 FLR2RdrDetn105To109RngRt1 1111;
BA_ "GenSigSendType" SG_ 150 FLR2RdrDetn105To109RngRt2 1;
BA_ "GenSigStartValue" SG_ 150 FLR2RdrDetn105To109RngRt2 1111;
BA_ "GenSigSendType" SG_ 150 FLR2RdrDetn105To109RngRt3 1;
BA_ "GenSigStartValue" SG_ 150 FLR2RdrDetn105To109RngRt3 1111;
BA_ "GenSigSendType" SG_ 150 FLR2RdrDetn105To109RngRt4 1;
BA_ "GenSigStartValue" SG_ 150 FLR2RdrDetn105To109RngRt4 1111;
BA_ "GenSigSendType" SG_ 150 FLR2RdrDetn105To109SNR0 1;
BA_ "GenSigSendType" SG_ 150 FLR2RdrDetn105To109SNR1 1;
BA_ "GenSigSendType" SG_ 150 FLR2RdrDetn105To109SNR2 1;
BA_ "GenSigSendType" SG_ 150 FLR2RdrDetn105To109SNR3 1;
BA_ "GenSigSendType" SG_ 150 FLR2RdrDetn105To109SNR4 1;
BA_ "GenSigSendType" SG_ 150 FLR2RdrDetn105To109ScanID 1;
BA_ "GenSigSendType" SG_ 153 FLR2RdrDetn110To114AziAng0 1;
BA_ "GenSigSendType" SG_ 153 FLR2RdrDetn110To114AziAng1 1;
BA_ "GenSigSendType" SG_ 153 FLR2RdrDetn110To114AziAng2 1;
BA_ "GenSigSendType" SG_ 153 FLR2RdrDetn110To114AziAng3 1;
BA_ "GenSigSendType" SG_ 153 FLR2RdrDetn110To114AziAng4 1;
BA_ "GenSigDataID" SG_ 153 FLR2RdrDetn110To114CRC "0xACF";
BA_ "GenSigFuncType" SG_ 153 FLR2RdrDetn110To114CRC 28;
BA_ "GenSigSendType" SG_ 153 FLR2RdrDetn110To114CRC 1;
BA_ "GenSigFuncType" SG_ 153 FLR2RdrDetn110To114Counter 27;
BA_ "GenSigSendType" SG_ 153 FLR2RdrDetn110To114Counter 1;
BA_ "GenSigSendType" SG_ 153 FLR2RdrDetn110To114DynPrpty0 1;
BA_ "GenSigSendType" SG_ 153 FLR2RdrDetn110To114DynPrpty1 1;
BA_ "GenSigSendType" SG_ 153 FLR2RdrDetn110To114DynPrpty2 1;
BA_ "GenSigSendType" SG_ 153 FLR2RdrDetn110To114DynPrpty3 1;
BA_ "GenSigSendType" SG_ 153 FLR2RdrDetn110To114DynPrpty4 1;
BA_ "GenSigSendType" SG_ 153 FLR2RdrDetn110To114EleAng0 1;
BA_ "GenSigSendType" SG_ 153 FLR2RdrDetn110To114EleAng1 1;
BA_ "GenSigSendType" SG_ 153 FLR2RdrDetn110To114EleAng2 1;
BA_ "GenSigSendType" SG_ 153 FLR2RdrDetn110To114EleAng3 1;
BA_ "GenSigSendType" SG_ 153 FLR2RdrDetn110To114EleAng4 1;
BA_ "GenSigSendType" SG_ 153 FLR2RdrDetn110To114Mode0 1;
BA_ "GenSigSendType" SG_ 153 FLR2RdrDetn110To114Mode1 1;
BA_ "GenSigSendType" SG_ 153 FLR2RdrDetn110To114Mode2 1;
BA_ "GenSigSendType" SG_ 153 FLR2RdrDetn110To114Mode3 1;
BA_ "GenSigSendType" SG_ 153 FLR2RdrDetn110To114Mode4 1;
BA_ "GenSigSendType" SG_ 153 FLR2RdrDetn110To114Quality0 1;
BA_ "GenSigSendType" SG_ 153 FLR2RdrDetn110To114Quality1 1;
BA_ "GenSigSendType" SG_ 153 FLR2RdrDetn110To114Quality2 1;
BA_ "GenSigSendType" SG_ 153 FLR2RdrDetn110To114Quality3 1;
BA_ "GenSigSendType" SG_ 153 FLR2RdrDetn110To114Quality4 1;
BA_ "GenSigSendType" SG_ 153 FLR2RdrDetn110To114RCS0 1;
BA_ "GenSigStartValue" SG_ 153 FLR2RdrDetn110To114RCS0 500;
BA_ "GenSigSendType" SG_ 153 FLR2RdrDetn110To114RCS1 1;
BA_ "GenSigStartValue" SG_ 153 FLR2RdrDetn110To114RCS1 500;
BA_ "GenSigSendType" SG_ 153 FLR2RdrDetn110To114RCS2 1;
BA_ "GenSigStartValue" SG_ 153 FLR2RdrDetn110To114RCS2 500;
BA_ "GenSigSendType" SG_ 153 FLR2RdrDetn110To114RCS3 1;
BA_ "GenSigStartValue" SG_ 153 FLR2RdrDetn110To114RCS3 500;
BA_ "GenSigSendType" SG_ 153 FLR2RdrDetn110To114RCS4 1;
BA_ "GenSigStartValue" SG_ 153 FLR2RdrDetn110To114RCS4 500;
BA_ "GenSigSendType" SG_ 153 FLR2RdrDetn110To114Range0 1;
BA_ "GenSigSendType" SG_ 153 FLR2RdrDetn110To114Range1 1;
BA_ "GenSigSendType" SG_ 153 FLR2RdrDetn110To114Range2 1;
BA_ "GenSigSendType" SG_ 153 FLR2RdrDetn110To114Range3 1;
BA_ "GenSigSendType" SG_ 153 FLR2RdrDetn110To114Range4 1;
BA_ "GenSigSendType" SG_ 153 FLR2RdrDetn110To114RngRt0 1;
BA_ "GenSigStartValue" SG_ 153 FLR2RdrDetn110To114RngRt0 1111;
BA_ "GenSigSendType" SG_ 153 FLR2RdrDetn110To114RngRt1 1;
BA_ "GenSigStartValue" SG_ 153 FLR2RdrDetn110To114RngRt1 1111;
BA_ "GenSigSendType" SG_ 153 FLR2RdrDetn110To114RngRt2 1;
BA_ "GenSigStartValue" SG_ 153 FLR2RdrDetn110To114RngRt2 1111;
BA_ "GenSigSendType" SG_ 153 FLR2RdrDetn110To114RngRt3 1;
BA_ "GenSigStartValue" SG_ 153 FLR2RdrDetn110To114RngRt3 1111;
BA_ "GenSigSendType" SG_ 153 FLR2RdrDetn110To114RngRt4 1;
BA_ "GenSigStartValue" SG_ 153 FLR2RdrDetn110To114RngRt4 1111;
BA_ "GenSigSendType" SG_ 153 FLR2RdrDetn110To114SNR0 1;
BA_ "GenSigSendType" SG_ 153 FLR2RdrDetn110To114SNR1 1;
BA_ "GenSigSendType" SG_ 153 FLR2RdrDetn110To114SNR2 1;
BA_ "GenSigSendType" SG_ 153 FLR2RdrDetn110To114SNR3 1;
BA_ "GenSigSendType" SG_ 153 FLR2RdrDetn110To114SNR4 1;
BA_ "GenSigSendType" SG_ 153 FLR2RdrDetn110To114ScanID 1;
BA_ "GenSigSendType" SG_ 156 FLR2RdrDetn115To119AziAng0 1;
BA_ "GenSigSendType" SG_ 156 FLR2RdrDetn115To119AziAng1 1;
BA_ "GenSigSendType" SG_ 156 FLR2RdrDetn115To119AziAng2 1;
BA_ "GenSigSendType" SG_ 156 FLR2RdrDetn115To119AziAng3 1;
BA_ "GenSigSendType" SG_ 156 FLR2RdrDetn115To119AziAng4 1;
BA_ "GenSigDataID" SG_ 156 FLR2RdrDetn115To119CRC "0xAD0";
BA_ "GenSigFuncType" SG_ 156 FLR2RdrDetn115To119CRC 28;
BA_ "GenSigSendType" SG_ 156 FLR2RdrDetn115To119CRC 1;
BA_ "GenSigFuncType" SG_ 156 FLR2RdrDetn115To119Counter 27;
BA_ "GenSigSendType" SG_ 156 FLR2RdrDetn115To119Counter 1;
BA_ "GenSigSendType" SG_ 156 FLR2RdrDetn115To119DynPrpty0 1;
BA_ "GenSigSendType" SG_ 156 FLR2RdrDetn115To119DynPrpty1 1;
BA_ "GenSigSendType" SG_ 156 FLR2RdrDetn115To119DynPrpty2 1;
BA_ "GenSigSendType" SG_ 156 FLR2RdrDetn115To119DynPrpty3 1;
BA_ "GenSigSendType" SG_ 156 FLR2RdrDetn115To119DynPrpty4 1;
BA_ "GenSigSendType" SG_ 156 FLR2RdrDetn115To119EleAng0 1;
BA_ "GenSigSendType" SG_ 156 FLR2RdrDetn115To119EleAng1 1;
BA_ "GenSigSendType" SG_ 156 FLR2RdrDetn115To119EleAng2 1;
BA_ "GenSigSendType" SG_ 156 FLR2RdrDetn115To119EleAng3 1;
BA_ "GenSigSendType" SG_ 156 FLR2RdrDetn115To119EleAng4 1;
BA_ "GenSigSendType" SG_ 156 FLR2RdrDetn115To119Mode0 1;
BA_ "GenSigSendType" SG_ 156 FLR2RdrDetn115To119Mode1 1;
BA_ "GenSigSendType" SG_ 156 FLR2RdrDetn115To119Mode2 1;
BA_ "GenSigSendType" SG_ 156 FLR2RdrDetn115To119Mode3 1;
BA_ "GenSigSendType" SG_ 156 FLR2RdrDetn115To119Mode4 1;
BA_ "GenSigSendType" SG_ 156 FLR2RdrDetn115To119Quality0 1;
BA_ "GenSigSendType" SG_ 156 FLR2RdrDetn115To119Quality1 1;
BA_ "GenSigSendType" SG_ 156 FLR2RdrDetn115To119Quality2 1;
BA_ "GenSigSendType" SG_ 156 FLR2RdrDetn115To119Quality3 1;
BA_ "GenSigSendType" SG_ 156 FLR2RdrDetn115To119Quality4 1;
BA_ "GenSigSendType" SG_ 156 FLR2RdrDetn115To119RCS0 1;
BA_ "GenSigStartValue" SG_ 156 FLR2RdrDetn115To119RCS0 500;
BA_ "GenSigSendType" SG_ 156 FLR2RdrDetn115To119RCS1 1;
BA_ "GenSigStartValue" SG_ 156 FLR2RdrDetn115To119RCS1 500;
BA_ "GenSigSendType" SG_ 156 FLR2RdrDetn115To119RCS2 1;
BA_ "GenSigStartValue" SG_ 156 FLR2RdrDetn115To119RCS2 500;
BA_ "GenSigSendType" SG_ 156 FLR2RdrDetn115To119RCS3 1;
BA_ "GenSigStartValue" SG_ 156 FLR2RdrDetn115To119RCS3 500;
BA_ "GenSigSendType" SG_ 156 FLR2RdrDetn115To119RCS4 1;
BA_ "GenSigStartValue" SG_ 156 FLR2RdrDetn115To119RCS4 500;
BA_ "GenSigSendType" SG_ 156 FLR2RdrDetn115To119Range0 1;
BA_ "GenSigSendType" SG_ 156 FLR2RdrDetn115To119Range1 1;
BA_ "GenSigSendType" SG_ 156 FLR2RdrDetn115To119Range2 1;
BA_ "GenSigSendType" SG_ 156 FLR2RdrDetn115To119Range3 1;
BA_ "GenSigSendType" SG_ 156 FLR2RdrDetn115To119Range4 1;
BA_ "GenSigSendType" SG_ 156 FLR2RdrDetn115To119RngRt0 1;
BA_ "GenSigStartValue" SG_ 156 FLR2RdrDetn115To119RngRt0 1111;
BA_ "GenSigSendType" SG_ 156 FLR2RdrDetn115To119RngRt1 1;
BA_ "GenSigStartValue" SG_ 156 FLR2RdrDetn115To119RngRt1 1111;
BA_ "GenSigSendType" SG_ 156 FLR2RdrDetn115To119RngRt2 1;
BA_ "GenSigStartValue" SG_ 156 FLR2RdrDetn115To119RngRt2 1111;
BA_ "GenSigSendType" SG_ 156 FLR2RdrDetn115To119RngRt3 1;
BA_ "GenSigStartValue" SG_ 156 FLR2RdrDetn115To119RngRt3 1111;
BA_ "GenSigSendType" SG_ 156 FLR2RdrDetn115To119RngRt4 1;
BA_ "GenSigStartValue" SG_ 156 FLR2RdrDetn115To119RngRt4 1111;
BA_ "GenSigSendType" SG_ 156 FLR2RdrDetn115To119SNR0 1;
BA_ "GenSigSendType" SG_ 156 FLR2RdrDetn115To119SNR1 1;
BA_ "GenSigSendType" SG_ 156 FLR2RdrDetn115To119SNR2 1;
BA_ "GenSigSendType" SG_ 156 FLR2RdrDetn115To119SNR3 1;
BA_ "GenSigSendType" SG_ 156 FLR2RdrDetn115To119SNR4 1;
BA_ "GenSigSendType" SG_ 156 FLR2RdrDetn115To119ScanID 1;
BA_ "GenSigSendType" SG_ 160 FLR2RdrDetn120To124AziAng0 1;
BA_ "GenSigSendType" SG_ 160 FLR2RdrDetn120To124AziAng1 1;
BA_ "GenSigSendType" SG_ 160 FLR2RdrDetn120To124AziAng2 1;
BA_ "GenSigSendType" SG_ 160 FLR2RdrDetn120To124AziAng3 1;
BA_ "GenSigSendType" SG_ 160 FLR2RdrDetn120To124AziAng4 1;
BA_ "GenSigDataID" SG_ 160 FLR2RdrDetn120To124CRC "0xAD1";
BA_ "GenSigFuncType" SG_ 160 FLR2RdrDetn120To124CRC 28;
BA_ "GenSigSendType" SG_ 160 FLR2RdrDetn120To124CRC 1;
BA_ "GenSigFuncType" SG_ 160 FLR2RdrDetn120To124Counter 27;
BA_ "GenSigSendType" SG_ 160 FLR2RdrDetn120To124Counter 1;
BA_ "GenSigSendType" SG_ 160 FLR2RdrDetn120To124DynPrpty0 1;
BA_ "GenSigSendType" SG_ 160 FLR2RdrDetn120To124DynPrpty1 1;
BA_ "GenSigSendType" SG_ 160 FLR2RdrDetn120To124DynPrpty2 1;
BA_ "GenSigSendType" SG_ 160 FLR2RdrDetn120To124DynPrpty3 1;
BA_ "GenSigSendType" SG_ 160 FLR2RdrDetn120To124DynPrpty4 1;
BA_ "GenSigSendType" SG_ 160 FLR2RdrDetn120To124EleAng0 1;
BA_ "GenSigSendType" SG_ 160 FLR2RdrDetn120To124EleAng1 1;
BA_ "GenSigSendType" SG_ 160 FLR2RdrDetn120To124EleAng2 1;
BA_ "GenSigSendType" SG_ 160 FLR2RdrDetn120To124EleAng3 1;
BA_ "GenSigSendType" SG_ 160 FLR2RdrDetn120To124EleAng4 1;
BA_ "GenSigSendType" SG_ 160 FLR2RdrDetn120To124Mode0 1;
BA_ "GenSigSendType" SG_ 160 FLR2RdrDetn120To124Mode1 1;
BA_ "GenSigSendType" SG_ 160 FLR2RdrDetn120To124Mode2 1;
BA_ "GenSigSendType" SG_ 160 FLR2RdrDetn120To124Mode3 1;
BA_ "GenSigSendType" SG_ 160 FLR2RdrDetn120To124Mode4 1;
BA_ "GenSigSendType" SG_ 160 FLR2RdrDetn120To124Quality0 1;
BA_ "GenSigSendType" SG_ 160 FLR2RdrDetn120To124Quality1 1;
BA_ "GenSigSendType" SG_ 160 FLR2RdrDetn120To124Quality2 1;
BA_ "GenSigSendType" SG_ 160 FLR2RdrDetn120To124Quality3 1;
BA_ "GenSigSendType" SG_ 160 FLR2RdrDetn120To124Quality4 1;
BA_ "GenSigSendType" SG_ 160 FLR2RdrDetn120To124RCS0 1;
BA_ "GenSigStartValue" SG_ 160 FLR2RdrDetn120To124RCS0 500;
BA_ "GenSigSendType" SG_ 160 FLR2RdrDetn120To124RCS1 1;
BA_ "GenSigStartValue" SG_ 160 FLR2RdrDetn120To124RCS1 500;
BA_ "GenSigSendType" SG_ 160 FLR2RdrDetn120To124RCS2 1;
BA_ "GenSigStartValue" SG_ 160 FLR2RdrDetn120To124RCS2 500;
BA_ "GenSigSendType" SG_ 160 FLR2RdrDetn120To124RCS3 1;
BA_ "GenSigStartValue" SG_ 160 FLR2RdrDetn120To124RCS3 500;
BA_ "GenSigSendType" SG_ 160 FLR2RdrDetn120To124RCS4 1;
BA_ "GenSigStartValue" SG_ 160 FLR2RdrDetn120To124RCS4 500;
BA_ "GenSigSendType" SG_ 160 FLR2RdrDetn120To124Range0 1;
BA_ "GenSigSendType" SG_ 160 FLR2RdrDetn120To124Range1 1;
BA_ "GenSigSendType" SG_ 160 FLR2RdrDetn120To124Range2 1;
BA_ "GenSigSendType" SG_ 160 FLR2RdrDetn120To124Range3 1;
BA_ "GenSigSendType" SG_ 160 FLR2RdrDetn120To124Range4 1;
BA_ "GenSigSendType" SG_ 160 FLR2RdrDetn120To124RngRt0 1;
BA_ "GenSigStartValue" SG_ 160 FLR2RdrDetn120To124RngRt0 1111;
BA_ "GenSigSendType" SG_ 160 FLR2RdrDetn120To124RngRt1 1;
BA_ "GenSigStartValue" SG_ 160 FLR2RdrDetn120To124RngRt1 1111;
BA_ "GenSigSendType" SG_ 160 FLR2RdrDetn120To124RngRt2 1;
BA_ "GenSigStartValue" SG_ 160 FLR2RdrDetn120To124RngRt2 1111;
BA_ "GenSigSendType" SG_ 160 FLR2RdrDetn120To124RngRt3 1;
BA_ "GenSigStartValue" SG_ 160 FLR2RdrDetn120To124RngRt3 1111;
BA_ "GenSigSendType" SG_ 160 FLR2RdrDetn120To124RngRt4 1;
BA_ "GenSigStartValue" SG_ 160 FLR2RdrDetn120To124RngRt4 1111;
BA_ "GenSigSendType" SG_ 160 FLR2RdrDetn120To124SNR0 1;
BA_ "GenSigSendType" SG_ 160 FLR2RdrDetn120To124SNR1 1;
BA_ "GenSigSendType" SG_ 160 FLR2RdrDetn120To124SNR2 1;
BA_ "GenSigSendType" SG_ 160 FLR2RdrDetn120To124SNR3 1;
BA_ "GenSigSendType" SG_ 160 FLR2RdrDetn120To124SNR4 1;
BA_ "GenSigSendType" SG_ 160 FLR2RdrDetn120To124ScanID 1;
BA_ "GenSigSendType" SG_ 163 FLR2RdrDetn125To129AziAng0 1;
BA_ "GenSigSendType" SG_ 163 FLR2RdrDetn125To129AziAng1 1;
BA_ "GenSigSendType" SG_ 163 FLR2RdrDetn125To129AziAng2 1;
BA_ "GenSigSendType" SG_ 163 FLR2RdrDetn125To129AziAng3 1;
BA_ "GenSigSendType" SG_ 163 FLR2RdrDetn125To129AziAng4 1;
BA_ "GenSigDataID" SG_ 163 FLR2RdrDetn125To129CRC "0xAD2";
BA_ "GenSigFuncType" SG_ 163 FLR2RdrDetn125To129CRC 28;
BA_ "GenSigSendType" SG_ 163 FLR2RdrDetn125To129CRC 1;
BA_ "GenSigFuncType" SG_ 163 FLR2RdrDetn125To129Counter 27;
BA_ "GenSigSendType" SG_ 163 FLR2RdrDetn125To129Counter 1;
BA_ "GenSigSendType" SG_ 163 FLR2RdrDetn125To129DynPrpty0 1;
BA_ "GenSigSendType" SG_ 163 FLR2RdrDetn125To129DynPrpty1 1;
BA_ "GenSigSendType" SG_ 163 FLR2RdrDetn125To129DynPrpty2 1;
BA_ "GenSigSendType" SG_ 163 FLR2RdrDetn125To129DynPrpty3 1;
BA_ "GenSigSendType" SG_ 163 FLR2RdrDetn125To129DynPrpty4 1;
BA_ "GenSigSendType" SG_ 163 FLR2RdrDetn125To129EleAng0 1;
BA_ "GenSigSendType" SG_ 163 FLR2RdrDetn125To129EleAng1 1;
BA_ "GenSigSendType" SG_ 163 FLR2RdrDetn125To129EleAng2 1;
BA_ "GenSigSendType" SG_ 163 FLR2RdrDetn125To129EleAng3 1;
BA_ "GenSigSendType" SG_ 163 FLR2RdrDetn125To129EleAng4 1;
BA_ "GenSigSendType" SG_ 163 FLR2RdrDetn125To129Mode0 1;
BA_ "GenSigSendType" SG_ 163 FLR2RdrDetn125To129Mode1 1;
BA_ "GenSigSendType" SG_ 163 FLR2RdrDetn125To129Mode2 1;
BA_ "GenSigSendType" SG_ 163 FLR2RdrDetn125To129Mode3 1;
BA_ "GenSigSendType" SG_ 163 FLR2RdrDetn125To129Mode4 1;
BA_ "GenSigSendType" SG_ 163 FLR2RdrDetn125To129Quality0 1;
BA_ "GenSigSendType" SG_ 163 FLR2RdrDetn125To129Quality1 1;
BA_ "GenSigSendType" SG_ 163 FLR2RdrDetn125To129Quality2 1;
BA_ "GenSigSendType" SG_ 163 FLR2RdrDetn125To129Quality3 1;
BA_ "GenSigSendType" SG_ 163 FLR2RdrDetn125To129Quality4 1;
BA_ "GenSigSendType" SG_ 163 FLR2RdrDetn125To129RCS0 1;
BA_ "GenSigStartValue" SG_ 163 FLR2RdrDetn125To129RCS0 500;
BA_ "GenSigSendType" SG_ 163 FLR2RdrDetn125To129RCS1 1;
BA_ "GenSigStartValue" SG_ 163 FLR2RdrDetn125To129RCS1 500;
BA_ "GenSigSendType" SG_ 163 FLR2RdrDetn125To129RCS2 1;
BA_ "GenSigStartValue" SG_ 163 FLR2RdrDetn125To129RCS2 500;
BA_ "GenSigSendType" SG_ 163 FLR2RdrDetn125To129RCS3 1;
BA_ "GenSigStartValue" SG_ 163 FLR2RdrDetn125To129RCS3 500;
BA_ "GenSigSendType" SG_ 163 FLR2RdrDetn125To129RCS4 1;
BA_ "GenSigStartValue" SG_ 163 FLR2RdrDetn125To129RCS4 500;
BA_ "GenSigSendType" SG_ 163 FLR2RdrDetn125To129Range0 1;
BA_ "GenSigSendType" SG_ 163 FLR2RdrDetn125To129Range1 1;
BA_ "GenSigSendType" SG_ 163 FLR2RdrDetn125To129Range2 1;
BA_ "GenSigSendType" SG_ 163 FLR2RdrDetn125To129Range3 1;
BA_ "GenSigSendType" SG_ 163 FLR2RdrDetn125To129Range4 1;
BA_ "GenSigSendType" SG_ 163 FLR2RdrDetn125To129RngRt0 1;
BA_ "GenSigStartValue" SG_ 163 FLR2RdrDetn125To129RngRt0 1111;
BA_ "GenSigSendType" SG_ 163 FLR2RdrDetn125To129RngRt1 1;
BA_ "GenSigStartValue" SG_ 163 FLR2RdrDetn125To129RngRt1 1111;
BA_ "GenSigSendType" SG_ 163 FLR2RdrDetn125To129RngRt2 1;
BA_ "GenSigStartValue" SG_ 163 FLR2RdrDetn125To129RngRt2 1111;
BA_ "GenSigSendType" SG_ 163 FLR2RdrDetn125To129RngRt3 1;
BA_ "GenSigStartValue" SG_ 163 FLR2RdrDetn125To129RngRt3 1111;
BA_ "GenSigSendType" SG_ 163 FLR2RdrDetn125To129RngRt4 1;
BA_ "GenSigStartValue" SG_ 163 FLR2RdrDetn125To129RngRt4 1111;
BA_ "GenSigSendType" SG_ 163 FLR2RdrDetn125To129SNR0 1;
BA_ "GenSigSendType" SG_ 163 FLR2RdrDetn125To129SNR1 1;
BA_ "GenSigSendType" SG_ 163 FLR2RdrDetn125To129SNR2 1;
BA_ "GenSigSendType" SG_ 163 FLR2RdrDetn125To129SNR3 1;
BA_ "GenSigSendType" SG_ 163 FLR2RdrDetn125To129SNR4 1;
BA_ "GenSigSendType" SG_ 163 FLR2RdrDetn125To129ScanID 1;
VAL_ 118 FLR2RdrDetn060To064Mode0 0 "FLR2RadrDetnMode_RngNearReslMod" 1 "FLR2RadrDetnMode_RngMidReslMod" 2 "FLR2RadrDetnMode_RngLongReslMod" 3 "FLR2RadrDetnMode_DetectionUnpopulated";
VAL_ 118 FLR2RdrDetn060To064Mode1 0 "FLR2RadrDetnMode_RngNearReslMod" 1 "FLR2RadrDetnMode_RngMidReslMod" 2 "FLR2RadrDetnMode_RngLongReslMod" 3 "FLR2RadrDetnMode_DetectionUnpopulated";
VAL_ 118 FLR2RdrDetn060To064Mode2 0 "FLR2RadrDetnMode_RngNearReslMod" 1 "FLR2RadrDetnMode_RngMidReslMod" 2 "FLR2RadrDetnMode_RngLongReslMod" 3 "FLR2RadrDetnMode_DetectionUnpopulated";
VAL_ 118 FLR2RdrDetn060To064Mode3 0 "FLR2RadrDetnMode_RngNearReslMod" 1 "FLR2RadrDetnMode_RngMidReslMod" 2 "FLR2RadrDetnMode_RngLongReslMod" 3 "FLR2RadrDetnMode_DetectionUnpopulated";
VAL_ 118 FLR2RdrDetn060To064Mode4 0 "FLR2RadrDetnMode_RngNearReslMod" 1 "FLR2RadrDetnMode_RngMidReslMod" 2 "FLR2RadrDetnMode_RngLongReslMod" 3 "FLR2RadrDetnMode_DetectionUnpopulated";
VAL_ 118 FLR2RdrDetn060To064Quality0 0 "Quality_Low" 1 "Quality_Medium" 2 "Quality_High" 3 "Quality_DetectionUnpopulated";
VAL_ 118 FLR2RdrDetn060To064Quality1 0 "Quality_Low" 1 "Quality_Medium" 2 "Quality_High" 3 "Quality_DetectionUnpopulated";
VAL_ 118 FLR2RdrDetn060To064Quality2 0 "Quality_Low" 1 "Quality_Medium" 2 "Quality_High" 3 "Quality_DetectionUnpopulated";
VAL_ 118 FLR2RdrDetn060To064Quality3 0 "Quality_Low" 1 "Quality_Medium" 2 "Quality_High" 3 "Quality_DetectionUnpopulated";
VAL_ 118 FLR2RdrDetn060To064Quality4 0 "Quality_Low" 1 "Quality_Medium" 2 "Quality_High" 3 "Quality_DetectionUnpopulated";
VAL_ 121 FLR2RdrDetn065To069Mode0 0 "FLR2RadrDetnMode_RngNearReslMod" 1 "FLR2RadrDetnMode_RngMidReslMod" 2 "FLR2RadrDetnMode_RngLongReslMod" 3 "FLR2RadrDetnMode_DetectionUnpopulated";
VAL_ 121 FLR2RdrDetn065To069Mode1 0 "FLR2RadrDetnMode_RngNearReslMod" 1 "FLR2RadrDetnMode_RngMidReslMod" 2 "FLR2RadrDetnMode_RngLongReslMod" 3 "FLR2RadrDetnMode_DetectionUnpopulated";
VAL_ 121 FLR2RdrDetn065To069Mode2 0 "FLR2RadrDetnMode_RngNearReslMod" 1 "FLR2RadrDetnMode_RngMidReslMod" 2 "FLR2RadrDetnMode_RngLongReslMod" 3 "FLR2RadrDetnMode_DetectionUnpopulated";
VAL_ 121 FLR2RdrDetn065To069Mode3 0 "FLR2RadrDetnMode_RngNearReslMod" 1 "FLR2RadrDetnMode_RngMidReslMod" 2 "FLR2RadrDetnMode_RngLongReslMod" 3 "FLR2RadrDetnMode_DetectionUnpopulated";
VAL_ 121 FLR2RdrDetn065To069Mode4 0 "FLR2RadrDetnMode_RngNearReslMod" 1 "FLR2RadrDetnMode_RngMidReslMod" 2 "FLR2RadrDetnMode_RngLongReslMod" 3 "FLR2RadrDetnMode_DetectionUnpopulated";
VAL_ 121 FLR2RdrDetn065To069Quality0 0 "Quality_Low" 1 "Quality_Medium" 2 "Quality_High" 3 "Quality_DetectionUnpopulated";
VAL_ 121 FLR2RdrDetn065To069Quality1 0 "Quality_Low" 1 "Quality_Medium" 2 "Quality_High" 3 "Quality_DetectionUnpopulated";
VAL_ 121 FLR2RdrDetn065To069Quality2 0 "Quality_Low" 1 "Quality_Medium" 2 "Quality_High" 3 "Quality_DetectionUnpopulated";
VAL_ 121 FLR2RdrDetn065To069Quality3 0 "Quality_Low" 1 "Quality_Medium" 2 "Quality_High" 3 "Quality_DetectionUnpopulated";
VAL_ 121 FLR2RdrDetn065To069Quality4 0 "Quality_Low" 1 "Quality_Medium" 2 "Quality_High" 3 "Quality_DetectionUnpopulated";
VAL_ 124 FLR2RdrDetn070To074Mode0 0 "FLR2RadrDetnMode_RngNearReslMod" 1 "FLR2RadrDetnMode_RngMidReslMod" 2 "FLR2RadrDetnMode_RngLongReslMod" 3 "FLR2RadrDetnMode_DetectionUnpopulated";
VAL_ 124 FLR2RdrDetn070To074Mode1 0 "FLR2RadrDetnMode_RngNearReslMod" 1 "FLR2RadrDetnMode_RngMidReslMod" 2 "FLR2RadrDetnMode_RngLongReslMod" 3 "FLR2RadrDetnMode_DetectionUnpopulated";
VAL_ 124 FLR2RdrDetn070To074Mode2 0 "FLR2RadrDetnMode_RngNearReslMod" 1 "FLR2RadrDetnMode_RngMidReslMod" 2 "FLR2RadrDetnMode_RngLongReslMod" 3 "FLR2RadrDetnMode_DetectionUnpopulated";
VAL_ 124 FLR2RdrDetn070To074Mode3 0 "FLR2RadrDetnMode_RngNearReslMod" 1 "FLR2RadrDetnMode_RngMidReslMod" 2 "FLR2RadrDetnMode_RngLongReslMod" 3 "FLR2RadrDetnMode_DetectionUnpopulated";
VAL_ 124 FLR2RdrDetn070To074Mode4 0 "FLR2RadrDetnMode_RngNearReslMod" 1 "FLR2RadrDetnMode_RngMidReslMod" 2 "FLR2RadrDetnMode_RngLongReslMod" 3 "FLR2RadrDetnMode_DetectionUnpopulated";
VAL_ 124 FLR2RdrDetn070To074Quality0 0 "Quality_Low" 1 "Quality_Medium" 2 "Quality_High" 3 "Quality_DetectionUnpopulated";
VAL_ 124 FLR2RdrDetn070To074Quality1 0 "Quality_Low" 1 "Quality_Medium" 2 "Quality_High" 3 "Quality_DetectionUnpopulated";
VAL_ 124 FLR2RdrDetn070To074Quality2 0 "Quality_Low" 1 "Quality_Medium" 2 "Quality_High" 3 "Quality_DetectionUnpopulated";
VAL_ 124 FLR2RdrDetn070To074Quality3 0 "Quality_Low" 1 "Quality_Medium" 2 "Quality_High" 3 "Quality_DetectionUnpopulated";
VAL_ 124 FLR2RdrDetn070To074Quality4 0 "Quality_Low" 1 "Quality_Medium" 2 "Quality_High" 3 "Quality_DetectionUnpopulated";
VAL_ 131 FLR2RdrDetn075To079Mode0 0 "FLR2RadrDetnMode_RngNearReslMod" 1 "FLR2RadrDetnMode_RngMidReslMod" 2 "FLR2RadrDetnMode_RngLongReslMod" 3 "FLR2RadrDetnMode_DetectionUnpopulated";
VAL_ 131 FLR2RdrDetn075To079Mode1 0 "FLR2RadrDetnMode_RngNearReslMod" 1 "FLR2RadrDetnMode_RngMidReslMod" 2 "FLR2RadrDetnMode_RngLongReslMod" 3 "FLR2RadrDetnMode_DetectionUnpopulated";
VAL_ 131 FLR2RdrDetn075To079Mode2 0 "FLR2RadrDetnMode_RngNearReslMod" 1 "FLR2RadrDetnMode_RngMidReslMod" 2 "FLR2RadrDetnMode_RngLongReslMod" 3 "FLR2RadrDetnMode_DetectionUnpopulated";
VAL_ 131 FLR2RdrDetn075To079Mode3 0 "FLR2RadrDetnMode_RngNearReslMod" 1 "FLR2RadrDetnMode_RngMidReslMod" 2 "FLR2RadrDetnMode_RngLongReslMod" 3 "FLR2RadrDetnMode_DetectionUnpopulated";
VAL_ 131 FLR2RdrDetn075To079Mode4 0 "FLR2RadrDetnMode_RngNearReslMod" 1 "FLR2RadrDetnMode_RngMidReslMod" 2 "FLR2RadrDetnMode_RngLongReslMod" 3 "FLR2RadrDetnMode_DetectionUnpopulated";
VAL_ 131 FLR2RdrDetn075To079Quality0 0 "Quality_Low" 1 "Quality_Medium" 2 "Quality_High" 3 "Quality_DetectionUnpopulated";
VAL_ 131 FLR2RdrDetn075To079Quality1 0 "Quality_Low" 1 "Quality_Medium" 2 "Quality_High" 3 "Quality_DetectionUnpopulated";
VAL_ 131 FLR2RdrDetn075To079Quality2 0 "Quality_Low" 1 "Quality_Medium" 2 "Quality_High" 3 "Quality_DetectionUnpopulated";
VAL_ 131 FLR2RdrDetn075To079Quality3 0 "Quality_Low" 1 "Quality_Medium" 2 "Quality_High" 3 "Quality_DetectionUnpopulated";
VAL_ 131 FLR2RdrDetn075To079Quality4 0 "Quality_Low" 1 "Quality_Medium" 2 "Quality_High" 3 "Quality_DetectionUnpopulated";
VAL_ 134 FLR2RdrDetn080To084Mode0 0 "FLR2RadrDetnMode_RngNearReslMod" 1 "FLR2RadrDetnMode_RngMidReslMod" 2 "FLR2RadrDetnMode_RngLongReslMod" 3 "FLR2RadrDetnMode_DetectionUnpopulated";
VAL_ 134 FLR2RdrDetn080To084Mode1 0 "FLR2RadrDetnMode_RngNearReslMod" 1 "FLR2RadrDetnMode_RngMidReslMod" 2 "FLR2RadrDetnMode_RngLongReslMod" 3 "FLR2RadrDetnMode_DetectionUnpopulated";
VAL_ 134 FLR2RdrDetn080To084Mode2 0 "FLR2RadrDetnMode_RngNearReslMod" 1 "FLR2RadrDetnMode_RngMidReslMod" 2 "FLR2RadrDetnMode_RngLongReslMod" 3 "FLR2RadrDetnMode_DetectionUnpopulated";
VAL_ 134 FLR2RdrDetn080To084Mode3 0 "FLR2RadrDetnMode_RngNearReslMod" 1 "FLR2RadrDetnMode_RngMidReslMod" 2 "FLR2RadrDetnMode_RngLongReslMod" 3 "FLR2RadrDetnMode_DetectionUnpopulated";
VAL_ 134 FLR2RdrDetn080To084Mode4 0 "FLR2RadrDetnMode_RngNearReslMod" 1 "FLR2RadrDetnMode_RngMidReslMod" 2 "FLR2RadrDetnMode_RngLongReslMod" 3 "FLR2RadrDetnMode_DetectionUnpopulated";
VAL_ 134 FLR2RdrDetn080To084Quality0 0 "Quality_Low" 1 "Quality_Medium" 2 "Quality_High" 3 "Quality_DetectionUnpopulated";
VAL_ 134 FLR2RdrDetn080To084Quality1 0 "Quality_Low" 1 "Quality_Medium" 2 "Quality_High" 3 "Quality_DetectionUnpopulated";
VAL_ 134 FLR2RdrDetn080To084Quality2 0 "Quality_Low" 1 "Quality_Medium" 2 "Quality_High" 3 "Quality_DetectionUnpopulated";
VAL_ 134 FLR2RdrDetn080To084Quality3 0 "Quality_Low" 1 "Quality_Medium" 2 "Quality_High" 3 "Quality_DetectionUnpopulated";
VAL_ 134 FLR2RdrDetn080To084Quality4 0 "Quality_Low" 1 "Quality_Medium" 2 "Quality_High" 3 "Quality_DetectionUnpopulated";
VAL_ 137 FLR2RdrDetn085To089Mode0 0 "FLR2RadrDetnMode_RngNearReslMod" 1 "FLR2RadrDetnMode_RngMidReslMod" 2 "FLR2RadrDetnMode_RngLongReslMod" 3 "FLR2RadrDetnMode_DetectionUnpopulated";
VAL_ 137 FLR2RdrDetn085To089Mode1 0 "FLR2RadrDetnMode_RngNearReslMod" 1 "FLR2RadrDetnMode_RngMidReslMod" 2 "FLR2RadrDetnMode_RngLongReslMod" 3 "FLR2RadrDetnMode_DetectionUnpopulated";
VAL_ 137 FLR2RdrDetn085To089Mode2 0 "FLR2RadrDetnMode_RngNearReslMod" 1 "FLR2RadrDetnMode_RngMidReslMod" 2 "FLR2RadrDetnMode_RngLongReslMod" 3 "FLR2RadrDetnMode_DetectionUnpopulated";
VAL_ 137 FLR2RdrDetn085To089Mode3 0 "FLR2RadrDetnMode_RngNearReslMod" 1 "FLR2RadrDetnMode_RngMidReslMod" 2 "FLR2RadrDetnMode_RngLongReslMod" 3 "FLR2RadrDetnMode_DetectionUnpopulated";
VAL_ 137 FLR2RdrDetn085To089Mode4 0 "FLR2RadrDetnMode_RngNearReslMod" 1 "FLR2RadrDetnMode_RngMidReslMod" 2 "FLR2RadrDetnMode_RngLongReslMod" 3 "FLR2RadrDetnMode_DetectionUnpopulated";
VAL_ 137 FLR2RdrDetn085To089Quality0 0 "Quality_Low" 1 "Quality_Medium" 2 "Quality_High" 3 "Quality_DetectionUnpopulated";
VAL_ 137 FLR2RdrDetn085To089Quality1 0 "Quality_Low" 1 "Quality_Medium" 2 "Quality_High" 3 "Quality_DetectionUnpopulated";
VAL_ 137 FLR2RdrDetn085To089Quality2 0 "Quality_Low" 1 "Quality_Medium" 2 "Quality_High" 3 "Quality_DetectionUnpopulated";
VAL_ 137 FLR2RdrDetn085To089Quality3 0 "Quality_Low" 1 "Quality_Medium" 2 "Quality_High" 3 "Quality_DetectionUnpopulated";
VAL_ 137 FLR2RdrDetn085To089Quality4 0 "Quality_Low" 1 "Quality_Medium" 2 "Quality_High" 3 "Quality_DetectionUnpopulated";
VAL_ 140 FLR2RdrDetn090To094Mode0 0 "FLR2RadrDetnMode_RngNearReslMod" 1 "FLR2RadrDetnMode_RngMidReslMod" 2 "FLR2RadrDetnMode_RngLongReslMod" 3 "FLR2RadrDetnMode_DetectionUnpopulated";
VAL_ 140 FLR2RdrDetn090To094Mode1 0 "FLR2RadrDetnMode_RngNearReslMod" 1 "FLR2RadrDetnMode_RngMidReslMod" 2 "FLR2RadrDetnMode_RngLongReslMod" 3 "FLR2RadrDetnMode_DetectionUnpopulated";
VAL_ 140 FLR2RdrDetn090To094Mode2 0 "FLR2RadrDetnMode_RngNearReslMod" 1 "FLR2RadrDetnMode_RngMidReslMod" 2 "FLR2RadrDetnMode_RngLongReslMod" 3 "FLR2RadrDetnMode_DetectionUnpopulated";
VAL_ 140 FLR2RdrDetn090To094Mode3 0 "FLR2RadrDetnMode_RngNearReslMod" 1 "FLR2RadrDetnMode_RngMidReslMod" 2 "FLR2RadrDetnMode_RngLongReslMod" 3 "FLR2RadrDetnMode_DetectionUnpopulated";
VAL_ 140 FLR2RdrDetn090To094Mode4 0 "FLR2RadrDetnMode_RngNearReslMod" 1 "FLR2RadrDetnMode_RngMidReslMod" 2 "FLR2RadrDetnMode_RngLongReslMod" 3 "FLR2RadrDetnMode_DetectionUnpopulated";
VAL_ 140 FLR2RdrDetn090To094Quality0 0 "Quality_Low" 1 "Quality_Medium" 2 "Quality_High" 3 "Quality_DetectionUnpopulated";
VAL_ 140 FLR2RdrDetn090To094Quality1 0 "Quality_Low" 1 "Quality_Medium" 2 "Quality_High" 3 "Quality_DetectionUnpopulated";
VAL_ 140 FLR2RdrDetn090To094Quality2 0 "Quality_Low" 1 "Quality_Medium" 2 "Quality_High" 3 "Quality_DetectionUnpopulated";
VAL_ 140 FLR2RdrDetn090To094Quality3 0 "Quality_Low" 1 "Quality_Medium" 2 "Quality_High" 3 "Quality_DetectionUnpopulated";
VAL_ 140 FLR2RdrDetn090To094Quality4 0 "Quality_Low" 1 "Quality_Medium" 2 "Quality_High" 3 "Quality_DetectionUnpopulated";
VAL_ 144 FLR2RdrDetn095To099Mode0 0 "FLR2RadrDetnMode_RngNearReslMod" 1 "FLR2RadrDetnMode_RngMidReslMod" 2 "FLR2RadrDetnMode_RngLongReslMod" 3 "FLR2RadrDetnMode_DetectionUnpopulated";
VAL_ 144 FLR2RdrDetn095To099Mode1 0 "FLR2RadrDetnMode_RngNearReslMod" 1 "FLR2RadrDetnMode_RngMidReslMod" 2 "FLR2RadrDetnMode_RngLongReslMod" 3 "FLR2RadrDetnMode_DetectionUnpopulated";
VAL_ 144 FLR2RdrDetn095To099Mode2 0 "FLR2RadrDetnMode_RngNearReslMod" 1 "FLR2RadrDetnMode_RngMidReslMod" 2 "FLR2RadrDetnMode_RngLongReslMod" 3 "FLR2RadrDetnMode_DetectionUnpopulated";
VAL_ 144 FLR2RdrDetn095To099Mode3 0 "FLR2RadrDetnMode_RngNearReslMod" 1 "FLR2RadrDetnMode_RngMidReslMod" 2 "FLR2RadrDetnMode_RngLongReslMod" 3 "FLR2RadrDetnMode_DetectionUnpopulated";
VAL_ 144 FLR2RdrDetn095To099Mode4 0 "FLR2RadrDetnMode_RngNearReslMod" 1 "FLR2RadrDetnMode_RngMidReslMod" 2 "FLR2RadrDetnMode_RngLongReslMod" 3 "FLR2RadrDetnMode_DetectionUnpopulated";
VAL_ 144 FLR2RdrDetn095To099Quality0 0 "Quality_Low" 1 "Quality_Medium" 2 "Quality_High" 3 "Quality_DetectionUnpopulated";
VAL_ 144 FLR2RdrDetn095To099Quality1 0 "Quality_Low" 1 "Quality_Medium" 2 "Quality_High" 3 "Quality_DetectionUnpopulated";
VAL_ 144 FLR2RdrDetn095To099Quality2 0 "Quality_Low" 1 "Quality_Medium" 2 "Quality_High" 3 "Quality_DetectionUnpopulated";
VAL_ 144 FLR2RdrDetn095To099Quality3 0 "Quality_Low" 1 "Quality_Medium" 2 "Quality_High" 3 "Quality_DetectionUnpopulated";
VAL_ 144 FLR2RdrDetn095To099Quality4 0 "Quality_Low" 1 "Quality_Medium" 2 "Quality_High" 3 "Quality_DetectionUnpopulated";
VAL_ 147 FLR2RdrDetn100To104Mode0 0 "FLR2RadrDetnMode_RngNearReslMod" 1 "FLR2RadrDetnMode_RngMidReslMod" 2 "FLR2RadrDetnMode_RngLongReslMod" 3 "FLR2RadrDetnMode_DetectionUnpopulated";
VAL_ 147 FLR2RdrDetn100To104Mode1 0 "FLR2RadrDetnMode_RngNearReslMod" 1 "FLR2RadrDetnMode_RngMidReslMod" 2 "FLR2RadrDetnMode_RngLongReslMod" 3 "FLR2RadrDetnMode_DetectionUnpopulated";
VAL_ 147 FLR2RdrDetn100To104Mode2 0 "FLR2RadrDetnMode_RngNearReslMod" 1 "FLR2RadrDetnMode_RngMidReslMod" 2 "FLR2RadrDetnMode_RngLongReslMod" 3 "FLR2RadrDetnMode_DetectionUnpopulated";
VAL_ 147 FLR2RdrDetn100To104Mode3 0 "FLR2RadrDetnMode_RngNearReslMod" 1 "FLR2RadrDetnMode_RngMidReslMod" 2 "FLR2RadrDetnMode_RngLongReslMod" 3 "FLR2RadrDetnMode_DetectionUnpopulated";
VAL_ 147 FLR2RdrDetn100To104Mode4 0 "FLR2RadrDetnMode_RngNearReslMod" 1 "FLR2RadrDetnMode_RngMidReslMod" 2 "FLR2RadrDetnMode_RngLongReslMod" 3 "FLR2RadrDetnMode_DetectionUnpopulated";
VAL_ 147 FLR2RdrDetn100To104Quality0 0 "Quality_Low" 1 "Quality_Medium" 2 "Quality_High" 3 "Quality_DetectionUnpopulated";
VAL_ 147 FLR2RdrDetn100To104Quality1 0 "Quality_Low" 1 "Quality_Medium" 2 "Quality_High" 3 "Quality_DetectionUnpopulated";
VAL_ 147 FLR2RdrDetn100To104Quality2 0 "Quality_Low" 1 "Quality_Medium" 2 "Quality_High" 3 "Quality_DetectionUnpopulated";
VAL_ 147 FLR2RdrDetn100To104Quality3 0 "Quality_Low" 1 "Quality_Medium" 2 "Quality_High" 3 "Quality_DetectionUnpopulated";
VAL_ 147 FLR2RdrDetn100To104Quality4 0 "Quality_Low" 1 "Quality_Medium" 2 "Quality_High" 3 "Quality_DetectionUnpopulated";
VAL_ 150 FLR2RdrDetn105To109Mode0 0 "FLR2RadrDetnMode_RngNearReslMod" 1 "FLR2RadrDetnMode_RngMidReslMod" 2 "FLR2RadrDetnMode_RngLongReslMod" 3 "FLR2RadrDetnMode_DetectionUnpopulated";
VAL_ 150 FLR2RdrDetn105To109Mode1 0 "FLR2RadrDetnMode_RngNearReslMod" 1 "FLR2RadrDetnMode_RngMidReslMod" 2 "FLR2RadrDetnMode_RngLongReslMod" 3 "FLR2RadrDetnMode_DetectionUnpopulated";
VAL_ 150 FLR2RdrDetn105To109Mode2 0 "FLR2RadrDetnMode_RngNearReslMod" 1 "FLR2RadrDetnMode_RngMidReslMod" 2 "FLR2RadrDetnMode_RngLongReslMod" 3 "FLR2RadrDetnMode_DetectionUnpopulated";
VAL_ 150 FLR2RdrDetn105To109Mode3 0 "FLR2RadrDetnMode_RngNearReslMod" 1 "FLR2RadrDetnMode_RngMidReslMod" 2 "FLR2RadrDetnMode_RngLongReslMod" 3 "FLR2RadrDetnMode_DetectionUnpopulated";
VAL_ 150 FLR2RdrDetn105To109Mode4 0 "FLR2RadrDetnMode_RngNearReslMod" 1 "FLR2RadrDetnMode_RngMidReslMod" 2 "FLR2RadrDetnMode_RngLongReslMod" 3 "FLR2RadrDetnMode_DetectionUnpopulated";
VAL_ 150 FLR2RdrDetn105To109Quality0 0 "Quality_Low" 1 "Quality_Medium" 2 "Quality_High" 3 "Quality_DetectionUnpopulated";
VAL_ 150 FLR2RdrDetn105To109Quality1 0 "Quality_Low" 1 "Quality_Medium" 2 "Quality_High" 3 "Quality_DetectionUnpopulated";
VAL_ 150 FLR2RdrDetn105To109Quality2 0 "Quality_Low" 1 "Quality_Medium" 2 "Quality_High" 3 "Quality_DetectionUnpopulated";
VAL_ 150 FLR2RdrDetn105To109Quality3 0 "Quality_Low" 1 "Quality_Medium" 2 "Quality_High" 3 "Quality_DetectionUnpopulated";
VAL_ 150 FLR2RdrDetn105To109Quality4 0 "Quality_Low" 1 "Quality_Medium" 2 "Quality_High" 3 "Quality_DetectionUnpopulated";
VAL_ 153 FLR2RdrDetn110To114Mode0 0 "FLR2RadrDetnMode_RngNearReslMod" 1 "FLR2RadrDetnMode_RngMidReslMod" 2 "FLR2RadrDetnMode_RngLongReslMod" 3 "FLR2RadrDetnMode_DetectionUnpopulated";
VAL_ 153 FLR2RdrDetn110To114Mode1 0 "FLR2RadrDetnMode_RngNearReslMod" 1 "FLR2RadrDetnMode_RngMidReslMod" 2 "FLR2RadrDetnMode_RngLongReslMod" 3 "FLR2RadrDetnMode_DetectionUnpopulated";
VAL_ 153 FLR2RdrDetn110To114Mode2 0 "FLR2RadrDetnMode_RngNearReslMod" 1 "FLR2RadrDetnMode_RngMidReslMod" 2 "FLR2RadrDetnMode_RngLongReslMod" 3 "FLR2RadrDetnMode_DetectionUnpopulated";
VAL_ 153 FLR2RdrDetn110To114Mode3 0 "FLR2RadrDetnMode_RngNearReslMod" 1 "FLR2RadrDetnMode_RngMidReslMod" 2 "FLR2RadrDetnMode_RngLongReslMod" 3 "FLR2RadrDetnMode_DetectionUnpopulated";
VAL_ 153 FLR2RdrDetn110To114Mode4 0 "FLR2RadrDetnMode_RngNearReslMod" 1 "FLR2RadrDetnMode_RngMidReslMod" 2 "FLR2RadrDetnMode_RngLongReslMod" 3 "FLR2RadrDetnMode_DetectionUnpopulated";
VAL_ 153 FLR2RdrDetn110To114Quality0 0 "Quality_Low" 1 "Quality_Medium" 2 "Quality_High" 3 "Quality_DetectionUnpopulated";
VAL_ 153 FLR2RdrDetn110To114Quality1 0 "Quality_Low" 1 "Quality_Medium" 2 "Quality_High" 3 "Quality_DetectionUnpopulated";
VAL_ 153 FLR2RdrDetn110To114Quality2 0 "Quality_Low" 1 "Quality_Medium" 2 "Quality_High" 3 "Quality_DetectionUnpopulated";
VAL_ 153 FLR2RdrDetn110To114Quality3 0 "Quality_Low" 1 "Quality_Medium" 2 "Quality_High" 3 "Quality_DetectionUnpopulated";
VAL_ 153 FLR2RdrDetn110To114Quality4 0 "Quality_Low" 1 "Quality_Medium" 2 "Quality_High" 3 "Quality_DetectionUnpopulated";
VAL_ 156 FLR2RdrDetn115To119Mode0 0 "FLR2RadrDetnMode_RngNearReslMod" 1 "FLR2RadrDetnMode_RngMidReslMod" 2 "FLR2RadrDetnMode_RngLongReslMod" 3 "FLR2RadrDetnMode_DetectionUnpopulated";
VAL_ 156 FLR2RdrDetn115To119Mode1 0 "FLR2RadrDetnMode_RngNearReslMod" 1 "FLR2RadrDetnMode_RngMidReslMod" 2 "FLR2RadrDetnMode_RngLongReslMod" 3 "FLR2RadrDetnMode_DetectionUnpopulated";
VAL_ 156 FLR2RdrDetn115To119Mode2 0 "FLR2RadrDetnMode_RngNearReslMod" 1 "FLR2RadrDetnMode_RngMidReslMod" 2 "FLR2RadrDetnMode_RngLongReslMod" 3 "FLR2RadrDetnMode_DetectionUnpopulated";
VAL_ 156 FLR2RdrDetn115To119Mode3 0 "FLR2RadrDetnMode_RngNearReslMod" 1 "FLR2RadrDetnMode_RngMidReslMod" 2 "FLR2RadrDetnMode_RngLongReslMod" 3 "FLR2RadrDetnMode_DetectionUnpopulated";
VAL_ 156 FLR2RdrDetn115To119Mode4 0 "FLR2RadrDetnMode_RngNearReslMod" 1 "FLR2RadrDetnMode_RngMidReslMod" 2 "FLR2RadrDetnMode_RngLongReslMod" 3 "FLR2RadrDetnMode_DetectionUnpopulated";
VAL_ 156 FLR2RdrDetn115To119Quality0 0 "Quality_Low" 1 "Quality_Medium" 2 "Quality_High" 3 "Quality_DetectionUnpopulated";
VAL_ 156 FLR2RdrDetn115To119Quality1 0 "Quality_Low" 1 "Quality_Medium" 2 "Quality_High" 3 "Quality_DetectionUnpopulated";
VAL_ 156 FLR2RdrDetn115To119Quality2 0 "Quality_Low" 1 "Quality_Medium" 2 "Quality_High" 3 "Quality_DetectionUnpopulated";
VAL_ 156 FLR2RdrDetn115To119Quality3 0 "Quality_Low" 1 "Quality_Medium" 2 "Quality_High" 3 "Quality_DetectionUnpopulated";
VAL_ 156 FLR2RdrDetn115To119Quality4 0 "Quality_Low" 1 "Quality_Medium" 2 "Quality_High" 3 "Quality_DetectionUnpopulated";
VAL_ 160 FLR2RdrDetn120To124Mode0 0 "FLR2RadrDetnMode_RngNearReslMod" 1 "FLR2RadrDetnMode_RngMidReslMod" 2 "FLR2RadrDetnMode_RngLongReslMod" 3 "FLR2RadrDetnMode_DetectionUnpopulated";
VAL_ 160 FLR2RdrDetn120To124Mode1 0 "FLR2RadrDetnMode_RngNearReslMod" 1 "FLR2RadrDetnMode_RngMidReslMod" 2 "FLR2RadrDetnMode_RngLongReslMod" 3 "FLR2RadrDetnMode_DetectionUnpopulated";
VAL_ 160 FLR2RdrDetn120To124Mode2 0 "FLR2RadrDetnMode_RngNearReslMod" 1 "FLR2RadrDetnMode_RngMidReslMod" 2 "FLR2RadrDetnMode_RngLongReslMod" 3 "FLR2RadrDetnMode_DetectionUnpopulated";
VAL_ 160 FLR2RdrDetn120To124Mode3 0 "FLR2RadrDetnMode_RngNearReslMod" 1 "FLR2RadrDetnMode_RngMidReslMod" 2 "FLR2RadrDetnMode_RngLongReslMod" 3 "FLR2RadrDetnMode_DetectionUnpopulated";
VAL_ 160 FLR2RdrDetn120To124Mode4 0 "FLR2RadrDetnMode_RngNearReslMod" 1 "FLR2RadrDetnMode_RngMidReslMod" 2 "FLR2RadrDetnMode_RngLongReslMod" 3 "FLR2RadrDetnMode_DetectionUnpopulated";
VAL_ 160 FLR2RdrDetn120To124Quality0 0 "Quality_Low" 1 "Quality_Medium" 2 "Quality_High" 3 "Quality_DetectionUnpopulated";
VAL_ 160 FLR2RdrDetn120To124Quality1 0 "Quality_Low" 1 "Quality_Medium" 2 "Quality_High" 3 "Quality_DetectionUnpopulated";
VAL_ 160 FLR2RdrDetn120To124Quality2 0 "Quality_Low" 1 "Quality_Medium" 2 "Quality_High" 3 "Quality_DetectionUnpopulated";
VAL_ 160 FLR2RdrDetn120To124Quality3 0 "Quality_Low" 1 "Quality_Medium" 2 "Quality_High" 3 "Quality_DetectionUnpopulated";
VAL_ 160 FLR2RdrDetn120To124Quality4 0 "Quality_Low" 1 "Quality_Medium" 2 "Quality_High" 3 "Quality_DetectionUnpopulated";
VAL_ 163 FLR2RdrDetn125To129Mode0 0 "FLR2RadrDetnMode_RngNearReslMod" 1 "FLR2RadrDetnMode_RngMidReslMod" 2 "FLR2RadrDetnMode_RngLongReslMod" 3 "FLR2RadrDetnMode_DetectionUnpopulated";
VAL_ 163 FLR2RdrDetn125To129Mode1 0 "FLR2RadrDetnMode_RngNearReslMod" 1 "FLR2RadrDetnMode_RngMidReslMod" 2 "FLR2RadrDetnMode_RngLongReslMod" 3 "FLR2RadrDetnMode_DetectionUnpopulated";
VAL_ 163 FLR2RdrDetn125To129Mode2 0 "FLR2RadrDetnMode_RngNearReslMod" 1 "FLR2RadrDetnMode_RngMidReslMod" 2 "FLR2RadrDetnMode_RngLongReslMod" 3 "FLR2RadrDetnMode_DetectionUnpopulated";
VAL_ 163 FLR2RdrDetn125To129Mode3 0 "FLR2RadrDetnMode_RngNearReslMod" 1 "FLR2RadrDetnMode_RngMidReslMod" 2 "FLR2RadrDetnMode_RngLongReslMod" 3 "FLR2RadrDetnMode_DetectionUnpopulated";
VAL_ 163 FLR2RdrDetn125To129Mode4 0 "FLR2RadrDetnMode_RngNearReslMod" 1 "FLR2RadrDetnMode_RngMidReslMod" 2 "FLR2RadrDetnMode_RngLongReslMod" 3 "FLR2RadrDetnMode_DetectionUnpopulated";
VAL_ 163 FLR2RdrDetn125To129Quality0 0 "Quality_Low" 1 "Quality_Medium" 2 "Quality_High" 3 "Quality_DetectionUnpopulated";
VAL_ 163 FLR2RdrDetn125To129Quality1 0 "Quality_Low" 1 "Quality_Medium" 2 "Quality_High" 3 "Quality_DetectionUnpopulated";
VAL_ 163 FLR2RdrDetn125To129Quality2 0 "Quality_Low" 1 "Quality_Medium" 2 "Quality_High" 3 "Quality_DetectionUnpopulated";
VAL_ 163 FLR2RdrDetn125To129Quality3 0 "Quality_Low" 1 "Quality_Medium" 2 "Quality_High" 3 "Quality_DetectionUnpopulated";
VAL_ 163 FLR2RdrDetn125To129Quality4 0 "Quality_Low" 1 "Quality_Medium" 2 "Quality_High" 3 "Quality_DetectionUnpopulated";
SIG_GROUP_ 118 FLR2RdrDetn060To064 1 : FLR2RdrDetn060To064AziAng0 FLR2RdrDetn060To064AziAng1 FLR2RdrDetn060To064AziAng2 FLR2RdrDetn060To064AziAng3 FLR2RdrDetn060To064AziAng4 FLR2RdrDetn060To064Counter FLR2RdrDetn060To064CRC FLR2RdrDetn060To064DynPrpty0 FLR2RdrDetn060To064DynPrpty1 FLR2RdrDetn060To064DynPrpty2 FLR2RdrDetn060To064DynPrpty3 FLR2RdrDetn060To064DynPrpty4 FLR2RdrDetn060To064EleAng0 FLR2RdrDetn060To064EleAng1 FLR2RdrDetn060To064EleAng2 FLR2RdrDetn060To064EleAng3 FLR2RdrDetn060To064EleAng4 FLR2RdrDetn060To064Mode0 FLR2RdrDetn060To064Mode1 FLR2RdrDetn060To064Mode2 FLR2RdrDetn060To064Mode3 FLR2RdrDetn060To064Mode4 FLR2RdrDetn060To064Quality0 FLR2RdrDetn060To064Quality1 FLR2RdrDetn060To064Quality2 FLR2RdrDetn060To064Quality3 FLR2RdrDetn060To064Quality4 FLR2RdrDetn060To064Range0 FLR2RdrDetn060To064Range1 FLR2RdrDetn060To064Range2 FLR2RdrDetn060To064Range3 FLR2RdrDetn060To064Range4 FLR2RdrDetn060To064RCS0 FLR2RdrDetn060To064RCS1 FLR2RdrDetn060To064RCS2 FLR2RdrDetn060To064RCS3 FLR2RdrDetn060To064RCS4 FLR2RdrDetn060To064RngRt0 FLR2RdrDetn060To064RngRt1 FLR2RdrDetn060To064RngRt2 FLR2RdrDetn060To064RngRt3 FLR2RdrDetn060To064RngRt4 FLR2RdrDetn060To064ScanID FLR2RdrDetn060To064SNR0 FLR2RdrDetn060To064SNR1 FLR2RdrDetn060To064SNR2 FLR2RdrDetn060To064SNR3 FLR2RdrDetn060To064SNR4;
SIG_GROUP_ 121 FLR2RdrDetn065To069 1 : FLR2RdrDetn065To069AziAng0 FLR2RdrDetn065To069AziAng1 FLR2RdrDetn065To069AziAng2 FLR2RdrDetn065To069AziAng3 FLR2RdrDetn065To069AziAng4 FLR2RdrDetn065To069Counter FLR2RdrDetn065To069CRC FLR2RdrDetn065To069DynPrpty0 FLR2RdrDetn065To069DynPrpty1 FLR2RdrDetn065To069DynPrpty2 FLR2RdrDetn065To069DynPrpty3 FLR2RdrDetn065To069DynPrpty4 FLR2RdrDetn065To069EleAng0 FLR2RdrDetn065To069EleAng1 FLR2RdrDetn065To069EleAng2 FLR2RdrDetn065To069EleAng3 FLR2RdrDetn065To069EleAng4 FLR2RdrDetn065To069Mode0 FLR2RdrDetn065To069Mode1 FLR2RdrDetn065To069Mode2 FLR2RdrDetn065To069Mode3 FLR2RdrDetn065To069Mode4 FLR2RdrDetn065To069Quality0 FLR2RdrDetn065To069Quality1 FLR2RdrDetn065To069Quality2 FLR2RdrDetn065To069Quality3 FLR2RdrDetn065To069Quality4 FLR2RdrDetn065To069Range0 FLR2RdrDetn065To069Range1 FLR2RdrDetn065To069Range2 FLR2RdrDetn065To069Range3 FLR2RdrDetn065To069Range4 FLR2RdrDetn065To069RCS0 FLR2RdrDetn065To069RCS1 FLR2RdrDetn065To069RCS2 FLR2RdrDetn065To069RCS3 FLR2RdrDetn065To069RCS4 FLR2RdrDetn065To069RngRt0 FLR2RdrDetn065To069RngRt1 FLR2RdrDetn065To069RngRt2 FLR2RdrDetn065To069RngRt3 FLR2RdrDetn065To069RngRt4 FLR2RdrDetn065To069ScanID FLR2RdrDetn065To069SNR0 FLR2RdrDetn065To069SNR1 FLR2RdrDetn065To069SNR2 FLR2RdrDetn065To069SNR3 FLR2RdrDetn065To069SNR4;
SIG_GROUP_ 124 FLR2RdrDetn070To074 1 : FLR2RdrDetn070To074AziAng0 FLR2RdrDetn070To074AziAng1 FLR2RdrDetn070To074AziAng2 FLR2RdrDetn070To074AziAng3 FLR2RdrDetn070To074AziAng4 FLR2RdrDetn070To074Counter FLR2RdrDetn070To074CRC FLR2RdrDetn070To074DynPrpty0 FLR2RdrDetn070To074DynPrpty1 FLR2RdrDetn070To074DynPrpty2 FLR2RdrDetn070To074DynPrpty3 FLR2RdrDetn070To074DynPrpty4 FLR2RdrDetn070To074EleAng0 FLR2RdrDetn070To074EleAng1 FLR2RdrDetn070To074EleAng2 FLR2RdrDetn070To074EleAng3 FLR2RdrDetn070To074EleAng4 FLR2RdrDetn070To074Mode0 FLR2RdrDetn070To074Mode1 FLR2RdrDetn070To074Mode2 FLR2RdrDetn070To074Mode3 FLR2RdrDetn070To074Mode4 FLR2RdrDetn070To074Quality0 FLR2RdrDetn070To074Quality1 FLR2RdrDetn070To074Quality2 FLR2RdrDetn070To074Quality3 FLR2RdrDetn070To074Quality4 FLR2RdrDetn070To074Range0 FLR2RdrDetn070To074Range1 FLR2RdrDetn070To074Range2 FLR2RdrDetn070To074Range3 FLR2RdrDetn070To074Range4 FLR2RdrDetn070To074RCS0 FLR2RdrDetn070To074RCS1 FLR2RdrDetn070To074RCS2 FLR2RdrDetn070To074RCS3 FLR2RdrDetn070To074RCS4 FLR2RdrDetn070To074RngRt0 FLR2RdrDetn070To074RngRt1 FLR2RdrDetn070To074RngRt2 FLR2RdrDetn070To074RngRt3 FLR2RdrDetn070To074RngRt4 FLR2RdrDetn070To074ScanID FLR2RdrDetn070To074SNR0 FLR2RdrDetn070To074SNR1 FLR2RdrDetn070To074SNR2 FLR2RdrDetn070To074SNR3 FLR2RdrDetn070To074SNR4;
SIG_GROUP_ 131 FLR2RdrDetn075To079 1 : FLR2RdrDetn075To079AziAng0 FLR2RdrDetn075To079AziAng1 FLR2RdrDetn075To079AziAng2 FLR2RdrDetn075To079AziAng3 FLR2RdrDetn075To079AziAng4 FLR2RdrDetn075To079Counter FLR2RdrDetn075To079CRC FLR2RdrDetn075To079DynPrpty0 FLR2RdrDetn075To079DynPrpty1 FLR2RdrDetn075To079DynPrpty2 FLR2RdrDetn075To079DynPrpty3 FLR2RdrDetn075To079DynPrpty4 FLR2RdrDetn075To079EleAng0 FLR2RdrDetn075To079EleAng1 FLR2RdrDetn075To079EleAng2 FLR2RdrDetn075To079EleAng3 FLR2RdrDetn075To079EleAng4 FLR2RdrDetn075To079Mode0 FLR2RdrDetn075To079Mode1 FLR2RdrDetn075To079Mode2 FLR2RdrDetn075To079Mode3 FLR2RdrDetn075To079Mode4 FLR2RdrDetn075To079Quality0 FLR2RdrDetn075To079Quality1 FLR2RdrDetn075To079Quality2 FLR2RdrDetn075To079Quality3 FLR2RdrDetn075To079Quality4 FLR2RdrDetn075To079Range0 FLR2RdrDetn075To079Range1 FLR2RdrDetn075To079Range2 FLR2RdrDetn075To079Range3 FLR2RdrDetn075To079Range4 FLR2RdrDetn075To079RCS0 FLR2RdrDetn075To079RCS1 FLR2RdrDetn075To079RCS2 FLR2RdrDetn075To079RCS3 FLR2RdrDetn075To079RCS4 FLR2RdrDetn075To079RngRt0 FLR2RdrDetn075To079RngRt1 FLR2RdrDetn075To079RngRt2 FLR2RdrDetn075To079RngRt3 FLR2RdrDetn075To079RngRt4 FLR2RdrDetn075To079ScanID FLR2RdrDetn075To079SNR0 FLR2RdrDetn075To079SNR1 FLR2RdrDetn075To079SNR2 FLR2RdrDetn075To079SNR3 FLR2RdrDetn075To079SNR4;
SIG_GROUP_ 134 FLR2RdrDetn080To084 1 : FLR2RdrDetn080To084AziAng0 FLR2RdrDetn080To084AziAng1 FLR2RdrDetn080To084AziAng2 FLR2RdrDetn080To084AziAng3 FLR2RdrDetn080To084AziAng4 FLR2RdrDetn080To084Counter FLR2RdrDetn080To084CRC FLR2RdrDetn080To084DynPrpty0 FLR2RdrDetn080To084DynPrpty1 FLR2RdrDetn080To084DynPrpty2 FLR2RdrDetn080To084DynPrpty3 FLR2RdrDetn080To084DynPrpty4 FLR2RdrDetn080To084EleAng0 FLR2RdrDetn080To084EleAng1 FLR2RdrDetn080To084EleAng2 FLR2RdrDetn080To084EleAng3 FLR2RdrDetn080To084EleAng4 FLR2RdrDetn080To084Mode0 FLR2RdrDetn080To084Mode1 FLR2RdrDetn080To084Mode2 FLR2RdrDetn080To084Mode3 FLR2RdrDetn080To084Mode4 FLR2RdrDetn080To084Quality0 FLR2RdrDetn080To084Quality1 FLR2RdrDetn080To084Quality2 FLR2RdrDetn080To084Quality3 FLR2RdrDetn080To084Quality4 FLR2RdrDetn080To084Range0 FLR2RdrDetn080To084Range1 FLR2RdrDetn080To084Range2 FLR2RdrDetn080To084Range3 FLR2RdrDetn080To084Range4 FLR2RdrDetn080To084RCS0 FLR2RdrDetn080To084RCS1 FLR2RdrDetn080To084RCS2 FLR2RdrDetn080To084RCS3 FLR2RdrDetn080To084RCS4 FLR2RdrDetn080To084RngRt0 FLR2RdrDetn080To084RngRt1 FLR2RdrDetn080To084RngRt2 FLR2RdrDetn080To084RngRt3 FLR2RdrDetn080To084RngRt4 FLR2RdrDetn080To084ScanID FLR2RdrDetn080To084SNR0 FLR2RdrDetn080To084SNR1 FLR2RdrDetn080To084SNR2 FLR2RdrDetn080To084SNR3 FLR2RdrDetn080To084SNR4;
SIG_GROUP_ 137 FLR2RdrDetn085To089 1 : FLR2RdrDetn085To089AziAng0 FLR2RdrDetn085To089AziAng1 FLR2RdrDetn085To089AziAng2 FLR2RdrDetn085To089AziAng3 FLR2RdrDetn085To089AziAng4 FLR2RdrDetn085To089Counter FLR2RdrDetn085To089CRC FLR2RdrDetn085To089DynPrpty0 FLR2RdrDetn085To089DynPrpty1 FLR2RdrDetn085To089DynPrpty2 FLR2RdrDetn085To089DynPrpty3 FLR2RdrDetn085To089DynPrpty4 FLR2RdrDetn085To089EleAng0 FLR2RdrDetn085To089EleAng1 FLR2RdrDetn085To089EleAng2 FLR2RdrDetn085To089EleAng3 FLR2RdrDetn085To089EleAng4 FLR2RdrDetn085To089Mode0 FLR2RdrDetn085To089Mode1 FLR2RdrDetn085To089Mode2 FLR2RdrDetn085To089Mode3 FLR2RdrDetn085To089Mode4 FLR2RdrDetn085To089Quality0 FLR2RdrDetn085To089Quality1 FLR2RdrDetn085To089Quality2 FLR2RdrDetn085To089Quality3 FLR2RdrDetn085To089Quality4 FLR2RdrDetn085To089Range0 FLR2RdrDetn085To089Range1 FLR2RdrDetn085To089Range2 FLR2RdrDetn085To089Range3 FLR2RdrDetn085To089Range4 FLR2RdrDetn085To089RCS0 FLR2RdrDetn085To089RCS1 FLR2RdrDetn085To089RCS2 FLR2RdrDetn085To089RCS3 FLR2RdrDetn085To089RCS4 FLR2RdrDetn085To089RngRt0 FLR2RdrDetn085To089RngRt1 FLR2RdrDetn085To089RngRt2 FLR2RdrDetn085To089RngRt3 FLR2RdrDetn085To089RngRt4 FLR2RdrDetn085To089ScanID FLR2RdrDetn085To089SNR0 FLR2RdrDetn085To089SNR1 FLR2RdrDetn085To089SNR2 FLR2RdrDetn085To089SNR3 FLR2RdrDetn085To089SNR4;
SIG_GROUP_ 140 FLR2RdrDetn090To094 1 : FLR2RdrDetn090To094AziAng0 FLR2RdrDetn090To094AziAng1 FLR2RdrDetn090To094AziAng2 FLR2RdrDetn090To094AziAng3 FLR2RdrDetn090To094AziAng4 FLR2RdrDetn090To094Counter FLR2RdrDetn090To094CRC FLR2RdrDetn090To094DynPrpty0 FLR2RdrDetn090To094DynPrpty1 FLR2RdrDetn090To094DynPrpty2 FLR2RdrDetn090To094DynPrpty3 FLR2RdrDetn090To094DynPrpty4 FLR2RdrDetn090To094EleAng0 FLR2RdrDetn090To094EleAng1 FLR2RdrDetn090To094EleAng2 FLR2RdrDetn090To094EleAng3 FLR2RdrDetn090To094EleAng4 FLR2RdrDetn090To094Mode0 FLR2RdrDetn090To094Mode1 FLR2RdrDetn090To094Mode2 FLR2RdrDetn090To094Mode3 FLR2RdrDetn090To094Mode4 FLR2RdrDetn090To094Quality0 FLR2RdrDetn090To094Quality1 FLR2RdrDetn090To094Quality2 FLR2RdrDetn090To094Quality3 FLR2RdrDetn090To094Quality4 FLR2RdrDetn090To094Range0 FLR2RdrDetn090To094Range1 FLR2RdrDetn090To094Range2 FLR2RdrDetn090To094Range3 FLR2RdrDetn090To094Range4 FLR2RdrDetn090To094RCS0 FLR2RdrDetn090To094RCS1 FLR2RdrDetn090To094RCS2 FLR2RdrDetn090To094RCS3 FLR2RdrDetn090To094RCS4 FLR2RdrDetn090To094RngRt0 FLR2RdrDetn090To094RngRt1 FLR2RdrDetn090To094RngRt2 FLR2RdrDetn090To094RngRt3 FLR2RdrDetn090To094RngRt4 FLR2RdrDetn090To094ScanID FLR2RdrDetn090To094SNR0 FLR2RdrDetn090To094SNR1 FLR2RdrDetn090To094SNR2 FLR2RdrDetn090To094SNR3 FLR2RdrDetn090To094SNR4;
SIG_GROUP_ 144 FLR2RdrDetn095To099 1 : FLR2RdrDetn095To099AziAng0 FLR2RdrDetn095To099AziAng1 FLR2RdrDetn095To099AziAng2 FLR2RdrDetn095To099AziAng3 FLR2RdrDetn095To099AziAng4 FLR2RdrDetn095To099Counter FLR2RdrDetn095To099CRC FLR2RdrDetn095To099DynPrpty0 FLR2RdrDetn095To099DynPrpty1 FLR2RdrDetn095To099DynPrpty2 FLR2RdrDetn095To099DynPrpty3 FLR2RdrDetn095To099DynPrpty4 FLR2RdrDetn095To099EleAng0 FLR2RdrDetn095To099EleAng1 FLR2RdrDetn095To099EleAng2 FLR2RdrDetn095To099EleAng3 FLR2RdrDetn095To099EleAng4 FLR2RdrDetn095To099Mode0 FLR2RdrDetn095To099Mode1 FLR2RdrDetn095To099Mode2 FLR2RdrDetn095To099Mode3 FLR2RdrDetn095To099Mode4 FLR2RdrDetn095To099Quality0 FLR2RdrDetn095To099Quality1 FLR2RdrDetn095To099Quality2 FLR2RdrDetn095To099Quality3 FLR2RdrDetn095To099Quality4 FLR2RdrDetn095To099Range0 FLR2RdrDetn095To099Range1 FLR2RdrDetn095To099Range2 FLR2RdrDetn095To099Range3 FLR2RdrDetn095To099Range4 FLR2RdrDetn095To099RCS0 FLR2RdrDetn095To099RCS1 FLR2RdrDetn095To099RCS2 FLR2RdrDetn095To099RCS3 FLR2RdrDetn095To099RCS4 FLR2RdrDetn095To099RngRt0 FLR2RdrDetn095To099RngRt1 FLR2RdrDetn095To099RngRt2 FLR2RdrDetn095To099RngRt3 FLR2RdrDetn095To099RngRt4 FLR2RdrDetn095To099ScanID FLR2RdrDetn095To099SNR0 FLR2RdrDetn095To099SNR1 FLR2RdrDetn095To099SNR2 FLR2RdrDetn095To099SNR3 FLR2RdrDetn095To099SNR4;
SIG_GROUP_ 147 FLR2RdrDetn100To104 1 : FLR2RdrDetn100To104AziAng0 FLR2RdrDetn100To104AziAng1 FLR2RdrDetn100To104AziAng2 FLR2RdrDetn100To104AziAng3 FLR2RdrDetn100To104AziAng4 FLR2RdrDetn100To104Counter FLR2RdrDetn100To104CRC FLR2RdrDetn100To104DynPrpty0 FLR2RdrDetn100To104DynPrpty1 FLR2RdrDetn100To104DynPrpty2 FLR2RdrDetn100To104DynPrpty3 FLR2RdrDetn100To104DynPrpty4 FLR2RdrDetn100To104EleAng0 FLR2RdrDetn100To104EleAng1 FLR2RdrDetn100To104EleAng2 FLR2RdrDetn100To104EleAng3 FLR2RdrDetn100To104EleAng4 FLR2RdrDetn100To104Mode0 FLR2RdrDetn100To104Mode1 FLR2RdrDetn100To104Mode2 FLR2RdrDetn100To104Mode3 FLR2RdrDetn100To104Mode4 FLR2RdrDetn100To104Quality0 FLR2RdrDetn100To104Quality1 FLR2RdrDetn100To104Quality2 FLR2RdrDetn100To104Quality3 FLR2RdrDetn100To104Quality4 FLR2RdrDetn100To104Range0 FLR2RdrDetn100To104Range1 FLR2RdrDetn100To104Range2 FLR2RdrDetn100To104Range3 FLR2RdrDetn100To104Range4 FLR2RdrDetn100To104RCS0 FLR2RdrDetn100To104RCS1 FLR2RdrDetn100To104RCS2 FLR2RdrDetn100To104RCS3 FLR2RdrDetn100To104RCS4 FLR2RdrDetn100To104RngRt0 FLR2RdrDetn100To104RngRt1 FLR2RdrDetn100To104RngRt2 FLR2RdrDetn100To104RngRt3 FLR2RdrDetn100To104RngRt4 FLR2RdrDetn100To104ScanID FLR2RdrDetn100To104SNR0 FLR2RdrDetn100To104SNR1 FLR2RdrDetn100To104SNR2 FLR2RdrDetn100To104SNR3 FLR2RdrDetn100To104SNR4;
SIG_GROUP_ 150 FLR2RdrDetn105To109 1 : FLR2RdrDetn105To109AziAng0 FLR2RdrDetn105To109AziAng1 FLR2RdrDetn105To109AziAng2 FLR2RdrDetn105To109AziAng3 FLR2RdrDetn105To109AziAng4 FLR2RdrDetn105To109Counter FLR2RdrDetn105To109CRC FLR2RdrDetn105To109DynPrpty0 FLR2RdrDetn105To109DynPrpty1 FLR2RdrDetn105To109DynPrpty2 FLR2RdrDetn105To109DynPrpty3 FLR2RdrDetn105To109DynPrpty4 FLR2RdrDetn105To109EleAng0 FLR2RdrDetn105To109EleAng1 FLR2RdrDetn105To109EleAng2 FLR2RdrDetn105To109EleAng3 FLR2RdrDetn105To109EleAng4 FLR2RdrDetn105To109Mode0 FLR2RdrDetn105To109Mode1 FLR2RdrDetn105To109Mode2 FLR2RdrDetn105To109Mode3 FLR2RdrDetn105To109Mode4 FLR2RdrDetn105To109Quality0 FLR2RdrDetn105To109Quality1 FLR2RdrDetn105To109Quality2 FLR2RdrDetn105To109Quality3 FLR2RdrDetn105To109Quality4 FLR2RdrDetn105To109Range0 FLR2RdrDetn105To109Range1 FLR2RdrDetn105To109Range2 FLR2RdrDetn105To109Range3 FLR2RdrDetn105To109Range4 FLR2RdrDetn105To109RCS0 FLR2RdrDetn105To109RCS1 FLR2RdrDetn105To109RCS2 FLR2RdrDetn105To109RCS3 FLR2RdrDetn105To109RCS4 FLR2RdrDetn105To109RngRt0 FLR2RdrDetn105To109RngRt1 FLR2RdrDetn105To109RngRt2 FLR2RdrDetn105To109RngRt3 FLR2RdrDetn105To109RngRt4 FLR2RdrDetn105To109ScanID FLR2RdrDetn105To109SNR0 FLR2RdrDetn105To109SNR1 FLR2RdrDetn105To109SNR2 FLR2RdrDetn105To109SNR3 FLR2RdrDetn105To109SNR4;
SIG_GROUP_ 153 FLR2RdrDetn110To114 1 : FLR2RdrDetn110To114AziAng0 FLR2RdrDetn110To114AziAng1 FLR2RdrDetn110To114AziAng2 FLR2RdrDetn110To114AziAng3 FLR2RdrDetn110To114AziAng4 FLR2RdrDetn110To114Counter FLR2RdrDetn110To114CRC FLR2RdrDetn110To114DynPrpty0 FLR2RdrDetn110To114DynPrpty1 FLR2RdrDetn110To114DynPrpty2 FLR2RdrDetn110To114DynPrpty3 FLR2RdrDetn110To114DynPrpty4 FLR2RdrDetn110To114EleAng0 FLR2RdrDetn110To114EleAng1 FLR2RdrDetn110To114EleAng2 FLR2RdrDetn110To114EleAng3 FLR2RdrDetn110To114EleAng4 FLR2RdrDetn110To114Mode0 FLR2RdrDetn110To114Mode1 FLR2RdrDetn110To114Mode2 FLR2RdrDetn110To114Mode3 FLR2RdrDetn110To114Mode4 FLR2RdrDetn110To114Quality0 FLR2RdrDetn110To114Quality1 FLR2RdrDetn110To114Quality2 FLR2RdrDetn110To114Quality3 FLR2RdrDetn110To114Quality4 FLR2RdrDetn110To114Range0 FLR2RdrDetn110To114Range1 FLR2RdrDetn110To114Range2 FLR2RdrDetn110To114Range3 FLR2RdrDetn110To114Range4 FLR2RdrDetn110To114RCS0 FLR2RdrDetn110To114RCS1 FLR2RdrDetn110To114RCS2 FLR2RdrDetn110To114RCS3 FLR2RdrDetn110To114RCS4 FLR2RdrDetn110To114RngRt0 FLR2RdrDetn110To114RngRt1 FLR2RdrDetn110To114RngRt2 FLR2RdrDetn110To114RngRt3 FLR2RdrDetn110To114RngRt4 FLR2RdrDetn110To114ScanID FLR2RdrDetn110To114SNR0 FLR2RdrDetn110To114SNR1 FLR2RdrDetn110To114SNR2 FLR2RdrDetn110To114SNR3 FLR2RdrDetn110To114SNR4;
SIG_GROUP_ 156 FLR2RdrDetn115To119 1 : FLR2RdrDetn115To119AziAng0 FLR2RdrDetn115To119AziAng1 FLR2RdrDetn115To119AziAng2 FLR2RdrDetn115To119AziAng3 FLR2RdrDetn115To119AziAng4 FLR2RdrDetn115To119Counter FLR2RdrDetn115To119CRC FLR2RdrDetn115To119DynPrpty0 FLR2RdrDetn115To119DynPrpty1 FLR2RdrDetn115To119DynPrpty2 FLR2RdrDetn115To119DynPrpty3 FLR2RdrDetn115To119DynPrpty4 FLR2RdrDetn115To119EleAng0 FLR2RdrDetn115To119EleAng1 FLR2RdrDetn115To119EleAng2 FLR2RdrDetn115To119EleAng3 FLR2RdrDetn115To119EleAng4 FLR2RdrDetn115To119Mode0 FLR2RdrDetn115To119Mode1 FLR2RdrDetn115To119Mode2 FLR2RdrDetn115To119Mode3 FLR2RdrDetn115To119Mode4 FLR2RdrDetn115To119Quality0 FLR2RdrDetn115To119Quality1 FLR2RdrDetn115To119Quality2 FLR2RdrDetn115To119Quality3 FLR2RdrDetn115To119Quality4 FLR2RdrDetn115To119Range0 FLR2RdrDetn115To119Range1 FLR2RdrDetn115To119Range2 FLR2RdrDetn115To119Range3 FLR2RdrDetn115To119Range4 FLR2RdrDetn115To119RCS0 FLR2RdrDetn115To119RCS1 FLR2RdrDetn115To119RCS2 FLR2RdrDetn115To119RCS3 FLR2RdrDetn115To119RCS4 FLR2RdrDetn115To119RngRt0 FLR2RdrDetn115To119RngRt1 FLR2RdrDetn115To119RngRt2 FLR2RdrDetn115To119RngRt3 FLR2RdrDetn115To119RngRt4 FLR2RdrDetn115To119ScanID FLR2RdrDetn115To119SNR0 FLR2RdrDetn115To119SNR1 FLR2RdrDetn115To119SNR2 FLR2RdrDetn115To119SNR3 FLR2RdrDetn115To119SNR4;
SIG_GROUP_ 160 FLR2RdrDetn120To124 1 : FLR2RdrDetn120To124AziAng0 FLR2RdrDetn120To124AziAng1 FLR2RdrDetn120To124AziAng2 FLR2RdrDetn120To124AziAng3 FLR2RdrDetn120To124AziAng4 FLR2RdrDetn120To124Counter FLR2RdrDetn120To124CRC FLR2RdrDetn120To124DynPrpty0 FLR2RdrDetn120To124DynPrpty1 FLR2RdrDetn120To124DynPrpty2 FLR2RdrDetn120To124DynPrpty3 FLR2RdrDetn120To124DynPrpty4 FLR2RdrDetn120To124EleAng0 FLR2RdrDetn120To124EleAng1 FLR2RdrDetn120To124EleAng2 FLR2RdrDetn120To124EleAng3 FLR2RdrDetn120To124EleAng4 FLR2RdrDetn120To124Mode0 FLR2RdrDetn120To124Mode1 FLR2RdrDetn120To124Mode2 FLR2RdrDetn120To124Mode3 FLR2RdrDetn120To124Mode4 FLR2RdrDetn120To124Quality0 FLR2RdrDetn120To124Quality1 FLR2RdrDetn120To124Quality2 FLR2RdrDetn120To124Quality3 FLR2RdrDetn120To124Quality4 FLR2RdrDetn120To124Range0 FLR2RdrDetn120To124Range1 FLR2RdrDetn120To124Range2 FLR2RdrDetn120To124Range3 FLR2RdrDetn120To124Range4 FLR2RdrDetn120To124RCS0 FLR2RdrDetn120To124RCS1 FLR2RdrDetn120To124RCS2 FLR2RdrDetn120To124RCS3 FLR2RdrDetn120To124RCS4 FLR2RdrDetn120To124RngRt0 FLR2RdrDetn120To124RngRt1 FLR2RdrDetn120To124RngRt2 FLR2RdrDetn120To124RngRt3 FLR2RdrDetn120To124RngRt4 FLR2RdrDetn120To124ScanID FLR2RdrDetn120To124SNR0 FLR2RdrDetn120To124SNR1 FLR2RdrDetn120To124SNR2 FLR2RdrDetn120To124SNR3 FLR2RdrDetn120To124SNR4;
SIG_GROUP_ 163 FLR2RdrDetn125To129 1 : FLR2RdrDetn125To129AziAng0 FLR2RdrDetn125To129AziAng1 FLR2RdrDetn125To129AziAng2 FLR2RdrDetn125To129AziAng3 FLR2RdrDetn125To129AziAng4 FLR2RdrDetn125To129Counter FLR2RdrDetn125To129CRC FLR2RdrDetn125To129DynPrpty0 FLR2RdrDetn125To129DynPrpty1 FLR2RdrDetn125To129DynPrpty2 FLR2RdrDetn125To129DynPrpty3 FLR2RdrDetn125To129DynPrpty4 FLR2RdrDetn125To129EleAng0 FLR2RdrDetn125To129EleAng1 FLR2RdrDetn125To129EleAng2 FLR2RdrDetn125To129EleAng3 FLR2RdrDetn125To129EleAng4 FLR2RdrDetn125To129Mode0 FLR2RdrDetn125To129Mode1 FLR2RdrDetn125To129Mode2 FLR2RdrDetn125To129Mode3 FLR2RdrDetn125To129Mode4 FLR2RdrDetn125To129Quality0 FLR2RdrDetn125To129Quality1 FLR2RdrDetn125To129Quality2 FLR2RdrDetn125To129Quality3 FLR2RdrDetn125To129Quality4 FLR2RdrDetn125To129Range0 FLR2RdrDetn125To129Range1 FLR2RdrDetn125To129Range2 FLR2RdrDetn125To129Range3 FLR2RdrDetn125To129Range4 FLR2RdrDetn125To129RCS0 FLR2RdrDetn125To129RCS1 FLR2RdrDetn125To129RCS2 FLR2RdrDetn125To129RCS3 FLR2RdrDetn125To129RCS4 FLR2RdrDetn125To129RngRt0 FLR2RdrDetn125To129RngRt1 FLR2RdrDetn125To129RngRt2 FLR2RdrDetn125To129RngRt3 FLR2RdrDetn125To129RngRt4 FLR2RdrDetn125To129ScanID FLR2RdrDetn125To129SNR0 FLR2RdrDetn125To129SNR1 FLR2RdrDetn125To129SNR2 FLR2RdrDetn125To129SNR3 FLR2RdrDetn125To129SNR4;
